[part 8 of 24: package /InitialEcuC]
AUTOSAR XML (schema 00053)
package /InitialEcuC  (continued)
  module config Com  (continued)
    ComConfig  (continued)
      242 x ComSignalGroup, all with ComTransferProperty=PENDING:  (continued)
        SG_Detections_109_112_oRDR_DETECTION_109_112_oPCAN_RADAR_7559a730_Tx: ComSystemTemplateSignalGroupRef=SG_Detections_109_112
          83 x ComGroupSignal, all with ComSignalEndianness=LITTLE_ENDIAN, ComTransferProperty=PENDING:
            DET_AZIMUTH_109_oRDR_DETECTION_109_112_oPCAN_RADAR_8c56a30e_Tx: ComBitPosition=88, ComBitSize=13, ComSignalInitValue=0, ComSignalType=UINT16, ComSystemTemplateSystemSignalRef=DET_AZIMUTH_109
            DET_AZIMUTH_110_oRDR_DETECTION_109_112_oPCAN_RADAR_e976d1aa_Tx: ComBitPosition=200, ComBitSize=13, ComSignalInitValue=0, ComSignalType=UINT16, ComSystemTemplateSystemSignalRef=DET_AZIMUTH_110
            DET_AZIMUTH_111_oRDR_DETECTION_109_112_oPCAN_RADAR_7c06053f_Tx: ComBitPosition=312, ComBitSize=13, ComSignalInitValue=0, ComSignalType=UINT16, ComSystemTemplateSystemSignalRef=DET_AZIMUTH_111
            DET_AZIMUTH_112_oRDR_DETECTION_109_112_oPCAN_RADAR_18e67ec1_Tx: ComBitPosition=424, ComBitSize=13, ComSignalInitValue=0, ComSignalType=UINT16, ComSystemTemplateSystemSignalRef=DET_AZIMUTH_112
            DET_AZIMUTH_ERR_109_oRDR_DETECTION_109_112_oPCAN_RADAR_28e336fb_Tx: ComBitPosition=105, ComBitSize=7, ComSignalInitValue=0, ComSignalType=UINT8, ComSystemTemplateSystemSignalRef=DET_AZIMUTH_ERR_109
            DET_AZIMUTH_ERR_110_oRDR_DETECTION_109_112_oPCAN_RADAR_4dc3445f_Tx: ComBitPosition=217, ComBitSize=7, ComSignalInitValue=0, ComSignalType=UINT8, ComSystemTemplateSystemSignalRef=DET_AZIMUTH_ERR_110
            DET_AZIMUTH_ERR_111_oRDR_DETECTION_109_112_oPCAN_RADAR_d8b390ca_Tx: ComBitPosition=329, ComBitSize=7, ComSignalInitValue=0, ComSignalType=UINT8, ComSystemTemplateSystemSignalRef=DET_AZIMUTH_ERR_111
            DET_AZIMUTH_ERR_112_oRDR_DETECTION_109_112_oPCAN_RADAR_bc53eb34_Tx: ComBitPosition=441, ComBitSize=7, ComSignalInitValue=0, ComSignalType=UINT8, ComSystemTemplateSystemSignalRef=DET_AZIMUTH_ERR_112
            DET_BELOW_RAIN_THOLD_109_oRDR_DETECTION_109_112_oPCAN_RADAR_595730ce_Tx: ComBitPosition=39, ComBitSize=1, ComSignalInitValue=0, ComSignalType=BOOLEAN, ComSystemTemplateSystemSignalRef=DET_BELOW_RAIN_THOLD_109
            DET_BELOW_RAIN_THOLD_110_oRDR_DETECTION_109_112_oPCAN_RADAR_3c77426a_Tx: ComBitPosition=151, ComBitSize=1, ComSignalInitValue=0, ComSignalType=BOOLEAN, ComSystemTemplateSystemSignalRef=DET_BELOW_RAIN_THOLD_110
            DET_BELOW_RAIN_THOLD_111_oRDR_DETECTION_109_112_oPCAN_RADAR_a90796ff_Tx: ComBitPosition=263, ComBitSize=1, ComSignalInitValue=0, ComSignalType=BOOLEAN, ComSystemTemplateSystemSignalRef=DET_BELOW_RAIN_THOLD_111
            DET_BELOW_RAIN_THOLD_112_oRDR_DETECTION_109_112_oPCAN_RADAR_cde7ed01_Tx: ComBitPosition=375, ComBitSize=1, ComSignalInitValue=0, ComSignalType=BOOLEAN, ComSystemTemplateSystemSignalRef=DET_BELOW_RAIN_THOLD_112
            DET_BI_STATIC_FLAG_109_oRDR_DETECTION_109_112_oPCAN_RADAR_da7ae38b_Tx: ComBitPosition=104, ComBitSize=1, ComSignalInitValue=0, ComSignalType=BOOLEAN, ComSystemTemplateSystemSignalRef=DET_BI_STATIC_FLAG_109
            DET_BI_STATIC_FLAG_110_oRDR_DETECTION_109_112_oPCAN_RADAR_bf5a912f_Tx: ComBitPosition=216, ComBitSize=1, ComSignalInitValue=0, ComSignalType=BOOLEAN, ComSystemTemplateSystemSignalRef=DET_BI_STATIC_FLAG_110
            DET_BI_STATIC_FLAG_111_oRDR_DETECTION_109_112_oPCAN_RADAR_2a2a45ba_Tx: ComBitPosition=328, ComBitSize=1, ComSignalInitValue=0, ComSignalType=BOOLEAN, ComSystemTemplateSystemSignalRef=DET_BI_STATIC_FLAG_111
            DET_BI_STATIC_FLAG_112_oRDR_DETECTION_109_112_oPCAN_RADAR_4eca3e44_Tx: ComBitPosition=440, ComBitSize=1, ComSignalInitValue=0, ComSignalType=BOOLEAN, ComSystemTemplateSystemSignalRef=DET_BI_STATIC_FLAG_112
            DET_CONFD_AZIMUTH_109_oRDR_DETECTION_109_112_oPCAN_RADAR_8eb0a9c4_Tx: ComBitPosition=118, ComBitSize=2, ComSignalInitValue=0, ComSignalType=UINT8, ComSystemTemplateSystemSignalRef=DET_CONFD_AZIMUTH_109
            DET_CONFD_AZIMUTH_110_oRDR_DETECTION_109_112_oPCAN_RADAR_eb90db60_Tx: ComBitPosition=230, ComBitSize=2, ComSignalInitValue=0, ComSignalType=UINT8, ComSystemTemplateSystemSignalRef=DET_CONFD_AZIMUTH_110
            DET_CONFD_AZIMUTH_111_oRDR_DETECTION_109_112_oPCAN_RADAR_7ee00ff5_Tx: ComBitPosition=342, ComBitSize=2, ComSignalInitValue=0, ComSignalType=UINT8, ComSystemTemplateSystemSignalRef=DET_CONFD_AZIMUTH_111
            DET_CONFD_AZIMUTH_112_oRDR_DETECTION_109_112_oPCAN_RADAR_1a00740b_Tx: ComBitPosition=454, ComBitSize=2, ComSignalInitValue=0, ComSignalType=UINT8, ComSystemTemplateSystemSignalRef=DET_CONFD_AZIMUTH_112
            DET_CONFD_ELEVATION_109_oRDR_DETECTION_109_112_oPCAN_RADAR_8c25a83e_Tx: ComBitPosition=101, ComBitSize=2, ComSignalInitValue=0, ComSignalType=UINT8, ComSystemTemplateSystemSignalRef=DET_CONFD_ELEVATION_109
            DET_CONFD_ELEVATION_110_oRDR_DETECTION_109_112_oPCAN_RADAR_e905da9a_Tx: ComBitPosition=213, ComBitSize=2, ComSignalInitValue=0, ComSignalType=UINT8, ComSystemTemplateSystemSignalRef=DET_CONFD_ELEVATION_110
            DET_CONFD_ELEVATION_111_oRDR_DETECTION_109_112_oPCAN_RADAR_7c750e0f_Tx: ComBitPosition=325, ComBitSize=2, ComSignalInitValue=0, ComSignalType=UINT8, ComSystemTemplateSystemSignalRef=DET_CONFD_ELEVATION_111
            DET_CONFD_ELEVATION_112_oRDR_DETECTION_109_112_oPCAN_RADAR_189575f1_Tx: ComBitPosition=437, ComBitSize=2, ComSignalInitValue=0, ComSignalType=UINT8, ComSystemTemplateSystemSignalRef=DET_CONFD_ELEVATION_112
            DET_ELEVATION_109_oRDR_DETECTION_109_112_oPCAN_RADAR_5de57c02_Tx: ComBitPosition=72, ComBitSize=8, ComSignalInitValue=0, ComSignalType=UINT8, ComSystemTemplateSystemSignalRef=DET_ELEVATION_109
            DET_ELEVATION_110_oRDR_DETECTION_109_112_oPCAN_RADAR_38c50ea6_Tx: ComBitPosition=184, ComBitSize=8, ComSignalInitValue=0, ComSignalType=UINT8, ComSystemTemplateSystemSignalRef=DET_ELEVATION_110
            DET_ELEVATION_111_oRDR_DETECTION_109_112_oPCAN_RADAR_adb5da33_Tx: ComBitPosition=296, ComBitSize=8, ComSignalInitValue=0, ComSignalType=UINT8, ComSystemTemplateSystemSignalRef=DET_ELEVATION_111
            DET_ELEVATION_112_oRDR_DETECTION_109_112_oPCAN_RADAR_c955a1cd_Tx: ComBitPosition=408, ComBitSize=8, ComSignalInitValue=0, ComSignalType=UINT8, ComSystemTemplateSystemSignalRef=DET_ELEVATION_112
            DET_ELEVATION_ERR_109_oRDR_DETECTION_109_112_oPCAN_RADAR_dadce477_Tx: ComBitPosition=80, ComBitSize=6, ComSignalInitValue=0, ComSignalType=UINT8, ComSystemTemplateSystemSignalRef=DET_ELEVATION_ERR_109
            DET_ELEVATION_ERR_110_oRDR_DETECTION_109_112_oPCAN_RADAR_bffc96d3_Tx: ComBitPosition=192, ComBitSize=6, ComSignalInitValue=0, ComSignalType=UINT8, ComSystemTemplateSystemSignalRef=DET_ELEVATION_ERR_110
            DET_ELEVATION_ERR_111_oRDR_DETECTION_109_112_oPCAN_RADAR_2a8c4246_Tx: ComBitPosition=304, ComBitSize=6, ComSignalInitValue=0, ComSignalType=UINT8, ComSystemTemplateSystemSignalRef=DET_ELEVATION_ERR_111
            DET_ELEVATION_ERR_112_oRDR_DETECTION_109_112_oPCAN_RADAR_4e6c39b8_Tx: ComBitPosition=416, ComBitSize=6, ComSignalInitValue=0, ComSignalType=UINT8, ComSystemTemplateSystemSignalRef=DET_ELEVATION_ERR_112
            DET_EXISTENCE_PROB_109_oRDR_DETECTION_109_112_oPCAN_RADAR_08439117_Tx: ComBitPosition=112, ComBitSize=6, ComSignalInitValue=0, ComSignalType=UINT8, ComSystemTemplateSystemSignalRef=DET_EXISTENCE_PROB_109
            DET_EXISTENCE_PROB_110_oRDR_DETECTION_109_112_oPCAN_RADAR_6d63e3b3_Tx: ComBitPosition=224, ComBitSize=6, ComSignalInitValue=0, ComSignalType=UINT8, ComSystemTemplateSystemSignalRef=DET_EXISTENCE_PROB_110
            DET_EXISTENCE_PROB_111_oRDR_DETECTION_109_112_oPCAN_RADAR_f8133726_Tx: ComBitPosition=336, ComBitSize=6, ComSignalInitValue=0, ComSignalType=UINT8, ComSystemTemplateSystemSignalRef=DET_EXISTENCE_PROB_111
            DET_EXISTENCE_PROB_112_oRDR_DETECTION_109_112_oPCAN_RADAR_9cf34cd8_Tx: ComBitPosition=448, ComBitSize=6, ComSignalInitValue=0, ComSignalType=UINT8, ComSystemTemplateSystemSignalRef=DET_EXISTENCE_PROB_112
            DET_HVC_FLAG_109_oRDR_DETECTION_109_112_oPCAN_RADAR_e937d268_Tx: ComBitPosition=86, ComBitSize=1, ComSignalInitValue=0, ComSignalType=BOOLEAN, ComSystemTemplateSystemSignalRef=DET_HVC_FLAG_109
            DET_HVC_FLAG_110_oRDR_DETECTION_109_112_oPCAN_RADAR_8c17a0cc_Tx: ComBitPosition=198, ComBitSize=1, ComSignalInitValue=0, ComSignalType=BOOLEAN, ComSystemTemplateSystemSignalRef=DET_HVC_FLAG_110
            DET_HVC_FLAG_111_oRDR_DETECTION_109_112_oPCAN_RADAR_19677459_Tx: ComBitPosition=310, ComBitSize=1, ComSignalInitValue=0, ComSignalType=BOOLEAN, ComSystemTemplateSystemSignalRef=DET_HVC_FLAG_111
            DET_HVC_FLAG_112_oRDR_DETECTION_109_112_oPCAN_RADAR_7d870fa7_Tx: ComBitPosition=422, ComBitSize=1, ComSignalInitValue=0, ComSignalType=BOOLEAN, ComSystemTemplateSystemSignalRef=DET_HVC_FLAG_112
            DET_IDM_109_oRDR_DETECTION_109_112_oPCAN_RADAR_6265e9d5_Tx: ComBitPosition=63, ComBitSize=1, ComSignalInitValue=0, ComSignalType=BOOLEAN, ComSystemTemplateSystemSignalRef=DET_IDM_109
            DET_IDM_110_oRDR_DETECTION_109_112_oPCAN_RADAR_07459b71_Tx: ComBitPosition=175, ComBitSize=1, ComSignalInitValue=0, ComSignalType=BOOLEAN, ComSystemTemplateSystemSignalRef=DET_IDM_110
            DET_IDM_111_oRDR_DETECTION_109_112_oPCAN_RADAR_92354fe4_Tx: ComBitPosition=287, ComBitSize=1, ComSignalInitValue=0, ComSignalType=BOOLEAN, ComSystemTemplateSystemSignalRef=DET_IDM_111
            DET_IDM_112_oRDR_DETECTION_109_112_oPCAN_RADAR_f6d5341a_Tx: ComBitPosition=399, ComBitSize=1, ComSignalInitValue=0, ComSignalType=BOOLEAN, ComSystemTemplateSystemSignalRef=DET_IDM_112
            DET_MH_CRC16_109_112_oRDR_DETECTION_109_112_oPCAN_RADAR_f1d1753b_Tx: ComBitPosition=0, ComBitSize=16, ComSignalInitValue=0, ComSignalType=UINT16, ComSystemTemplateSystemSignalRef=DET_MH_CRC16_109_112
            DET_MH_CYCLE_COUNTER_109_112_oRDR_DETECTION_109_112_oPCAN_RADAR_75a4d40c_Tx: ComBitPosition=16, ComBitSize=8, ComSignalInitValue=0, ComSignalType=UINT8, ComSystemTemplateSystemSignalRef=DET_MH_CYCLE_COUNTER_109_112
            DET_MH_SCAN_INDEX_4LSB_109_112_oRDR_DETECTION_109_112_oPCAN_RADAR_b98ef180_Tx: ComBitPosition=476, ComBitSize=4, ComSignalInitValue=0, ComSignalType=UINT8, ComSystemTemplateSystemSignalRef=DET_MH_SCAN_INDEX_4LSB_109_112
            DET_MTD_109_oRDR_DETECTION_109_112_oPCAN_RADAR_04d6db0e_Tx: ComBitPosition=47, ComBitSize=1, ComSignalInitValue=0, ComSignalType=BOOLEAN, ComSystemTemplateSystemSignalRef=DET_MTD_109
            DET_MTD_110_oRDR_DETECTION_109_112_oPCAN_RADAR_61f6a9aa_Tx: ComBitPosition=159, ComBitSize=1, ComSignalInitValue=0, ComSignalType=BOOLEAN, ComSystemTemplateSystemSignalRef=DET_MTD_110
            DET_MTD_111_oRDR_DETECTION_109_112_oPCAN_RADAR_f4867d3f_Tx: ComBitPosition=271, ComBitSize=1, ComSignalInitValue=0, ComSignalType=BOOLEAN, ComSystemTemplateSystemSignalRef=DET_MTD_111
            DET_MTD_112_oRDR_DETECTION_109_112_oPCAN_RADAR_906606c1_Tx: ComBitPosition=383, ComBitSize=1, ComSignalInitValue=0, ComSignalType=BOOLEAN, ComSystemTemplateSystemSignalRef=DET_MTD_112
            DET_PROB_1STAZHYPO_109_oRDR_DETECTION_109_112_oPCAN_RADAR_976233c3_Tx: ComBitPosition=103, ComBitSize=1, ComSignalInitValue=0, ComSignalType=BOOLEAN, ComSystemTemplateSystemSignalRef=DET_PROB_1STAZHYPO_109
            DET_PROB_1STAZHYPO_110_oRDR_DETECTION_109_112_oPCAN_RADAR_f2424167_Tx: ComBitPosition=215, ComBitSize=1, ComSignalInitValue=0, ComSignalType=BOOLEAN, ComSystemTemplateSystemSignalRef=DET_PROB_1STAZHYPO_110
            DET_PROB_1STAZHYPO_111_oRDR_DETECTION_109_112_oPCAN_RADAR_673295f2_Tx: ComBitPosition=327, ComBitSize=1, ComSignalInitValue=0, ComSignalType=BOOLEAN, ComSystemTemplateSystemSignalRef=DET_PROB_1STAZHYPO_111
            DET_PROB_1STAZHYPO_112_oRDR_DETECTION_109_112_oPCAN_RADAR_03d2ee0c_Tx: ComBitPosition=439, ComBitSize=1, ComSignalInitValue=0, ComSignalType=BOOLEAN, ComSystemTemplateSystemSignalRef=DET_PROB_1STAZHYPO_112
            DET_RANGE_109_oRDR_DETECTION_109_112_oPCAN_RADAR_9ccdd0b5_Tx: ComBitPosition=24, ComBitSize=15, ComSignalInitValue=0, ComSignalType=UINT16, ComSystemTemplateSystemSignalRef=DET_RANGE_109
            DET_RANGE_110_oRDR_DETECTION_109_112_oPCAN_RADAR_f9eda211_Tx: ComBitPosition=136, ComBitSize=15, ComSignalInitValue=0, ComSignalType=UINT16, ComSystemTemplateSystemSignalRef=DET_RANGE_110
            DET_RANGE_111_oRDR_DETECTION_109_112_oPCAN_RADAR_6c9d7684_Tx: ComBitPosition=248, ComBitSize=15, ComSignalInitValue=0, ComSignalType=UINT16, ComSystemTemplateSystemSignalRef=DET_RANGE_111
            DET_RANGE_112_oRDR_DETECTION_109_112_oPCAN_RADAR_087d0d7a_Tx: ComBitPosition=360, ComBitSize=15, ComSignalInitValue=0, ComSignalType=UINT16, ComSystemTemplateSystemSignalRef=DET_RANGE_112
            DET_RANGE_ERR_109_oRDR_DETECTION_109_112_oPCAN_RADAR_3b256adc_Tx: ComBitPosition=40, ComBitSize=7, ComSignalInitValue=0, ComSignalType=UINT8, ComSystemTemplateSystemSignalRef=DET_RANGE_ERR_109
            DET_RANGE_ERR_110_oRDR_DETECTION_109_112_oPCAN_RADAR_5e051878_Tx: ComBitPosition=152, ComBitSize=7, ComSignalInitValue=0, ComSignalType=UINT8, ComSystemTemplateSystemSignalRef=DET_RANGE_ERR_110
            DET_RANGE_ERR_111_oRDR_DETECTION_109_112_oPCAN_RADAR_cb75cced_Tx: ComBitPosition=264, ComBitSize=7, ComSignalInitValue=0, ComSignalType=UINT8, ComSystemTemplateSystemSignalRef=DET_RANGE_ERR_111
            DET_RANGE_ERR_112_oRDR_DETECTION_109_112_oPCAN_RADAR_af95b713_Tx: ComBitPosition=376, ComBitSize=7, ComSignalInitValue=0, ComSignalType=UINT8, ComSystemTemplateSystemSignalRef=DET_RANGE_ERR_112
            DET_RANGE_VELOCITY_109_oRDR_DETECTION_109_112_oPCAN_RADAR_e96b1290_Tx: ComBitPosition=48, ComBitSize=15, ComSignalInitValue=16384, ComSignalType=UINT16, ComSystemTemplateSystemSignalRef=DET_RANGE_VELOCITY_109
            DET_RANGE_VELOCITY_110_oRDR_DETECTION_109_112_oPCAN_RADAR_8c4b6034_Tx: ComBitPosition=160, ComBitSize=15, ComSignalInitValue=16384, ComSignalType=UINT16, ComSystemTemplateSystemSignalRef=DET_RANGE_VELOCITY_110
            DET_RANGE_VELOCITY_111_oRDR_DETECTION_109_112_oPCAN_RADAR_193bb4a1_Tx: ComBitPosition=272, ComBitSize=15, ComSignalInitValue=16384, ComSignalType=UINT16, ComSystemTemplateSystemSignalRef=DET_RANGE_VELOCITY_111
            DET_RANGE_VELOCITY_112_oRDR_DETECTION_109_112_oPCAN_RADAR_7ddbcf5f_Tx: ComBitPosition=384, ComBitSize=15, ComSignalInitValue=16384, ComSignalType=UINT16, ComSystemTemplateSystemSignalRef=DET_RANGE_VELOCITY_112
            DET_RANGE_VELOCITY_ERR_109_oRDR_DETECTION_109_112_oPCAN_RADAR_e6d0e922_Tx: ComBitPosition=64, ComBitSize=8, ComSignalInitValue=0, ComSignalType=UINT8, ComSystemTemplateSystemSignalRef=DET_RANGE_VELOCITY_ERR_109
            DET_RANGE_VELOCITY_ERR_110_oRDR_DETECTION_109_112_oPCAN_RADAR_83f09b86_Tx: ComBitPosition=176, ComBitSize=8, ComSignalInitValue=0, ComSignalType=UINT8, ComSystemTemplateSystemSignalRef=DET_RANGE_VELOCITY_ERR_110
            DET_RANGE_VELOCITY_ERR_111_oRDR_DETECTION_109_112_oPCAN_RADAR_16804f13_Tx: ComBitPosition=288, ComBitSize=8, ComSignalInitValue=0, ComSignalType=UINT8, ComSystemTemplateSystemSignalRef=DET_RANGE_VELOCITY_ERR_111
            DET_RANGE_VELOCITY_ERR_112_oRDR_DETECTION_109_112_oPCAN_RADAR_726034ed_Tx: ComBitPosition=400, ComBitSize=8, ComSignalInitValue=0, ComSignalType=UINT8, ComSystemTemplateSystemSignalRef=DET_RANGE_VELOCITY_ERR_112
            DET_RCS_109_oRDR_DETECTION_109_112_oPCAN_RADAR_6eeb25ca_Tx: ComBitPosition=128, ComBitSize=8, ComSignalInitValue=128, ComSignalType=UINT8, ComSystemTemplateSystemSignalRef=DET_RCS_109
            DET_RCS_110_oRDR_DETECTION_109_112_oPCAN_RADAR_0bcb576e_Tx: ComBitPosition=240, ComBitSize=8, ComSignalInitValue=128, ComSignalType=UINT8, ComSystemTemplateSystemSignalRef=DET_RCS_110
            DET_RCS_111_oRDR_DETECTION_109_112_oPCAN_RADAR_9ebb83fb_Tx: ComBitPosition=352, ComBitSize=8, ComSignalInitValue=128, ComSignalType=UINT8, ComSystemTemplateSystemSignalRef=DET_RCS_111
            DET_RCS_112_oRDR_DETECTION_109_112_oPCAN_RADAR_fa5bf805_Tx: ComBitPosition=464, ComBitSize=8, ComSignalInitValue=128, ComSignalType=UINT8, ComSystemTemplateSystemSignalRef=DET_RCS_112
            DET_SNR_109_oRDR_DETECTION_109_112_oPCAN_RADAR_b34571c8_Tx: ComBitPosition=120, ComBitSize=8, ComSignalInitValue=0, ComSignalType=UINT8, ComSystemTemplateSystemSignalRef=DET_SNR_109
            DET_SNR_110_oRDR_DETECTION_109_112_oPCAN_RADAR_d665036c_Tx: ComBitPosition=232, ComBitSize=8, ComSignalInitValue=0, ComSignalType=UINT8, ComSystemTemplateSystemSignalRef=DET_SNR_110
            DET_SNR_111_oRDR_DETECTION_109_112_oPCAN_RADAR_4315d7f9_Tx: ComBitPosition=344, ComBitSize=8, ComSignalInitValue=0, ComSignalType=UINT8, ComSystemTemplateSystemSignalRef=DET_SNR_111
            DET_SNR_112_oRDR_DETECTION_109_112_oPCAN_RADAR_27f5ac07_Tx: ComBitPosition=456, ComBitSize=8, ComSignalInitValue=0, ComSignalType=UINT8, ComSystemTemplateSystemSignalRef=DET_SNR_112
            DET_SUPER_RES_TARGET_109_oRDR_DETECTION_109_112_oPCAN_RADAR_82dc59ad_Tx: ComBitPosition=87, ComBitSize=1, ComSignalInitValue=0, ComSignalType=BOOLEAN, ComSystemTemplateSystemSignalRef=DET_SUPER_RES_TARGET_109
            DET_SUPER_RES_TARGET_110_oRDR_DETECTION_109_112_oPCAN_RADAR_e7fc2b09_Tx: ComBitPosition=199, ComBitSize=1, ComSignalInitValue=0, ComSignalType=BOOLEAN, ComSystemTemplateSystemSignalRef=DET_SUPER_RES_TARGET_110
            DET_SUPER_RES_TARGET_111_oRDR_DETECTION_109_112_oPCAN_RADAR_728cff9c_Tx: ComBitPosition=311, ComBitSize=1, ComSignalInitValue=0, ComSignalType=BOOLEAN, ComSystemTemplateSystemSignalRef=DET_SUPER_RES_TARGET_111
            DET_SUPER_RES_TARGET_112_oRDR_DETECTION_109_112_oPCAN_RADAR_166c8462_Tx: ComBitPosition=423, ComBitSize=1, ComSignalInitValue=0, ComSignalType=BOOLEAN, ComSystemTemplateSystemSignalRef=DET_SUPER_RES_TARGET_112
        SG_Detections_113_116_oRDR_DETECTION_113_116_oPCAN_RADAR_4752cf18_Tx: ComSystemTemplateSignalGroupRef=SG_Detections_113_116
          83 x ComGroupSignal, all with ComSignalEndianness=LITTLE_ENDIAN, ComTransferProperty=PENDING:
            DET_AZIMUTH_113_oRDR_DETECTION_113_116_oPCAN_RADAR_9051a97a_Tx: ComBitPosition=88, ComBitSize=13, ComSignalInitValue=0, ComSignalType=UINT16, ComSystemTemplateSystemSignalRef=DET_AZIMUTH_113
            DET_AZIMUTH_114_oRDR_DETECTION_113_116_oPCAN_RADAR_cce18a13_Tx: ComBitPosition=200, ComBitSize=13, ComSignalInitValue=0, ComSignalType=UINT16, ComSystemTemplateSystemSignalRef=DET_AZIMUTH_114
            DET_AZIMUTH_115_oRDR_DETECTION_113_116_oPCAN_RADAR_59915e86_Tx: ComBitPosition=312, ComBitSize=13, ComSignalInitValue=0, ComSignalType=UINT16, ComSystemTemplateSystemSignalRef=DET_AZIMUTH_115
            DET_AZIMUTH_116_oRDR_DETECTION_113_116_oPCAN_RADAR_3d712578_Tx: ComBitPosition=424, ComBitSize=13, ComSignalInitValue=0, ComSignalType=UINT16, ComSystemTemplateSystemSignalRef=DET_AZIMUTH_116
            DET_AZIMUTH_ERR_113_oRDR_DETECTION_113_116_oPCAN_RADAR_34e43c8f_Tx: ComBitPosition=105, ComBitSize=7, ComSignalInitValue=0, ComSignalType=UINT8, ComSystemTemplateSystemSignalRef=DET_AZIMUTH_ERR_113
            DET_AZIMUTH_ERR_114_oRDR_DETECTION_113_116_oPCAN_RADAR_68541fe6_Tx: ComBitPosition=217, ComBitSize=7, ComSignalInitValue=0, ComSignalType=UINT8, ComSystemTemplateSystemSignalRef=DET_AZIMUTH_ERR_114
            DET_AZIMUTH_ERR_115_oRDR_DETECTION_113_116_oPCAN_RADAR_fd24cb73_Tx: ComBitPosition=329, ComBitSize=7, ComSignalInitValue=0, ComSignalType=UINT8, ComSystemTemplateSystemSignalRef=DET_AZIMUTH_ERR_115
            DET_AZIMUTH_ERR_116_oRDR_DETECTION_113_116_oPCAN_RADAR_99c4b08d_Tx: ComBitPosition=441, ComBitSize=7, ComSignalInitValue=0, ComSignalType=UINT8, ComSystemTemplateSystemSignalRef=DET_AZIMUTH_ERR_116
            DET_BELOW_RAIN_THOLD_113_oRDR_DETECTION_113_116_oPCAN_RADAR_45503aba_Tx: ComBitPosition=39, ComBitSize=1, ComSignalInitValue=0, ComSignalType=BOOLEAN, ComSystemTemplateSystemSignalRef=DET_BELOW_RAIN_THOLD_113
            DET_BELOW_RAIN_THOLD_114_oRDR_DETECTION_113_116_oPCAN_RADAR_19e019d3_Tx: ComBitPosition=151, ComBitSize=1, ComSignalInitValue=0, ComSignalType=BOOLEAN, ComSystemTemplateSystemSignalRef=DET_BELOW_RAIN_THOLD_114
            DET_BELOW_RAIN_THOLD_115_oRDR_DETECTION_113_116_oPCAN_RADAR_8c90cd46_Tx: ComBitPosition=263, ComBitSize=1, ComSignalInitValue=0, ComSignalType=BOOLEAN, ComSystemTemplateSystemSignalRef=DET_BELOW_RAIN_THOLD_115
            DET_BELOW_RAIN_THOLD_116_oRDR_DETECTION_113_116_oPCAN_RADAR_e870b6b8_Tx: ComBitPosition=375, ComBitSize=1, ComSignalInitValue=0, ComSignalType=BOOLEAN, ComSystemTemplateSystemSignalRef=DET_BELOW_RAIN_THOLD_116
            DET_BI_STATIC_FLAG_113_oRDR_DETECTION_113_116_oPCAN_RADAR_c67de9ff_Tx: ComBitPosition=104, ComBitSize=1, ComSignalInitValue=0, ComSignalType=BOOLEAN, ComSystemTemplateSystemSignalRef=DET_BI_STATIC_FLAG_113
            DET_BI_STATIC_FLAG_114_oRDR_DETECTION_113_116_oPCAN_RADAR_9acdca96_Tx: ComBitPosition=216, ComBitSize=1, ComSignalInitValue=0, ComSignalType=BOOLEAN, ComSystemTemplateSystemSignalRef=DET_BI_STATIC_FLAG_114
            DET_BI_STATIC_FLAG_115_oRDR_DETECTION_113_116_oPCAN_RADAR_0fbd1e03_Tx: ComBitPosition=328, ComBitSize=1, ComSignalInitValue=0, ComSignalType=BOOLEAN, ComSystemTemplateSystemSignalRef=DET_BI_STATIC_FLAG_115
            DET_BI_STATIC_FLAG_116_oRDR_DETECTION_113_116_oPCAN_RADAR_6b5d65fd_Tx: ComBitPosition=440, ComBitSize=1, ComSignalInitValue=0, ComSignalType=BOOLEAN, ComSystemTemplateSystemSignalRef=DET_BI_STATIC_FLAG_116
            DET_CONFD_AZIMUTH_113_oRDR_DETECTION_113_116_oPCAN_RADAR_92b7a3b0_Tx: ComBitPosition=118, ComBitSize=2, ComSignalInitValue=0, ComSignalType=UINT8, ComSystemTemplateSystemSignalRef=DET_CONFD_AZIMUTH_113
            DET_CONFD_AZIMUTH_114_oRDR_DETECTION_113_116_oPCAN_RADAR_ce0780d9_Tx: ComBitPosition=230, ComBitSize=2, ComSignalInitValue=0, ComSignalType=UINT8, ComSystemTemplateSystemSignalRef=DET_CONFD_AZIMUTH_114
            DET_CONFD_AZIMUTH_115_oRDR_DETECTION_113_116_oPCAN_RADAR_5b77544c_Tx: ComBitPosition=342, ComBitSize=2, ComSignalInitValue=0, ComSignalType=UINT8, ComSystemTemplateSystemSignalRef=DET_CONFD_AZIMUTH_115
            DET_CONFD_AZIMUTH_116_oRDR_DETECTION_113_116_oPCAN_RADAR_3f972fb2_Tx: ComBitPosition=454, ComBitSize=2, ComSignalInitValue=0, ComSignalType=UINT8, ComSystemTemplateSystemSignalRef=DET_CONFD_AZIMUTH_116
            DET_CONFD_ELEVATION_113_oRDR_DETECTION_113_116_oPCAN_RADAR_9022a24a_Tx: ComBitPosition=101, ComBitSize=2, ComSignalInitValue=0, ComSignalType=UINT8, ComSystemTemplateSystemSignalRef=DET_CONFD_ELEVATION_113
            DET_CONFD_ELEVATION_114_oRDR_DETECTION_113_116_oPCAN_RADAR_cc928123_Tx: ComBitPosition=213, ComBitSize=2, ComSignalInitValue=0, ComSignalType=UINT8, ComSystemTemplateSystemSignalRef=DET_CONFD_ELEVATION_114
            DET_CONFD_ELEVATION_115_oRDR_DETECTION_113_116_oPCAN_RADAR_59e255b6_Tx: ComBitPosition=325, ComBitSize=2, ComSignalInitValue=0, ComSignalType=UINT8, ComSystemTemplateSystemSignalRef=DET_CONFD_ELEVATION_115
            DET_CONFD_ELEVATION_116_oRDR_DETECTION_113_116_oPCAN_RADAR_3d022e48_Tx: ComBitPosition=437, ComBitSize=2, ComSignalInitValue=0, ComSignalType=UINT8, ComSystemTemplateSystemSignalRef=DET_CONFD_ELEVATION_116
            DET_ELEVATION_113_oRDR_DETECTION_113_116_oPCAN_RADAR_41e27676_Tx: ComBitPosition=72, ComBitSize=8, ComSignalInitValue=0, ComSignalType=UINT8, ComSystemTemplateSystemSignalRef=DET_ELEVATION_113
            DET_ELEVATION_114_oRDR_DETECTION_113_116_oPCAN_RADAR_1d52551f_Tx: ComBitPosition=184, ComBitSize=8, ComSignalInitValue=0, ComSignalType=UINT8, ComSystemTemplateSystemSignalRef=DET_ELEVATION_114
            DET_ELEVATION_115_oRDR_DETECTION_113_116_oPCAN_RADAR_8822818a_Tx: ComBitPosition=296, ComBitSize=8, ComSignalInitValue=0, ComSignalType=UINT8, ComSystemTemplateSystemSignalRef=DET_ELEVATION_115
            DET_ELEVATION_116_oRDR_DETECTION_113_116_oPCAN_RADAR_ecc2fa74_Tx: ComBitPosition=408, ComBitSize=8, ComSignalInitValue=0, ComSignalType=UINT8, ComSystemTemplateSystemSignalRef=DET_ELEVATION_116
            DET_ELEVATION_ERR_113_oRDR_DETECTION_113_116_oPCAN_RADAR_c6dbee03_Tx: ComBitPosition=80, ComBitSize=6, ComSignalInitValue=0, ComSignalType=UINT8, ComSystemTemplateSystemSignalRef=DET_ELEVATION_ERR_113
            DET_ELEVATION_ERR_114_oRDR_DETECTION_113_116_oPCAN_RADAR_9a6bcd6a_Tx: ComBitPosition=192, ComBitSize=6, ComSignalInitValue=0, ComSignalType=UINT8, ComSystemTemplateSystemSignalRef=DET_ELEVATION_ERR_114
            DET_ELEVATION_ERR_115_oRDR_DETECTION_113_116_oPCAN_RADAR_0f1b19ff_Tx: ComBitPosition=304, ComBitSize=6, ComSignalInitValue=0, ComSignalType=UINT8, ComSystemTemplateSystemSignalRef=DET_ELEVATION_ERR_115
            DET_ELEVATION_ERR_116_oRDR_DETECTION_113_116_oPCAN_RADAR_6bfb6201_Tx: ComBitPosition=416, ComBitSize=6, ComSignalInitValue=0, ComSignalType=UINT8, ComSystemTemplateSystemSignalRef=DET_ELEVATION_ERR_116
            DET_EXISTENCE_PROB_113_oRDR_DETECTION_113_116_oPCAN_RADAR_14449b63_Tx: ComBitPosition=112, ComBitSize=6, ComSignalInitValue=0, ComSignalType=UINT8, ComSystemTemplateSystemSignalRef=DET_EXISTENCE_PROB_113
            DET_EXISTENCE_PROB_114_oRDR_DETECTION_113_116_oPCAN_RADAR_48f4b80a_Tx: ComBitPosition=224, ComBitSize=6, ComSignalInitValue=0, ComSignalType=UINT8, ComSystemTemplateSystemSignalRef=DET_EXISTENCE_PROB_114
            DET_EXISTENCE_PROB_115_oRDR_DETECTION_113_116_oPCAN_RADAR_dd846c9f_Tx: ComBitPosition=336, ComBitSize=6, ComSignalInitValue=0, ComSignalType=UINT8, ComSystemTemplateSystemSignalRef=DET_EXISTENCE_PROB_115
            DET_EXISTENCE_PROB_116_oRDR_DETECTION_113_116_oPCAN_RADAR_b9641761_Tx: ComBitPosition=448, ComBitSize=6, ComSignalInitValue=0, ComSignalType=UINT8, ComSystemTemplateSystemSignalRef=DET_EXISTENCE_PROB_116
            DET_HVC_FLAG_113_oRDR_DETECTION_113_116_oPCAN_RADAR_f530d81c_Tx: ComBitPosition=86, ComBitSize=1, ComSignalInitValue=0, ComSignalType=BOOLEAN, ComSystemTemplateSystemSignalRef=DET_HVC_FLAG_113
            DET_HVC_FLAG_114_oRDR_DETECTION_113_116_oPCAN_RADAR_a980fb75_Tx: ComBitPosition=198, ComBitSize=1, ComSignalInitValue=0, ComSignalType=BOOLEAN, ComSystemTemplateSystemSignalRef=DET_HVC_FLAG_114
            DET_HVC_FLAG_115_oRDR_DETECTION_113_116_oPCAN_RADAR_3cf02fe0_Tx: ComBitPosition=310, ComBitSize=1, ComSignalInitValue=0, ComSignalType=BOOLEAN, ComSystemTemplateSystemSignalRef=DET_HVC_FLAG_115
            DET_HVC_FLAG_116_oRDR_DETECTION_113_116_oPCAN_RADAR_5810541e_Tx: ComBitPosition=422, ComBitSize=1, ComSignalInitValue=0, ComSignalType=BOOLEAN, ComSystemTemplateSystemSignalRef=DET_HVC_FLAG_116
            DET_IDM_113_oRDR_DETECTION_113_116_oPCAN_RADAR_7e62e3a1_Tx: ComBitPosition=63, ComBitSize=1, ComSignalInitValue=0, ComSignalType=BOOLEAN, ComSystemTemplateSystemSignalRef=DET_IDM_113
            DET_IDM_114_oRDR_DETECTION_113_116_oPCAN_RADAR_22d2c0c8_Tx: ComBitPosition=175, ComBitSize=1, ComSignalInitValue=0, ComSignalType=BOOLEAN, ComSystemTemplateSystemSignalRef=DET_IDM_114
            DET_IDM_115_oRDR_DETECTION_113_116_oPCAN_RADAR_b7a2145d_Tx: ComBitPosition=287, ComBitSize=1, ComSignalInitValue=0, ComSignalType=BOOLEAN, ComSystemTemplateSystemSignalRef=DET_IDM_115
            DET_IDM_116_oRDR_DETECTION_113_116_oPCAN_RADAR_d3426fa3_Tx: ComBitPosition=399, ComBitSize=1, ComSignalInitValue=0, ComSignalType=BOOLEAN, ComSystemTemplateSystemSignalRef=DET_IDM_116
            DET_MH_CRC16_113_116_oRDR_DETECTION_113_116_oPCAN_RADAR_c3da1d13_Tx: ComBitPosition=0, ComBitSize=16, ComSignalInitValue=0, ComSignalType=UINT16, ComSystemTemplateSystemSignalRef=DET_MH_CRC16_113_116
            DET_MH_CYCLE_COUNTER_113_116_oRDR_DETECTION_113_116_oPCAN_RADAR_47afbc24_Tx: ComBitPosition=16, ComBitSize=8, ComSignalInitValue=0, ComSignalType=UINT8, ComSystemTemplateSystemSignalRef=DET_MH_CYCLE_COUNTER_113_116
            DET_MH_SCAN_INDEX_4LSB_113_116_oRDR_DETECTION_113_116_oPCAN_RADAR_8b8599a8_Tx: ComBitPosition=476, ComBitSize=4, ComSignalInitValue=0, ComSignalType=UINT8, ComSystemTemplateSystemSignalRef=DET_MH_SCAN_INDEX_4LSB_113_116
            DET_MTD_113_oRDR_DETECTION_113_116_oPCAN_RADAR_18d1d17a_Tx: ComBitPosition=47, ComBitSize=1, ComSignalInitValue=0, ComSignalType=BOOLEAN, ComSystemTemplateSystemSignalRef=DET_MTD_113
            DET_MTD_114_oRDR_DETECTION_113_116_oPCAN_RADAR_4461f213_Tx: ComBitPosition=159, ComBitSize=1, ComSignalInitValue=0, ComSignalType=BOOLEAN, ComSystemTemplateSystemSignalRef=DET_MTD_114
            DET_MTD_115_oRDR_DETECTION_113_116_oPCAN_RADAR_d1112686_Tx: ComBitPosition=271, ComBitSize=1, ComSignalInitValue=0, ComSignalType=BOOLEAN, ComSystemTemplateSystemSignalRef=DET_MTD_115
            DET_MTD_116_oRDR_DETECTION_113_116_oPCAN_RADAR_b5f15d78_Tx: ComBitPosition=383, ComBitSize=1, ComSignalInitValue=0, ComSignalType=BOOLEAN, ComSystemTemplateSystemSignalRef=DET_MTD_116
            DET_PROB_1STAZHYPO_113_oRDR_DETECTION_113_116_oPCAN_RADAR_8b6539b7_Tx: ComBitPosition=103, ComBitSize=1, ComSignalInitValue=0, ComSignalType=BOOLEAN, ComSystemTemplateSystemSignalRef=DET_PROB_1STAZHYPO_113
            DET_PROB_1STAZHYPO_114_oRDR_DETECTION_113_116_oPCAN_RADAR_d7d51ade_Tx: ComBitPosition=215, ComBitSize=1, ComSignalInitValue=0, ComSignalType=BOOLEAN, ComSystemTemplateSystemSignalRef=DET_PROB_1STAZHYPO_114
            DET_PROB_1STAZHYPO_115_oRDR_DETECTION_113_116_oPCAN_RADAR_42a5ce4b_Tx: ComBitPosition=327, ComBitSize=1, ComSignalInitValue=0, ComSignalType=BOOLEAN, ComSystemTemplateSystemSignalRef=DET_PROB_1STAZHYPO_115
            DET_PROB_1STAZHYPO_116_oRDR_DETECTION_113_116_oPCAN_RADAR_2645b5b5_Tx: ComBitPosition=439, ComBitSize=1, ComSignalInitValue=0, ComSignalType=BOOLEAN, ComSystemTemplateSystemSignalRef=DET_PROB_1STAZHYPO_116
            DET_RANGE_113_oRDR_DETECTION_113_116_oPCAN_RADAR_80cadac1_Tx: ComBitPosition=24, ComBitSize=15, ComSignalInitValue=0, ComSignalType=UINT16, ComSystemTemplateSystemSignalRef=DET_RANGE_113
            DET_RANGE_114_oRDR_DETECTION_113_116_oPCAN_RADAR_dc7af9a8_Tx: ComBitPosition=136, ComBitSize=15, ComSignalInitValue=0, ComSignalType=UINT16, ComSystemTemplateSystemSignalRef=DET_RANGE_114
            DET_RANGE_115_oRDR_DETECTION_113_116_oPCAN_RADAR_490a2d3d_Tx: ComBitPosition=248, ComBitSize=15, ComSignalInitValue=0, ComSignalType=UINT16, ComSystemTemplateSystemSignalRef=DET_RANGE_115
            DET_RANGE_116_oRDR_DETECTION_113_116_oPCAN_RADAR_2dea56c3_Tx: ComBitPosition=360, ComBitSize=15, ComSignalInitValue=0, ComSignalType=UINT16, ComSystemTemplateSystemSignalRef=DET_RANGE_116
            DET_RANGE_ERR_113_oRDR_DETECTION_113_116_oPCAN_RADAR_272260a8_Tx: ComBitPosition=40, ComBitSize=7, ComSignalInitValue=0, ComSignalType=UINT8, ComSystemTemplateSystemSignalRef=DET_RANGE_ERR_113
            DET_RANGE_ERR_114_oRDR_DETECTION_113_116_oPCAN_RADAR_7b9243c1_Tx: ComBitPosition=152, ComBitSize=7, ComSignalInitValue=0, ComSignalType=UINT8, ComSystemTemplateSystemSignalRef=DET_RANGE_ERR_114
            DET_RANGE_ERR_115_oRDR_DETECTION_113_116_oPCAN_RADAR_eee29754_Tx: ComBitPosition=264, ComBitSize=7, ComSignalInitValue=0, ComSignalType=UINT8, ComSystemTemplateSystemSignalRef=DET_RANGE_ERR_115
            DET_RANGE_ERR_116_oRDR_DETECTION_113_116_oPCAN_RADAR_8a02ecaa_Tx: ComBitPosition=376, ComBitSize=7, ComSignalInitValue=0, ComSignalType=UINT8, ComSystemTemplateSystemSignalRef=DET_RANGE_ERR_116
            DET_RANGE_VELOCITY_113_oRDR_DETECTION_113_116_oPCAN_RADAR_f56c18e4_Tx: ComBitPosition=48, ComBitSize=15, ComSignalInitValue=16384, ComSignalType=UINT16, ComSystemTemplateSystemSignalRef=DET_RANGE_VELOCITY_113
            DET_RANGE_VELOCITY_114_oRDR_DETECTION_113_116_oPCAN_RADAR_a9dc3b8d_Tx: ComBitPosition=160, ComBitSize=15, ComSignalInitValue=16384, ComSignalType=UINT16, ComSystemTemplateSystemSignalRef=DET_RANGE_VELOCITY_114
            DET_RANGE_VELOCITY_115_oRDR_DETECTION_113_116_oPCAN_RADAR_3cacef18_Tx: ComBitPosition=272, ComBitSize=15, ComSignalInitValue=16384, ComSignalType=UINT16, ComSystemTemplateSystemSignalRef=DET_RANGE_VELOCITY_115
            DET_RANGE_VELOCITY_116_oRDR_DETECTION_113_116_oPCAN_RADAR_584c94e6_Tx: ComBitPosition=384, ComBitSize=15, ComSignalInitValue=16384, ComSignalType=UINT16, ComSystemTemplateSystemSignalRef=DET_RANGE_VELOCITY_116
            DET_RANGE_VELOCITY_ERR_113_oRDR_DETECTION_113_116_oPCAN_RADAR_fad7e356_Tx: ComBitPosition=64, ComBitSize=8, ComSignalInitValue=0, ComSignalType=UINT8, ComSystemTemplateSystemSignalRef=DET_RANGE_VELOCITY_ERR_113
            DET_RANGE_VELOCITY_ERR_114_oRDR_DETECTION_113_116_oPCAN_RADAR_a667c03f_Tx: ComBitPosition=176, ComBitSize=8, ComSignalInitValue=0, ComSignalType=UINT8, ComSystemTemplateSystemSignalRef=DET_RANGE_VELOCITY_ERR_114
            DET_RANGE_VELOCITY_ERR_115_oRDR_DETECTION_113_116_oPCAN_RADAR_331714aa_Tx: ComBitPosition=288, ComBitSize=8, ComSignalInitValue=0, ComSignalType=UINT8, ComSystemTemplateSystemSignalRef=DET_RANGE_VELOCITY_ERR_115
            DET_RANGE_VELOCITY_ERR_116_oRDR_DETECTION_113_116_oPCAN_RADAR_57f76f54_Tx: ComBitPosition=400, ComBitSize=8, ComSignalInitValue=0, ComSignalType=UINT8, ComSystemTemplateSystemSignalRef=DET_RANGE_VELOCITY_ERR_116
            DET_RCS_113_oRDR_DETECTION_113_116_oPCAN_RADAR_72ec2fbe_Tx: ComBitPosition=128, ComBitSize=8, ComSignalInitValue=128, ComSignalType=UINT8, ComSystemTemplateSystemSignalRef=DET_RCS_113
            DET_RCS_114_oRDR_DETECTION_113_116_oPCAN_RADAR_2e5c0cd7_Tx: ComBitPosition=240, ComBitSize=8, ComSignalInitValue=128, ComSignalType=UINT8, ComSystemTemplateSystemSignalRef=DET_RCS_114
            DET_RCS_115_oRDR_DETECTION_113_116_oPCAN_RADAR_bb2cd842_Tx: ComBitPosition=352, ComBitSize=8, ComSignalInitValue=128, ComSignalType=UINT8, ComSystemTemplateSystemSignalRef=DET_RCS_115
            DET_RCS_116_oRDR_DETECTION_113_116_oPCAN_RADAR_dfcca3bc_Tx: ComBitPosition=464, ComBitSize=8, ComSignalInitValue=128, ComSignalType=UINT8, ComSystemTemplateSystemSignalRef=DET_RCS_116
            DET_SNR_113_oRDR_DETECTION_113_116_oPCAN_RADAR_af427bbc_Tx: ComBitPosition=120, ComBitSize=8, ComSignalInitValue=0, ComSignalType=UINT8, ComSystemTemplateSystemSignalRef=DET_SNR_113
            DET_SNR_114_oRDR_DETECTION_113_116_oPCAN_RADAR_f3f258d5_Tx: ComBitPosition=232, ComBitSize=8, ComSignalInitValue=0, ComSignalType=UINT8, ComSystemTemplateSystemSignalRef=DET_SNR_114
            DET_SNR_115_oRDR_DETECTION_113_116_oPCAN_RADAR_66828c40_Tx: ComBitPosition=344, ComBitSize=8, ComSignalInitValue=0, ComSignalType=UINT8, ComSystemTemplateSystemSignalRef=DET_SNR_115
            DET_SNR_116_oRDR_DETECTION_113_116_oPCAN_RADAR_0262f7be_Tx: ComBitPosition=456, ComBitSize=8, ComSignalInitValue=0, ComSignalType=UINT8, ComSystemTemplateSystemSignalRef=DET_SNR_116
            DET_SUPER_RES_TARGET_113_oRDR_DETECTION_113_116_oPCAN_RADAR_9edb53d9_Tx: ComBitPosition=87, ComBitSize=1, ComSignalInitValue=0, ComSignalType=BOOLEAN, ComSystemTemplateSystemSignalRef=DET_SUPER_RES_TARGET_113
            DET_SUPER_RES_TARGET_114_oRDR_DETECTION_113_116_oPCAN_RADAR_c26b70b0_Tx: ComBitPosition=199, ComBitSize=1, ComSignalInitValue=0, ComSignalType=BOOLEAN, ComSystemTemplateSystemSignalRef=DET_SUPER_RES_TARGET_114
            DET_SUPER_RES_TARGET_115_oRDR_DETECTION_113_116_oPCAN_RADAR_571ba425_Tx: ComBitPosition=311, ComBitSize=1, ComSignalInitValue=0, ComSignalType=BOOLEAN, ComSystemTemplateSystemSignalRef=DET_SUPER_RES_TARGET_115
            DET_SUPER_RES_TARGET_116_oRDR_DETECTION_113_116_oPCAN_RADAR_33fbdfdb_Tx: ComBitPosition=423, ComBitSize=1, ComSignalInitValue=0, ComSignalType=BOOLEAN, ComSystemTemplateSystemSignalRef=DET_SUPER_RES_TARGET_116
        SG_Detections_117_120_oRDR_DETECTION_117_120_oPCAN_RADAR_abfe9992_Tx: ComSystemTemplateSignalGroupRef=SG_Detections_117_120
          83 x ComGroupSignal, all with ComSignalEndianness=LITTLE_ENDIAN, ComTransferProperty=PENDING:
            DET_AZIMUTH_117_oRDR_DETECTION_117_120_oPCAN_RADAR_078d2c24_Tx: ComBitPosition=88, ComBitSize=13, ComSignalInitValue=0, ComSignalType=UINT16, ComSystemTemplateSystemSignalRef=DET_AZIMUTH_117
            DET_AZIMUTH_118_oRDR_DETECTION_117_120_oPCAN_RADAR_2b9dbe63_Tx: ComBitPosition=200, ComBitSize=13, ComSignalInitValue=0, ComSignalType=UINT16, ComSystemTemplateSystemSignalRef=DET_AZIMUTH_118
            DET_AZIMUTH_119_oRDR_DETECTION_117_120_oPCAN_RADAR_beed6af6_Tx: ComBitPosition=312, ComBitSize=13, ComSignalInitValue=0, ComSignalType=UINT16, ComSystemTemplateSystemSignalRef=DET_AZIMUTH_119
            DET_AZIMUTH_120_oRDR_DETECTION_117_120_oPCAN_RADAR_015c302d_Tx: ComBitPosition=424, ComBitSize=13, ComSignalInitValue=0, ComSignalType=UINT16, ComSystemTemplateSystemSignalRef=DET_AZIMUTH_120
            DET_AZIMUTH_ERR_117_oRDR_DETECTION_117_120_oPCAN_RADAR_a338b9d1_Tx: ComBitPosition=105, ComBitSize=7, ComSignalInitValue=0, ComSignalType=UINT8, ComSystemTemplateSystemSignalRef=DET_AZIMUTH_ERR_117
            DET_AZIMUTH_ERR_118_oRDR_DETECTION_117_120_oPCAN_RADAR_8f282b96_Tx: ComBitPosition=217, ComBitSize=7, ComSignalInitValue=0, ComSignalType=UINT8, ComSystemTemplateSystemSignalRef=DET_AZIMUTH_ERR_118
            DET_AZIMUTH_ERR_119_oRDR_DETECTION_117_120_oPCAN_RADAR_1a58ff03_Tx: ComBitPosition=329, ComBitSize=7, ComSignalInitValue=0, ComSignalType=UINT8, ComSystemTemplateSystemSignalRef=DET_AZIMUTH_ERR_119
            DET_AZIMUTH_ERR_120_oRDR_DETECTION_117_120_oPCAN_RADAR_a5e9a5d8_Tx: ComBitPosition=441, ComBitSize=7, ComSignalInitValue=0, ComSignalType=UINT8, ComSystemTemplateSystemSignalRef=DET_AZIMUTH_ERR_120
            DET_BELOW_RAIN_THOLD_117_oRDR_DETECTION_117_120_oPCAN_RADAR_d28cbfe4_Tx: ComBitPosition=39, ComBitSize=1, ComSignalInitValue=0, ComSignalType=BOOLEAN, ComSystemTemplateSystemSignalRef=DET_BELOW_RAIN_THOLD_117
            DET_BELOW_RAIN_THOLD_118_oRDR_DETECTION_117_120_oPCAN_RADAR_fe9c2da3_Tx: ComBitPosition=151, ComBitSize=1, ComSignalInitValue=0, ComSignalType=BOOLEAN, ComSystemTemplateSystemSignalRef=DET_BELOW_RAIN_THOLD_118
            DET_BELOW_RAIN_THOLD_119_oRDR_DETECTION_117_120_oPCAN_RADAR_6becf936_Tx: ComBitPosition=263, ComBitSize=1, ComSignalInitValue=0, ComSignalType=BOOLEAN, ComSystemTemplateSystemSignalRef=DET_BELOW_RAIN_THOLD_119
            DET_BELOW_RAIN_THOLD_120_oRDR_DETECTION_117_120_oPCAN_RADAR_d45da3ed_Tx: ComBitPosition=375, ComBitSize=1, ComSignalInitValue=0, ComSignalType=BOOLEAN, ComSystemTemplateSystemSignalRef=DET_BELOW_RAIN_THOLD_120
            DET_BI_STATIC_FLAG_117_oRDR_DETECTION_117_120_oPCAN_RADAR_51a16ca1_Tx: ComBitPosition=104, ComBitSize=1, ComSignalInitValue=0, ComSignalType=BOOLEAN, ComSystemTemplateSystemSignalRef=DET_BI_STATIC_FLAG_117
            DET_BI_STATIC_FLAG_118_oRDR_DETECTION_117_120_oPCAN_RADAR_7db1fee6_Tx: ComBitPosition=216, ComBitSize=1, ComSignalInitValue=0, ComSignalType=BOOLEAN, ComSystemTemplateSystemSignalRef=DET_BI_STATIC_FLAG_118
            DET_BI_STATIC_FLAG_119_oRDR_DETECTION_117_120_oPCAN_RADAR_e8c12a73_Tx: ComBitPosition=328, ComBitSize=1, ComSignalInitValue=0, ComSignalType=BOOLEAN, ComSystemTemplateSystemSignalRef=DET_BI_STATIC_FLAG_119
            DET_BI_STATIC_FLAG_120_oRDR_DETECTION_117_120_oPCAN_RADAR_577070a8_Tx: ComBitPosition=440, ComBitSize=1, ComSignalInitValue=0, ComSignalType=BOOLEAN, ComSystemTemplateSystemSignalRef=DET_BI_STATIC_FLAG_120
            DET_CONFD_AZIMUTH_117_oRDR_DETECTION_117_120_oPCAN_RADAR_056b26ee_Tx: ComBitPosition=118, ComBitSize=2, ComSignalInitValue=0, ComSignalType=UINT8, ComSystemTemplateSystemSignalRef=DET_CONFD_AZIMUTH_117
            DET_CONFD_AZIMUTH_118_oRDR_DETECTION_117_120_oPCAN_RADAR_297bb4a9_Tx: ComBitPosition=230, ComBitSize=2, ComSignalInitValue=0, ComSignalType=UINT8, ComSystemTemplateSystemSignalRef=DET_CONFD_AZIMUTH_118
            DET_CONFD_AZIMUTH_119_oRDR_DETECTION_117_120_oPCAN_RADAR_bc0b603c_Tx: ComBitPosition=342, ComBitSize=2, ComSignalInitValue=0, ComSignalType=UINT8, ComSystemTemplateSystemSignalRef=DET_CONFD_AZIMUTH_119
            DET_CONFD_AZIMUTH_120_oRDR_DETECTION_117_120_oPCAN_RADAR_03ba3ae7_Tx: ComBitPosition=454, ComBitSize=2, ComSignalInitValue=0, ComSignalType=UINT8, ComSystemTemplateSystemSignalRef=DET_CONFD_AZIMUTH_120
            DET_CONFD_ELEVATION_117_oRDR_DETECTION_117_120_oPCAN_RADAR_07fe2714_Tx: ComBitPosition=101, ComBitSize=2, ComSignalInitValue=0, ComSignalType=UINT8, ComSystemTemplateSystemSignalRef=DET_CONFD_ELEVATION_117
            DET_CONFD_ELEVATION_118_oRDR_DETECTION_117_120_oPCAN_RADAR_2beeb553_Tx: ComBitPosition=213, ComBitSize=2, ComSignalInitValue=0, ComSignalType=UINT8, ComSystemTemplateSystemSignalRef=DET_CONFD_ELEVATION_118
            DET_CONFD_ELEVATION_119_oRDR_DETECTION_117_120_oPCAN_RADAR_be9e61c6_Tx: ComBitPosition=325, ComBitSize=2, ComSignalInitValue=0, ComSignalType=UINT8, ComSystemTemplateSystemSignalRef=DET_CONFD_ELEVATION_119
            DET_CONFD_ELEVATION_120_oRDR_DETECTION_117_120_oPCAN_RADAR_012f3b1d_Tx: ComBitPosition=437, ComBitSize=2, ComSignalInitValue=0, ComSignalType=UINT8, ComSystemTemplateSystemSignalRef=DET_CONFD_ELEVATION_120
            DET_ELEVATION_117_oRDR_DETECTION_117_120_oPCAN_RADAR_d63ef328_Tx: ComBitPosition=72, ComBitSize=8, ComSignalInitValue=0, ComSignalType=UINT8, ComSystemTemplateSystemSignalRef=DET_ELEVATION_117
            DET_ELEVATION_118_oRDR_DETECTION_117_120_oPCAN_RADAR_fa2e616f_Tx: ComBitPosition=184, ComBitSize=8, ComSignalInitValue=0, ComSignalType=UINT8, ComSystemTemplateSystemSignalRef=DET_ELEVATION_118
            DET_ELEVATION_119_oRDR_DETECTION_117_120_oPCAN_RADAR_6f5eb5fa_Tx: ComBitPosition=296, ComBitSize=8, ComSignalInitValue=0, ComSignalType=UINT8, ComSystemTemplateSystemSignalRef=DET_ELEVATION_119
            DET_ELEVATION_120_oRDR_DETECTION_117_120_oPCAN_RADAR_d0efef21_Tx: ComBitPosition=408, ComBitSize=8, ComSignalInitValue=0, ComSignalType=UINT8, ComSystemTemplateSystemSignalRef=DET_ELEVATION_120
            DET_ELEVATION_ERR_117_oRDR_DETECTION_117_120_oPCAN_RADAR_51076b5d_Tx: ComBitPosition=80, ComBitSize=6, ComSignalInitValue=0, ComSignalType=UINT8, ComSystemTemplateSystemSignalRef=DET_ELEVATION_ERR_117
            DET_ELEVATION_ERR_118_oRDR_DETECTION_117_120_oPCAN_RADAR_7d17f91a_Tx: ComBitPosition=192, ComBitSize=6, ComSignalInitValue=0, ComSignalType=UINT8, ComSystemTemplateSystemSignalRef=DET_ELEVATION_ERR_118
            DET_ELEVATION_ERR_119_oRDR_DETECTION_117_120_oPCAN_RADAR_e8672d8f_Tx: ComBitPosition=304, ComBitSize=6, ComSignalInitValue=0, ComSignalType=UINT8, ComSystemTemplateSystemSignalRef=DET_ELEVATION_ERR_119
            DET_ELEVATION_ERR_120_oRDR_DETECTION_117_120_oPCAN_RADAR_57d67754_Tx: ComBitPosition=416, ComBitSize=6, ComSignalInitValue=0, ComSignalType=UINT8, ComSystemTemplateSystemSignalRef=DET_ELEVATION_ERR_120
            DET_EXISTENCE_PROB_117_oRDR_DETECTION_117_120_oPCAN_RADAR_83981e3d_Tx: ComBitPosition=112, ComBitSize=6, ComSignalInitValue=0, ComSignalType=UINT8, ComSystemTemplateSystemSignalRef=DET_EXISTENCE_PROB_117
            DET_EXISTENCE_PROB_118_oRDR_DETECTION_117_120_oPCAN_RADAR_af888c7a_Tx: ComBitPosition=224, ComBitSize=6, ComSignalInitValue=0, ComSignalType=UINT8, ComSystemTemplateSystemSignalRef=DET_EXISTENCE_PROB_118
            DET_EXISTENCE_PROB_119_oRDR_DETECTION_117_120_oPCAN_RADAR_3af858ef_Tx: ComBitPosition=336, ComBitSize=6, ComSignalInitValue=0, ComSignalType=UINT8, ComSystemTemplateSystemSignalRef=DET_EXISTENCE_PROB_119
            DET_EXISTENCE_PROB_120_oRDR_DETECTION_117_120_oPCAN_RADAR_85490234_Tx: ComBitPosition=448, ComBitSize=6, ComSignalInitValue=0, ComSignalType=UINT8, ComSystemTemplateSystemSignalRef=DET_EXISTENCE_PROB_120
            DET_HVC_FLAG_117_oRDR_DETECTION_117_120_oPCAN_RADAR_62ec5d42_Tx: ComBitPosition=86, ComBitSize=1, ComSignalInitValue=0, ComSignalType=BOOLEAN, ComSystemTemplateSystemSignalRef=DET_HVC_FLAG_117
            DET_HVC_FLAG_118_oRDR_DETECTION_117_120_oPCAN_RADAR_4efccf05_Tx: ComBitPosition=198, ComBitSize=1, ComSignalInitValue=0, ComSignalType=BOOLEAN, ComSystemTemplateSystemSignalRef=DET_HVC_FLAG_118
            DET_HVC_FLAG_119_oRDR_DETECTION_117_120_oPCAN_RADAR_db8c1b90_Tx: ComBitPosition=310, ComBitSize=1, ComSignalInitValue=0, ComSignalType=BOOLEAN, ComSystemTemplateSystemSignalRef=DET_HVC_FLAG_119
            DET_HVC_FLAG_120_oRDR_DETECTION_117_120_oPCAN_RADAR_643d414b_Tx: ComBitPosition=422, ComBitSize=1, ComSignalInitValue=0, ComSignalType=BOOLEAN, ComSystemTemplateSystemSignalRef=DET_HVC_FLAG_120
            DET_IDM_117_oRDR_DETECTION_117_120_oPCAN_RADAR_e9be66ff_Tx: ComBitPosition=63, ComBitSize=1, ComSignalInitValue=0, ComSignalType=BOOLEAN, ComSystemTemplateSystemSignalRef=DET_IDM_117
            DET_IDM_118_oRDR_DETECTION_117_120_oPCAN_RADAR_c5aef4b8_Tx: ComBitPosition=175, ComBitSize=1, ComSignalInitValue=0, ComSignalType=BOOLEAN, ComSystemTemplateSystemSignalRef=DET_IDM_118
            DET_IDM_119_oRDR_DETECTION_117_120_oPCAN_RADAR_50de202d_Tx: ComBitPosition=287, ComBitSize=1, ComSignalInitValue=0, ComSignalType=BOOLEAN, ComSystemTemplateSystemSignalRef=DET_IDM_119
            DET_IDM_120_oRDR_DETECTION_117_120_oPCAN_RADAR_ef6f7af6_Tx: ComBitPosition=399, ComBitSize=1, ComSignalInitValue=0, ComSignalType=BOOLEAN, ComSystemTemplateSystemSignalRef=DET_IDM_120
            DET_MH_CRC16_117_120_oRDR_DETECTION_117_120_oPCAN_RADAR_2f764b99_Tx: ComBitPosition=0, ComBitSize=16, ComSignalInitValue=0, ComSignalType=UINT16, ComSystemTemplateSystemSignalRef=DET_MH_CRC16_117_120
            DET_MH_CYCLE_COUNTER_117_120_oRDR_DETECTION_117_120_oPCAN_RADAR_ab03eaae_Tx: ComBitPosition=16, ComBitSize=8, ComSignalInitValue=0, ComSignalType=UINT8, ComSystemTemplateSystemSignalRef=DET_MH_CYCLE_COUNTER_117_120
            DET_MH_SCAN_INDEX_4LSB_117_120_oRDR_DETECTION_117_120_oPCAN_RADAR_6729cf22_Tx: ComBitPosition=476, ComBitSize=4, ComSignalInitValue=0, ComSignalType=UINT8, ComSystemTemplateSystemSignalRef=DET_MH_SCAN_INDEX_4LSB_117_120
            DET_MTD_117_oRDR_DETECTION_117_120_oPCAN_RADAR_8f0d5424_Tx: ComBitPosition=47, ComBitSize=1, ComSignalInitValue=0, ComSignalType=BOOLEAN, ComSystemTemplateSystemSignalRef=DET_MTD_117
            DET_MTD_118_oRDR_DETECTION_117_120_oPCAN_RADAR_a31dc663_Tx: ComBitPosition=159, ComBitSize=1, ComSignalInitValue=0, ComSignalType=BOOLEAN, ComSystemTemplateSystemSignalRef=DET_MTD_118
            DET_MTD_119_oRDR_DETECTION_117_120_oPCAN_RADAR_366d12f6_Tx: ComBitPosition=271, ComBitSize=1, ComSignalInitValue=0, ComSignalType=BOOLEAN, ComSystemTemplateSystemSignalRef=DET_MTD_119
            DET_MTD_120_oRDR_DETECTION_117_120_oPCAN_RADAR_89dc482d_Tx: ComBitPosition=383, ComBitSize=1, ComSignalInitValue=0, ComSignalType=BOOLEAN, ComSystemTemplateSystemSignalRef=DET_MTD_120
            DET_PROB_1STAZHYPO_117_oRDR_DETECTION_117_120_oPCAN_RADAR_1cb9bce9_Tx: ComBitPosition=103, ComBitSize=1, ComSignalInitValue=0, ComSignalType=BOOLEAN, ComSystemTemplateSystemSignalRef=DET_PROB_1STAZHYPO_117
            DET_PROB_1STAZHYPO_118_oRDR_DETECTION_117_120_oPCAN_RADAR_30a92eae_Tx: ComBitPosition=215, ComBitSize=1, ComSignalInitValue=0, ComSignalType=BOOLEAN, ComSystemTemplateSystemSignalRef=DET_PROB_1STAZHYPO_118
            DET_PROB_1STAZHYPO_119_oRDR_DETECTION_117_120_oPCAN_RADAR_a5d9fa3b_Tx: ComBitPosition=327, ComBitSize=1, ComSignalInitValue=0, ComSignalType=BOOLEAN, ComSystemTemplateSystemSignalRef=DET_PROB_1STAZHYPO_119
            DET_PROB_1STAZHYPO_120_oRDR_DETECTION_117_120_oPCAN_RADAR_1a68a0e0_Tx: ComBitPosition=439, ComBitSize=1, ComSignalInitValue=0, ComSignalType=BOOLEAN, ComSystemTemplateSystemSignalRef=DET_PROB_1STAZHYPO_120
            DET_RANGE_117_oRDR_DETECTION_117_120_oPCAN_RADAR_17165f9f_Tx: ComBitPosition=24, ComBitSize=15, ComSignalInitValue=0, ComSignalType=UINT16, ComSystemTemplateSystemSignalRef=DET_RANGE_117
            DET_RANGE_118_oRDR_DETECTION_117_120_oPCAN_RADAR_3b06cdd8_Tx: ComBitPosition=136, ComBitSize=15, ComSignalInitValue=0, ComSignalType=UINT16, ComSystemTemplateSystemSignalRef=DET_RANGE_118
            DET_RANGE_119_oRDR_DETECTION_117_120_oPCAN_RADAR_ae76194d_Tx: ComBitPosition=248, ComBitSize=15, ComSignalInitValue=0, ComSignalType=UINT16, ComSystemTemplateSystemSignalRef=DET_RANGE_119
            DET_RANGE_120_oRDR_DETECTION_117_120_oPCAN_RADAR_11c74396_Tx: ComBitPosition=360, ComBitSize=15, ComSignalInitValue=0, ComSignalType=UINT16, ComSystemTemplateSystemSignalRef=DET_RANGE_120
            DET_RANGE_ERR_117_oRDR_DETECTION_117_120_oPCAN_RADAR_b0fee5f6_Tx: ComBitPosition=40, ComBitSize=7, ComSignalInitValue=0, ComSignalType=UINT8, ComSystemTemplateSystemSignalRef=DET_RANGE_ERR_117
            DET_RANGE_ERR_118_oRDR_DETECTION_117_120_oPCAN_RADAR_9cee77b1_Tx: ComBitPosition=152, ComBitSize=7, ComSignalInitValue=0, ComSignalType=UINT8, ComSystemTemplateSystemSignalRef=DET_RANGE_ERR_118
            DET_RANGE_ERR_119_oRDR_DETECTION_117_120_oPCAN_RADAR_099ea324_Tx: ComBitPosition=264, ComBitSize=7, ComSignalInitValue=0, ComSignalType=UINT8, ComSystemTemplateSystemSignalRef=DET_RANGE_ERR_119
            DET_RANGE_ERR_120_oRDR_DETECTION_117_120_oPCAN_RADAR_b62ff9ff_Tx: ComBitPosition=376, ComBitSize=7, ComSignalInitValue=0, ComSignalType=UINT8, ComSystemTemplateSystemSignalRef=DET_RANGE_ERR_120
            DET_RANGE_VELOCITY_117_oRDR_DETECTION_117_120_oPCAN_RADAR_62b09dba_Tx: ComBitPosition=48, ComBitSize=15, ComSignalInitValue=16384, ComSignalType=UINT16, ComSystemTemplateSystemSignalRef=DET_RANGE_VELOCITY_117
            DET_RANGE_VELOCITY_118_oRDR_DETECTION_117_120_oPCAN_RADAR_4ea00ffd_Tx: ComBitPosition=160, ComBitSize=15, ComSignalInitValue=16384, ComSignalType=UINT16, ComSystemTemplateSystemSignalRef=DET_RANGE_VELOCITY_118
            DET_RANGE_VELOCITY_119_oRDR_DETECTION_117_120_oPCAN_RADAR_dbd0db68_Tx: ComBitPosition=272, ComBitSize=15, ComSignalInitValue=16384, ComSignalType=UINT16, ComSystemTemplateSystemSignalRef=DET_RANGE_VELOCITY_119
            DET_RANGE_VELOCITY_120_oRDR_DETECTION_117_120_oPCAN_RADAR_646181b3_Tx: ComBitPosition=384, ComBitSize=15, ComSignalInitValue=16384, ComSignalType=UINT16, ComSystemTemplateSystemSignalRef=DET_RANGE_VELOCITY_120
            DET_RANGE_VELOCITY_ERR_117_oRDR_DETECTION_117_120_oPCAN_RADAR_6d0b6608_Tx: ComBitPosition=64, ComBitSize=8, ComSignalInitValue=0, ComSignalType=UINT8, ComSystemTemplateSystemSignalRef=DET_RANGE_VELOCITY_ERR_117
            DET_RANGE_VELOCITY_ERR_118_oRDR_DETECTION_117_120_oPCAN_RADAR_411bf44f_Tx: ComBitPosition=176, ComBitSize=8, ComSignalInitValue=0, ComSignalType=UINT8, ComSystemTemplateSystemSignalRef=DET_RANGE_VELOCITY_ERR_118
            DET_RANGE_VELOCITY_ERR_119_oRDR_DETECTION_117_120_oPCAN_RADAR_d46b20da_Tx: ComBitPosition=288, ComBitSize=8, ComSignalInitValue=0, ComSignalType=UINT8, ComSystemTemplateSystemSignalRef=DET_RANGE_VELOCITY_ERR_119
            DET_RANGE_VELOCITY_ERR_120_oRDR_DETECTION_117_120_oPCAN_RADAR_6bda7a01_Tx: ComBitPosition=400, ComBitSize=8, ComSignalInitValue=0, ComSignalType=UINT8, ComSystemTemplateSystemSignalRef=DET_RANGE_VELOCITY_ERR_120
            DET_RCS_117_oRDR_DETECTION_117_120_oPCAN_RADAR_e530aae0_Tx: ComBitPosition=128, ComBitSize=8, ComSignalInitValue=128, ComSignalType=UINT8, ComSystemTemplateSystemSignalRef=DET_RCS_117
            DET_RCS_118_oRDR_DETECTION_117_120_oPCAN_RADAR_c92038a7_Tx: ComBitPosition=240, ComBitSize=8, ComSignalInitValue=128, ComSignalType=UINT8, ComSystemTemplateSystemSignalRef=DET_RCS_118
            DET_RCS_119_oRDR_DETECTION_117_120_oPCAN_RADAR_5c50ec32_Tx: ComBitPosition=352, ComBitSize=8, ComSignalInitValue=128, ComSignalType=UINT8, ComSystemTemplateSystemSignalRef=DET_RCS_119
            DET_RCS_120_oRDR_DETECTION_117_120_oPCAN_RADAR_e3e1b6e9_Tx: ComBitPosition=464, ComBitSize=8, ComSignalInitValue=128, ComSignalType=UINT8, ComSystemTemplateSystemSignalRef=DET_RCS_120
            DET_SNR_117_oRDR_DETECTION_117_120_oPCAN_RADAR_389efee2_Tx: ComBitPosition=120, ComBitSize=8, ComSignalInitValue=0, ComSignalType=UINT8, ComSystemTemplateSystemSignalRef=DET_SNR_117
            DET_SNR_118_oRDR_DETECTION_117_120_oPCAN_RADAR_148e6ca5_Tx: ComBitPosition=232, ComBitSize=8, ComSignalInitValue=0, ComSignalType=UINT8, ComSystemTemplateSystemSignalRef=DET_SNR_118
            DET_SNR_119_oRDR_DETECTION_117_120_oPCAN_RADAR_81feb830_Tx: ComBitPosition=344, ComBitSize=8, ComSignalInitValue=0, ComSignalType=UINT8, ComSystemTemplateSystemSignalRef=DET_SNR_119
            DET_SNR_120_oRDR_DETECTION_117_120_oPCAN_RADAR_3e4fe2eb_Tx: ComBitPosition=456, ComBitSize=8, ComSignalInitValue=0, ComSignalType=UINT8, ComSystemTemplateSystemSignalRef=DET_SNR_120
            DET_SUPER_RES_TARGET_117_oRDR_DETECTION_117_120_oPCAN_RADAR_0907d687_Tx: ComBitPosition=87, ComBitSize=1, ComSignalInitValue=0, ComSignalType=BOOLEAN, ComSystemTemplateSystemSignalRef=DET_SUPER_RES_TARGET_117
            DET_SUPER_RES_TARGET_118_oRDR_DETECTION_117_120_oPCAN_RADAR_251744c0_Tx: ComBitPosition=199, ComBitSize=1, ComSignalInitValue=0, ComSignalType=BOOLEAN, ComSystemTemplateSystemSignalRef=DET_SUPER_RES_TARGET_118
            DET_SUPER_RES_TARGET_119_oRDR_DETECTION_117_120_oPCAN_RADAR_b0679055_Tx: ComBitPosition=311, ComBitSize=1, ComSignalInitValue=0, ComSignalType=BOOLEAN, ComSystemTemplateSystemSignalRef=DET_SUPER_RES_TARGET_119
            DET_SUPER_RES_TARGET_120_oRDR_DETECTION_117_120_oPCAN_RADAR_0fd6ca8e_Tx: ComBitPosition=423, ComBitSize=1, ComSignalInitValue=0, ComSignalType=BOOLEAN, ComSystemTemplateSystemSignalRef=DET_SUPER_RES_TARGET_120
        SG_Detections_121_124_oRDR_DETECTION_121_124_oPCAN_RADAR_a895174b_Tx: ComSystemTemplateSignalGroupRef=SG_Detections_121_124
          83 x ComGroupSignal, all with ComSignalEndianness=LITTLE_ENDIAN, ComTransferProperty=PENDING:
            DET_AZIMUTH_121_oRDR_DETECTION_121_124_oPCAN_RADAR_1927e444_Tx: ComBitPosition=88, ComBitSize=13, ComSignalInitValue=0, ComSignalType=UINT16, ComSystemTemplateSystemSignalRef=DET_AZIMUTH_121
            DET_AZIMUTH_122_oRDR_DETECTION_121_124_oPCAN_RADAR_7dc79fba_Tx: ComBitPosition=200, ComBitSize=13, ComSignalInitValue=0, ComSignalType=UINT16, ComSystemTemplateSystemSignalRef=DET_AZIMUTH_122
            DET_AZIMUTH_123_oRDR_DETECTION_121_124_oPCAN_RADAR_e8b74b2f_Tx: ComBitPosition=312, ComBitSize=13, ComSignalInitValue=0, ComSignalType=UINT16, ComSystemTemplateSystemSignalRef=DET_AZIMUTH_123
            DET_AZIMUTH_124_oRDR_DETECTION_121_124_oPCAN_RADAR_b4076846_Tx: ComBitPosition=424, ComBitSize=13, ComSignalInitValue=0, ComSignalType=UINT16, ComSystemTemplateSystemSignalRef=DET_AZIMUTH_124
            DET_AZIMUTH_ERR_121_oRDR_DETECTION_121_124_oPCAN_RADAR_bd9271b1_Tx: ComBitPosition=105, ComBitSize=7, ComSignalInitValue=0, ComSignalType=UINT8, ComSystemTemplateSystemSignalRef=DET_AZIMUTH_ERR_121
            DET_AZIMUTH_ERR_122_oRDR_DETECTION_121_124_oPCAN_RADAR_d9720a4f_Tx: ComBitPosition=217, ComBitSize=7, ComSignalInitValue=0, ComSignalType=UINT8, ComSystemTemplateSystemSignalRef=DET_AZIMUTH_ERR_122
            DET_AZIMUTH_ERR_123_oRDR_DETECTION_121_124_oPCAN_RADAR_4c02deda_Tx: ComBitPosition=329, ComBitSize=7, ComSignalInitValue=0, ComSignalType=UINT8, ComSystemTemplateSystemSignalRef=DET_AZIMUTH_ERR_123
            DET_AZIMUTH_ERR_124_oRDR_DETECTION_121_124_oPCAN_RADAR_10b2fdb3_Tx: ComBitPosition=441, ComBitSize=7, ComSignalInitValue=0, ComSignalType=UINT8, ComSystemTemplateSystemSignalRef=DET_AZIMUTH_ERR_124
            DET_BELOW_RAIN_THOLD_121_oRDR_DETECTION_121_124_oPCAN_RADAR_cc267784_Tx: ComBitPosition=39, ComBitSize=1, ComSignalInitValue=0, ComSignalType=BOOLEAN, ComSystemTemplateSystemSignalRef=DET_BELOW_RAIN_THOLD_121
            DET_BELOW_RAIN_THOLD_122_oRDR_DETECTION_121_124_oPCAN_RADAR_a8c60c7a_Tx: ComBitPosition=151, ComBitSize=1, ComSignalInitValue=0, ComSignalType=BOOLEAN, ComSystemTemplateSystemSignalRef=DET_BELOW_RAIN_THOLD_122
            DET_BELOW_RAIN_THOLD_123_oRDR_DETECTION_121_124_oPCAN_RADAR_3db6d8ef_Tx: ComBitPosition=263, ComBitSize=1, ComSignalInitValue=0, ComSignalType=BOOLEAN, ComSystemTemplateSystemSignalRef=DET_BELOW_RAIN_THOLD_123
            DET_BELOW_RAIN_THOLD_124_oRDR_DETECTION_121_124_oPCAN_RADAR_6106fb86_Tx: ComBitPosition=375, ComBitSize=1, ComSignalInitValue=0, ComSignalType=BOOLEAN, ComSystemTemplateSystemSignalRef=DET_BELOW_RAIN_THOLD_124
            DET_BI_STATIC_FLAG_121_oRDR_DETECTION_121_124_oPCAN_RADAR_4f0ba4c1_Tx: ComBitPosition=104, ComBitSize=1, ComSignalInitValue=0, ComSignalType=BOOLEAN, ComSystemTemplateSystemSignalRef=DET_BI_STATIC_FLAG_121
            DET_BI_STATIC_FLAG_122_oRDR_DETECTION_121_124_oPCAN_RADAR_2bebdf3f_Tx: ComBitPosition=216, ComBitSize=1, ComSignalInitValue=0, ComSignalType=BOOLEAN, ComSystemTemplateSystemSignalRef=DET_BI_STATIC_FLAG_122
            DET_BI_STATIC_FLAG_123_oRDR_DETECTION_121_124_oPCAN_RADAR_be9b0baa_Tx: ComBitPosition=328, ComBitSize=1, ComSignalInitValue=0, ComSignalType=BOOLEAN, ComSystemTemplateSystemSignalRef=DET_BI_STATIC_FLAG_123
            DET_BI_STATIC_FLAG_124_oRDR_DETECTION_121_124_oPCAN_RADAR_e22b28c3_Tx: ComBitPosition=440, ComBitSize=1, ComSignalInitValue=0, ComSignalType=BOOLEAN, ComSystemTemplateSystemSignalRef=DET_BI_STATIC_FLAG_124
            DET_CONFD_AZIMUTH_121_oRDR_DETECTION_121_124_oPCAN_RADAR_1bc1ee8e_Tx: ComBitPosition=118, ComBitSize=2, ComSignalInitValue=0, ComSignalType=UINT8, ComSystemTemplateSystemSignalRef=DET_CONFD_AZIMUTH_121
            DET_CONFD_AZIMUTH_122_oRDR_DETECTION_121_124_oPCAN_RADAR_7f219570_Tx: ComBitPosition=230, ComBitSize=2, ComSignalInitValue=0, ComSignalType=UINT8, ComSystemTemplateSystemSignalRef=DET_CONFD_AZIMUTH_122
            DET_CONFD_AZIMUTH_123_oRDR_DETECTION_121_124_oPCAN_RADAR_ea5141e5_Tx: ComBitPosition=342, ComBitSize=2, ComSignalInitValue=0, ComSignalType=UINT8, ComSystemTemplateSystemSignalRef=DET_CONFD_AZIMUTH_123
            DET_CONFD_AZIMUTH_124_oRDR_DETECTION_121_124_oPCAN_RADAR_b6e1628c_Tx: ComBitPosition=454, ComBitSize=2, ComSignalInitValue=0, ComSignalType=UINT8, ComSystemTemplateSystemSignalRef=DET_CONFD_AZIMUTH_124
            DET_CONFD_ELEVATION_121_oRDR_DETECTION_121_124_oPCAN_RADAR_1954ef74_Tx: ComBitPosition=101, ComBitSize=2, ComSignalInitValue=0, ComSignalType=UINT8, ComSystemTemplateSystemSignalRef=DET_CONFD_ELEVATION_121
            DET_CONFD_ELEVATION_122_oRDR_DETECTION_121_124_oPCAN_RADAR_7db4948a_Tx: ComBitPosition=213, ComBitSize=2, ComSignalInitValue=0, ComSignalType=UINT8, ComSystemTemplateSystemSignalRef=DET_CONFD_ELEVATION_122
            DET_CONFD_ELEVATION_123_oRDR_DETECTION_121_124_oPCAN_RADAR_e8c4401f_Tx: ComBitPosition=325, ComBitSize=2, ComSignalInitValue=0, ComSignalType=UINT8, ComSystemTemplateSystemSignalRef=DET_CONFD_ELEVATION_123
            DET_CONFD_ELEVATION_124_oRDR_DETECTION_121_124_oPCAN_RADAR_b4746376_Tx: ComBitPosition=437, ComBitSize=2, ComSignalInitValue=0, ComSignalType=UINT8, ComSystemTemplateSystemSignalRef=DET_CONFD_ELEVATION_124
            DET_ELEVATION_121_oRDR_DETECTION_121_124_oPCAN_RADAR_c8943b48_Tx: ComBitPosition=72, ComBitSize=8, ComSignalInitValue=0, ComSignalType=UINT8, ComSystemTemplateSystemSignalRef=DET_ELEVATION_121
            DET_ELEVATION_122_oRDR_DETECTION_121_124_oPCAN_RADAR_ac7440b6_Tx: ComBitPosition=184, ComBitSize=8, ComSignalInitValue=0, ComSignalType=UINT8, ComSystemTemplateSystemSignalRef=DET_ELEVATION_122
            DET_ELEVATION_123_oRDR_DETECTION_121_124_oPCAN_RADAR_39049423_Tx: ComBitPosition=296, ComBitSize=8, ComSignalInitValue=0, ComSignalType=UINT8, ComSystemTemplateSystemSignalRef=DET_ELEVATION_123
            DET_ELEVATION_124_oRDR_DETECTION_121_124_oPCAN_RADAR_65b4b74a_Tx: ComBitPosition=408, ComBitSize=8, ComSignalInitValue=0, ComSignalType=UINT8, ComSystemTemplateSystemSignalRef=DET_ELEVATION_124
            DET_ELEVATION_ERR_121_oRDR_DETECTION_121_124_oPCAN_RADAR_4fada33d_Tx: ComBitPosition=80, ComBitSize=6, ComSignalInitValue=0, ComSignalType=UINT8, ComSystemTemplateSystemSignalRef=DET_ELEVATION_ERR_121
            DET_ELEVATION_ERR_122_oRDR_DETECTION_121_124_oPCAN_RADAR_2b4dd8c3_Tx: ComBitPosition=192, ComBitSize=6, ComSignalInitValue=0, ComSignalType=UINT8, ComSystemTemplateSystemSignalRef=DET_ELEVATION_ERR_122
            DET_ELEVATION_ERR_123_oRDR_DETECTION_121_124_oPCAN_RADAR_be3d0c56_Tx: ComBitPosition=304, ComBitSize=6, ComSignalInitValue=0, ComSignalType=UINT8, ComSystemTemplateSystemSignalRef=DET_ELEVATION_ERR_123
            DET_ELEVATION_ERR_124_oRDR_DETECTION_121_124_oPCAN_RADAR_e28d2f3f_Tx: ComBitPosition=416, ComBitSize=6, ComSignalInitValue=0, ComSignalType=UINT8, ComSystemTemplateSystemSignalRef=DET_ELEVATION_ERR_124
            DET_EXISTENCE_PROB_121_oRDR_DETECTION_121_124_oPCAN_RADAR_9d32d65d_Tx: ComBitPosition=112, ComBitSize=6, ComSignalInitValue=0, ComSignalType=UINT8, ComSystemTemplateSystemSignalRef=DET_EXISTENCE_PROB_121
            DET_EXISTENCE_PROB_122_oRDR_DETECTION_121_124_oPCAN_RADAR_f9d2ada3_Tx: ComBitPosition=224, ComBitSize=6, ComSignalInitValue=0, ComSignalType=UINT8, ComSystemTemplateSystemSignalRef=DET_EXISTENCE_PROB_122
            DET_EXISTENCE_PROB_123_oRDR_DETECTION_121_124_oPCAN_RADAR_6ca27936_Tx: ComBitPosition=336, ComBitSize=6, ComSignalInitValue=0, ComSignalType=UINT8, ComSystemTemplateSystemSignalRef=DET_EXISTENCE_PROB_123
            DET_EXISTENCE_PROB_124_oRDR_DETECTION_121_124_oPCAN_RADAR_30125a5f_Tx: ComBitPosition=448, ComBitSize=6, ComSignalInitValue=0, ComSignalType=UINT8, ComSystemTemplateSystemSignalRef=DET_EXISTENCE_PROB_124
            DET_HVC_FLAG_121_oRDR_DETECTION_121_124_oPCAN_RADAR_7c469522_Tx: ComBitPosition=86, ComBitSize=1, ComSignalInitValue=0, ComSignalType=BOOLEAN, ComSystemTemplateSystemSignalRef=DET_HVC_FLAG_121
            DET_HVC_FLAG_122_oRDR_DETECTION_121_124_oPCAN_RADAR_18a6eedc_Tx: ComBitPosition=198, ComBitSize=1, ComSignalInitValue=0, ComSignalType=BOOLEAN, ComSystemTemplateSystemSignalRef=DET_HVC_FLAG_122
            DET_HVC_FLAG_123_oRDR_DETECTION_121_124_oPCAN_RADAR_8dd63a49_Tx: ComBitPosition=310, ComBitSize=1, ComSignalInitValue=0, ComSignalType=BOOLEAN, ComSystemTemplateSystemSignalRef=DET_HVC_FLAG_123
            DET_HVC_FLAG_124_oRDR_DETECTION_121_124_oPCAN_RADAR_d1661920_Tx: ComBitPosition=422, ComBitSize=1, ComSignalInitValue=0, ComSignalType=BOOLEAN, ComSystemTemplateSystemSignalRef=DET_HVC_FLAG_124
            DET_IDM_121_oRDR_DETECTION_121_124_oPCAN_RADAR_f714ae9f_Tx: ComBitPosition=63, ComBitSize=1, ComSignalInitValue=0, ComSignalType=BOOLEAN, ComSystemTemplateSystemSignalRef=DET_IDM_121
            DET_IDM_122_oRDR_DETECTION_121_124_oPCAN_RADAR_93f4d561_Tx: ComBitPosition=175, ComBitSize=1, ComSignalInitValue=0, ComSignalType=BOOLEAN, ComSystemTemplateSystemSignalRef=DET_IDM_122
            DET_IDM_123_oRDR_DETECTION_121_124_oPCAN_RADAR_068401f4_Tx: ComBitPosition=287, ComBitSize=1, ComSignalInitValue=0, ComSignalType=BOOLEAN, ComSystemTemplateSystemSignalRef=DET_IDM_123
            DET_IDM_124_oRDR_DETECTION_121_124_oPCAN_RADAR_5a34229d_Tx: ComBitPosition=399, ComBitSize=1, ComSignalInitValue=0, ComSignalType=BOOLEAN, ComSystemTemplateSystemSignalRef=DET_IDM_124
            DET_MH_CRC16_121_124_oRDR_DETECTION_121_124_oPCAN_RADAR_2c1dc540_Tx: ComBitPosition=0, ComBitSize=16, ComSignalInitValue=0, ComSignalType=UINT16, ComSystemTemplateSystemSignalRef=DET_MH_CRC16_121_124
            DET_MH_CYCLE_COUNTER_121_124_oRDR_DETECTION_121_124_oPCAN_RADAR_a8686477_Tx: ComBitPosition=16, ComBitSize=8, ComSignalInitValue=0, ComSignalType=UINT8, ComSystemTemplateSystemSignalRef=DET_MH_CYCLE_COUNTER_121_124
            DET_MH_SCAN_INDEX_4LSB_121_124_oRDR_DETECTION_121_124_oPCAN_RADAR_644241fb_Tx: ComBitPosition=476, ComBitSize=4, ComSignalInitValue=0, ComSignalType=UINT8, ComSystemTemplateSystemSignalRef=DET_MH_SCAN_INDEX_4LSB_121_124
            DET_MTD_121_oRDR_DETECTION_121_124_oPCAN_RADAR_91a79c44_Tx: ComBitPosition=47, ComBitSize=1, ComSignalInitValue=0, ComSignalType=BOOLEAN, ComSystemTemplateSystemSignalRef=DET_MTD_121
            DET_MTD_122_oRDR_DETECTION_121_124_oPCAN_RADAR_f547e7ba_Tx: ComBitPosition=159, ComBitSize=1, ComSignalInitValue=0, ComSignalType=BOOLEAN, ComSystemTemplateSystemSignalRef=DET_MTD_122
            DET_MTD_123_oRDR_DETECTION_121_124_oPCAN_RADAR_6037332f_Tx: ComBitPosition=271, ComBitSize=1, ComSignalInitValue=0, ComSignalType=BOOLEAN, ComSystemTemplateSystemSignalRef=DET_MTD_123
            DET_MTD_124_oRDR_DETECTION_121_124_oPCAN_RADAR_3c871046_Tx: ComBitPosition=383, ComBitSize=1, ComSignalInitValue=0, ComSignalType=BOOLEAN, ComSystemTemplateSystemSignalRef=DET_MTD_124
            DET_PROB_1STAZHYPO_121_oRDR_DETECTION_121_124_oPCAN_RADAR_02137489_Tx: ComBitPosition=103, ComBitSize=1, ComSignalInitValue=0, ComSignalType=BOOLEAN, ComSystemTemplateSystemSignalRef=DET_PROB_1STAZHYPO_121
            DET_PROB_1STAZHYPO_122_oRDR_DETECTION_121_124_oPCAN_RADAR_66f30f77_Tx: ComBitPosition=215, ComBitSize=1, ComSignalInitValue=0, ComSignalType=BOOLEAN, ComSystemTemplateSystemSignalRef=DET_PROB_1STAZHYPO_122
            DET_PROB_1STAZHYPO_123_oRDR_DETECTION_121_124_oPCAN_RADAR_f383dbe2_Tx: ComBitPosition=327, ComBitSize=1, ComSignalInitValue=0, ComSignalType=BOOLEAN, ComSystemTemplateSystemSignalRef=DET_PROB_1STAZHYPO_123
            DET_PROB_1STAZHYPO_124_oRDR_DETECTION_121_124_oPCAN_RADAR_af33f88b_Tx: ComBitPosition=439, ComBitSize=1, ComSignalInitValue=0, ComSignalType=BOOLEAN, ComSystemTemplateSystemSignalRef=DET_PROB_1STAZHYPO_124
            DET_RANGE_121_oRDR_DETECTION_121_124_oPCAN_RADAR_09bc97ff_Tx: ComBitPosition=24, ComBitSize=15, ComSignalInitValue=0, ComSignalType=UINT16, ComSystemTemplateSystemSignalRef=DET_RANGE_121
            DET_RANGE_122_oRDR_DETECTION_121_124_oPCAN_RADAR_6d5cec01_Tx: ComBitPosition=136, ComBitSize=15, ComSignalInitValue=0, ComSignalType=UINT16, ComSystemTemplateSystemSignalRef=DET_RANGE_122
            DET_RANGE_123_oRDR_DETECTION_121_124_oPCAN_RADAR_f82c3894_Tx: ComBitPosition=248, ComBitSize=15, ComSignalInitValue=0, ComSignalType=UINT16, ComSystemTemplateSystemSignalRef=DET_RANGE_123
            DET_RANGE_124_oRDR_DETECTION_121_124_oPCAN_RADAR_a49c1bfd_Tx: ComBitPosition=360, ComBitSize=15, ComSignalInitValue=0, ComSignalType=UINT16, ComSystemTemplateSystemSignalRef=DET_RANGE_124
            DET_RANGE_ERR_121_oRDR_DETECTION_121_124_oPCAN_RADAR_ae542d96_Tx: ComBitPosition=40, ComBitSize=7, ComSignalInitValue=0, ComSignalType=UINT8, ComSystemTemplateSystemSignalRef=DET_RANGE_ERR_121
            DET_RANGE_ERR_122_oRDR_DETECTION_121_124_oPCAN_RADAR_cab45668_Tx: ComBitPosition=152, ComBitSize=7, ComSignalInitValue=0, ComSignalType=UINT8, ComSystemTemplateSystemSignalRef=DET_RANGE_ERR_122
            DET_RANGE_ERR_123_oRDR_DETECTION_121_124_oPCAN_RADAR_5fc482fd_Tx: ComBitPosition=264, ComBitSize=7, ComSignalInitValue=0, ComSignalType=UINT8, ComSystemTemplateSystemSignalRef=DET_RANGE_ERR_123
            DET_RANGE_ERR_124_oRDR_DETECTION_121_124_oPCAN_RADAR_0374a194_Tx: ComBitPosition=376, ComBitSize=7, ComSignalInitValue=0, ComSignalType=UINT8, ComSystemTemplateSystemSignalRef=DET_RANGE_ERR_124
            DET_RANGE_VELOCITY_121_oRDR_DETECTION_121_124_oPCAN_RADAR_7c1a55da_Tx: ComBitPosition=48, ComBitSize=15, ComSignalInitValue=16384, ComSignalType=UINT16, ComSystemTemplateSystemSignalRef=DET_RANGE_VELOCITY_121
            DET_RANGE_VELOCITY_122_oRDR_DETECTION_121_124_oPCAN_RADAR_18fa2e24_Tx: ComBitPosition=160, ComBitSize=15, ComSignalInitValue=16384, ComSignalType=UINT16, ComSystemTemplateSystemSignalRef=DET_RANGE_VELOCITY_122
            DET_RANGE_VELOCITY_123_oRDR_DETECTION_121_124_oPCAN_RADAR_8d8afab1_Tx: ComBitPosition=272, ComBitSize=15, ComSignalInitValue=16384, ComSignalType=UINT16, ComSystemTemplateSystemSignalRef=DET_RANGE_VELOCITY_123
            DET_RANGE_VELOCITY_124_oRDR_DETECTION_121_124_oPCAN_RADAR_d13ad9d8_Tx: ComBitPosition=384, ComBitSize=15, ComSignalInitValue=16384, ComSignalType=UINT16, ComSystemTemplateSystemSignalRef=DET_RANGE_VELOCITY_124
            DET_RANGE_VELOCITY_ERR_121_oRDR_DETECTION_121_124_oPCAN_RADAR_73a1ae68_Tx: ComBitPosition=64, ComBitSize=8, ComSignalInitValue=0, ComSignalType=UINT8, ComSystemTemplateSystemSignalRef=DET_RANGE_VELOCITY_ERR_121
            DET_RANGE_VELOCITY_ERR_122_oRDR_DETECTION_121_124_oPCAN_RADAR_1741d596_Tx: ComBitPosition=176, ComBitSize=8, ComSignalInitValue=0, ComSignalType=UINT8, ComSystemTemplateSystemSignalRef=DET_RANGE_VELOCITY_ERR_122
            DET_RANGE_VELOCITY_ERR_123_oRDR_DETECTION_121_124_oPCAN_RADAR_82310103_Tx: ComBitPosition=288, ComBitSize=8, ComSignalInitValue=0, ComSignalType=UINT8, ComSystemTemplateSystemSignalRef=DET_RANGE_VELOCITY_ERR_123
            DET_RANGE_VELOCITY_ERR_124_oRDR_DETECTION_121_124_oPCAN_RADAR_de81226a_Tx: ComBitPosition=400, ComBitSize=8, ComSignalInitValue=0, ComSignalType=UINT8, ComSystemTemplateSystemSignalRef=DET_RANGE_VELOCITY_ERR_124
            DET_RCS_121_oRDR_DETECTION_121_124_oPCAN_RADAR_fb9a6280_Tx: ComBitPosition=128, ComBitSize=8, ComSignalInitValue=128, ComSignalType=UINT8, ComSystemTemplateSystemSignalRef=DET_RCS_121
            DET_RCS_122_oRDR_DETECTION_121_124_oPCAN_RADAR_9f7a197e_Tx: ComBitPosition=240, ComBitSize=8, ComSignalInitValue=128, ComSignalType=UINT8, ComSystemTemplateSystemSignalRef=DET_RCS_122
            DET_RCS_123_oRDR_DETECTION_121_124_oPCAN_RADAR_0a0acdeb_Tx: ComBitPosition=352, ComBitSize=8, ComSignalInitValue=128, ComSignalType=UINT8, ComSystemTemplateSystemSignalRef=DET_RCS_123
            DET_RCS_124_oRDR_DETECTION_121_124_oPCAN_RADAR_56baee82_Tx: ComBitPosition=464, ComBitSize=8, ComSignalInitValue=128, ComSignalType=UINT8, ComSystemTemplateSystemSignalRef=DET_RCS_124
            DET_SNR_121_oRDR_DETECTION_121_124_oPCAN_RADAR_26343682_Tx: ComBitPosition=120, ComBitSize=8, ComSignalInitValue=0, ComSignalType=UINT8, ComSystemTemplateSystemSignalRef=DET_SNR_121
            DET_SNR_122_oRDR_DETECTION_121_124_oPCAN_RADAR_42d44d7c_Tx: ComBitPosition=232, ComBitSize=8, ComSignalInitValue=0, ComSignalType=UINT8, ComSystemTemplateSystemSignalRef=DET_SNR_122
            DET_SNR_123_oRDR_DETECTION_121_124_oPCAN_RADAR_d7a499e9_Tx: ComBitPosition=344, ComBitSize=8, ComSignalInitValue=0, ComSignalType=UINT8, ComSystemTemplateSystemSignalRef=DET_SNR_123
            DET_SNR_124_oRDR_DETECTION_121_124_oPCAN_RADAR_8b14ba80_Tx: ComBitPosition=456, ComBitSize=8, ComSignalInitValue=0, ComSignalType=UINT8, ComSystemTemplateSystemSignalRef=DET_SNR_124
            DET_SUPER_RES_TARGET_121_oRDR_DETECTION_121_124_oPCAN_RADAR_17ad1ee7_Tx: ComBitPosition=87, ComBitSize=1, ComSignalInitValue=0, ComSignalType=BOOLEAN, ComSystemTemplateSystemSignalRef=DET_SUPER_RES_TARGET_121
            DET_SUPER_RES_TARGET_122_oRDR_DETECTION_121_124_oPCAN_RADAR_734d6519_Tx: ComBitPosition=199, ComBitSize=1, ComSignalInitValue=0, ComSignalType=BOOLEAN, ComSystemTemplateSystemSignalRef=DET_SUPER_RES_TARGET_122
            DET_SUPER_RES_TARGET_123_oRDR_DETECTION_121_124_oPCAN_RADAR_e63db18c_Tx: ComBitPosition=311, ComBitSize=1, ComSignalInitValue=0, ComSignalType=BOOLEAN, ComSystemTemplateSystemSignalRef=DET_SUPER_RES_TARGET_123
            DET_SUPER_RES_TARGET_124_oRDR_DETECTION_121_124_oPCAN_RADAR_ba8d92e5_Tx: ComBitPosition=423, ComBitSize=1, ComSignalInitValue=0, ComSignalType=BOOLEAN, ComSystemTemplateSystemSignalRef=DET_SUPER_RES_TARGET_124
        SG_Detections_125_128_oRDR_DETECTION_125_128_oPCAN_RADAR_d9562319_Tx: ComSystemTemplateSignalGroupRef=SG_Detections_125_128
          83 x ComGroupSignal, all with ComSignalEndianness=LITTLE_ENDIAN, ComTransferProperty=PENDING:
            DET_AZIMUTH_125_oRDR_DETECTION_125_128_oPCAN_RADAR_c8c522e7_Tx: ComBitPosition=88, ComBitSize=13, ComSignalInitValue=0, ComSignalType=UINT16, ComSystemTemplateSystemSignalRef=DET_AZIMUTH_125
            DET_AZIMUTH_126_oRDR_DETECTION_125_128_oPCAN_RADAR_ac255919_Tx: ComBitPosition=200, ComBitSize=13, ComSignalInitValue=0, ComSignalType=UINT16, ComSystemTemplateSystemSignalRef=DET_AZIMUTH_126
            DET_AZIMUTH_127_oRDR_DETECTION_125_128_oPCAN_RADAR_39558d8c_Tx: ComBitPosition=312, ComBitSize=13, ComSignalInitValue=0, ComSignalType=UINT16, ComSystemTemplateSystemSignalRef=DET_AZIMUTH_127
            DET_AZIMUTH_128_oRDR_DETECTION_125_128_oPCAN_RADAR_15451fcb_Tx: ComBitPosition=424, ComBitSize=13, ComSignalInitValue=0, ComSignalType=UINT16, ComSystemTemplateSystemSignalRef=DET_AZIMUTH_128
            DET_AZIMUTH_ERR_125_oRDR_DETECTION_125_128_oPCAN_RADAR_6c70b712_Tx: ComBitPosition=105, ComBitSize=7, ComSignalInitValue=0, ComSignalType=UINT8, ComSystemTemplateSystemSignalRef=DET_AZIMUTH_ERR_125
            DET_AZIMUTH_ERR_126_oRDR_DETECTION_125_128_oPCAN_RADAR_0890ccec_Tx: ComBitPosition=217, ComBitSize=7, ComSignalInitValue=0, ComSignalType=UINT8, ComSystemTemplateSystemSignalRef=DET_AZIMUTH_ERR_126
            DET_AZIMUTH_ERR_127_oRDR_DETECTION_125_128_oPCAN_RADAR_9de01879_Tx: ComBitPosition=329, ComBitSize=7, ComSignalInitValue=0, ComSignalType=UINT8, ComSystemTemplateSystemSignalRef=DET_AZIMUTH_ERR_127
            DET_AZIMUTH_ERR_128_oRDR_DETECTION_125_128_oPCAN_RADAR_b1f08a3e_Tx: ComBitPosition=441, ComBitSize=7, ComSignalInitValue=0, ComSignalType=UINT8, ComSystemTemplateSystemSignalRef=DET_AZIMUTH_ERR_128
            DET_BELOW_RAIN_THOLD_125_oRDR_DETECTION_125_128_oPCAN_RADAR_1dc4b127_Tx: ComBitPosition=39, ComBitSize=1, ComSignalInitValue=0, ComSignalType=BOOLEAN, ComSystemTemplateSystemSignalRef=DET_BELOW_RAIN_THOLD_125
            DET_BELOW_RAIN_THOLD_126_oRDR_DETECTION_125_128_oPCAN_RADAR_7924cad9_Tx: ComBitPosition=151, ComBitSize=1, ComSignalInitValue=0, ComSignalType=BOOLEAN, ComSystemTemplateSystemSignalRef=DET_BELOW_RAIN_THOLD_126
            DET_BELOW_RAIN_THOLD_127_oRDR_DETECTION_125_128_oPCAN_RADAR_ec541e4c_Tx: ComBitPosition=263, ComBitSize=1, ComSignalInitValue=0, ComSignalType=BOOLEAN, ComSystemTemplateSystemSignalRef=DET_BELOW_RAIN_THOLD_127
            DET_BELOW_RAIN_THOLD_128_oRDR_DETECTION_125_128_oPCAN_RADAR_c0448c0b_Tx: ComBitPosition=375, ComBitSize=1, ComSignalInitValue=0, ComSignalType=BOOLEAN, ComSystemTemplateSystemSignalRef=DET_BELOW_RAIN_THOLD_128
            DET_BI_STATIC_FLAG_125_oRDR_DETECTION_125_128_oPCAN_RADAR_9ee96262_Tx: ComBitPosition=104, ComBitSize=1, ComSignalInitValue=0, ComSignalType=BOOLEAN, ComSystemTemplateSystemSignalRef=DET_BI_STATIC_FLAG_125
            DET_BI_STATIC_FLAG_126_oRDR_DETECTION_125_128_oPCAN_RADAR_fa09199c_Tx: ComBitPosition=216, ComBitSize=1, ComSignalInitValue=0, ComSignalType=BOOLEAN, ComSystemTemplateSystemSignalRef=DET_BI_STATIC_FLAG_126
            DET_BI_STATIC_FLAG_127_oRDR_DETECTION_125_128_oPCAN_RADAR_6f79cd09_Tx: ComBitPosition=328, ComBitSize=1, ComSignalInitValue=0, ComSignalType=BOOLEAN, ComSystemTemplateSystemSignalRef=DET_BI_STATIC_FLAG_127
            DET_BI_STATIC_FLAG_128_oRDR_DETECTION_125_128_oPCAN_RADAR_43695f4e_Tx: ComBitPosition=440, ComBitSize=1, ComSignalInitValue=0, ComSignalType=BOOLEAN, ComSystemTemplateSystemSignalRef=DET_BI_STATIC_FLAG_128
            DET_CONFD_AZIMUTH_125_oRDR_DETECTION_125_128_oPCAN_RADAR_ca23282d_Tx: ComBitPosition=118, ComBitSize=2, ComSignalInitValue=0, ComSignalType=UINT8, ComSystemTemplateSystemSignalRef=DET_CONFD_AZIMUTH_125
            DET_CONFD_AZIMUTH_126_oRDR_DETECTION_125_128_oPCAN_RADAR_aec353d3_Tx: ComBitPosition=230, ComBitSize=2, ComSignalInitValue=0, ComSignalType=UINT8, ComSystemTemplateSystemSignalRef=DET_CONFD_AZIMUTH_126
            DET_CONFD_AZIMUTH_127_oRDR_DETECTION_125_128_oPCAN_RADAR_3bb38746_Tx: ComBitPosition=342, ComBitSize=2, ComSignalInitValue=0, ComSignalType=UINT8, ComSystemTemplateSystemSignalRef=DET_CONFD_AZIMUTH_127
            DET_CONFD_AZIMUTH_128_oRDR_DETECTION_125_128_oPCAN_RADAR_17a31501_Tx: ComBitPosition=454, ComBitSize=2, ComSignalInitValue=0, ComSignalType=UINT8, ComSystemTemplateSystemSignalRef=DET_CONFD_AZIMUTH_128
            DET_CONFD_ELEVATION_125_oRDR_DETECTION_125_128_oPCAN_RADAR_c8b629d7_Tx: ComBitPosition=101, ComBitSize=2, ComSignalInitValue=0, ComSignalType=UINT8, ComSystemTemplateSystemSignalRef=DET_CONFD_ELEVATION_125
            DET_CONFD_ELEVATION_126_oRDR_DETECTION_125_128_oPCAN_RADAR_ac565229_Tx: ComBitPosition=213, ComBitSize=2, ComSignalInitValue=0, ComSignalType=UINT8, ComSystemTemplateSystemSignalRef=DET_CONFD_ELEVATION_126
            DET_CONFD_ELEVATION_127_oRDR_DETECTION_125_128_oPCAN_RADAR_392686bc_Tx: ComBitPosition=325, ComBitSize=2, ComSignalInitValue=0, ComSignalType=UINT8, ComSystemTemplateSystemSignalRef=DET_CONFD_ELEVATION_127
            DET_CONFD_ELEVATION_128_oRDR_DETECTION_125_128_oPCAN_RADAR_153614fb_Tx: ComBitPosition=437, ComBitSize=2, ComSignalInitValue=0, ComSignalType=UINT8, ComSystemTemplateSystemSignalRef=DET_CONFD_ELEVATION_128
            DET_ELEVATION_125_oRDR_DETECTION_125_128_oPCAN_RADAR_1976fdeb_Tx: ComBitPosition=72, ComBitSize=8, ComSignalInitValue=0, ComSignalType=UINT8, ComSystemTemplateSystemSignalRef=DET_ELEVATION_125
            DET_ELEVATION_126_oRDR_DETECTION_125_128_oPCAN_RADAR_7d968615_Tx: ComBitPosition=184, ComBitSize=8, ComSignalInitValue=0, ComSignalType=UINT8, ComSystemTemplateSystemSignalRef=DET_ELEVATION_126
            DET_ELEVATION_127_oRDR_DETECTION_125_128_oPCAN_RADAR_e8e65280_Tx: ComBitPosition=296, ComBitSize=8, ComSignalInitValue=0, ComSignalType=UINT8, ComSystemTemplateSystemSignalRef=DET_ELEVATION_127
            DET_ELEVATION_128_oRDR_DETECTION_125_128_oPCAN_RADAR_c4f6c0c7_Tx: ComBitPosition=408, ComBitSize=8, ComSignalInitValue=0, ComSignalType=UINT8, ComSystemTemplateSystemSignalRef=DET_ELEVATION_128
            DET_ELEVATION_ERR_125_oRDR_DETECTION_125_128_oPCAN_RADAR_9e4f659e_Tx: ComBitPosition=80, ComBitSize=6, ComSignalInitValue=0, ComSignalType=UINT8, ComSystemTemplateSystemSignalRef=DET_ELEVATION_ERR_125
            DET_ELEVATION_ERR_126_oRDR_DETECTION_125_128_oPCAN_RADAR_faaf1e60_Tx: ComBitPosition=192, ComBitSize=6, ComSignalInitValue=0, ComSignalType=UINT8, ComSystemTemplateSystemSignalRef=DET_ELEVATION_ERR_126
            DET_ELEVATION_ERR_127_oRDR_DETECTION_125_128_oPCAN_RADAR_6fdfcaf5_Tx: ComBitPosition=304, ComBitSize=6, ComSignalInitValue=0, ComSignalType=UINT8, ComSystemTemplateSystemSignalRef=DET_ELEVATION_ERR_127
            DET_ELEVATION_ERR_128_oRDR_DETECTION_125_128_oPCAN_RADAR_43cf58b2_Tx: ComBitPosition=416, ComBitSize=6, ComSignalInitValue=0, ComSignalType=UINT8, ComSystemTemplateSystemSignalRef=DET_ELEVATION_ERR_128
            DET_EXISTENCE_PROB_125_oRDR_DETECTION_125_128_oPCAN_RADAR_4cd010fe_Tx: ComBitPosition=112, ComBitSize=6, ComSignalInitValue=0, ComSignalType=UINT8, ComSystemTemplateSystemSignalRef=DET_EXISTENCE_PROB_125
            DET_EXISTENCE_PROB_126_oRDR_DETECTION_125_128_oPCAN_RADAR_28306b00_Tx: ComBitPosition=224, ComBitSize=6, ComSignalInitValue=0, ComSignalType=UINT8, ComSystemTemplateSystemSignalRef=DET_EXISTENCE_PROB_126
            DET_EXISTENCE_PROB_127_oRDR_DETECTION_125_128_oPCAN_RADAR_bd40bf95_Tx: ComBitPosition=336, ComBitSize=6, ComSignalInitValue=0, ComSignalType=UINT8, ComSystemTemplateSystemSignalRef=DET_EXISTENCE_PROB_127
            DET_EXISTENCE_PROB_128_oRDR_DETECTION_125_128_oPCAN_RADAR_91502dd2_Tx: ComBitPosition=448, ComBitSize=6, ComSignalInitValue=0, ComSignalType=UINT8, ComSystemTemplateSystemSignalRef=DET_EXISTENCE_PROB_128
            DET_HVC_FLAG_125_oRDR_DETECTION_125_128_oPCAN_RADAR_ada45381_Tx: ComBitPosition=86, ComBitSize=1, ComSignalInitValue=0, ComSignalType=BOOLEAN, ComSystemTemplateSystemSignalRef=DET_HVC_FLAG_125
            DET_HVC_FLAG_126_oRDR_DETECTION_125_128_oPCAN_RADAR_c944287f_Tx: ComBitPosition=198, ComBitSize=1, ComSignalInitValue=0, ComSignalType=BOOLEAN, ComSystemTemplateSystemSignalRef=DET_HVC_FLAG_126
            DET_HVC_FLAG_127_oRDR_DETECTION_125_128_oPCAN_RADAR_5c34fcea_Tx: ComBitPosition=310, ComBitSize=1, ComSignalInitValue=0, ComSignalType=BOOLEAN, ComSystemTemplateSystemSignalRef=DET_HVC_FLAG_127
            DET_HVC_FLAG_128_oRDR_DETECTION_125_128_oPCAN_RADAR_70246ead_Tx: ComBitPosition=422, ComBitSize=1, ComSignalInitValue=0, ComSignalType=BOOLEAN, ComSystemTemplateSystemSignalRef=DET_HVC_FLAG_128
            DET_IDM_125_oRDR_DETECTION_125_128_oPCAN_RADAR_26f6683c_Tx: ComBitPosition=63, ComBitSize=1, ComSignalInitValue=0, ComSignalType=BOOLEAN, ComSystemTemplateSystemSignalRef=DET_IDM_125
            DET_IDM_126_oRDR_DETECTION_125_128_oPCAN_RADAR_421613c2_Tx: ComBitPosition=175, ComBitSize=1, ComSignalInitValue=0, ComSignalType=BOOLEAN, ComSystemTemplateSystemSignalRef=DET_IDM_126
            DET_IDM_127_oRDR_DETECTION_125_128_oPCAN_RADAR_d766c757_Tx: ComBitPosition=287, ComBitSize=1, ComSignalInitValue=0, ComSignalType=BOOLEAN, ComSystemTemplateSystemSignalRef=DET_IDM_127
            DET_IDM_128_oRDR_DETECTION_125_128_oPCAN_RADAR_fb765510_Tx: ComBitPosition=399, ComBitSize=1, ComSignalInitValue=0, ComSignalType=BOOLEAN, ComSystemTemplateSystemSignalRef=DET_IDM_128
            DET_MH_CRC16_125_128_oRDR_DETECTION_125_128_oPCAN_RADAR_5ddef112_Tx: ComBitPosition=0, ComBitSize=16, ComSignalInitValue=0, ComSignalType=UINT16, ComSystemTemplateSystemSignalRef=DET_MH_CRC16_125_128
            DET_MH_CYCLE_COUNTER_125_128_oRDR_DETECTION_125_128_oPCAN_RADAR_d9ab5025_Tx: ComBitPosition=16, ComBitSize=8, ComSignalInitValue=0, ComSignalType=UINT8, ComSystemTemplateSystemSignalRef=DET_MH_CYCLE_COUNTER_125_128
            DET_MH_SCAN_INDEX_4LSB_125_128_oRDR_DETECTION_125_128_oPCAN_RADAR_158175a9_Tx: ComBitPosition=476, ComBitSize=4, ComSignalInitValue=0, ComSignalType=UINT8, ComSystemTemplateSystemSignalRef=DET_MH_SCAN_INDEX_4LSB_125_128
            DET_MTD_125_oRDR_DETECTION_125_128_oPCAN_RADAR_40455ae7_Tx: ComBitPosition=47, ComBitSize=1, ComSignalInitValue=0, ComSignalType=BOOLEAN, ComSystemTemplateSystemSignalRef=DET_MTD_125
            DET_MTD_126_oRDR_DETECTION_125_128_oPCAN_RADAR_24a52119_Tx: ComBitPosition=159, ComBitSize=1, ComSignalInitValue=0, ComSignalType=BOOLEAN, ComSystemTemplateSystemSignalRef=DET_MTD_126
            DET_MTD_127_oRDR_DETECTION_125_128_oPCAN_RADAR_b1d5f58c_Tx: ComBitPosition=271, ComBitSize=1, ComSignalInitValue=0, ComSignalType=BOOLEAN, ComSystemTemplateSystemSignalRef=DET_MTD_127
            DET_MTD_128_oRDR_DETECTION_125_128_oPCAN_RADAR_9dc567cb_Tx: ComBitPosition=383, ComBitSize=1, ComSignalInitValue=0, ComSignalType=BOOLEAN, ComSystemTemplateSystemSignalRef=DET_MTD_128
            DET_PROB_1STAZHYPO_125_oRDR_DETECTION_125_128_oPCAN_RADAR_d3f1b22a_Tx: ComBitPosition=103, ComBitSize=1, ComSignalInitValue=0, ComSignalType=BOOLEAN, ComSystemTemplateSystemSignalRef=DET_PROB_1STAZHYPO_125
            DET_PROB_1STAZHYPO_126_oRDR_DETECTION_125_128_oPCAN_RADAR_b711c9d4_Tx: ComBitPosition=215, ComBitSize=1, ComSignalInitValue=0, ComSignalType=BOOLEAN, ComSystemTemplateSystemSignalRef=DET_PROB_1STAZHYPO_126
            DET_PROB_1STAZHYPO_127_oRDR_DETECTION_125_128_oPCAN_RADAR_22611d41_Tx: ComBitPosition=327, ComBitSize=1, ComSignalInitValue=0, ComSignalType=BOOLEAN, ComSystemTemplateSystemSignalRef=DET_PROB_1STAZHYPO_127
            DET_PROB_1STAZHYPO_128_oRDR_DETECTION_125_128_oPCAN_RADAR_0e718f06_Tx: ComBitPosition=439, ComBitSize=1, ComSignalInitValue=0, ComSignalType=BOOLEAN, ComSystemTemplateSystemSignalRef=DET_PROB_1STAZHYPO_128
            DET_RANGE_125_oRDR_DETECTION_125_128_oPCAN_RADAR_d85e515c_Tx: ComBitPosition=24, ComBitSize=15, ComSignalInitValue=0, ComSignalType=UINT16, ComSystemTemplateSystemSignalRef=DET_RANGE_125
            DET_RANGE_126_oRDR_DETECTION_125_128_oPCAN_RADAR_bcbe2aa2_Tx: ComBitPosition=136, ComBitSize=15, ComSignalInitValue=0, ComSignalType=UINT16, ComSystemTemplateSystemSignalRef=DET_RANGE_126
            DET_RANGE_127_oRDR_DETECTION_125_128_oPCAN_RADAR_29cefe37_Tx: ComBitPosition=248, ComBitSize=15, ComSignalInitValue=0, ComSignalType=UINT16, ComSystemTemplateSystemSignalRef=DET_RANGE_127
            DET_RANGE_128_oRDR_DETECTION_125_128_oPCAN_RADAR_05de6c70_Tx: ComBitPosition=360, ComBitSize=15, ComSignalInitValue=0, ComSignalType=UINT16, ComSystemTemplateSystemSignalRef=DET_RANGE_128
            DET_RANGE_ERR_125_oRDR_DETECTION_125_128_oPCAN_RADAR_7fb6eb35_Tx: ComBitPosition=40, ComBitSize=7, ComSignalInitValue=0, ComSignalType=UINT8, ComSystemTemplateSystemSignalRef=DET_RANGE_ERR_125
            DET_RANGE_ERR_126_oRDR_DETECTION_125_128_oPCAN_RADAR_1b5690cb_Tx: ComBitPosition=152, ComBitSize=7, ComSignalInitValue=0, ComSignalType=UINT8, ComSystemTemplateSystemSignalRef=DET_RANGE_ERR_126
            DET_RANGE_ERR_127_oRDR_DETECTION_125_128_oPCAN_RADAR_8e26445e_Tx: ComBitPosition=264, ComBitSize=7, ComSignalInitValue=0, ComSignalType=UINT8, ComSystemTemplateSystemSignalRef=DET_RANGE_ERR_127
            DET_RANGE_ERR_128_oRDR_DETECTION_125_128_oPCAN_RADAR_a236d619_Tx: ComBitPosition=376, ComBitSize=7, ComSignalInitValue=0, ComSignalType=UINT8, ComSystemTemplateSystemSignalRef=DET_RANGE_ERR_128
            DET_RANGE_VELOCITY_125_oRDR_DETECTION_125_128_oPCAN_RADAR_adf89379_Tx: ComBitPosition=48, ComBitSize=15, ComSignalInitValue=16384, ComSignalType=UINT16, ComSystemTemplateSystemSignalRef=DET_RANGE_VELOCITY_125
            DET_RANGE_VELOCITY_126_oRDR_DETECTION_125_128_oPCAN_RADAR_c918e887_Tx: ComBitPosition=160, ComBitSize=15, ComSignalInitValue=16384, ComSignalType=UINT16, ComSystemTemplateSystemSignalRef=DET_RANGE_VELOCITY_126
            DET_RANGE_VELOCITY_127_oRDR_DETECTION_125_128_oPCAN_RADAR_5c683c12_Tx: ComBitPosition=272, ComBitSize=15, ComSignalInitValue=16384, ComSignalType=UINT16, ComSystemTemplateSystemSignalRef=DET_RANGE_VELOCITY_127
            DET_RANGE_VELOCITY_128_oRDR_DETECTION_125_128_oPCAN_RADAR_7078ae55_Tx: ComBitPosition=384, ComBitSize=15, ComSignalInitValue=16384, ComSignalType=UINT16, ComSystemTemplateSystemSignalRef=DET_RANGE_VELOCITY_128
            DET_RANGE_VELOCITY_ERR_125_oRDR_DETECTION_125_128_oPCAN_RADAR_a24368cb_Tx: ComBitPosition=64, ComBitSize=8, ComSignalInitValue=0, ComSignalType=UINT8, ComSystemTemplateSystemSignalRef=DET_RANGE_VELOCITY_ERR_125
            DET_RANGE_VELOCITY_ERR_126_oRDR_DETECTION_125_128_oPCAN_RADAR_c6a31335_Tx: ComBitPosition=176, ComBitSize=8, ComSignalInitValue=0, ComSignalType=UINT8, ComSystemTemplateSystemSignalRef=DET_RANGE_VELOCITY_ERR_126
            DET_RANGE_VELOCITY_ERR_127_oRDR_DETECTION_125_128_oPCAN_RADAR_53d3c7a0_Tx: ComBitPosition=288, ComBitSize=8, ComSignalInitValue=0, ComSignalType=UINT8, ComSystemTemplateSystemSignalRef=DET_RANGE_VELOCITY_ERR_127
            DET_RANGE_VELOCITY_ERR_128_oRDR_DETECTION_125_128_oPCAN_RADAR_7fc355e7_Tx: ComBitPosition=400, ComBitSize=8, ComSignalInitValue=0, ComSignalType=UINT8, ComSystemTemplateSystemSignalRef=DET_RANGE_VELOCITY_ERR_128
            DET_RCS_125_oRDR_DETECTION_125_128_oPCAN_RADAR_2a78a423_Tx: ComBitPosition=128, ComBitSize=8, ComSignalInitValue=128, ComSignalType=UINT8, ComSystemTemplateSystemSignalRef=DET_RCS_125
            DET_RCS_126_oRDR_DETECTION_125_128_oPCAN_RADAR_4e98dfdd_Tx: ComBitPosition=240, ComBitSize=8, ComSignalInitValue=128, ComSignalType=UINT8, ComSystemTemplateSystemSignalRef=DET_RCS_126
            DET_RCS_127_oRDR_DETECTION_125_128_oPCAN_RADAR_dbe80b48_Tx: ComBitPosition=352, ComBitSize=8, ComSignalInitValue=128, ComSignalType=UINT8, ComSystemTemplateSystemSignalRef=DET_RCS_127
            DET_RCS_128_oRDR_DETECTION_125_128_oPCAN_RADAR_f7f8990f_Tx: ComBitPosition=464, ComBitSize=8, ComSignalInitValue=128, ComSignalType=UINT8, ComSystemTemplateSystemSignalRef=DET_RCS_128
            DET_SNR_125_oRDR_DETECTION_125_128_oPCAN_RADAR_f7d6f021_Tx: ComBitPosition=120, ComBitSize=8, ComSignalInitValue=0, ComSignalType=UINT8, ComSystemTemplateSystemSignalRef=DET_SNR_125
            DET_SNR_126_oRDR_DETECTION_125_128_oPCAN_RADAR_93368bdf_Tx: ComBitPosition=232, ComBitSize=8, ComSignalInitValue=0, ComSignalType=UINT8, ComSystemTemplateSystemSignalRef=DET_SNR_126
            DET_SNR_127_oRDR_DETECTION_125_128_oPCAN_RADAR_06465f4a_Tx: ComBitPosition=344, ComBitSize=8, ComSignalInitValue=0, ComSignalType=UINT8, ComSystemTemplateSystemSignalRef=DET_SNR_127
            DET_SNR_128_oRDR_DETECTION_125_128_oPCAN_RADAR_2a56cd0d_Tx: ComBitPosition=456, ComBitSize=8, ComSignalInitValue=0, ComSignalType=UINT8, ComSystemTemplateSystemSignalRef=DET_SNR_128
            DET_SUPER_RES_TARGET_125_oRDR_DETECTION_125_128_oPCAN_RADAR_c64fd844_Tx: ComBitPosition=87, ComBitSize=1, ComSignalInitValue=0, ComSignalType=BOOLEAN, ComSystemTemplateSystemSignalRef=DET_SUPER_RES_TARGET_125
            DET_SUPER_RES_TARGET_126_oRDR_DETECTION_125_128_oPCAN_RADAR_a2afa3ba_Tx: ComBitPosition=199, ComBitSize=1, ComSignalInitValue=0, ComSignalType=BOOLEAN, ComSystemTemplateSystemSignalRef=DET_SUPER_RES_TARGET_126
            DET_SUPER_RES_TARGET_127_oRDR_DETECTION_125_128_oPCAN_RADAR_37df772f_Tx: ComBitPosition=311, ComBitSize=1, ComSignalInitValue=0, ComSignalType=BOOLEAN, ComSystemTemplateSystemSignalRef=DET_SUPER_RES_TARGET_127
            DET_SUPER_RES_TARGET_128_oRDR_DETECTION_125_128_oPCAN_RADAR_1bcfe568_Tx: ComBitPosition=423, ComBitSize=1, ComSignalInitValue=0, ComSignalType=BOOLEAN, ComSystemTemplateSystemSignalRef=DET_SUPER_RES_TARGET_128
        SG_Detections_129_132_oRDR_DETECTION_129_132_oPCAN_RADAR_402c0762_Tx: ComSystemTemplateSignalGroupRef=SG_Detections_129_132
          83 x ComGroupSignal, all with ComSignalEndianness=LITTLE_ENDIAN, ComTransferProperty=PENDING:
            DET_AZIMUTH_129_oRDR_DETECTION_129_132_oPCAN_RADAR_b27d245f_Tx: ComBitPosition=88, ComBitSize=13, ComSignalInitValue=0, ComSignalType=UINT16, ComSystemTemplateSystemSignalRef=DET_AZIMUTH_129
            DET_AZIMUTH_130_oRDR_DETECTION_129_132_oPCAN_RADAR_d75d56fb_Tx: ComBitPosition=200, ComBitSize=13, ComSignalInitValue=0, ComSignalType=UINT16, ComSystemTemplateSystemSignalRef=DET_AZIMUTH_130
            DET_AZIMUTH_131_oRDR_DETECTION_129_132_oPCAN_RADAR_422d826e_Tx: ComBitPosition=312, ComBitSize=13, ComSignalInitValue=0, ComSignalType=UINT16, ComSystemTemplateSystemSignalRef=DET_AZIMUTH_131
            DET_AZIMUTH_132_oRDR_DETECTION_129_132_oPCAN_RADAR_26cdf990_Tx: ComBitPosition=424, ComBitSize=13, ComSignalInitValue=0, ComSignalType=UINT16, ComSystemTemplateSystemSignalRef=DET_AZIMUTH_132
            DET_AZIMUTH_ERR_129_oRDR_DETECTION_129_132_oPCAN_RADAR_16c8b1aa_Tx: ComBitPosition=105, ComBitSize=7, ComSignalInitValue=0, ComSignalType=UINT8, ComSystemTemplateSystemSignalRef=DET_AZIMUTH_ERR_129
            DET_AZIMUTH_ERR_130_oRDR_DETECTION_129_132_oPCAN_RADAR_73e8c30e_Tx: ComBitPosition=217, ComBitSize=7, ComSignalInitValue=0, ComSignalType=UINT8, ComSystemTemplateSystemSignalRef=DET_AZIMUTH_ERR_130
            DET_AZIMUTH_ERR_131_oRDR_DETECTION_129_132_oPCAN_RADAR_e698179b_Tx: ComBitPosition=329, ComBitSize=7, ComSignalInitValue=0, ComSignalType=UINT8, ComSystemTemplateSystemSignalRef=DET_AZIMUTH_ERR_131
            DET_AZIMUTH_ERR_132_oRDR_DETECTION_129_132_oPCAN_RADAR_82786c65_Tx: ComBitPosition=441, ComBitSize=7, ComSignalInitValue=0, ComSignalType=UINT8, ComSystemTemplateSystemSignalRef=DET_AZIMUTH_ERR_132
            DET_BELOW_RAIN_THOLD_129_oRDR_DETECTION_129_132_oPCAN_RADAR_677cb79f_Tx: ComBitPosition=39, ComBitSize=1, ComSignalInitValue=0, ComSignalType=BOOLEAN, ComSystemTemplateSystemSignalRef=DET_BELOW_RAIN_THOLD_129
            DET_BELOW_RAIN_THOLD_130_oRDR_DETECTION_129_132_oPCAN_RADAR_025cc53b_Tx: ComBitPosition=151, ComBitSize=1, ComSignalInitValue=0, ComSignalType=BOOLEAN, ComSystemTemplateSystemSignalRef=DET_BELOW_RAIN_THOLD_130
            DET_BELOW_RAIN_THOLD_131_oRDR_DETECTION_129_132_oPCAN_RADAR_972c11ae_Tx: ComBitPosition=263, ComBitSize=1, ComSignalInitValue=0, ComSignalType=BOOLEAN, ComSystemTemplateSystemSignalRef=DET_BELOW_RAIN_THOLD_131
            DET_BELOW_RAIN_THOLD_132_oRDR_DETECTION_129_132_oPCAN_RADAR_f3cc6a50_Tx: ComBitPosition=375, ComBitSize=1, ComSignalInitValue=0, ComSignalType=BOOLEAN, ComSystemTemplateSystemSignalRef=DET_BELOW_RAIN_THOLD_132
            DET_BI_STATIC_FLAG_129_oRDR_DETECTION_129_132_oPCAN_RADAR_e45164da_Tx: ComBitPosition=104, ComBitSize=1, ComSignalInitValue=0, ComSignalType=BOOLEAN, ComSystemTemplateSystemSignalRef=DET_BI_STATIC_FLAG_129
            DET_BI_STATIC_FLAG_130_oRDR_DETECTION_129_132_oPCAN_RADAR_8171167e_Tx: ComBitPosition=216, ComBitSize=1, ComSignalInitValue=0, ComSignalType=BOOLEAN, ComSystemTemplateSystemSignalRef=DET_BI_STATIC_FLAG_130
            DET_BI_STATIC_FLAG_131_oRDR_DETECTION_129_132_oPCAN_RADAR_1401c2eb_Tx: ComBitPosition=328, ComBitSize=1, ComSignalInitValue=0, ComSignalType=BOOLEAN, ComSystemTemplateSystemSignalRef=DET_BI_STATIC_FLAG_131
            DET_BI_STATIC_FLAG_132_oRDR_DETECTION_129_132_oPCAN_RADAR_70e1b915_Tx: ComBitPosition=440, ComBitSize=1, ComSignalInitValue=0, ComSignalType=BOOLEAN, ComSystemTemplateSystemSignalRef=DET_BI_STATIC_FLAG_132
            DET_CONFD_AZIMUTH_129_oRDR_DETECTION_129_132_oPCAN_RADAR_b09b2e95_Tx: ComBitPosition=118, ComBitSize=2, ComSignalInitValue=0, ComSignalType=UINT8, ComSystemTemplateSystemSignalRef=DET_CONFD_AZIMUTH_129
            DET_CONFD_AZIMUTH_130_oRDR_DETECTION_129_132_oPCAN_RADAR_d5bb5c31_Tx: ComBitPosition=230, ComBitSize=2, ComSignalInitValue=0, ComSignalType=UINT8, ComSystemTemplateSystemSignalRef=DET_CONFD_AZIMUTH_130
            DET_CONFD_AZIMUTH_131_oRDR_DETECTION_129_132_oPCAN_RADAR_40cb88a4_Tx: ComBitPosition=342, ComBitSize=2, ComSignalInitValue=0, ComSignalType=UINT8, ComSystemTemplateSystemSignalRef=DET_CONFD_AZIMUTH_131
            DET_CONFD_AZIMUTH_132_oRDR_DETECTION_129_132_oPCAN_RADAR_242bf35a_Tx: ComBitPosition=454, ComBitSize=2, ComSignalInitValue=0, ComSignalType=UINT8, ComSystemTemplateSystemSignalRef=DET_CONFD_AZIMUTH_132
            DET_CONFD_ELEVATION_129_oRDR_DETECTION_129_132_oPCAN_RADAR_b20e2f6f_Tx: ComBitPosition=101, ComBitSize=2, ComSignalInitValue=0, ComSignalType=UINT8, ComSystemTemplateSystemSignalRef=DET_CONFD_ELEVATION_129
            DET_CONFD_ELEVATION_130_oRDR_DETECTION_129_132_oPCAN_RADAR_d72e5dcb_Tx: ComBitPosition=213, ComBitSize=2, ComSignalInitValue=0, ComSignalType=UINT8, ComSystemTemplateSystemSignalRef=DET_CONFD_ELEVATION_130
            DET_CONFD_ELEVATION_131_oRDR_DETECTION_129_132_oPCAN_RADAR_425e895e_Tx: ComBitPosition=325, ComBitSize=2, ComSignalInitValue=0, ComSignalType=UINT8, ComSystemTemplateSystemSignalRef=DET_CONFD_ELEVATION_131
            DET_CONFD_ELEVATION_132_oRDR_DETECTION_129_132_oPCAN_RADAR_26bef2a0_Tx: ComBitPosition=437, ComBitSize=2, ComSignalInitValue=0, ComSignalType=UINT8, ComSystemTemplateSystemSignalRef=DET_CONFD_ELEVATION_132
            DET_ELEVATION_129_oRDR_DETECTION_129_132_oPCAN_RADAR_63cefb53_Tx: ComBitPosition=72, ComBitSize=8, ComSignalInitValue=0, ComSignalType=UINT8, ComSystemTemplateSystemSignalRef=DET_ELEVATION_129
            DET_ELEVATION_130_oRDR_DETECTION_129_132_oPCAN_RADAR_06ee89f7_Tx: ComBitPosition=184, ComBitSize=8, ComSignalInitValue=0, ComSignalType=UINT8, ComSystemTemplateSystemSignalRef=DET_ELEVATION_130
            DET_ELEVATION_131_oRDR_DETECTION_129_132_oPCAN_RADAR_939e5d62_Tx: ComBitPosition=296, ComBitSize=8, ComSignalInitValue=0, ComSignalType=UINT8, ComSystemTemplateSystemSignalRef=DET_ELEVATION_131
            DET_ELEVATION_132_oRDR_DETECTION_129_132_oPCAN_RADAR_f77e269c_Tx: ComBitPosition=408, ComBitSize=8, ComSignalInitValue=0, ComSignalType=UINT8, ComSystemTemplateSystemSignalRef=DET_ELEVATION_132
            DET_ELEVATION_ERR_129_oRDR_DETECTION_129_132_oPCAN_RADAR_e4f76326_Tx: ComBitPosition=80, ComBitSize=6, ComSignalInitValue=0, ComSignalType=UINT8, ComSystemTemplateSystemSignalRef=DET_ELEVATION_ERR_129
            DET_ELEVATION_ERR_130_oRDR_DETECTION_129_132_oPCAN_RADAR_81d71182_Tx: ComBitPosition=192, ComBitSize=6, ComSignalInitValue=0, ComSignalType=UINT8, ComSystemTemplateSystemSignalRef=DET_ELEVATION_ERR_130
            DET_ELEVATION_ERR_131_oRDR_DETECTION_129_132_oPCAN_RADAR_14a7c517_Tx: ComBitPosition=304, ComBitSize=6, ComSignalInitValue=0, ComSignalType=UINT8, ComSystemTemplateSystemSignalRef=DET_ELEVATION_ERR_131
            DET_ELEVATION_ERR_132_oRDR_DETECTION_129_132_oPCAN_RADAR_7047bee9_Tx: ComBitPosition=416, ComBitSize=6, ComSignalInitValue=0, ComSignalType=UINT8, ComSystemTemplateSystemSignalRef=DET_ELEVATION_ERR_132
            DET_EXISTENCE_PROB_129_oRDR_DETECTION_129_132_oPCAN_RADAR_36681646_Tx: ComBitPosition=112, ComBitSize=6, ComSignalInitValue=0, ComSignalType=UINT8, ComSystemTemplateSystemSignalRef=DET_EXISTENCE_PROB_129
            DET_EXISTENCE_PROB_130_oRDR_DETECTION_129_132_oPCAN_RADAR_534864e2_Tx: ComBitPosition=224, ComBitSize=6, ComSignalInitValue=0, ComSignalType=UINT8, ComSystemTemplateSystemSignalRef=DET_EXISTENCE_PROB_130
            DET_EXISTENCE_PROB_131_oRDR_DETECTION_129_132_oPCAN_RADAR_c638b077_Tx: ComBitPosition=336, ComBitSize=6, ComSignalInitValue=0, ComSignalType=UINT8, ComSystemTemplateSystemSignalRef=DET_EXISTENCE_PROB_131
            DET_EXISTENCE_PROB_132_oRDR_DETECTION_129_132_oPCAN_RADAR_a2d8cb89_Tx: ComBitPosition=448, ComBitSize=6, ComSignalInitValue=0, ComSignalType=UINT8, ComSystemTemplateSystemSignalRef=DET_EXISTENCE_PROB_132
            DET_HVC_FLAG_129_oRDR_DETECTION_129_132_oPCAN_RADAR_d71c5539_Tx: ComBitPosition=86, ComBitSize=1, ComSignalInitValue=0, ComSignalType=BOOLEAN, ComSystemTemplateSystemSignalRef=DET_HVC_FLAG_129
            DET_HVC_FLAG_130_oRDR_DETECTION_129_132_oPCAN_RADAR_b23c279d_Tx: ComBitPosition=198, ComBitSize=1, ComSignalInitValue=0, ComSignalType=BOOLEAN, ComSystemTemplateSystemSignalRef=DET_HVC_FLAG_130
            DET_HVC_FLAG_131_oRDR_DETECTION_129_132_oPCAN_RADAR_274cf308_Tx: ComBitPosition=310, ComBitSize=1, ComSignalInitValue=0, ComSignalType=BOOLEAN, ComSystemTemplateSystemSignalRef=DET_HVC_FLAG_131
            DET_HVC_FLAG_132_oRDR_DETECTION_129_132_oPCAN_RADAR_43ac88f6_Tx: ComBitPosition=422, ComBitSize=1, ComSignalInitValue=0, ComSignalType=BOOLEAN, ComSystemTemplateSystemSignalRef=DET_HVC_FLAG_132
            DET_IDM_129_oRDR_DETECTION_129_132_oPCAN_RADAR_5c4e6e84_Tx: ComBitPosition=63, ComBitSize=1, ComSignalInitValue=0, ComSignalType=BOOLEAN, ComSystemTemplateSystemSignalRef=DET_IDM_129
            DET_IDM_130_oRDR_DETECTION_129_132_oPCAN_RADAR_396e1c20_Tx: ComBitPosition=175, ComBitSize=1, ComSignalInitValue=0, ComSignalType=BOOLEAN, ComSystemTemplateSystemSignalRef=DET_IDM_130
            DET_IDM_131_oRDR_DETECTION_129_132_oPCAN_RADAR_ac1ec8b5_Tx: ComBitPosition=287, ComBitSize=1, ComSignalInitValue=0, ComSignalType=BOOLEAN, ComSystemTemplateSystemSignalRef=DET_IDM_131
            DET_IDM_132_oRDR_DETECTION_129_132_oPCAN_RADAR_c8feb34b_Tx: ComBitPosition=399, ComBitSize=1, ComSignalInitValue=0, ComSignalType=BOOLEAN, ComSystemTemplateSystemSignalRef=DET_IDM_132
            DET_MH_CRC16_129_132_oRDR_DETECTION_129_132_oPCAN_RADAR_c4a4d569_Tx: ComBitPosition=0, ComBitSize=16, ComSignalInitValue=0, ComSignalType=UINT16, ComSystemTemplateSystemSignalRef=DET_MH_CRC16_129_132
            DET_MH_CYCLE_COUNTER_129_132_oRDR_DETECTION_129_132_oPCAN_RADAR_40d1745e_Tx: ComBitPosition=16, ComBitSize=8, ComSignalInitValue=0, ComSignalType=UINT8, ComSystemTemplateSystemSignalRef=DET_MH_CYCLE_COUNTER_129_132
            DET_MH_SCAN_INDEX_4LSB_129_132_oRDR_DETECTION_129_132_oPCAN_RADAR_8cfb51d2_Tx: ComBitPosition=476, ComBitSize=4, ComSignalInitValue=0, ComSignalType=UINT8, ComSystemTemplateSystemSignalRef=DET_MH_SCAN_INDEX_4LSB_129_132
            DET_MTD_129_oRDR_DETECTION_129_132_oPCAN_RADAR_3afd5c5f_Tx: ComBitPosition=47, ComBitSize=1, ComSignalInitValue=0, ComSignalType=BOOLEAN, ComSystemTemplateSystemSignalRef=DET_MTD_129
            DET_MTD_130_oRDR_DETECTION_129_132_oPCAN_RADAR_5fdd2efb_Tx: ComBitPosition=159, ComBitSize=1, ComSignalInitValue=0, ComSignalType=BOOLEAN, ComSystemTemplateSystemSignalRef=DET_MTD_130
            DET_MTD_131_oRDR_DETECTION_129_132_oPCAN_RADAR_caadfa6e_Tx: ComBitPosition=271, ComBitSize=1, ComSignalInitValue=0, ComSignalType=BOOLEAN, ComSystemTemplateSystemSignalRef=DET_MTD_131
            DET_MTD_132_oRDR_DETECTION_129_132_oPCAN_RADAR_ae4d8190_Tx: ComBitPosition=383, ComBitSize=1, ComSignalInitValue=0, ComSignalType=BOOLEAN, ComSystemTemplateSystemSignalRef=DET_MTD_132
            DET_PROB_1STAZHYPO_129_oRDR_DETECTION_129_132_oPCAN_RADAR_a949b492_Tx: ComBitPosition=103, ComBitSize=1, ComSignalInitValue=0, ComSignalType=BOOLEAN, ComSystemTemplateSystemSignalRef=DET_PROB_1STAZHYPO_129
            DET_PROB_1STAZHYPO_130_oRDR_DETECTION_129_132_oPCAN_RADAR_cc69c636_Tx: ComBitPosition=215, ComBitSize=1, ComSignalInitValue=0, ComSignalType=BOOLEAN, ComSystemTemplateSystemSignalRef=DET_PROB_1STAZHYPO_130
            DET_PROB_1STAZHYPO_131_oRDR_DETECTION_129_132_oPCAN_RADAR_591912a3_Tx: ComBitPosition=327, ComBitSize=1, ComSignalInitValue=0, ComSignalType=BOOLEAN, ComSystemTemplateSystemSignalRef=DET_PROB_1STAZHYPO_131
            DET_PROB_1STAZHYPO_132_oRDR_DETECTION_129_132_oPCAN_RADAR_3df9695d_Tx: ComBitPosition=439, ComBitSize=1, ComSignalInitValue=0, ComSignalType=BOOLEAN, ComSystemTemplateSystemSignalRef=DET_PROB_1STAZHYPO_132
            DET_RANGE_129_oRDR_DETECTION_129_132_oPCAN_RADAR_a2e657e4_Tx: ComBitPosition=24, ComBitSize=15, ComSignalInitValue=0, ComSignalType=UINT16, ComSystemTemplateSystemSignalRef=DET_RANGE_129
            DET_RANGE_130_oRDR_DETECTION_129_132_oPCAN_RADAR_c7c62540_Tx: ComBitPosition=136, ComBitSize=15, ComSignalInitValue=0, ComSignalType=UINT16, ComSystemTemplateSystemSignalRef=DET_RANGE_130
            DET_RANGE_131_oRDR_DETECTION_129_132_oPCAN_RADAR_52b6f1d5_Tx: ComBitPosition=248, ComBitSize=15, ComSignalInitValue=0, ComSignalType=UINT16, ComSystemTemplateSystemSignalRef=DET_RANGE_131
            DET_RANGE_132_oRDR_DETECTION_129_132_oPCAN_RADAR_36568a2b_Tx: ComBitPosition=360, ComBitSize=15, ComSignalInitValue=0, ComSignalType=UINT16, ComSystemTemplateSystemSignalRef=DET_RANGE_132
            DET_RANGE_ERR_129_oRDR_DETECTION_129_132_oPCAN_RADAR_050eed8d_Tx: ComBitPosition=40, ComBitSize=7, ComSignalInitValue=0, ComSignalType=UINT8, ComSystemTemplateSystemSignalRef=DET_RANGE_ERR_129
            DET_RANGE_ERR_130_oRDR_DETECTION_129_132_oPCAN_RADAR_602e9f29_Tx: ComBitPosition=152, ComBitSize=7, ComSignalInitValue=0, ComSignalType=UINT8, ComSystemTemplateSystemSignalRef=DET_RANGE_ERR_130
            DET_RANGE_ERR_131_oRDR_DETECTION_129_132_oPCAN_RADAR_f55e4bbc_Tx: ComBitPosition=264, ComBitSize=7, ComSignalInitValue=0, ComSignalType=UINT8, ComSystemTemplateSystemSignalRef=DET_RANGE_ERR_131
            DET_RANGE_ERR_132_oRDR_DETECTION_129_132_oPCAN_RADAR_91be3042_Tx: ComBitPosition=376, ComBitSize=7, ComSignalInitValue=0, ComSignalType=UINT8, ComSystemTemplateSystemSignalRef=DET_RANGE_ERR_132
            DET_RANGE_VELOCITY_129_oRDR_DETECTION_129_132_oPCAN_RADAR_d74095c1_Tx: ComBitPosition=48, ComBitSize=15, ComSignalInitValue=16384, ComSignalType=UINT16, ComSystemTemplateSystemSignalRef=DET_RANGE_VELOCITY_129
            DET_RANGE_VELOCITY_130_oRDR_DETECTION_129_132_oPCAN_RADAR_b260e765_Tx: ComBitPosition=160, ComBitSize=15, ComSignalInitValue=16384, ComSignalType=UINT16, ComSystemTemplateSystemSignalRef=DET_RANGE_VELOCITY_130
            DET_RANGE_VELOCITY_131_oRDR_DETECTION_129_132_oPCAN_RADAR_271033f0_Tx: ComBitPosition=272, ComBitSize=15, ComSignalInitValue=16384, ComSignalType=UINT16, ComSystemTemplateSystemSignalRef=DET_RANGE_VELOCITY_131
            DET_RANGE_VELOCITY_132_oRDR_DETECTION_129_132_oPCAN_RADAR_43f0480e_Tx: ComBitPosition=384, ComBitSize=15, ComSignalInitValue=16384, ComSignalType=UINT16, ComSystemTemplateSystemSignalRef=DET_RANGE_VELOCITY_132
            DET_RANGE_VELOCITY_ERR_129_oRDR_DETECTION_129_132_oPCAN_RADAR_d8fb6e73_Tx: ComBitPosition=64, ComBitSize=8, ComSignalInitValue=0, ComSignalType=UINT8, ComSystemTemplateSystemSignalRef=DET_RANGE_VELOCITY_ERR_129
            DET_RANGE_VELOCITY_ERR_130_oRDR_DETECTION_129_132_oPCAN_RADAR_bddb1cd7_Tx: ComBitPosition=176, ComBitSize=8, ComSignalInitValue=0, ComSignalType=UINT8, ComSystemTemplateSystemSignalRef=DET_RANGE_VELOCITY_ERR_130
            DET_RANGE_VELOCITY_ERR_131_oRDR_DETECTION_129_132_oPCAN_RADAR_28abc842_Tx: ComBitPosition=288, ComBitSize=8, ComSignalInitValue=0, ComSignalType=UINT8, ComSystemTemplateSystemSignalRef=DET_RANGE_VELOCITY_ERR_131
            DET_RANGE_VELOCITY_ERR_132_oRDR_DETECTION_129_132_oPCAN_RADAR_4c4bb3bc_Tx: ComBitPosition=400, ComBitSize=8, ComSignalInitValue=0, ComSignalType=UINT8, ComSystemTemplateSystemSignalRef=DET_RANGE_VELOCITY_ERR_132
            DET_RCS_129_oRDR_DETECTION_129_132_oPCAN_RADAR_50c0a29b_Tx: ComBitPosition=128, ComBitSize=8, ComSignalInitValue=128, ComSignalType=UINT8, ComSystemTemplateSystemSignalRef=DET_RCS_129
            DET_RCS_130_oRDR_DETECTION_129_132_oPCAN_RADAR_35e0d03f_Tx: ComBitPosition=240, ComBitSize=8, ComSignalInitValue=128, ComSignalType=UINT8, ComSystemTemplateSystemSignalRef=DET_RCS_130
            DET_RCS_131_oRDR_DETECTION_129_132_oPCAN_RADAR_a09004aa_Tx: ComBitPosition=352, ComBitSize=8, ComSignalInitValue=128, ComSignalType=UINT8, ComSystemTemplateSystemSignalRef=DET_RCS_131
            DET_RCS_132_oRDR_DETECTION_129_132_oPCAN_RADAR_c4707f54_Tx: ComBitPosition=464, ComBitSize=8, ComSignalInitValue=128, ComSignalType=UINT8, ComSystemTemplateSystemSignalRef=DET_RCS_132
            DET_SNR_129_oRDR_DETECTION_129_132_oPCAN_RADAR_8d6ef699_Tx: ComBitPosition=120, ComBitSize=8, ComSignalInitValue=0, ComSignalType=UINT8, ComSystemTemplateSystemSignalRef=DET_SNR_129
            DET_SNR_130_oRDR_DETECTION_129_132_oPCAN_RADAR_e84e843d_Tx: ComBitPosition=232, ComBitSize=8, ComSignalInitValue=0, ComSignalType=UINT8, ComSystemTemplateSystemSignalRef=DET_SNR_130
            DET_SNR_131_oRDR_DETECTION_129_132_oPCAN_RADAR_7d3e50a8_Tx: ComBitPosition=344, ComBitSize=8, ComSignalInitValue=0, ComSignalType=UINT8, ComSystemTemplateSystemSignalRef=DET_SNR_131
            DET_SNR_132_oRDR_DETECTION_129_132_oPCAN_RADAR_19de2b56_Tx: ComBitPosition=456, ComBitSize=8, ComSignalInitValue=0, ComSignalType=UINT8, ComSystemTemplateSystemSignalRef=DET_SNR_132
            DET_SUPER_RES_TARGET_129_oRDR_DETECTION_129_132_oPCAN_RADAR_bcf7defc_Tx: ComBitPosition=87, ComBitSize=1, ComSignalInitValue=0, ComSignalType=BOOLEAN, ComSystemTemplateSystemSignalRef=DET_SUPER_RES_TARGET_129
            DET_SUPER_RES_TARGET_130_oRDR_DETECTION_129_132_oPCAN_RADAR_d9d7ac58_Tx: ComBitPosition=199, ComBitSize=1, ComSignalInitValue=0, ComSignalType=BOOLEAN, ComSystemTemplateSystemSignalRef=DET_SUPER_RES_TARGET_130
            DET_SUPER_RES_TARGET_131_oRDR_DETECTION_129_132_oPCAN_RADAR_4ca778cd_Tx: ComBitPosition=311, ComBitSize=1, ComSignalInitValue=0, ComSignalType=BOOLEAN, ComSystemTemplateSystemSignalRef=DET_SUPER_RES_TARGET_131
            DET_SUPER_RES_TARGET_132_oRDR_DETECTION_129_132_oPCAN_RADAR_28470333_Tx: ComBitPosition=423, ComBitSize=1, ComSignalInitValue=0, ComSignalType=BOOLEAN, ComSystemTemplateSystemSignalRef=DET_SUPER_RES_TARGET_132
        SG_Detections_133_136_oRDR_DETECTION_133_136_oPCAN_RADAR_72276f4a_Tx: ComSystemTemplateSignalGroupRef=SG_Detections_133_136
          83 x ComGroupSignal, all with ComSignalEndianness=LITTLE_ENDIAN, ComTransferProperty=PENDING:
            DET_AZIMUTH_133_oRDR_DETECTION_133_136_oPCAN_RADAR_ae7a2e2b_Tx: ComBitPosition=88, ComBitSize=13, ComSignalInitValue=0, ComSignalType=UINT16, ComSystemTemplateSystemSignalRef=DET_AZIMUTH_133
            DET_AZIMUTH_134_oRDR_DETECTION_133_136_oPCAN_RADAR_f2ca0d42_Tx: ComBitPosition=200, ComBitSize=13, ComSignalInitValue=0, ComSignalType=UINT16, ComSystemTemplateSystemSignalRef=DET_AZIMUTH_134
            DET_AZIMUTH_135_oRDR_DETECTION_133_136_oPCAN_RADAR_67bad9d7_Tx: ComBitPosition=312, ComBitSize=13, ComSignalInitValue=0, ComSignalType=UINT16, ComSystemTemplateSystemSignalRef=DET_AZIMUTH_135
            DET_AZIMUTH_136_oRDR_DETECTION_133_136_oPCAN_RADAR_035aa229_Tx: ComBitPosition=424, ComBitSize=13, ComSignalInitValue=0, ComSignalType=UINT16, ComSystemTemplateSystemSignalRef=DET_AZIMUTH_136
            DET_AZIMUTH_ERR_133_oRDR_DETECTION_133_136_oPCAN_RADAR_0acfbbde_Tx: ComBitPosition=105, ComBitSize=7, ComSignalInitValue=0, ComSignalType=UINT8, ComSystemTemplateSystemSignalRef=DET_AZIMUTH_ERR_133
            DET_AZIMUTH_ERR_134_oRDR_DETECTION_133_136_oPCAN_RADAR_567f98b7_Tx: ComBitPosition=217, ComBitSize=7, ComSignalInitValue=0, ComSignalType=UINT8, ComSystemTemplateSystemSignalRef=DET_AZIMUTH_ERR_134
            DET_AZIMUTH_ERR_135_oRDR_DETECTION_133_136_oPCAN_RADAR_c30f4c22_Tx: ComBitPosition=329, ComBitSize=7, ComSignalInitValue=0, ComSignalType=UINT8, ComSystemTemplateSystemSignalRef=DET_AZIMUTH_ERR_135
            DET_AZIMUTH_ERR_136_oRDR_DETECTION_133_136_oPCAN_RADAR_a7ef37dc_Tx: ComBitPosition=441, ComBitSize=7, ComSignalInitValue=0, ComSignalType=UINT8, ComSystemTemplateSystemSignalRef=DET_AZIMUTH_ERR_136
            DET_BELOW_RAIN_THOLD_133_oRDR_DETECTION_133_136_oPCAN_RADAR_7b7bbdeb_Tx: ComBitPosition=39, ComBitSize=1, ComSignalInitValue=0, ComSignalType=BOOLEAN, ComSystemTemplateSystemSignalRef=DET_BELOW_RAIN_THOLD_133
            DET_BELOW_RAIN_THOLD_134_oRDR_DETECTION_133_136_oPCAN_RADAR_27cb9e82_Tx: ComBitPosition=151, ComBitSize=1, ComSignalInitValue=0, ComSignalType=BOOLEAN, ComSystemTemplateSystemSignalRef=DET_BELOW_RAIN_THOLD_134
            DET_BELOW_RAIN_THOLD_135_oRDR_DETECTION_133_136_oPCAN_RADAR_b2bb4a17_Tx: ComBitPosition=263, ComBitSize=1, ComSignalInitValue=0, ComSignalType=BOOLEAN, ComSystemTemplateSystemSignalRef=DET_BELOW_RAIN_THOLD_135
            DET_BELOW_RAIN_THOLD_136_oRDR_DETECTION_133_136_oPCAN_RADAR_d65b31e9_Tx: ComBitPosition=375, ComBitSize=1, ComSignalInitValue=0, ComSignalType=BOOLEAN, ComSystemTemplateSystemSignalRef=DET_BELOW_RAIN_THOLD_136
            DET_BI_STATIC_FLAG_133_oRDR_DETECTION_133_136_oPCAN_RADAR_f8566eae_Tx: ComBitPosition=104, ComBitSize=1, ComSignalInitValue=0, ComSignalType=BOOLEAN, ComSystemTemplateSystemSignalRef=DET_BI_STATIC_FLAG_133
            DET_BI_STATIC_FLAG_134_oRDR_DETECTION_133_136_oPCAN_RADAR_a4e64dc7_Tx: ComBitPosition=216, ComBitSize=1, ComSignalInitValue=0, ComSignalType=BOOLEAN, ComSystemTemplateSystemSignalRef=DET_BI_STATIC_FLAG_134
            DET_BI_STATIC_FLAG_135_oRDR_DETECTION_133_136_oPCAN_RADAR_31969952_Tx: ComBitPosition=328, ComBitSize=1, ComSignalInitValue=0, ComSignalType=BOOLEAN, ComSystemTemplateSystemSignalRef=DET_BI_STATIC_FLAG_135
            DET_BI_STATIC_FLAG_136_oRDR_DETECTION_133_136_oPCAN_RADAR_5576e2ac_Tx: ComBitPosition=440, ComBitSize=1, ComSignalInitValue=0, ComSignalType=BOOLEAN, ComSystemTemplateSystemSignalRef=DET_BI_STATIC_FLAG_136
            DET_CONFD_AZIMUTH_133_oRDR_DETECTION_133_136_oPCAN_RADAR_ac9c24e1_Tx: ComBitPosition=118, ComBitSize=2, ComSignalInitValue=0, ComSignalType=UINT8, ComSystemTemplateSystemSignalRef=DET_CONFD_AZIMUTH_133
            DET_CONFD_AZIMUTH_134_oRDR_DETECTION_133_136_oPCAN_RADAR_f02c0788_Tx: ComBitPosition=230, ComBitSize=2, ComSignalInitValue=0, ComSignalType=UINT8, ComSystemTemplateSystemSignalRef=DET_CONFD_AZIMUTH_134
            DET_CONFD_AZIMUTH_135_oRDR_DETECTION_133_136_oPCAN_RADAR_655cd31d_Tx: ComBitPosition=342, ComBitSize=2, ComSignalInitValue=0, ComSignalType=UINT8, ComSystemTemplateSystemSignalRef=DET_CONFD_AZIMUTH_135
            DET_CONFD_AZIMUTH_136_oRDR_DETECTION_133_136_oPCAN_RADAR_01bca8e3_Tx: ComBitPosition=454, ComBitSize=2, ComSignalInitValue=0, ComSignalType=UINT8, ComSystemTemplateSystemSignalRef=DET_CONFD_AZIMUTH_136
            DET_CONFD_ELEVATION_133_oRDR_DETECTION_133_136_oPCAN_RADAR_ae09251b_Tx: ComBitPosition=101, ComBitSize=2, ComSignalInitValue=0, ComSignalType=UINT8, ComSystemTemplateSystemSignalRef=DET_CONFD_ELEVATION_133
            DET_CONFD_ELEVATION_134_oRDR_DETECTION_133_136_oPCAN_RADAR_f2b90672_Tx: ComBitPosition=213, ComBitSize=2, ComSignalInitValue=0, ComSignalType=UINT8, ComSystemTemplateSystemSignalRef=DET_CONFD_ELEVATION_134
            DET_CONFD_ELEVATION_135_oRDR_DETECTION_133_136_oPCAN_RADAR_67c9d2e7_Tx: ComBitPosition=325, ComBitSize=2, ComSignalInitValue=0, ComSignalType=UINT8, ComSystemTemplateSystemSignalRef=DET_CONFD_ELEVATION_135
            DET_CONFD_ELEVATION_136_oRDR_DETECTION_133_136_oPCAN_RADAR_0329a919_Tx: ComBitPosition=437, ComBitSize=2, ComSignalInitValue=0, ComSignalType=UINT8, ComSystemTemplateSystemSignalRef=DET_CONFD_ELEVATION_136
            DET_ELEVATION_133_oRDR_DETECTION_133_136_oPCAN_RADAR_7fc9f127_Tx: ComBitPosition=72, ComBitSize=8, ComSignalInitValue=0, ComSignalType=UINT8, ComSystemTemplateSystemSignalRef=DET_ELEVATION_133
            DET_ELEVATION_134_oRDR_DETECTION_133_136_oPCAN_RADAR_2379d24e_Tx: ComBitPosition=184, ComBitSize=8, ComSignalInitValue=0, ComSignalType=UINT8, ComSystemTemplateSystemSignalRef=DET_ELEVATION_134
            DET_ELEVATION_135_oRDR_DETECTION_133_136_oPCAN_RADAR_b60906db_Tx: ComBitPosition=296, ComBitSize=8, ComSignalInitValue=0, ComSignalType=UINT8, ComSystemTemplateSystemSignalRef=DET_ELEVATION_135
            DET_ELEVATION_136_oRDR_DETECTION_133_136_oPCAN_RADAR_d2e97d25_Tx: ComBitPosition=408, ComBitSize=8, ComSignalInitValue=0, ComSignalType=UINT8, ComSystemTemplateSystemSignalRef=DET_ELEVATION_136
            DET_ELEVATION_ERR_133_oRDR_DETECTION_133_136_oPCAN_RADAR_f8f06952_Tx: ComBitPosition=80, ComBitSize=6, ComSignalInitValue=0, ComSignalType=UINT8, ComSystemTemplateSystemSignalRef=DET_ELEVATION_ERR_133
            DET_ELEVATION_ERR_134_oRDR_DETECTION_133_136_oPCAN_RADAR_a4404a3b_Tx: ComBitPosition=192, ComBitSize=6, ComSignalInitValue=0, ComSignalType=UINT8, ComSystemTemplateSystemSignalRef=DET_ELEVATION_ERR_134
            DET_ELEVATION_ERR_135_oRDR_DETECTION_133_136_oPCAN_RADAR_31309eae_Tx: ComBitPosition=304, ComBitSize=6, ComSignalInitValue=0, ComSignalType=UINT8, ComSystemTemplateSystemSignalRef=DET_ELEVATION_ERR_135
            DET_ELEVATION_ERR_136_oRDR_DETECTION_133_136_oPCAN_RADAR_55d0e550_Tx: ComBitPosition=416, ComBitSize=6, ComSignalInitValue=0, ComSignalType=UINT8, ComSystemTemplateSystemSignalRef=DET_ELEVATION_ERR_136
            DET_EXISTENCE_PROB_133_oRDR_DETECTION_133_136_oPCAN_RADAR_2a6f1c32_Tx: ComBitPosition=112, ComBitSize=6, ComSignalInitValue=0, ComSignalType=UINT8, ComSystemTemplateSystemSignalRef=DET_EXISTENCE_PROB_133
            DET_EXISTENCE_PROB_134_oRDR_DETECTION_133_136_oPCAN_RADAR_76df3f5b_Tx: ComBitPosition=224, ComBitSize=6, ComSignalInitValue=0, ComSignalType=UINT8, ComSystemTemplateSystemSignalRef=DET_EXISTENCE_PROB_134
            DET_EXISTENCE_PROB_135_oRDR_DETECTION_133_136_oPCAN_RADAR_e3afebce_Tx: ComBitPosition=336, ComBitSize=6, ComSignalInitValue=0, ComSignalType=UINT8, ComSystemTemplateSystemSignalRef=DET_EXISTENCE_PROB_135
            DET_EXISTENCE_PROB_136_oRDR_DETECTION_133_136_oPCAN_RADAR_874f9030_Tx: ComBitPosition=448, ComBitSize=6, ComSignalInitValue=0, ComSignalType=UINT8, ComSystemTemplateSystemSignalRef=DET_EXISTENCE_PROB_136
            DET_HVC_FLAG_133_oRDR_DETECTION_133_136_oPCAN_RADAR_cb1b5f4d_Tx: ComBitPosition=86, ComBitSize=1, ComSignalInitValue=0, ComSignalType=BOOLEAN, ComSystemTemplateSystemSignalRef=DET_HVC_FLAG_133
            DET_HVC_FLAG_134_oRDR_DETECTION_133_136_oPCAN_RADAR_97ab7c24_Tx: ComBitPosition=198, ComBitSize=1, ComSignalInitValue=0, ComSignalType=BOOLEAN, ComSystemTemplateSystemSignalRef=DET_HVC_FLAG_134
            DET_HVC_FLAG_135_oRDR_DETECTION_133_136_oPCAN_RADAR_02dba8b1_Tx: ComBitPosition=310, ComBitSize=1, ComSignalInitValue=0, ComSignalType=BOOLEAN, ComSystemTemplateSystemSignalRef=DET_HVC_FLAG_135
            DET_HVC_FLAG_136_oRDR_DETECTION_133_136_oPCAN_RADAR_663bd34f_Tx: ComBitPosition=422, ComBitSize=1, ComSignalInitValue=0, ComSignalType=BOOLEAN, ComSystemTemplateSystemSignalRef=DET_HVC_FLAG_136
            DET_IDM_133_oRDR_DETECTION_133_136_oPCAN_RADAR_404964f0_Tx: ComBitPosition=63, ComBitSize=1, ComSignalInitValue=0, ComSignalType=BOOLEAN, ComSystemTemplateSystemSignalRef=DET_IDM_133
            DET_IDM_134_oRDR_DETECTION_133_136_oPCAN_RADAR_1cf94799_Tx: ComBitPosition=175, ComBitSize=1, ComSignalInitValue=0, ComSignalType=BOOLEAN, ComSystemTemplateSystemSignalRef=DET_IDM_134
            DET_IDM_135_oRDR_DETECTION_133_136_oPCAN_RADAR_8989930c_Tx: ComBitPosition=287, ComBitSize=1, ComSignalInitValue=0, ComSignalType=BOOLEAN, ComSystemTemplateSystemSignalRef=DET_IDM_135
            DET_IDM_136_oRDR_DETECTION_133_136_oPCAN_RADAR_ed69e8f2_Tx: ComBitPosition=399, ComBitSize=1, ComSignalInitValue=0, ComSignalType=BOOLEAN, ComSystemTemplateSystemSignalRef=DET_IDM_136
            DET_MH_CRC16_133_136_oRDR_DETECTION_133_136_oPCAN_RADAR_f6afbd41_Tx: ComBitPosition=0, ComBitSize=16, ComSignalInitValue=0, ComSignalType=UINT16, ComSystemTemplateSystemSignalRef=DET_MH_CRC16_133_136
            DET_MH_CYCLE_COUNTER_133_136_oRDR_DETECTION_133_136_oPCAN_RADAR_72da1c76_Tx: ComBitPosition=16, ComBitSize=8, ComSignalInitValue=0, ComSignalType=UINT8, ComSystemTemplateSystemSignalRef=DET_MH_CYCLE_COUNTER_133_136
            DET_MH_SCAN_INDEX_4LSB_133_136_oRDR_DETECTION_133_136_oPCAN_RADAR_bef039fa_Tx: ComBitPosition=476, ComBitSize=4, ComSignalInitValue=0, ComSignalType=UINT8, ComSystemTemplateSystemSignalRef=DET_MH_SCAN_INDEX_4LSB_133_136
            DET_MTD_133_oRDR_DETECTION_133_136_oPCAN_RADAR_26fa562b_Tx: ComBitPosition=47, ComBitSize=1, ComSignalInitValue=0, ComSignalType=BOOLEAN, ComSystemTemplateSystemSignalRef=DET_MTD_133
            DET_MTD_134_oRDR_DETECTION_133_136_oPCAN_RADAR_7a4a7542_Tx: ComBitPosition=159, ComBitSize=1, ComSignalInitValue=0, ComSignalType=BOOLEAN, ComSystemTemplateSystemSignalRef=DET_MTD_134
            DET_MTD_135_oRDR_DETECTION_133_136_oPCAN_RADAR_ef3aa1d7_Tx: ComBitPosition=271, ComBitSize=1, ComSignalInitValue=0, ComSignalType=BOOLEAN, ComSystemTemplateSystemSignalRef=DET_MTD_135
            DET_MTD_136_oRDR_DETECTION_133_136_oPCAN_RADAR_8bdada29_Tx: ComBitPosition=383, ComBitSize=1, ComSignalInitValue=0, ComSignalType=BOOLEAN, ComSystemTemplateSystemSignalRef=DET_MTD_136
            DET_PROB_1STAZHYPO_133_oRDR_DETECTION_133_136_oPCAN_RADAR_b54ebee6_Tx: ComBitPosition=103, ComBitSize=1, ComSignalInitValue=0, ComSignalType=BOOLEAN, ComSystemTemplateSystemSignalRef=DET_PROB_1STAZHYPO_133
            DET_PROB_1STAZHYPO_134_oRDR_DETECTION_133_136_oPCAN_RADAR_e9fe9d8f_Tx: ComBitPosition=215, ComBitSize=1, ComSignalInitValue=0, ComSignalType=BOOLEAN, ComSystemTemplateSystemSignalRef=DET_PROB_1STAZHYPO_134
            DET_PROB_1STAZHYPO_135_oRDR_DETECTION_133_136_oPCAN_RADAR_7c8e491a_Tx: ComBitPosition=327, ComBitSize=1, ComSignalInitValue=0, ComSignalType=BOOLEAN, ComSystemTemplateSystemSignalRef=DET_PROB_1STAZHYPO_135
            DET_PROB_1STAZHYPO_136_oRDR_DETECTION_133_136_oPCAN_RADAR_186e32e4_Tx: ComBitPosition=439, ComBitSize=1, ComSignalInitValue=0, ComSignalType=BOOLEAN, ComSystemTemplateSystemSignalRef=DET_PROB_1STAZHYPO_136
            DET_RANGE_133_oRDR_DETECTION_133_136_oPCAN_RADAR_bee15d90_Tx: ComBitPosition=24, ComBitSize=15, ComSignalInitValue=0, ComSignalType=UINT16, ComSystemTemplateSystemSignalRef=DET_RANGE_133
            DET_RANGE_134_oRDR_DETECTION_133_136_oPCAN_RADAR_e2517ef9_Tx: ComBitPosition=136, ComBitSize=15, ComSignalInitValue=0, ComSignalType=UINT16, ComSystemTemplateSystemSignalRef=DET_RANGE_134
            DET_RANGE_135_oRDR_DETECTION_133_136_oPCAN_RADAR_7721aa6c_Tx: ComBitPosition=248, ComBitSize=15, ComSignalInitValue=0, ComSignalType=UINT16, ComSystemTemplateSystemSignalRef=DET_RANGE_135
            DET_RANGE_136_oRDR_DETECTION_133_136_oPCAN_RADAR_13c1d192_Tx: ComBitPosition=360, ComBitSize=15, ComSignalInitValue=0, ComSignalType=UINT16, ComSystemTemplateSystemSignalRef=DET_RANGE_136
            DET_RANGE_ERR_133_oRDR_DETECTION_133_136_oPCAN_RADAR_1909e7f9_Tx: ComBitPosition=40, ComBitSize=7, ComSignalInitValue=0, ComSignalType=UINT8, ComSystemTemplateSystemSignalRef=DET_RANGE_ERR_133
            DET_RANGE_ERR_134_oRDR_DETECTION_133_136_oPCAN_RADAR_45b9c490_Tx: ComBitPosition=152, ComBitSize=7, ComSignalInitValue=0, ComSignalType=UINT8, ComSystemTemplateSystemSignalRef=DET_RANGE_ERR_134
            DET_RANGE_ERR_135_oRDR_DETECTION_133_136_oPCAN_RADAR_d0c91005_Tx: ComBitPosition=264, ComBitSize=7, ComSignalInitValue=0, ComSignalType=UINT8, ComSystemTemplateSystemSignalRef=DET_RANGE_ERR_135
            DET_RANGE_ERR_136_oRDR_DETECTION_133_136_oPCAN_RADAR_b4296bfb_Tx: ComBitPosition=376, ComBitSize=7, ComSignalInitValue=0, ComSignalType=UINT8, ComSystemTemplateSystemSignalRef=DET_RANGE_ERR_136
            DET_RANGE_VELOCITY_133_oRDR_DETECTION_133_136_oPCAN_RADAR_cb479fb5_Tx: ComBitPosition=48, ComBitSize=15, ComSignalInitValue=16384, ComSignalType=UINT16, ComSystemTemplateSystemSignalRef=DET_RANGE_VELOCITY_133
            DET_RANGE_VELOCITY_134_oRDR_DETECTION_133_136_oPCAN_RADAR_97f7bcdc_Tx: ComBitPosition=160, ComBitSize=15, ComSignalInitValue=16384, ComSignalType=UINT16, ComSystemTemplateSystemSignalRef=DET_RANGE_VELOCITY_134
            DET_RANGE_VELOCITY_135_oRDR_DETECTION_133_136_oPCAN_RADAR_02876849_Tx: ComBitPosition=272, ComBitSize=15, ComSignalInitValue=16384, ComSignalType=UINT16, ComSystemTemplateSystemSignalRef=DET_RANGE_VELOCITY_135
            DET_RANGE_VELOCITY_136_oRDR_DETECTION_133_136_oPCAN_RADAR_666713b7_Tx: ComBitPosition=384, ComBitSize=15, ComSignalInitValue=16384, ComSignalType=UINT16, ComSystemTemplateSystemSignalRef=DET_RANGE_VELOCITY_136
            DET_RANGE_VELOCITY_ERR_133_oRDR_DETECTION_133_136_oPCAN_RADAR_c4fc6407_Tx: ComBitPosition=64, ComBitSize=8, ComSignalInitValue=0, ComSignalType=UINT8, ComSystemTemplateSystemSignalRef=DET_RANGE_VELOCITY_ERR_133
            DET_RANGE_VELOCITY_ERR_134_oRDR_DETECTION_133_136_oPCAN_RADAR_984c476e_Tx: ComBitPosition=176, ComBitSize=8, ComSignalInitValue=0, ComSignalType=UINT8, ComSystemTemplateSystemSignalRef=DET_RANGE_VELOCITY_ERR_134
            DET_RANGE_VELOCITY_ERR_135_oRDR_DETECTION_133_136_oPCAN_RADAR_0d3c93fb_Tx: ComBitPosition=288, ComBitSize=8, ComSignalInitValue=0, ComSignalType=UINT8, ComSystemTemplateSystemSignalRef=DET_RANGE_VELOCITY_ERR_135
            DET_RANGE_VELOCITY_ERR_136_oRDR_DETECTION_133_136_oPCAN_RADAR_69dce805_Tx: ComBitPosition=400, ComBitSize=8, ComSignalInitValue=0, ComSignalType=UINT8, ComSystemTemplateSystemSignalRef=DET_RANGE_VELOCITY_ERR_136
            DET_RCS_133_oRDR_DETECTION_133_136_oPCAN_RADAR_4cc7a8ef_Tx: ComBitPosition=128, ComBitSize=8, ComSignalInitValue=128, ComSignalType=UINT8, ComSystemTemplateSystemSignalRef=DET_RCS_133
            DET_RCS_134_oRDR_DETECTION_133_136_oPCAN_RADAR_10778b86_Tx: ComBitPosition=240, ComBitSize=8, ComSignalInitValue=128, ComSignalType=UINT8, ComSystemTemplateSystemSignalRef=DET_RCS_134
            DET_RCS_135_oRDR_DETECTION_133_136_oPCAN_RADAR_85075f13_Tx: ComBitPosition=352, ComBitSize=8, ComSignalInitValue=128, ComSignalType=UINT8, ComSystemTemplateSystemSignalRef=DET_RCS_135
            DET_RCS_136_oRDR_DETECTION_133_136_oPCAN_RADAR_e1e724ed_Tx: ComBitPosition=464, ComBitSize=8, ComSignalInitValue=128, ComSignalType=UINT8, ComSystemTemplateSystemSignalRef=DET_RCS_136
            DET_SNR_133_oRDR_DETECTION_133_136_oPCAN_RADAR_9169fced_Tx: ComBitPosition=120, ComBitSize=8, ComSignalInitValue=0, ComSignalType=UINT8, ComSystemTemplateSystemSignalRef=DET_SNR_133
            DET_SNR_134_oRDR_DETECTION_133_136_oPCAN_RADAR_cdd9df84_Tx: ComBitPosition=232, ComBitSize=8, ComSignalInitValue=0, ComSignalType=UINT8, ComSystemTemplateSystemSignalRef=DET_SNR_134
            DET_SNR_135_oRDR_DETECTION_133_136_oPCAN_RADAR_58a90b11_Tx: ComBitPosition=344, ComBitSize=8, ComSignalInitValue=0, ComSignalType=UINT8, ComSystemTemplateSystemSignalRef=DET_SNR_135
            DET_SNR_136_oRDR_DETECTION_133_136_oPCAN_RADAR_3c4970ef_Tx: ComBitPosition=456, ComBitSize=8, ComSignalInitValue=0, ComSignalType=UINT8, ComSystemTemplateSystemSignalRef=DET_SNR_136
            DET_SUPER_RES_TARGET_133_oRDR_DETECTION_133_136_oPCAN_RADAR_a0f0d488_Tx: ComBitPosition=87, ComBitSize=1, ComSignalInitValue=0, ComSignalType=BOOLEAN, ComSystemTemplateSystemSignalRef=DET_SUPER_RES_TARGET_133
            DET_SUPER_RES_TARGET_134_oRDR_DETECTION_133_136_oPCAN_RADAR_fc40f7e1_Tx: ComBitPosition=199, ComBitSize=1, ComSignalInitValue=0, ComSignalType=BOOLEAN, ComSystemTemplateSystemSignalRef=DET_SUPER_RES_TARGET_134
            DET_SUPER_RES_TARGET_135_oRDR_DETECTION_133_136_oPCAN_RADAR_69302374_Tx: ComBitPosition=311, ComBitSize=1, ComSignalInitValue=0, ComSignalType=BOOLEAN, ComSystemTemplateSystemSignalRef=DET_SUPER_RES_TARGET_135
            DET_SUPER_RES_TARGET_136_oRDR_DETECTION_133_136_oPCAN_RADAR_0dd0588a_Tx: ComBitPosition=423, ComBitSize=1, ComSignalInitValue=0, ComSignalType=BOOLEAN, ComSystemTemplateSystemSignalRef=DET_SUPER_RES_TARGET_136
        SG_Detections_137_140_oRDR_DETECTION_137_140_oPCAN_RADAR_e974e064_Tx: ComSystemTemplateSignalGroupRef=SG_Detections_137_140
          83 x ComGroupSignal, all with ComSignalEndianness=LITTLE_ENDIAN, ComTransferProperty=PENDING:
            DET_AZIMUTH_137_oRDR_DETECTION_137_140_oPCAN_RADAR_200a246e_Tx: ComBitPosition=88, ComBitSize=13, ComSignalInitValue=0, ComSignalType=UINT16, ComSystemTemplateSystemSignalRef=DET_AZIMUTH_137
            DET_AZIMUTH_138_oRDR_DETECTION_137_140_oPCAN_RADAR_0c1ab629_Tx: ComBitPosition=200, ComBitSize=13, ComSignalInitValue=0, ComSignalType=UINT16, ComSystemTemplateSystemSignalRef=DET_AZIMUTH_138
            DET_AZIMUTH_139_oRDR_DETECTION_137_140_oPCAN_RADAR_996a62bc_Tx: ComBitPosition=312, ComBitSize=13, ComSignalInitValue=0, ComSignalType=UINT16, ComSystemTemplateSystemSignalRef=DET_AZIMUTH_139
            DET_AZIMUTH_140_oRDR_DETECTION_137_140_oPCAN_RADAR_48886ed8_Tx: ComBitPosition=424, ComBitSize=13, ComSignalInitValue=0, ComSignalType=UINT16, ComSystemTemplateSystemSignalRef=DET_AZIMUTH_140
            DET_AZIMUTH_ERR_137_oRDR_DETECTION_137_140_oPCAN_RADAR_84bfb19b_Tx: ComBitPosition=105, ComBitSize=7, ComSignalInitValue=0, ComSignalType=UINT8, ComSystemTemplateSystemSignalRef=DET_AZIMUTH_ERR_137
            DET_AZIMUTH_ERR_138_oRDR_DETECTION_137_140_oPCAN_RADAR_a8af23dc_Tx: ComBitPosition=217, ComBitSize=7, ComSignalInitValue=0, ComSignalType=UINT8, ComSystemTemplateSystemSignalRef=DET_AZIMUTH_ERR_138
            DET_AZIMUTH_ERR_139_oRDR_DETECTION_137_140_oPCAN_RADAR_3ddff749_Tx: ComBitPosition=329, ComBitSize=7, ComSignalInitValue=0, ComSignalType=UINT8, ComSystemTemplateSystemSignalRef=DET_AZIMUTH_ERR_139
            DET_AZIMUTH_ERR_140_oRDR_DETECTION_137_140_oPCAN_RADAR_ec3dfb2d_Tx: ComBitPosition=441, ComBitSize=7, ComSignalInitValue=0, ComSignalType=UINT8, ComSystemTemplateSystemSignalRef=DET_AZIMUTH_ERR_140
            DET_BELOW_RAIN_THOLD_137_oRDR_DETECTION_137_140_oPCAN_RADAR_f50bb7ae_Tx: ComBitPosition=39, ComBitSize=1, ComSignalInitValue=0, ComSignalType=BOOLEAN, ComSystemTemplateSystemSignalRef=DET_BELOW_RAIN_THOLD_137
            DET_BELOW_RAIN_THOLD_138_oRDR_DETECTION_137_140_oPCAN_RADAR_d91b25e9_Tx: ComBitPosition=151, ComBitSize=1, ComSignalInitValue=0, ComSignalType=BOOLEAN, ComSystemTemplateSystemSignalRef=DET_BELOW_RAIN_THOLD_138
            DET_BELOW_RAIN_THOLD_139_oRDR_DETECTION_137_140_oPCAN_RADAR_4c6bf17c_Tx: ComBitPosition=263, ComBitSize=1, ComSignalInitValue=0, ComSignalType=BOOLEAN, ComSystemTemplateSystemSignalRef=DET_BELOW_RAIN_THOLD_139
            DET_BELOW_RAIN_THOLD_140_oRDR_DETECTION_137_140_oPCAN_RADAR_9d89fd18_Tx: ComBitPosition=375, ComBitSize=1, ComSignalInitValue=0, ComSignalType=BOOLEAN, ComSystemTemplateSystemSignalRef=DET_BELOW_RAIN_THOLD_140
            DET_BI_STATIC_FLAG_137_oRDR_DETECTION_137_140_oPCAN_RADAR_762664eb_Tx: ComBitPosition=104, ComBitSize=1, ComSignalInitValue=0, ComSignalType=BOOLEAN, ComSystemTemplateSystemSignalRef=DET_BI_STATIC_FLAG_137
            DET_BI_STATIC_FLAG_138_oRDR_DETECTION_137_140_oPCAN_RADAR_5a36f6ac_Tx: ComBitPosition=216, ComBitSize=1, ComSignalInitValue=0, ComSignalType=BOOLEAN, ComSystemTemplateSystemSignalRef=DET_BI_STATIC_FLAG_138
            DET_BI_STATIC_FLAG_139_oRDR_DETECTION_137_140_oPCAN_RADAR_cf462239_Tx: ComBitPosition=328, ComBitSize=1, ComSignalInitValue=0, ComSignalType=BOOLEAN, ComSystemTemplateSystemSignalRef=DET_BI_STATIC_FLAG_139
            DET_BI_STATIC_FLAG_140_oRDR_DETECTION_137_140_oPCAN_RADAR_1ea42e5d_Tx: ComBitPosition=440, ComBitSize=1, ComSignalInitValue=0, ComSignalType=BOOLEAN, ComSystemTemplateSystemSignalRef=DET_BI_STATIC_FLAG_140
            DET_CONFD_AZIMUTH_137_oRDR_DETECTION_137_140_oPCAN_RADAR_22ec2ea4_Tx: ComBitPosition=118, ComBitSize=2, ComSignalInitValue=0, ComSignalType=UINT8, ComSystemTemplateSystemSignalRef=DET_CONFD_AZIMUTH_137
            DET_CONFD_AZIMUTH_138_oRDR_DETECTION_137_140_oPCAN_RADAR_0efcbce3_Tx: ComBitPosition=230, ComBitSize=2, ComSignalInitValue=0, ComSignalType=UINT8, ComSystemTemplateSystemSignalRef=DET_CONFD_AZIMUTH_138
            DET_CONFD_AZIMUTH_139_oRDR_DETECTION_137_140_oPCAN_RADAR_9b8c6876_Tx: ComBitPosition=342, ComBitSize=2, ComSignalInitValue=0, ComSignalType=UINT8, ComSystemTemplateSystemSignalRef=DET_CONFD_AZIMUTH_139
            DET_CONFD_AZIMUTH_140_oRDR_DETECTION_137_140_oPCAN_RADAR_4a6e6412_Tx: ComBitPosition=454, ComBitSize=2, ComSignalInitValue=0, ComSignalType=UINT8, ComSystemTemplateSystemSignalRef=DET_CONFD_AZIMUTH_140
            DET_CONFD_ELEVATION_137_oRDR_DETECTION_137_140_oPCAN_RADAR_20792f5e_Tx: ComBitPosition=101, ComBitSize=2, ComSignalInitValue=0, ComSignalType=UINT8, ComSystemTemplateSystemSignalRef=DET_CONFD_ELEVATION_137
            DET_CONFD_ELEVATION_138_oRDR_DETECTION_137_140_oPCAN_RADAR_0c69bd19_Tx: ComBitPosition=213, ComBitSize=2, ComSignalInitValue=0, ComSignalType=UINT8, ComSystemTemplateSystemSignalRef=DET_CONFD_ELEVATION_138
            DET_CONFD_ELEVATION_139_oRDR_DETECTION_137_140_oPCAN_RADAR_9919698c_Tx: ComBitPosition=325, ComBitSize=2, ComSignalInitValue=0, ComSignalType=UINT8, ComSystemTemplateSystemSignalRef=DET_CONFD_ELEVATION_139
            DET_CONFD_ELEVATION_140_oRDR_DETECTION_137_140_oPCAN_RADAR_48fb65e8_Tx: ComBitPosition=437, ComBitSize=2, ComSignalInitValue=0, ComSignalType=UINT8, ComSystemTemplateSystemSignalRef=DET_CONFD_ELEVATION_140
            DET_ELEVATION_137_oRDR_DETECTION_137_140_oPCAN_RADAR_f1b9fb62_Tx: ComBitPosition=72, ComBitSize=8, ComSignalInitValue=0, ComSignalType=UINT8, ComSystemTemplateSystemSignalRef=DET_ELEVATION_137
            DET_ELEVATION_138_oRDR_DETECTION_137_140_oPCAN_RADAR_dda96925_Tx: ComBitPosition=184, ComBitSize=8, ComSignalInitValue=0, ComSignalType=UINT8, ComSystemTemplateSystemSignalRef=DET_ELEVATION_138
            DET_ELEVATION_139_oRDR_DETECTION_137_140_oPCAN_RADAR_48d9bdb0_Tx: ComBitPosition=296, ComBitSize=8, ComSignalInitValue=0, ComSignalType=UINT8, ComSystemTemplateSystemSignalRef=DET_ELEVATION_139
            DET_ELEVATION_140_oRDR_DETECTION_137_140_oPCAN_RADAR_993bb1d4_Tx: ComBitPosition=408, ComBitSize=8, ComSignalInitValue=0, ComSignalType=UINT8, ComSystemTemplateSystemSignalRef=DET_ELEVATION_140
            DET_ELEVATION_ERR_137_oRDR_DETECTION_137_140_oPCAN_RADAR_76806317_Tx: ComBitPosition=80, ComBitSize=6, ComSignalInitValue=0, ComSignalType=UINT8, ComSystemTemplateSystemSignalRef=DET_ELEVATION_ERR_137
            DET_ELEVATION_ERR_138_oRDR_DETECTION_137_140_oPCAN_RADAR_5a90f150_Tx: ComBitPosition=192, ComBitSize=6, ComSignalInitValue=0, ComSignalType=UINT8, ComSystemTemplateSystemSignalRef=DET_ELEVATION_ERR_138
            DET_ELEVATION_ERR_139_oRDR_DETECTION_137_140_oPCAN_RADAR_cfe025c5_Tx: ComBitPosition=304, ComBitSize=6, ComSignalInitValue=0, ComSignalType=UINT8, ComSystemTemplateSystemSignalRef=DET_ELEVATION_ERR_139
            DET_ELEVATION_ERR_140_oRDR_DETECTION_137_140_oPCAN_RADAR_1e0229a1_Tx: ComBitPosition=416, ComBitSize=6, ComSignalInitValue=0, ComSignalType=UINT8, ComSystemTemplateSystemSignalRef=DET_ELEVATION_ERR_140
            DET_EXISTENCE_PROB_137_oRDR_DETECTION_137_140_oPCAN_RADAR_a41f1677_Tx: ComBitPosition=112, ComBitSize=6, ComSignalInitValue=0, ComSignalType=UINT8, ComSystemTemplateSystemSignalRef=DET_EXISTENCE_PROB_137
            DET_EXISTENCE_PROB_138_oRDR_DETECTION_137_140_oPCAN_RADAR_880f8430_Tx: ComBitPosition=224, ComBitSize=6, ComSignalInitValue=0, ComSignalType=UINT8, ComSystemTemplateSystemSignalRef=DET_EXISTENCE_PROB_138
            DET_EXISTENCE_PROB_139_oRDR_DETECTION_137_140_oPCAN_RADAR_1d7f50a5_Tx: ComBitPosition=336, ComBitSize=6, ComSignalInitValue=0, ComSignalType=UINT8, ComSystemTemplateSystemSignalRef=DET_EXISTENCE_PROB_139
            DET_EXISTENCE_PROB_140_oRDR_DETECTION_137_140_oPCAN_RADAR_cc9d5cc1_Tx: ComBitPosition=448, ComBitSize=6, ComSignalInitValue=0, ComSignalType=UINT8, ComSystemTemplateSystemSignalRef=DET_EXISTENCE_PROB_140
            DET_HVC_FLAG_137_oRDR_DETECTION_137_140_oPCAN_RADAR_456b5508_Tx: ComBitPosition=86, ComBitSize=1, ComSignalInitValue=0, ComSignalType=BOOLEAN, ComSystemTemplateSystemSignalRef=DET_HVC_FLAG_137
            DET_HVC_FLAG_138_oRDR_DETECTION_137_140_oPCAN_RADAR_697bc74f_Tx: ComBitPosition=198, ComBitSize=1, ComSignalInitValue=0, ComSignalType=BOOLEAN, ComSystemTemplateSystemSignalRef=DET_HVC_FLAG_138
            DET_HVC_FLAG_139_oRDR_DETECTION_137_140_oPCAN_RADAR_fc0b13da_Tx: ComBitPosition=310, ComBitSize=1, ComSignalInitValue=0, ComSignalType=BOOLEAN, ComSystemTemplateSystemSignalRef=DET_HVC_FLAG_139
            DET_HVC_FLAG_140_oRDR_DETECTION_137_140_oPCAN_RADAR_2de91fbe_Tx: ComBitPosition=422, ComBitSize=1, ComSignalInitValue=0, ComSignalType=BOOLEAN, ComSystemTemplateSystemSignalRef=DET_HVC_FLAG_140
            DET_IDM_137_oRDR_DETECTION_137_140_oPCAN_RADAR_ce396eb5_Tx: ComBitPosition=63, ComBitSize=1, ComSignalInitValue=0, ComSignalType=BOOLEAN, ComSystemTemplateSystemSignalRef=DET_IDM_137
            DET_IDM_138_oRDR_DETECTION_137_140_oPCAN_RADAR_e229fcf2_Tx: ComBitPosition=175, ComBitSize=1, ComSignalInitValue=0, ComSignalType=BOOLEAN, ComSystemTemplateSystemSignalRef=DET_IDM_138
            DET_IDM_139_oRDR_DETECTION_137_140_oPCAN_RADAR_77592867_Tx: ComBitPosition=287, ComBitSize=1, ComSignalInitValue=0, ComSignalType=BOOLEAN, ComSystemTemplateSystemSignalRef=DET_IDM_139
            DET_IDM_140_oRDR_DETECTION_137_140_oPCAN_RADAR_a6bb2403_Tx: ComBitPosition=399, ComBitSize=1, ComSignalInitValue=0, ComSignalType=BOOLEAN, ComSystemTemplateSystemSignalRef=DET_IDM_140
            DET_MH_CRC16_137_140_oRDR_DETECTION_137_140_oPCAN_RADAR_6dfc326f_Tx: ComBitPosition=0, ComBitSize=16, ComSignalInitValue=0, ComSignalType=UINT16, ComSystemTemplateSystemSignalRef=DET_MH_CRC16_137_140
            DET_MH_CYCLE_COUNTER_137_140_oRDR_DETECTION_137_140_oPCAN_RADAR_e9899358_Tx: ComBitPosition=16, ComBitSize=8, ComSignalInitValue=0, ComSignalType=UINT8, ComSystemTemplateSystemSignalRef=DET_MH_CYCLE_COUNTER_137_140
            DET_MH_SCAN_INDEX_4LSB_137_140_oRDR_DETECTION_137_140_oPCAN_RADAR_25a3b6d4_Tx: ComBitPosition=476, ComBitSize=4, ComSignalInitValue=0, ComSignalType=UINT8, ComSystemTemplateSystemSignalRef=DET_MH_SCAN_INDEX_4LSB_137_140
            DET_MTD_137_oRDR_DETECTION_137_140_oPCAN_RADAR_a88a5c6e_Tx: ComBitPosition=47, ComBitSize=1, ComSignalInitValue=0, ComSignalType=BOOLEAN, ComSystemTemplateSystemSignalRef=DET_MTD_137
            DET_MTD_138_oRDR_DETECTION_137_140_oPCAN_RADAR_849ace29_Tx: ComBitPosition=159, ComBitSize=1, ComSignalInitValue=0, ComSignalType=BOOLEAN, ComSystemTemplateSystemSignalRef=DET_MTD_138
            DET_MTD_139_oRDR_DETECTION_137_140_oPCAN_RADAR_11ea1abc_Tx: ComBitPosition=271, ComBitSize=1, ComSignalInitValue=0, ComSignalType=BOOLEAN, ComSystemTemplateSystemSignalRef=DET_MTD_139
            DET_MTD_140_oRDR_DETECTION_137_140_oPCAN_RADAR_c00816d8_Tx: ComBitPosition=383, ComBitSize=1, ComSignalInitValue=0, ComSignalType=BOOLEAN, ComSystemTemplateSystemSignalRef=DET_MTD_140
            DET_PROB_1STAZHYPO_137_oRDR_DETECTION_137_140_oPCAN_RADAR_3b3eb4a3_Tx: ComBitPosition=103, ComBitSize=1, ComSignalInitValue=0, ComSignalType=BOOLEAN, ComSystemTemplateSystemSignalRef=DET_PROB_1STAZHYPO_137
            DET_PROB_1STAZHYPO_138_oRDR_DETECTION_137_140_oPCAN_RADAR_172e26e4_Tx: ComBitPosition=215, ComBitSize=1, ComSignalInitValue=0, ComSignalType=BOOLEAN, ComSystemTemplateSystemSignalRef=DET_PROB_1STAZHYPO_138
            DET_PROB_1STAZHYPO_139_oRDR_DETECTION_137_140_oPCAN_RADAR_825ef271_Tx: ComBitPosition=327, ComBitSize=1, ComSignalInitValue=0, ComSignalType=BOOLEAN, ComSystemTemplateSystemSignalRef=DET_PROB_1STAZHYPO_139
            DET_PROB_1STAZHYPO_140_oRDR_DETECTION_137_140_oPCAN_RADAR_53bcfe15_Tx: ComBitPosition=439, ComBitSize=1, ComSignalInitValue=0, ComSignalType=BOOLEAN, ComSystemTemplateSystemSignalRef=DET_PROB_1STAZHYPO_140
            DET_RANGE_137_oRDR_DETECTION_137_140_oPCAN_RADAR_309157d5_Tx: ComBitPosition=24, ComBitSize=15, ComSignalInitValue=0, ComSignalType=UINT16, ComSystemTemplateSystemSignalRef=DET_RANGE_137
            DET_RANGE_138_oRDR_DETECTION_137_140_oPCAN_RADAR_1c81c592_Tx: ComBitPosition=136, ComBitSize=15, ComSignalInitValue=0, ComSignalType=UINT16, ComSystemTemplateSystemSignalRef=DET_RANGE_138
            DET_RANGE_139_oRDR_DETECTION_137_140_oPCAN_RADAR_89f11107_Tx: ComBitPosition=248, ComBitSize=15, ComSignalInitValue=0, ComSignalType=UINT16, ComSystemTemplateSystemSignalRef=DET_RANGE_139
            DET_RANGE_140_oRDR_DETECTION_137_140_oPCAN_RADAR_58131d63_Tx: ComBitPosition=360, ComBitSize=15, ComSignalInitValue=0, ComSignalType=UINT16, ComSystemTemplateSystemSignalRef=DET_RANGE_140
            DET_RANGE_ERR_137_oRDR_DETECTION_137_140_oPCAN_RADAR_9779edbc_Tx: ComBitPosition=40, ComBitSize=7, ComSignalInitValue=0, ComSignalType=UINT8, ComSystemTemplateSystemSignalRef=DET_RANGE_ERR_137
            DET_RANGE_ERR_138_oRDR_DETECTION_137_140_oPCAN_RADAR_bb697ffb_Tx: ComBitPosition=152, ComBitSize=7, ComSignalInitValue=0, ComSignalType=UINT8, ComSystemTemplateSystemSignalRef=DET_RANGE_ERR_138
            DET_RANGE_ERR_139_oRDR_DETECTION_137_140_oPCAN_RADAR_2e19ab6e_Tx: ComBitPosition=264, ComBitSize=7, ComSignalInitValue=0, ComSignalType=UINT8, ComSystemTemplateSystemSignalRef=DET_RANGE_ERR_139
            DET_RANGE_ERR_140_oRDR_DETECTION_137_140_oPCAN_RADAR_fffba70a_Tx: ComBitPosition=376, ComBitSize=7, ComSignalInitValue=0, ComSignalType=UINT8, ComSystemTemplateSystemSignalRef=DET_RANGE_ERR_140
            DET_RANGE_VELOCITY_137_oRDR_DETECTION_137_140_oPCAN_RADAR_453795f0_Tx: ComBitPosition=48, ComBitSize=15, ComSignalInitValue=16384, ComSignalType=UINT16, ComSystemTemplateSystemSignalRef=DET_RANGE_VELOCITY_137
            DET_RANGE_VELOCITY_138_oRDR_DETECTION_137_140_oPCAN_RADAR_692707b7_Tx: ComBitPosition=160, ComBitSize=15, ComSignalInitValue=16384, ComSignalType=UINT16, ComSystemTemplateSystemSignalRef=DET_RANGE_VELOCITY_138
            DET_RANGE_VELOCITY_139_oRDR_DETECTION_137_140_oPCAN_RADAR_fc57d322_Tx: ComBitPosition=272, ComBitSize=15, ComSignalInitValue=16384, ComSignalType=UINT16, ComSystemTemplateSystemSignalRef=DET_RANGE_VELOCITY_139
            DET_RANGE_VELOCITY_140_oRDR_DETECTION_137_140_oPCAN_RADAR_2db5df46_Tx: ComBitPosition=384, ComBitSize=15, ComSignalInitValue=16384, ComSignalType=UINT16, ComSystemTemplateSystemSignalRef=DET_RANGE_VELOCITY_140
            DET_RANGE_VELOCITY_ERR_137_oRDR_DETECTION_137_140_oPCAN_RADAR_4a8c6e42_Tx: ComBitPosition=64, ComBitSize=8, ComSignalInitValue=0, ComSignalType=UINT8, ComSystemTemplateSystemSignalRef=DET_RANGE_VELOCITY_ERR_137
            DET_RANGE_VELOCITY_ERR_138_oRDR_DETECTION_137_140_oPCAN_RADAR_669cfc05_Tx: ComBitPosition=176, ComBitSize=8, ComSignalInitValue=0, ComSignalType=UINT8, ComSystemTemplateSystemSignalRef=DET_RANGE_VELOCITY_ERR_138
            DET_RANGE_VELOCITY_ERR_139_oRDR_DETECTION_137_140_oPCAN_RADAR_f3ec2890_Tx: ComBitPosition=288, ComBitSize=8, ComSignalInitValue=0, ComSignalType=UINT8, ComSystemTemplateSystemSignalRef=DET_RANGE_VELOCITY_ERR_139
            DET_RANGE_VELOCITY_ERR_140_oRDR_DETECTION_137_140_oPCAN_RADAR_220e24f4_Tx: ComBitPosition=400, ComBitSize=8, ComSignalInitValue=0, ComSignalType=UINT8, ComSystemTemplateSystemSignalRef=DET_RANGE_VELOCITY_ERR_140
            DET_RCS_137_oRDR_DETECTION_137_140_oPCAN_RADAR_c2b7a2aa_Tx: ComBitPosition=128, ComBitSize=8, ComSignalInitValue=128, ComSignalType=UINT8, ComSystemTemplateSystemSignalRef=DET_RCS_137
            DET_RCS_138_oRDR_DETECTION_137_140_oPCAN_RADAR_eea730ed_Tx: ComBitPosition=240, ComBitSize=8, ComSignalInitValue=128, ComSignalType=UINT8, ComSystemTemplateSystemSignalRef=DET_RCS_138
            DET_RCS_139_oRDR_DETECTION_137_140_oPCAN_RADAR_7bd7e478_Tx: ComBitPosition=352, ComBitSize=8, ComSignalInitValue=128, ComSignalType=UINT8, ComSystemTemplateSystemSignalRef=DET_RCS_139
            DET_RCS_140_oRDR_DETECTION_137_140_oPCAN_RADAR_aa35e81c_Tx: ComBitPosition=464, ComBitSize=8, ComSignalInitValue=128, ComSignalType=UINT8, ComSystemTemplateSystemSignalRef=DET_RCS_140
            DET_SNR_137_oRDR_DETECTION_137_140_oPCAN_RADAR_1f19f6a8_Tx: ComBitPosition=120, ComBitSize=8, ComSignalInitValue=0, ComSignalType=UINT8, ComSystemTemplateSystemSignalRef=DET_SNR_137
            DET_SNR_138_oRDR_DETECTION_137_140_oPCAN_RADAR_330964ef_Tx: ComBitPosition=232, ComBitSize=8, ComSignalInitValue=0, ComSignalType=UINT8, ComSystemTemplateSystemSignalRef=DET_SNR_138
            DET_SNR_139_oRDR_DETECTION_137_140_oPCAN_RADAR_a679b07a_Tx: ComBitPosition=344, ComBitSize=8, ComSignalInitValue=0, ComSignalType=UINT8, ComSystemTemplateSystemSignalRef=DET_SNR_139
            DET_SNR_140_oRDR_DETECTION_137_140_oPCAN_RADAR_779bbc1e_Tx: ComBitPosition=456, ComBitSize=8, ComSignalInitValue=0, ComSignalType=UINT8, ComSystemTemplateSystemSignalRef=DET_SNR_140
            DET_SUPER_RES_TARGET_137_oRDR_DETECTION_137_140_oPCAN_RADAR_2e80decd_Tx: ComBitPosition=87, ComBitSize=1, ComSignalInitValue=0, ComSignalType=BOOLEAN, ComSystemTemplateSystemSignalRef=DET_SUPER_RES_TARGET_137
            DET_SUPER_RES_TARGET_138_oRDR_DETECTION_137_140_oPCAN_RADAR_02904c8a_Tx: ComBitPosition=199, ComBitSize=1, ComSignalInitValue=0, ComSignalType=BOOLEAN, ComSystemTemplateSystemSignalRef=DET_SUPER_RES_TARGET_138
            DET_SUPER_RES_TARGET_139_oRDR_DETECTION_137_140_oPCAN_RADAR_97e0981f_Tx: ComBitPosition=311, ComBitSize=1, ComSignalInitValue=0, ComSignalType=BOOLEAN, ComSystemTemplateSystemSignalRef=DET_SUPER_RES_TARGET_139
            DET_SUPER_RES_TARGET_140_oRDR_DETECTION_137_140_oPCAN_RADAR_4602947b_Tx: ComBitPosition=423, ComBitSize=1, ComSignalInitValue=0, ComSignalType=BOOLEAN, ComSystemTemplateSystemSignalRef=DET_SUPER_RES_TARGET_140
        SG_Detections_141_144_oRDR_DETECTION_141_144_oPCAN_RADAR_f70bf7bd_Tx: ComSystemTemplateSignalGroupRef=SG_Detections_141_144
          83 x ComGroupSignal, all with ComSignalEndianness=LITTLE_ENDIAN, ComTransferProperty=PENDING:
            DET_AZIMUTH_141_oRDR_DETECTION_141_144_oPCAN_RADAR_5b5b6db7_Tx: ComBitPosition=88, ComBitSize=13, ComSignalInitValue=0, ComSignalType=UINT16, ComSystemTemplateSystemSignalRef=DET_AZIMUTH_141
            DET_AZIMUTH_142_oRDR_DETECTION_141_144_oPCAN_RADAR_3fbb1649_Tx: ComBitPosition=200, ComBitSize=13, ComSignalInitValue=0, ComSignalType=UINT16, ComSystemTemplateSystemSignalRef=DET_AZIMUTH_142
            DET_AZIMUTH_143_oRDR_DETECTION_141_144_oPCAN_RADAR_aacbc2dc_Tx: ComBitPosition=312, ComBitSize=13, ComSignalInitValue=0, ComSignalType=UINT16, ComSystemTemplateSystemSignalRef=DET_AZIMUTH_143
            DET_AZIMUTH_144_oRDR_DETECTION_141_144_oPCAN_RADAR_f67be1b5_Tx: ComBitPosition=424, ComBitSize=13, ComSignalInitValue=0, ComSignalType=UINT16, ComSystemTemplateSystemSignalRef=DET_AZIMUTH_144
            DET_AZIMUTH_ERR_141_oRDR_DETECTION_141_144_oPCAN_RADAR_ffeef842_Tx: ComBitPosition=105, ComBitSize=7, ComSignalInitValue=0, ComSignalType=UINT8, ComSystemTemplateSystemSignalRef=DET_AZIMUTH_ERR_141
            DET_AZIMUTH_ERR_142_oRDR_DETECTION_141_144_oPCAN_RADAR_9b0e83bc_Tx: ComBitPosition=217, ComBitSize=7, ComSignalInitValue=0, ComSignalType=UINT8, ComSystemTemplateSystemSignalRef=DET_AZIMUTH_ERR_142
            DET_AZIMUTH_ERR_143_oRDR_DETECTION_141_144_oPCAN_RADAR_0e7e5729_Tx: ComBitPosition=329, ComBitSize=7, ComSignalInitValue=0, ComSignalType=UINT8, ComSystemTemplateSystemSignalRef=DET_AZIMUTH_ERR_143
            DET_AZIMUTH_ERR_144_oRDR_DETECTION_141_144_oPCAN_RADAR_52ce7440_Tx: ComBitPosition=441, ComBitSize=7, ComSignalInitValue=0, ComSignalType=UINT8, ComSystemTemplateSystemSignalRef=DET_AZIMUTH_ERR_144
            DET_BELOW_RAIN_THOLD_141_oRDR_DETECTION_141_144_oPCAN_RADAR_8e5afe77_Tx: ComBitPosition=39, ComBitSize=1, ComSignalInitValue=0, ComSignalType=BOOLEAN, ComSystemTemplateSystemSignalRef=DET_BELOW_RAIN_THOLD_141
            DET_BELOW_RAIN_THOLD_142_oRDR_DETECTION_141_144_oPCAN_RADAR_eaba8589_Tx: ComBitPosition=151, ComBitSize=1, ComSignalInitValue=0, ComSignalType=BOOLEAN, ComSystemTemplateSystemSignalRef=DET_BELOW_RAIN_THOLD_142
            DET_BELOW_RAIN_THOLD_143_oRDR_DETECTION_141_144_oPCAN_RADAR_7fca511c_Tx: ComBitPosition=263, ComBitSize=1, ComSignalInitValue=0, ComSignalType=BOOLEAN, ComSystemTemplateSystemSignalRef=DET_BELOW_RAIN_THOLD_143
            DET_BELOW_RAIN_THOLD_144_oRDR_DETECTION_141_144_oPCAN_RADAR_237a7275_Tx: ComBitPosition=375, ComBitSize=1, ComSignalInitValue=0, ComSignalType=BOOLEAN, ComSystemTemplateSystemSignalRef=DET_BELOW_RAIN_THOLD_144
            DET_BI_STATIC_FLAG_141_oRDR_DETECTION_141_144_oPCAN_RADAR_0d772d32_Tx: ComBitPosition=104, ComBitSize=1, ComSignalInitValue=0, ComSignalType=BOOLEAN, ComSystemTemplateSystemSignalRef=DET_BI_STATIC_FLAG_141
            DET_BI_STATIC_FLAG_142_oRDR_DETECTION_141_144_oPCAN_RADAR_699756cc_Tx: ComBitPosition=216, ComBitSize=1, ComSignalInitValue=0, ComSignalType=BOOLEAN, ComSystemTemplateSystemSignalRef=DET_BI_STATIC_FLAG_142
            DET_BI_STATIC_FLAG_143_oRDR_DETECTION_141_144_oPCAN_RADAR_fce78259_Tx: ComBitPosition=328, ComBitSize=1, ComSignalInitValue=0, ComSignalType=BOOLEAN, ComSystemTemplateSystemSignalRef=DET_BI_STATIC_FLAG_143
            DET_BI_STATIC_FLAG_144_oRDR_DETECTION_141_144_oPCAN_RADAR_a057a130_Tx: ComBitPosition=440, ComBitSize=1, ComSignalInitValue=0, ComSignalType=BOOLEAN, ComSystemTemplateSystemSignalRef=DET_BI_STATIC_FLAG_144
            DET_CONFD_AZIMUTH_141_oRDR_DETECTION_141_144_oPCAN_RADAR_59bd677d_Tx: ComBitPosition=118, ComBitSize=2, ComSignalInitValue=0, ComSignalType=UINT8, ComSystemTemplateSystemSignalRef=DET_CONFD_AZIMUTH_141
            DET_CONFD_AZIMUTH_142_oRDR_DETECTION_141_144_oPCAN_RADAR_3d5d1c83_Tx: ComBitPosition=230, ComBitSize=2, ComSignalInitValue=0, ComSignalType=UINT8, ComSystemTemplateSystemSignalRef=DET_CONFD_AZIMUTH_142
            DET_CONFD_AZIMUTH_143_oRDR_DETECTION_141_144_oPCAN_RADAR_a82dc816_Tx: ComBitPosition=342, ComBitSize=2, ComSignalInitValue=0, ComSignalType=UINT8, ComSystemTemplateSystemSignalRef=DET_CONFD_AZIMUTH_143
            DET_CONFD_AZIMUTH_144_oRDR_DETECTION_141_144_oPCAN_RADAR_f49deb7f_Tx: ComBitPosition=454, ComBitSize=2, ComSignalInitValue=0, ComSignalType=UINT8, ComSystemTemplateSystemSignalRef=DET_CONFD_AZIMUTH_144
            DET_CONFD_ELEVATION_141_oRDR_DETECTION_141_144_oPCAN_RADAR_5b286687_Tx: ComBitPosition=101, ComBitSize=2, ComSignalInitValue=0, ComSignalType=UINT8, ComSystemTemplateSystemSignalRef=DET_CONFD_ELEVATION_141
            DET_CONFD_ELEVATION_142_oRDR_DETECTION_141_144_oPCAN_RADAR_3fc81d79_Tx: ComBitPosition=213, ComBitSize=2, ComSignalInitValue=0, ComSignalType=UINT8, ComSystemTemplateSystemSignalRef=DET_CONFD_ELEVATION_142
            DET_CONFD_ELEVATION_143_oRDR_DETECTION_141_144_oPCAN_RADAR_aab8c9ec_Tx: ComBitPosition=325, ComBitSize=2, ComSignalInitValue=0, ComSignalType=UINT8, ComSystemTemplateSystemSignalRef=DET_CONFD_ELEVATION_143
            DET_CONFD_ELEVATION_144_oRDR_DETECTION_141_144_oPCAN_RADAR_f608ea85_Tx: ComBitPosition=437, ComBitSize=2, ComSignalInitValue=0, ComSignalType=UINT8, ComSystemTemplateSystemSignalRef=DET_CONFD_ELEVATION_144
            DET_ELEVATION_141_oRDR_DETECTION_141_144_oPCAN_RADAR_8ae8b2bb_Tx: ComBitPosition=72, ComBitSize=8, ComSignalInitValue=0, ComSignalType=UINT8, ComSystemTemplateSystemSignalRef=DET_ELEVATION_141
            DET_ELEVATION_142_oRDR_DETECTION_141_144_oPCAN_RADAR_ee08c945_Tx: ComBitPosition=184, ComBitSize=8, ComSignalInitValue=0, ComSignalType=UINT8, ComSystemTemplateSystemSignalRef=DET_ELEVATION_142
            DET_ELEVATION_143_oRDR_DETECTION_141_144_oPCAN_RADAR_7b781dd0_Tx: ComBitPosition=296, ComBitSize=8, ComSignalInitValue=0, ComSignalType=UINT8, ComSystemTemplateSystemSignalRef=DET_ELEVATION_143
            DET_ELEVATION_144_oRDR_DETECTION_141_144_oPCAN_RADAR_27c83eb9_Tx: ComBitPosition=408, ComBitSize=8, ComSignalInitValue=0, ComSignalType=UINT8, ComSystemTemplateSystemSignalRef=DET_ELEVATION_144
            DET_ELEVATION_ERR_141_oRDR_DETECTION_141_144_oPCAN_RADAR_0dd12ace_Tx: ComBitPosition=80, ComBitSize=6, ComSignalInitValue=0, ComSignalType=UINT8, ComSystemTemplateSystemSignalRef=DET_ELEVATION_ERR_141
            DET_ELEVATION_ERR_142_oRDR_DETECTION_141_144_oPCAN_RADAR_69315130_Tx: ComBitPosition=192, ComBitSize=6, ComSignalInitValue=0, ComSignalType=UINT8, ComSystemTemplateSystemSignalRef=DET_ELEVATION_ERR_142
            DET_ELEVATION_ERR_143_oRDR_DETECTION_141_144_oPCAN_RADAR_fc4185a5_Tx: ComBitPosition=304, ComBitSize=6, ComSignalInitValue=0, ComSignalType=UINT8, ComSystemTemplateSystemSignalRef=DET_ELEVATION_ERR_143
            DET_ELEVATION_ERR_144_oRDR_DETECTION_141_144_oPCAN_RADAR_a0f1a6cc_Tx: ComBitPosition=416, ComBitSize=6, ComSignalInitValue=0, ComSignalType=UINT8, ComSystemTemplateSystemSignalRef=DET_ELEVATION_ERR_144
            DET_EXISTENCE_PROB_141_oRDR_DETECTION_141_144_oPCAN_RADAR_df4e5fae_Tx: ComBitPosition=112, ComBitSize=6, ComSignalInitValue=0, ComSignalType=UINT8, ComSystemTemplateSystemSignalRef=DET_EXISTENCE_PROB_141
            DET_EXISTENCE_PROB_142_oRDR_DETECTION_141_144_oPCAN_RADAR_bbae2450_Tx: ComBitPosition=224, ComBitSize=6, ComSignalInitValue=0, ComSignalType=UINT8, ComSystemTemplateSystemSignalRef=DET_EXISTENCE_PROB_142
            DET_EXISTENCE_PROB_143_oRDR_DETECTION_141_144_oPCAN_RADAR_2edef0c5_Tx: ComBitPosition=336, ComBitSize=6, ComSignalInitValue=0, ComSignalType=UINT8, ComSystemTemplateSystemSignalRef=DET_EXISTENCE_PROB_143
            DET_EXISTENCE_PROB_144_oRDR_DETECTION_141_144_oPCAN_RADAR_726ed3ac_Tx: ComBitPosition=448, ComBitSize=6, ComSignalInitValue=0, ComSignalType=UINT8, ComSystemTemplateSystemSignalRef=DET_EXISTENCE_PROB_144
            DET_HVC_FLAG_141_oRDR_DETECTION_141_144_oPCAN_RADAR_3e3a1cd1_Tx: ComBitPosition=86, ComBitSize=1, ComSignalInitValue=0, ComSignalType=BOOLEAN, ComSystemTemplateSystemSignalRef=DET_HVC_FLAG_141
            DET_HVC_FLAG_142_oRDR_DETECTION_141_144_oPCAN_RADAR_5ada672f_Tx: ComBitPosition=198, ComBitSize=1, ComSignalInitValue=0, ComSignalType=BOOLEAN, ComSystemTemplateSystemSignalRef=DET_HVC_FLAG_142
            DET_HVC_FLAG_143_oRDR_DETECTION_141_144_oPCAN_RADAR_cfaab3ba_Tx: ComBitPosition=310, ComBitSize=1, ComSignalInitValue=0, ComSignalType=BOOLEAN, ComSystemTemplateSystemSignalRef=DET_HVC_FLAG_143
            DET_HVC_FLAG_144_oRDR_DETECTION_141_144_oPCAN_RADAR_931a90d3_Tx: ComBitPosition=422, ComBitSize=1, ComSignalInitValue=0, ComSignalType=BOOLEAN, ComSystemTemplateSystemSignalRef=DET_HVC_FLAG_144
            DET_IDM_141_oRDR_DETECTION_141_144_oPCAN_RADAR_b568276c_Tx: ComBitPosition=63, ComBitSize=1, ComSignalInitValue=0, ComSignalType=BOOLEAN, ComSystemTemplateSystemSignalRef=DET_IDM_141
            DET_IDM_142_oRDR_DETECTION_141_144_oPCAN_RADAR_d1885c92_Tx: ComBitPosition=175, ComBitSize=1, ComSignalInitValue=0, ComSignalType=BOOLEAN, ComSystemTemplateSystemSignalRef=DET_IDM_142
            DET_IDM_143_oRDR_DETECTION_141_144_oPCAN_RADAR_44f88807_Tx: ComBitPosition=287, ComBitSize=1, ComSignalInitValue=0, ComSignalType=BOOLEAN, ComSystemTemplateSystemSignalRef=DET_IDM_143
            DET_IDM_144_oRDR_DETECTION_141_144_oPCAN_RADAR_1848ab6e_Tx: ComBitPosition=399, ComBitSize=1, ComSignalInitValue=0, ComSignalType=BOOLEAN, ComSystemTemplateSystemSignalRef=DET_IDM_144
            DET_MH_CRC16_141_144_oRDR_DETECTION_141_144_oPCAN_RADAR_738325b6_Tx: ComBitPosition=0, ComBitSize=16, ComSignalInitValue=0, ComSignalType=UINT16, ComSystemTemplateSystemSignalRef=DET_MH_CRC16_141_144
            DET_MH_CYCLE_COUNTER_141_144_oRDR_DETECTION_141_144_oPCAN_RADAR_f7f68481_Tx: ComBitPosition=16, ComBitSize=8, ComSignalInitValue=0, ComSignalType=UINT8, ComSystemTemplateSystemSignalRef=DET_MH_CYCLE_COUNTER_141_144
            DET_MH_SCAN_INDEX_4LSB_141_144_oRDR_DETECTION_141_144_oPCAN_RADAR_3bdca10d_Tx: ComBitPosition=476, ComBitSize=4, ComSignalInitValue=0, ComSignalType=UINT8, ComSystemTemplateSystemSignalRef=DET_MH_SCAN_INDEX_4LSB_141_144
            DET_MTD_141_oRDR_DETECTION_141_144_oPCAN_RADAR_d3db15b7_Tx: ComBitPosition=47, ComBitSize=1, ComSignalInitValue=0, ComSignalType=BOOLEAN, ComSystemTemplateSystemSignalRef=DET_MTD_141
            DET_MTD_142_oRDR_DETECTION_141_144_oPCAN_RADAR_b73b6e49_Tx: ComBitPosition=159, ComBitSize=1, ComSignalInitValue=0, ComSignalType=BOOLEAN, ComSystemTemplateSystemSignalRef=DET_MTD_142
            DET_MTD_143_oRDR_DETECTION_141_144_oPCAN_RADAR_224bbadc_Tx: ComBitPosition=271, ComBitSize=1, ComSignalInitValue=0, ComSignalType=BOOLEAN, ComSystemTemplateSystemSignalRef=DET_MTD_143
            DET_MTD_144_oRDR_DETECTION_141_144_oPCAN_RADAR_7efb99b5_Tx: ComBitPosition=383, ComBitSize=1, ComSignalInitValue=0, ComSignalType=BOOLEAN, ComSystemTemplateSystemSignalRef=DET_MTD_144
            DET_PROB_1STAZHYPO_141_oRDR_DETECTION_141_144_oPCAN_RADAR_406ffd7a_Tx: ComBitPosition=103, ComBitSize=1, ComSignalInitValue=0, ComSignalType=BOOLEAN, ComSystemTemplateSystemSignalRef=DET_PROB_1STAZHYPO_141
            DET_PROB_1STAZHYPO_142_oRDR_DETECTION_141_144_oPCAN_RADAR_248f8684_Tx: ComBitPosition=215, ComBitSize=1, ComSignalInitValue=0, ComSignalType=BOOLEAN, ComSystemTemplateSystemSignalRef=DET_PROB_1STAZHYPO_142
            DET_PROB_1STAZHYPO_143_oRDR_DETECTION_141_144_oPCAN_RADAR_b1ff5211_Tx: ComBitPosition=327, ComBitSize=1, ComSignalInitValue=0, ComSignalType=BOOLEAN, ComSystemTemplateSystemSignalRef=DET_PROB_1STAZHYPO_143
            DET_PROB_1STAZHYPO_144_oRDR_DETECTION_141_144_oPCAN_RADAR_ed4f7178_Tx: ComBitPosition=439, ComBitSize=1, ComSignalInitValue=0, ComSignalType=BOOLEAN, ComSystemTemplateSystemSignalRef=DET_PROB_1STAZHYPO_144
            DET_RANGE_141_oRDR_DETECTION_141_144_oPCAN_RADAR_4bc01e0c_Tx: ComBitPosition=24, ComBitSize=15, ComSignalInitValue=0, ComSignalType=UINT16, ComSystemTemplateSystemSignalRef=DET_RANGE_141
            DET_RANGE_142_oRDR_DETECTION_141_144_oPCAN_RADAR_2f2065f2_Tx: ComBitPosition=136, ComBitSize=15, ComSignalInitValue=0, ComSignalType=UINT16, ComSystemTemplateSystemSignalRef=DET_RANGE_142
            DET_RANGE_143_oRDR_DETECTION_141_144_oPCAN_RADAR_ba50b167_Tx: ComBitPosition=248, ComBitSize=15, ComSignalInitValue=0, ComSignalType=UINT16, ComSystemTemplateSystemSignalRef=DET_RANGE_143
            DET_RANGE_144_oRDR_DETECTION_141_144_oPCAN_RADAR_e6e0920e_Tx: ComBitPosition=360, ComBitSize=15, ComSignalInitValue=0, ComSignalType=UINT16, ComSystemTemplateSystemSignalRef=DET_RANGE_144
            DET_RANGE_ERR_141_oRDR_DETECTION_141_144_oPCAN_RADAR_ec28a465_Tx: ComBitPosition=40, ComBitSize=7, ComSignalInitValue=0, ComSignalType=UINT8, ComSystemTemplateSystemSignalRef=DET_RANGE_ERR_141
            DET_RANGE_ERR_142_oRDR_DETECTION_141_144_oPCAN_RADAR_88c8df9b_Tx: ComBitPosition=152, ComBitSize=7, ComSignalInitValue=0, ComSignalType=UINT8, ComSystemTemplateSystemSignalRef=DET_RANGE_ERR_142
            DET_RANGE_ERR_143_oRDR_DETECTION_141_144_oPCAN_RADAR_1db80b0e_Tx: ComBitPosition=264, ComBitSize=7, ComSignalInitValue=0, ComSignalType=UINT8, ComSystemTemplateSystemSignalRef=DET_RANGE_ERR_143
            DET_RANGE_ERR_144_oRDR_DETECTION_141_144_oPCAN_RADAR_41082867_Tx: ComBitPosition=376, ComBitSize=7, ComSignalInitValue=0, ComSignalType=UINT8, ComSystemTemplateSystemSignalRef=DET_RANGE_ERR_144
            DET_RANGE_VELOCITY_141_oRDR_DETECTION_141_144_oPCAN_RADAR_3e66dc29_Tx: ComBitPosition=48, ComBitSize=15, ComSignalInitValue=16384, ComSignalType=UINT16, ComSystemTemplateSystemSignalRef=DET_RANGE_VELOCITY_141
            DET_RANGE_VELOCITY_142_oRDR_DETECTION_141_144_oPCAN_RADAR_5a86a7d7_Tx: ComBitPosition=160, ComBitSize=15, ComSignalInitValue=16384, ComSignalType=UINT16, ComSystemTemplateSystemSignalRef=DET_RANGE_VELOCITY_142
            DET_RANGE_VELOCITY_143_oRDR_DETECTION_141_144_oPCAN_RADAR_cff67342_Tx: ComBitPosition=272, ComBitSize=15, ComSignalInitValue=16384, ComSignalType=UINT16, ComSystemTemplateSystemSignalRef=DET_RANGE_VELOCITY_143
            DET_RANGE_VELOCITY_144_oRDR_DETECTION_141_144_oPCAN_RADAR_9346502b_Tx: ComBitPosition=384, ComBitSize=15, ComSignalInitValue=16384, ComSignalType=UINT16, ComSystemTemplateSystemSignalRef=DET_RANGE_VELOCITY_144
            DET_RANGE_VELOCITY_ERR_141_oRDR_DETECTION_141_144_oPCAN_RADAR_31dd279b_Tx: ComBitPosition=64, ComBitSize=8, ComSignalInitValue=0, ComSignalType=UINT8, ComSystemTemplateSystemSignalRef=DET_RANGE_VELOCITY_ERR_141
            DET_RANGE_VELOCITY_ERR_142_oRDR_DETECTION_141_144_oPCAN_RADAR_553d5c65_Tx: ComBitPosition=176, ComBitSize=8, ComSignalInitValue=0, ComSignalType=UINT8, ComSystemTemplateSystemSignalRef=DET_RANGE_VELOCITY_ERR_142
            DET_RANGE_VELOCITY_ERR_143_oRDR_DETECTION_141_144_oPCAN_RADAR_c04d88f0_Tx: ComBitPosition=288, ComBitSize=8, ComSignalInitValue=0, ComSignalType=UINT8, ComSystemTemplateSystemSignalRef=DET_RANGE_VELOCITY_ERR_143
            DET_RANGE_VELOCITY_ERR_144_oRDR_DETECTION_141_144_oPCAN_RADAR_9cfdab99_Tx: ComBitPosition=400, ComBitSize=8, ComSignalInitValue=0, ComSignalType=UINT8, ComSystemTemplateSystemSignalRef=DET_RANGE_VELOCITY_ERR_144
            DET_RCS_141_oRDR_DETECTION_141_144_oPCAN_RADAR_b9e6eb73_Tx: ComBitPosition=128, ComBitSize=8, ComSignalInitValue=128, ComSignalType=UINT8, ComSystemTemplateSystemSignalRef=DET_RCS_141
            DET_RCS_142_oRDR_DETECTION_141_144_oPCAN_RADAR_dd06908d_Tx: ComBitPosition=240, ComBitSize=8, ComSignalInitValue=128, ComSignalType=UINT8, ComSystemTemplateSystemSignalRef=DET_RCS_142
            DET_RCS_143_oRDR_DETECTION_141_144_oPCAN_RADAR_48764418_Tx: ComBitPosition=352, ComBitSize=8, ComSignalInitValue=128, ComSignalType=UINT8, ComSystemTemplateSystemSignalRef=DET_RCS_143
            DET_RCS_144_oRDR_DETECTION_141_144_oPCAN_RADAR_14c66771_Tx: ComBitPosition=464, ComBitSize=8, ComSignalInitValue=128, ComSignalType=UINT8, ComSystemTemplateSystemSignalRef=DET_RCS_144
            DET_SNR_141_oRDR_DETECTION_141_144_oPCAN_RADAR_6448bf71_Tx: ComBitPosition=120, ComBitSize=8, ComSignalInitValue=0, ComSignalType=UINT8, ComSystemTemplateSystemSignalRef=DET_SNR_141
            DET_SNR_142_oRDR_DETECTION_141_144_oPCAN_RADAR_00a8c48f_Tx: ComBitPosition=232, ComBitSize=8, ComSignalInitValue=0, ComSignalType=UINT8, ComSystemTemplateSystemSignalRef=DET_SNR_142
            DET_SNR_143_oRDR_DETECTION_141_144_oPCAN_RADAR_95d8101a_Tx: ComBitPosition=344, ComBitSize=8, ComSignalInitValue=0, ComSignalType=UINT8, ComSystemTemplateSystemSignalRef=DET_SNR_143
            DET_SNR_144_oRDR_DETECTION_141_144_oPCAN_RADAR_c9683373_Tx: ComBitPosition=456, ComBitSize=8, ComSignalInitValue=0, ComSignalType=UINT8, ComSystemTemplateSystemSignalRef=DET_SNR_144
            DET_SUPER_RES_TARGET_141_oRDR_DETECTION_141_144_oPCAN_RADAR_55d19714_Tx: ComBitPosition=87, ComBitSize=1, ComSignalInitValue=0, ComSignalType=BOOLEAN, ComSystemTemplateSystemSignalRef=DET_SUPER_RES_TARGET_141
            DET_SUPER_RES_TARGET_142_oRDR_DETECTION_141_144_oPCAN_RADAR_3131ecea_Tx: ComBitPosition=199, ComBitSize=1, ComSignalInitValue=0, ComSignalType=BOOLEAN, ComSystemTemplateSystemSignalRef=DET_SUPER_RES_TARGET_142
            DET_SUPER_RES_TARGET_143_oRDR_DETECTION_141_144_oPCAN_RADAR_a441387f_Tx: ComBitPosition=311, ComBitSize=1, ComSignalInitValue=0, ComSignalType=BOOLEAN, ComSystemTemplateSystemSignalRef=DET_SUPER_RES_TARGET_143
            DET_SUPER_RES_TARGET_144_oRDR_DETECTION_141_144_oPCAN_RADAR_f8f11b16_Tx: ComBitPosition=423, ComBitSize=1, ComSignalInitValue=0, ComSignalType=BOOLEAN, ComSystemTemplateSystemSignalRef=DET_SUPER_RES_TARGET_144
        SG_Detections_145_148_oRDR_DETECTION_145_148_oPCAN_RADAR_86c8c3ef_Tx: ComSystemTemplateSignalGroupRef=SG_Detections_145_148
          83 x ComGroupSignal, all with ComSignalEndianness=LITTLE_ENDIAN, ComTransferProperty=PENDING:
            DET_AZIMUTH_145_oRDR_DETECTION_145_148_oPCAN_RADAR_8ab9ab14_Tx: ComBitPosition=88, ComBitSize=13, ComSignalInitValue=0, ComSignalType=UINT16, ComSystemTemplateSystemSignalRef=DET_AZIMUTH_145
            DET_AZIMUTH_146_oRDR_DETECTION_145_148_oPCAN_RADAR_ee59d0ea_Tx: ComBitPosition=200, ComBitSize=13, ComSignalInitValue=0, ComSignalType=UINT16, ComSystemTemplateSystemSignalRef=DET_AZIMUTH_146
            DET_AZIMUTH_147_oRDR_DETECTION_145_148_oPCAN_RADAR_7b29047f_Tx: ComBitPosition=312, ComBitSize=13, ComSignalInitValue=0, ComSignalType=UINT16, ComSystemTemplateSystemSignalRef=DET_AZIMUTH_147
            DET_AZIMUTH_148_oRDR_DETECTION_145_148_oPCAN_RADAR_57399638_Tx: ComBitPosition=424, ComBitSize=13, ComSignalInitValue=0, ComSignalType=UINT16, ComSystemTemplateSystemSignalRef=DET_AZIMUTH_148
            DET_AZIMUTH_ERR_145_oRDR_DETECTION_145_148_oPCAN_RADAR_2e0c3ee1_Tx: ComBitPosition=105, ComBitSize=7, ComSignalInitValue=0, ComSignalType=UINT8, ComSystemTemplateSystemSignalRef=DET_AZIMUTH_ERR_145
            DET_AZIMUTH_ERR_146_oRDR_DETECTION_145_148_oPCAN_RADAR_4aec451f_Tx: ComBitPosition=217, ComBitSize=7, ComSignalInitValue=0, ComSignalType=UINT8, ComSystemTemplateSystemSignalRef=DET_AZIMUTH_ERR_146
            DET_AZIMUTH_ERR_147_oRDR_DETECTION_145_148_oPCAN_RADAR_df9c918a_Tx: ComBitPosition=329, ComBitSize=7, ComSignalInitValue=0, ComSignalType=UINT8, ComSystemTemplateSystemSignalRef=DET_AZIMUTH_ERR_147
            DET_AZIMUTH_ERR_148_oRDR_DETECTION_145_148_oPCAN_RADAR_f38c03cd_Tx: ComBitPosition=441, ComBitSize=7, ComSignalInitValue=0, ComSignalType=UINT8, ComSystemTemplateSystemSignalRef=DET_AZIMUTH_ERR_148
            DET_BELOW_RAIN_THOLD_145_oRDR_DETECTION_145_148_oPCAN_RADAR_5fb838d4_Tx: ComBitPosition=39, ComBitSize=1, ComSignalInitValue=0, ComSignalType=BOOLEAN, ComSystemTemplateSystemSignalRef=DET_BELOW_RAIN_THOLD_145
            DET_BELOW_RAIN_THOLD_146_oRDR_DETECTION_145_148_oPCAN_RADAR_3b58432a_Tx: ComBitPosition=151, ComBitSize=1, ComSignalInitValue=0, ComSignalType=BOOLEAN, ComSystemTemplateSystemSignalRef=DET_BELOW_RAIN_THOLD_146
            DET_BELOW_RAIN_THOLD_147_oRDR_DETECTION_145_148_oPCAN_RADAR_ae2897bf_Tx: ComBitPosition=263, ComBitSize=1, ComSignalInitValue=0, ComSignalType=BOOLEAN, ComSystemTemplateSystemSignalRef=DET_BELOW_RAIN_THOLD_147
            DET_BELOW_RAIN_THOLD_148_oRDR_DETECTION_145_148_oPCAN_RADAR_823805f8_Tx: ComBitPosition=375, ComBitSize=1, ComSignalInitValue=0, ComSignalType=BOOLEAN, ComSystemTemplateSystemSignalRef=DET_BELOW_RAIN_THOLD_148
            DET_BI_STATIC_FLAG_145_oRDR_DETECTION_145_148_oPCAN_RADAR_dc95eb91_Tx: ComBitPosition=104, ComBitSize=1, ComSignalInitValue=0, ComSignalType=BOOLEAN, ComSystemTemplateSystemSignalRef=DET_BI_STATIC_FLAG_145
            DET_BI_STATIC_FLAG_146_oRDR_DETECTION_145_148_oPCAN_RADAR_b875906f_Tx: ComBitPosition=216, ComBitSize=1, ComSignalInitValue=0, ComSignalType=BOOLEAN, ComSystemTemplateSystemSignalRef=DET_BI_STATIC_FLAG_146
            DET_BI_STATIC_FLAG_147_oRDR_DETECTION_145_148_oPCAN_RADAR_2d0544fa_Tx: ComBitPosition=328, ComBitSize=1, ComSignalInitValue=0, ComSignalType=BOOLEAN, ComSystemTemplateSystemSignalRef=DET_BI_STATIC_FLAG_147
            DET_BI_STATIC_FLAG_148_oRDR_DETECTION_145_148_oPCAN_RADAR_0115d6bd_Tx: ComBitPosition=440, ComBitSize=1, ComSignalInitValue=0, ComSignalType=BOOLEAN, ComSystemTemplateSystemSignalRef=DET_BI_STATIC_FLAG_148
            DET_CONFD_AZIMUTH_145_oRDR_DETECTION_145_148_oPCAN_RADAR_885fa1de_Tx: ComBitPosition=118, ComBitSize=2, ComSignalInitValue=0, ComSignalType=UINT8, ComSystemTemplateSystemSignalRef=DET_CONFD_AZIMUTH_145
            DET_CONFD_AZIMUTH_146_oRDR_DETECTION_145_148_oPCAN_RADAR_ecbfda20_Tx: ComBitPosition=230, ComBitSize=2, ComSignalInitValue=0, ComSignalType=UINT8, ComSystemTemplateSystemSignalRef=DET_CONFD_AZIMUTH_146
            DET_CONFD_AZIMUTH_147_oRDR_DETECTION_145_148_oPCAN_RADAR_79cf0eb5_Tx: ComBitPosition=342, ComBitSize=2, ComSignalInitValue=0, ComSignalType=UINT8, ComSystemTemplateSystemSignalRef=DET_CONFD_AZIMUTH_147
            DET_CONFD_AZIMUTH_148_oRDR_DETECTION_145_148_oPCAN_RADAR_55df9cf2_Tx: ComBitPosition=454, ComBitSize=2, ComSignalInitValue=0, ComSignalType=UINT8, ComSystemTemplateSystemSignalRef=DET_CONFD_AZIMUTH_148
            DET_CONFD_ELEVATION_145_oRDR_DETECTION_145_148_oPCAN_RADAR_8acaa024_Tx: ComBitPosition=101, ComBitSize=2, ComSignalInitValue=0, ComSignalType=UINT8, ComSystemTemplateSystemSignalRef=DET_CONFD_ELEVATION_145
            DET_CONFD_ELEVATION_146_oRDR_DETECTION_145_148_oPCAN_RADAR_ee2adbda_Tx: ComBitPosition=213, ComBitSize=2, ComSignalInitValue=0, ComSignalType=UINT8, ComSystemTemplateSystemSignalRef=DET_CONFD_ELEVATION_146
            DET_CONFD_ELEVATION_147_oRDR_DETECTION_145_148_oPCAN_RADAR_7b5a0f4f_Tx: ComBitPosition=325, ComBitSize=2, ComSignalInitValue=0, ComSignalType=UINT8, ComSystemTemplateSystemSignalRef=DET_CONFD_ELEVATION_147
            DET_CONFD_ELEVATION_148_oRDR_DETECTION_145_148_oPCAN_RADAR_574a9d08_Tx: ComBitPosition=437, ComBitSize=2, ComSignalInitValue=0, ComSignalType=UINT8, ComSystemTemplateSystemSignalRef=DET_CONFD_ELEVATION_148
            DET_ELEVATION_145_oRDR_DETECTION_145_148_oPCAN_RADAR_5b0a7418_Tx: ComBitPosition=72, ComBitSize=8, ComSignalInitValue=0, ComSignalType=UINT8, ComSystemTemplateSystemSignalRef=DET_ELEVATION_145
            DET_ELEVATION_146_oRDR_DETECTION_145_148_oPCAN_RADAR_3fea0fe6_Tx: ComBitPosition=184, ComBitSize=8, ComSignalInitValue=0, ComSignalType=UINT8, ComSystemTemplateSystemSignalRef=DET_ELEVATION_146
            DET_ELEVATION_147_oRDR_DETECTION_145_148_oPCAN_RADAR_aa9adb73_Tx: ComBitPosition=296, ComBitSize=8, ComSignalInitValue=0, ComSignalType=UINT8, ComSystemTemplateSystemSignalRef=DET_ELEVATION_147
            DET_ELEVATION_148_oRDR_DETECTION_145_148_oPCAN_RADAR_868a4934_Tx: ComBitPosition=408, ComBitSize=8, ComSignalInitValue=0, ComSignalType=UINT8, ComSystemTemplateSystemSignalRef=DET_ELEVATION_148
            DET_ELEVATION_ERR_145_oRDR_DETECTION_145_148_oPCAN_RADAR_dc33ec6d_Tx: ComBitPosition=80, ComBitSize=6, ComSignalInitValue=0, ComSignalType=UINT8, ComSystemTemplateSystemSignalRef=DET_ELEVATION_ERR_145
            DET_ELEVATION_ERR_146_oRDR_DETECTION_145_148_oPCAN_RADAR_b8d39793_Tx: ComBitPosition=192, ComBitSize=6, ComSignalInitValue=0, ComSignalType=UINT8, ComSystemTemplateSystemSignalRef=DET_ELEVATION_ERR_146
            DET_ELEVATION_ERR_147_oRDR_DETECTION_145_148_oPCAN_RADAR_2da34306_Tx: ComBitPosition=304, ComBitSize=6, ComSignalInitValue=0, ComSignalType=UINT8, ComSystemTemplateSystemSignalRef=DET_ELEVATION_ERR_147
            DET_ELEVATION_ERR_148_oRDR_DETECTION_145_148_oPCAN_RADAR_01b3d141_Tx: ComBitPosition=416, ComBitSize=6, ComSignalInitValue=0, ComSignalType=UINT8, ComSystemTemplateSystemSignalRef=DET_ELEVATION_ERR_148
            DET_EXISTENCE_PROB_145_oRDR_DETECTION_145_148_oPCAN_RADAR_0eac990d_Tx: ComBitPosition=112, ComBitSize=6, ComSignalInitValue=0, ComSignalType=UINT8, ComSystemTemplateSystemSignalRef=DET_EXISTENCE_PROB_145
            DET_EXISTENCE_PROB_146_oRDR_DETECTION_145_148_oPCAN_RADAR_6a4ce2f3_Tx: ComBitPosition=224, ComBitSize=6, ComSignalInitValue=0, ComSignalType=UINT8, ComSystemTemplateSystemSignalRef=DET_EXISTENCE_PROB_146
            DET_EXISTENCE_PROB_147_oRDR_DETECTION_145_148_oPCAN_RADAR_ff3c3666_Tx: ComBitPosition=336, ComBitSize=6, ComSignalInitValue=0, ComSignalType=UINT8, ComSystemTemplateSystemSignalRef=DET_EXISTENCE_PROB_147
            DET_EXISTENCE_PROB_148_oRDR_DETECTION_145_148_oPCAN_RADAR_d32ca421_Tx: ComBitPosition=448, ComBitSize=6, ComSignalInitValue=0, ComSignalType=UINT8, ComSystemTemplateSystemSignalRef=DET_EXISTENCE_PROB_148
            DET_HVC_FLAG_145_oRDR_DETECTION_145_148_oPCAN_RADAR_efd8da72_Tx: ComBitPosition=86, ComBitSize=1, ComSignalInitValue=0, ComSignalType=BOOLEAN, ComSystemTemplateSystemSignalRef=DET_HVC_FLAG_145
            DET_HVC_FLAG_146_oRDR_DETECTION_145_148_oPCAN_RADAR_8b38a18c_Tx: ComBitPosition=198, ComBitSize=1, ComSignalInitValue=0, ComSignalType=BOOLEAN, ComSystemTemplateSystemSignalRef=DET_HVC_FLAG_146
            DET_HVC_FLAG_147_oRDR_DETECTION_145_148_oPCAN_RADAR_1e487519_Tx: ComBitPosition=310, ComBitSize=1, ComSignalInitValue=0, ComSignalType=BOOLEAN, ComSystemTemplateSystemSignalRef=DET_HVC_FLAG_147
            DET_HVC_FLAG_148_oRDR_DETECTION_145_148_oPCAN_RADAR_3258e75e_Tx: ComBitPosition=422, ComBitSize=1, ComSignalInitValue=0, ComSignalType=BOOLEAN, ComSystemTemplateSystemSignalRef=DET_HVC_FLAG_148
            DET_IDM_145_oRDR_DETECTION_145_148_oPCAN_RADAR_648ae1cf_Tx: ComBitPosition=63, ComBitSize=1, ComSignalInitValue=0, ComSignalType=BOOLEAN, ComSystemTemplateSystemSignalRef=DET_IDM_145
            DET_IDM_146_oRDR_DETECTION_145_148_oPCAN_RADAR_006a9a31_Tx: ComBitPosition=175, ComBitSize=1, ComSignalInitValue=0, ComSignalType=BOOLEAN, ComSystemTemplateSystemSignalRef=DET_IDM_146
            DET_IDM_147_oRDR_DETECTION_145_148_oPCAN_RADAR_951a4ea4_Tx: ComBitPosition=287, ComBitSize=1, ComSignalInitValue=0, ComSignalType=BOOLEAN, ComSystemTemplateSystemSignalRef=DET_IDM_147
            DET_IDM_148_oRDR_DETECTION_145_148_oPCAN_RADAR_b90adce3_Tx: ComBitPosition=399, ComBitSize=1, ComSignalInitValue=0, ComSignalType=BOOLEAN, ComSystemTemplateSystemSignalRef=DET_IDM_148
            DET_MH_CRC16_145_148_oRDR_DETECTION_145_148_oPCAN_RADAR_024011e4_Tx: ComBitPosition=0, ComBitSize=16, ComSignalInitValue=0, ComSignalType=UINT16, ComSystemTemplateSystemSignalRef=DET_MH_CRC16_145_148
            DET_MH_CYCLE_COUNTER_145_148_oRDR_DETECTION_145_148_oPCAN_RADAR_8635b0d3_Tx: ComBitPosition=16, ComBitSize=8, ComSignalInitValue=0, ComSignalType=UINT8, ComSystemTemplateSystemSignalRef=DET_MH_CYCLE_COUNTER_145_148
            DET_MH_SCAN_INDEX_4LSB_145_148_oRDR_DETECTION_145_148_oPCAN_RADAR_4a1f955f_Tx: ComBitPosition=476, ComBitSize=4, ComSignalInitValue=0, ComSignalType=UINT8, ComSystemTemplateSystemSignalRef=DET_MH_SCAN_INDEX_4LSB_145_148
            DET_MTD_145_oRDR_DETECTION_145_148_oPCAN_RADAR_0239d314_Tx: ComBitPosition=47, ComBitSize=1, ComSignalInitValue=0, ComSignalType=BOOLEAN, ComSystemTemplateSystemSignalRef=DET_MTD_145
            DET_MTD_146_oRDR_DETECTION_145_148_oPCAN_RADAR_66d9a8ea_Tx: ComBitPosition=159, ComBitSize=1, ComSignalInitValue=0, ComSignalType=BOOLEAN, ComSystemTemplateSystemSignalRef=DET_MTD_146
            DET_MTD_147_oRDR_DETECTION_145_148_oPCAN_RADAR_f3a97c7f_Tx: ComBitPosition=271, ComBitSize=1, ComSignalInitValue=0, ComSignalType=BOOLEAN, ComSystemTemplateSystemSignalRef=DET_MTD_147
            DET_MTD_148_oRDR_DETECTION_145_148_oPCAN_RADAR_dfb9ee38_Tx: ComBitPosition=383, ComBitSize=1, ComSignalInitValue=0, ComSignalType=BOOLEAN, ComSystemTemplateSystemSignalRef=DET_MTD_148
            DET_PROB_1STAZHYPO_145_oRDR_DETECTION_145_148_oPCAN_RADAR_918d3bd9_Tx: ComBitPosition=103, ComBitSize=1, ComSignalInitValue=0, ComSignalType=BOOLEAN, ComSystemTemplateSystemSignalRef=DET_PROB_1STAZHYPO_145
            DET_PROB_1STAZHYPO_146_oRDR_DETECTION_145_148_oPCAN_RADAR_f56d4027_Tx: ComBitPosition=215, ComBitSize=1, ComSignalInitValue=0, ComSignalType=BOOLEAN, ComSystemTemplateSystemSignalRef=DET_PROB_1STAZHYPO_146
            DET_PROB_1STAZHYPO_147_oRDR_DETECTION_145_148_oPCAN_RADAR_601d94b2_Tx: ComBitPosition=327, ComBitSize=1, ComSignalInitValue=0, ComSignalType=BOOLEAN, ComSystemTemplateSystemSignalRef=DET_PROB_1STAZHYPO_147
            DET_PROB_1STAZHYPO_148_oRDR_DETECTION_145_148_oPCAN_RADAR_4c0d06f5_Tx: ComBitPosition=439, ComBitSize=1, ComSignalInitValue=0, ComSignalType=BOOLEAN, ComSystemTemplateSystemSignalRef=DET_PROB_1STAZHYPO_148
            DET_RANGE_145_oRDR_DETECTION_145_148_oPCAN_RADAR_9a22d8af_Tx: ComBitPosition=24, ComBitSize=15, ComSignalInitValue=0, ComSignalType=UINT16, ComSystemTemplateSystemSignalRef=DET_RANGE_145
            DET_RANGE_146_oRDR_DETECTION_145_148_oPCAN_RADAR_fec2a351_Tx: ComBitPosition=136, ComBitSize=15, ComSignalInitValue=0, ComSignalType=UINT16, ComSystemTemplateSystemSignalRef=DET_RANGE_146
            DET_RANGE_147_oRDR_DETECTION_145_148_oPCAN_RADAR_6bb277c4_Tx: ComBitPosition=248, ComBitSize=15, ComSignalInitValue=0, ComSignalType=UINT16, ComSystemTemplateSystemSignalRef=DET_RANGE_147
            DET_RANGE_148_oRDR_DETECTION_145_148_oPCAN_RADAR_47a2e583_Tx: ComBitPosition=360, ComBitSize=15, ComSignalInitValue=0, ComSignalType=UINT16, ComSystemTemplateSystemSignalRef=DET_RANGE_148
            DET_RANGE_ERR_145_oRDR_DETECTION_145_148_oPCAN_RADAR_3dca62c6_Tx: ComBitPosition=40, ComBitSize=7, ComSignalInitValue=0, ComSignalType=UINT8, ComSystemTemplateSystemSignalRef=DET_RANGE_ERR_145
            DET_RANGE_ERR_146_oRDR_DETECTION_145_148_oPCAN_RADAR_592a1938_Tx: ComBitPosition=152, ComBitSize=7, ComSignalInitValue=0, ComSignalType=UINT8, ComSystemTemplateSystemSignalRef=DET_RANGE_ERR_146
            DET_RANGE_ERR_147_oRDR_DETECTION_145_148_oPCAN_RADAR_cc5acdad_Tx: ComBitPosition=264, ComBitSize=7, ComSignalInitValue=0, ComSignalType=UINT8, ComSystemTemplateSystemSignalRef=DET_RANGE_ERR_147
            DET_RANGE_ERR_148_oRDR_DETECTION_145_148_oPCAN_RADAR_e04a5fea_Tx: ComBitPosition=376, ComBitSize=7, ComSignalInitValue=0, ComSignalType=UINT8, ComSystemTemplateSystemSignalRef=DET_RANGE_ERR_148
            DET_RANGE_VELOCITY_145_oRDR_DETECTION_145_148_oPCAN_RADAR_ef841a8a_Tx: ComBitPosition=48, ComBitSize=15, ComSignalInitValue=16384, ComSignalType=UINT16, ComSystemTemplateSystemSignalRef=DET_RANGE_VELOCITY_145
            DET_RANGE_VELOCITY_146_oRDR_DETECTION_145_148_oPCAN_RADAR_8b646174_Tx: ComBitPosition=160, ComBitSize=15, ComSignalInitValue=16384, ComSignalType=UINT16, ComSystemTemplateSystemSignalRef=DET_RANGE_VELOCITY_146
            DET_RANGE_VELOCITY_147_oRDR_DETECTION_145_148_oPCAN_RADAR_1e14b5e1_Tx: ComBitPosition=272, ComBitSize=15, ComSignalInitValue=16384, ComSignalType=UINT16, ComSystemTemplateSystemSignalRef=DET_RANGE_VELOCITY_147
            DET_RANGE_VELOCITY_148_oRDR_DETECTION_145_148_oPCAN_RADAR_320427a6_Tx: ComBitPosition=384, ComBitSize=15, ComSignalInitValue=16384, ComSignalType=UINT16, ComSystemTemplateSystemSignalRef=DET_RANGE_VELOCITY_148
            DET_RANGE_VELOCITY_ERR_145_oRDR_DETECTION_145_148_oPCAN_RADAR_e03fe138_Tx: ComBitPosition=64, ComBitSize=8, ComSignalInitValue=0, ComSignalType=UINT8, ComSystemTemplateSystemSignalRef=DET_RANGE_VELOCITY_ERR_145
            DET_RANGE_VELOCITY_ERR_146_oRDR_DETECTION_145_148_oPCAN_RADAR_84df9ac6_Tx: ComBitPosition=176, ComBitSize=8, ComSignalInitValue=0, ComSignalType=UINT8, ComSystemTemplateSystemSignalRef=DET_RANGE_VELOCITY_ERR_146
            DET_RANGE_VELOCITY_ERR_147_oRDR_DETECTION_145_148_oPCAN_RADAR_11af4e53_Tx: ComBitPosition=288, ComBitSize=8, ComSignalInitValue=0, ComSignalType=UINT8, ComSystemTemplateSystemSignalRef=DET_RANGE_VELOCITY_ERR_147
            DET_RANGE_VELOCITY_ERR_148_oRDR_DETECTION_145_148_oPCAN_RADAR_3dbfdc14_Tx: ComBitPosition=400, ComBitSize=8, ComSignalInitValue=0, ComSignalType=UINT8, ComSystemTemplateSystemSignalRef=DET_RANGE_VELOCITY_ERR_148
            DET_RCS_145_oRDR_DETECTION_145_148_oPCAN_RADAR_68042dd0_Tx: ComBitPosition=128, ComBitSize=8, ComSignalInitValue=128, ComSignalType=UINT8, ComSystemTemplateSystemSignalRef=DET_RCS_145
            DET_RCS_146_oRDR_DETECTION_145_148_oPCAN_RADAR_0ce4562e_Tx: ComBitPosition=240, ComBitSize=8, ComSignalInitValue=128, ComSignalType=UINT8, ComSystemTemplateSystemSignalRef=DET_RCS_146
            DET_RCS_147_oRDR_DETECTION_145_148_oPCAN_RADAR_999482bb_Tx: ComBitPosition=352, ComBitSize=8, ComSignalInitValue=128, ComSignalType=UINT8, ComSystemTemplateSystemSignalRef=DET_RCS_147
            DET_RCS_148_oRDR_DETECTION_145_148_oPCAN_RADAR_b58410fc_Tx: ComBitPosition=464, ComBitSize=8, ComSignalInitValue=128, ComSignalType=UINT8, ComSystemTemplateSystemSignalRef=DET_RCS_148
            DET_SNR_145_oRDR_DETECTION_145_148_oPCAN_RADAR_b5aa79d2_Tx: ComBitPosition=120, ComBitSize=8, ComSignalInitValue=0, ComSignalType=UINT8, ComSystemTemplateSystemSignalRef=DET_SNR_145
            DET_SNR_146_oRDR_DETECTION_145_148_oPCAN_RADAR_d14a022c_Tx: ComBitPosition=232, ComBitSize=8, ComSignalInitValue=0, ComSignalType=UINT8, ComSystemTemplateSystemSignalRef=DET_SNR_146
            DET_SNR_147_oRDR_DETECTION_145_148_oPCAN_RADAR_443ad6b9_Tx: ComBitPosition=344, ComBitSize=8, ComSignalInitValue=0, ComSignalType=UINT8, ComSystemTemplateSystemSignalRef=DET_SNR_147
            DET_SNR_148_oRDR_DETECTION_145_148_oPCAN_RADAR_682a44fe_Tx: ComBitPosition=456, ComBitSize=8, ComSignalInitValue=0, ComSignalType=UINT8, ComSystemTemplateSystemSignalRef=DET_SNR_148
            DET_SUPER_RES_TARGET_145_oRDR_DETECTION_145_148_oPCAN_RADAR_843351b7_Tx: ComBitPosition=87, ComBitSize=1, ComSignalInitValue=0, ComSignalType=BOOLEAN, ComSystemTemplateSystemSignalRef=DET_SUPER_RES_TARGET_145
            DET_SUPER_RES_TARGET_146_oRDR_DETECTION_145_148_oPCAN_RADAR_e0d32a49_Tx: ComBitPosition=199, ComBitSize=1, ComSignalInitValue=0, ComSignalType=BOOLEAN, ComSystemTemplateSystemSignalRef=DET_SUPER_RES_TARGET_146
            DET_SUPER_RES_TARGET_147_oRDR_DETECTION_145_148_oPCAN_RADAR_75a3fedc_Tx: ComBitPosition=311, ComBitSize=1, ComSignalInitValue=0, ComSignalType=BOOLEAN, ComSystemTemplateSystemSignalRef=DET_SUPER_RES_TARGET_147
            DET_SUPER_RES_TARGET_148_oRDR_DETECTION_145_148_oPCAN_RADAR_59b36c9b_Tx: ComBitPosition=423, ComBitSize=1, ComSignalInitValue=0, ComSignalType=BOOLEAN, ComSystemTemplateSystemSignalRef=DET_SUPER_RES_TARGET_148
        SG_Detections_149_152_oRDR_DETECTION_149_152_oPCAN_RADAR_1fb2e794_Tx: ComSystemTemplateSignalGroupRef=SG_Detections_149_152
          83 x ComGroupSignal, all with ComSignalEndianness=LITTLE_ENDIAN, ComTransferProperty=PENDING:
            DET_AZIMUTH_149_oRDR_DETECTION_149_152_oPCAN_RADAR_f001adac_Tx: ComBitPosition=88, ComBitSize=13, ComSignalInitValue=0, ComSignalType=UINT16, ComSystemTemplateSystemSignalRef=DET_AZIMUTH_149
            DET_AZIMUTH_150_oRDR_DETECTION_149_152_oPCAN_RADAR_9521df08_Tx: ComBitPosition=200, ComBitSize=13, ComSignalInitValue=0, ComSignalType=UINT16, ComSystemTemplateSystemSignalRef=DET_AZIMUTH_150
            DET_AZIMUTH_151_oRDR_DETECTION_149_152_oPCAN_RADAR_00510b9d_Tx: ComBitPosition=312, ComBitSize=13, ComSignalInitValue=0, ComSignalType=UINT16, ComSystemTemplateSystemSignalRef=DET_AZIMUTH_151
            DET_AZIMUTH_152_oRDR_DETECTION_149_152_oPCAN_RADAR_64b17063_Tx: ComBitPosition=424, ComBitSize=13, ComSignalInitValue=0, ComSignalType=UINT16, ComSystemTemplateSystemSignalRef=DET_AZIMUTH_152
            DET_AZIMUTH_ERR_149_oRDR_DETECTION_149_152_oPCAN_RADAR_54b43859_Tx: ComBitPosition=105, ComBitSize=7, ComSignalInitValue=0, ComSignalType=UINT8, ComSystemTemplateSystemSignalRef=DET_AZIMUTH_ERR_149
            DET_AZIMUTH_ERR_150_oRDR_DETECTION_149_152_oPCAN_RADAR_31944afd_Tx: ComBitPosition=217, ComBitSize=7, ComSignalInitValue=0, ComSignalType=UINT8, ComSystemTemplateSystemSignalRef=DET_AZIMUTH_ERR_150
            DET_AZIMUTH_ERR_151_oRDR_DETECTION_149_152_oPCAN_RADAR_a4e49e68_Tx: ComBitPosition=329, ComBitSize=7, ComSignalInitValue=0, ComSignalType=UINT8, ComSystemTemplateSystemSignalRef=DET_AZIMUTH_ERR_151
            DET_AZIMUTH_ERR_152_oRDR_DETECTION_149_152_oPCAN_RADAR_c004e596_Tx: ComBitPosition=441, ComBitSize=7, ComSignalInitValue=0, ComSignalType=UINT8, ComSystemTemplateSystemSignalRef=DET_AZIMUTH_ERR_152
            DET_BELOW_RAIN_THOLD_149_oRDR_DETECTION_149_152_oPCAN_RADAR_25003e6c_Tx: ComBitPosition=39, ComBitSize=1, ComSignalInitValue=0, ComSignalType=BOOLEAN, ComSystemTemplateSystemSignalRef=DET_BELOW_RAIN_THOLD_149
            DET_BELOW_RAIN_THOLD_150_oRDR_DETECTION_149_152_oPCAN_RADAR_40204cc8_Tx: ComBitPosition=151, ComBitSize=1, ComSignalInitValue=0, ComSignalType=BOOLEAN, ComSystemTemplateSystemSignalRef=DET_BELOW_RAIN_THOLD_150
            DET_BELOW_RAIN_THOLD_151_oRDR_DETECTION_149_152_oPCAN_RADAR_d550985d_Tx: ComBitPosition=263, ComBitSize=1, ComSignalInitValue=0, ComSignalType=BOOLEAN, ComSystemTemplateSystemSignalRef=DET_BELOW_RAIN_THOLD_151
            DET_BELOW_RAIN_THOLD_152_oRDR_DETECTION_149_152_oPCAN_RADAR_b1b0e3a3_Tx: ComBitPosition=375, ComBitSize=1, ComSignalInitValue=0, ComSignalType=BOOLEAN, ComSystemTemplateSystemSignalRef=DET_BELOW_RAIN_THOLD_152
            DET_BI_STATIC_FLAG_149_oRDR_DETECTION_149_152_oPCAN_RADAR_a62ded29_Tx: ComBitPosition=104, ComBitSize=1, ComSignalInitValue=0, ComSignalType=BOOLEAN, ComSystemTemplateSystemSignalRef=DET_BI_STATIC_FLAG_149
            DET_BI_STATIC_FLAG_150_oRDR_DETECTION_149_152_oPCAN_RADAR_c30d9f8d_Tx: ComBitPosition=216, ComBitSize=1, ComSignalInitValue=0, ComSignalType=BOOLEAN, ComSystemTemplateSystemSignalRef=DET_BI_STATIC_FLAG_150
            DET_BI_STATIC_FLAG_151_oRDR_DETECTION_149_152_oPCAN_RADAR_567d4b18_Tx: ComBitPosition=328, ComBitSize=1, ComSignalInitValue=0, ComSignalType=BOOLEAN, ComSystemTemplateSystemSignalRef=DET_BI_STATIC_FLAG_151
            DET_BI_STATIC_FLAG_152_oRDR_DETECTION_149_152_oPCAN_RADAR_329d30e6_Tx: ComBitPosition=440, ComBitSize=1, ComSignalInitValue=0, ComSignalType=BOOLEAN, ComSystemTemplateSystemSignalRef=DET_BI_STATIC_FLAG_152
            DET_CONFD_AZIMUTH_149_oRDR_DETECTION_149_152_oPCAN_RADAR_f2e7a766_Tx: ComBitPosition=118, ComBitSize=2, ComSignalInitValue=0, ComSignalType=UINT8, ComSystemTemplateSystemSignalRef=DET_CONFD_AZIMUTH_149
            DET_CONFD_AZIMUTH_150_oRDR_DETECTION_149_152_oPCAN_RADAR_97c7d5c2_Tx: ComBitPosition=230, ComBitSize=2, ComSignalInitValue=0, ComSignalType=UINT8, ComSystemTemplateSystemSignalRef=DET_CONFD_AZIMUTH_150
            DET_CONFD_AZIMUTH_151_oRDR_DETECTION_149_152_oPCAN_RADAR_02b70157_Tx: ComBitPosition=342, ComBitSize=2, ComSignalInitValue=0, ComSignalType=UINT8, ComSystemTemplateSystemSignalRef=DET_CONFD_AZIMUTH_151
            DET_CONFD_AZIMUTH_152_oRDR_DETECTION_149_152_oPCAN_RADAR_66577aa9_Tx: ComBitPosition=454, ComBitSize=2, ComSignalInitValue=0, ComSignalType=UINT8, ComSystemTemplateSystemSignalRef=DET_CONFD_AZIMUTH_152
            DET_CONFD_ELEVATION_149_oRDR_DETECTION_149_152_oPCAN_RADAR_f072a69c_Tx: ComBitPosition=101, ComBitSize=2, ComSignalInitValue=0, ComSignalType=UINT8, ComSystemTemplateSystemSignalRef=DET_CONFD_ELEVATION_149
            DET_CONFD_ELEVATION_150_oRDR_DETECTION_149_152_oPCAN_RADAR_9552d438_Tx: ComBitPosition=213, ComBitSize=2, ComSignalInitValue=0, ComSignalType=UINT8, ComSystemTemplateSystemSignalRef=DET_CONFD_ELEVATION_150
            DET_CONFD_ELEVATION_151_oRDR_DETECTION_149_152_oPCAN_RADAR_002200ad_Tx: ComBitPosition=325, ComBitSize=2, ComSignalInitValue=0, ComSignalType=UINT8, ComSystemTemplateSystemSignalRef=DET_CONFD_ELEVATION_151
            DET_CONFD_ELEVATION_152_oRDR_DETECTION_149_152_oPCAN_RADAR_64c27b53_Tx: ComBitPosition=437, ComBitSize=2, ComSignalInitValue=0, ComSignalType=UINT8, ComSystemTemplateSystemSignalRef=DET_CONFD_ELEVATION_152
            DET_ELEVATION_149_oRDR_DETECTION_149_152_oPCAN_RADAR_21b272a0_Tx: ComBitPosition=72, ComBitSize=8, ComSignalInitValue=0, ComSignalType=UINT8, ComSystemTemplateSystemSignalRef=DET_ELEVATION_149
            DET_ELEVATION_150_oRDR_DETECTION_149_152_oPCAN_RADAR_44920004_Tx: ComBitPosition=184, ComBitSize=8, ComSignalInitValue=0, ComSignalType=UINT8, ComSystemTemplateSystemSignalRef=DET_ELEVATION_150
            DET_ELEVATION_151_oRDR_DETECTION_149_152_oPCAN_RADAR_d1e2d491_Tx: ComBitPosition=296, ComBitSize=8, ComSignalInitValue=0, ComSignalType=UINT8, ComSystemTemplateSystemSignalRef=DET_ELEVATION_151
            DET_ELEVATION_152_oRDR_DETECTION_149_152_oPCAN_RADAR_b502af6f_Tx: ComBitPosition=408, ComBitSize=8, ComSignalInitValue=0, ComSignalType=UINT8, ComSystemTemplateSystemSignalRef=DET_ELEVATION_152
            DET_ELEVATION_ERR_149_oRDR_DETECTION_149_152_oPCAN_RADAR_a68bead5_Tx: ComBitPosition=80, ComBitSize=6, ComSignalInitValue=0, ComSignalType=UINT8, ComSystemTemplateSystemSignalRef=DET_ELEVATION_ERR_149
            DET_ELEVATION_ERR_150_oRDR_DETECTION_149_152_oPCAN_RADAR_c3ab9871_Tx: ComBitPosition=192, ComBitSize=6, ComSignalInitValue=0, ComSignalType=UINT8, ComSystemTemplateSystemSignalRef=DET_ELEVATION_ERR_150
            DET_ELEVATION_ERR_151_oRDR_DETECTION_149_152_oPCAN_RADAR_56db4ce4_Tx: ComBitPosition=304, ComBitSize=6, ComSignalInitValue=0, ComSignalType=UINT8, ComSystemTemplateSystemSignalRef=DET_ELEVATION_ERR_151
            DET_ELEVATION_ERR_152_oRDR_DETECTION_149_152_oPCAN_RADAR_323b371a_Tx: ComBitPosition=416, ComBitSize=6, ComSignalInitValue=0, ComSignalType=UINT8, ComSystemTemplateSystemSignalRef=DET_ELEVATION_ERR_152
            DET_EXISTENCE_PROB_149_oRDR_DETECTION_149_152_oPCAN_RADAR_74149fb5_Tx: ComBitPosition=112, ComBitSize=6, ComSignalInitValue=0, ComSignalType=UINT8, ComSystemTemplateSystemSignalRef=DET_EXISTENCE_PROB_149
            DET_EXISTENCE_PROB_150_oRDR_DETECTION_149_152_oPCAN_RADAR_1134ed11_Tx: ComBitPosition=224, ComBitSize=6, ComSignalInitValue=0, ComSignalType=UINT8, ComSystemTemplateSystemSignalRef=DET_EXISTENCE_PROB_150
            DET_EXISTENCE_PROB_151_oRDR_DETECTION_149_152_oPCAN_RADAR_84443984_Tx: ComBitPosition=336, ComBitSize=6, ComSignalInitValue=0, ComSignalType=UINT8, ComSystemTemplateSystemSignalRef=DET_EXISTENCE_PROB_151
            DET_EXISTENCE_PROB_152_oRDR_DETECTION_149_152_oPCAN_RADAR_e0a4427a_Tx: ComBitPosition=448, ComBitSize=6, ComSignalInitValue=0, ComSignalType=UINT8, ComSystemTemplateSystemSignalRef=DET_EXISTENCE_PROB_152
            DET_HVC_FLAG_149_oRDR_DETECTION_149_152_oPCAN_RADAR_9560dcca_Tx: ComBitPosition=86, ComBitSize=1, ComSignalInitValue=0, ComSignalType=BOOLEAN, ComSystemTemplateSystemSignalRef=DET_HVC_FLAG_149
            DET_HVC_FLAG_150_oRDR_DETECTION_149_152_oPCAN_RADAR_f040ae6e_Tx: ComBitPosition=198, ComBitSize=1, ComSignalInitValue=0, ComSignalType=BOOLEAN, ComSystemTemplateSystemSignalRef=DET_HVC_FLAG_150
            DET_HVC_FLAG_151_oRDR_DETECTION_149_152_oPCAN_RADAR_65307afb_Tx: ComBitPosition=310, ComBitSize=1, ComSignalInitValue=0, ComSignalType=BOOLEAN, ComSystemTemplateSystemSignalRef=DET_HVC_FLAG_151
            DET_HVC_FLAG_152_oRDR_DETECTION_149_152_oPCAN_RADAR_01d00105_Tx: ComBitPosition=422, ComBitSize=1, ComSignalInitValue=0, ComSignalType=BOOLEAN, ComSystemTemplateSystemSignalRef=DET_HVC_FLAG_152
            DET_IDM_149_oRDR_DETECTION_149_152_oPCAN_RADAR_1e32e777_Tx: ComBitPosition=63, ComBitSize=1, ComSignalInitValue=0, ComSignalType=BOOLEAN, ComSystemTemplateSystemSignalRef=DET_IDM_149
            DET_IDM_150_oRDR_DETECTION_149_152_oPCAN_RADAR_7b1295d3_Tx: ComBitPosition=175, ComBitSize=1, ComSignalInitValue=0, ComSignalType=BOOLEAN, ComSystemTemplateSystemSignalRef=DET_IDM_150
            DET_IDM_151_oRDR_DETECTION_149_152_oPCAN_RADAR_ee624146_Tx: ComBitPosition=287, ComBitSize=1, ComSignalInitValue=0, ComSignalType=BOOLEAN, ComSystemTemplateSystemSignalRef=DET_IDM_151
            DET_IDM_152_oRDR_DETECTION_149_152_oPCAN_RADAR_8a823ab8_Tx: ComBitPosition=399, ComBitSize=1, ComSignalInitValue=0, ComSignalType=BOOLEAN, ComSystemTemplateSystemSignalRef=DET_IDM_152
            DET_MH_CRC16_149_152_oRDR_DETECTION_149_152_oPCAN_RADAR_9b3a359f_Tx: ComBitPosition=0, ComBitSize=16, ComSignalInitValue=0, ComSignalType=UINT16, ComSystemTemplateSystemSignalRef=DET_MH_CRC16_149_152
            DET_MH_CYCLE_COUNTER_149_152_oRDR_DETECTION_149_152_oPCAN_RADAR_1f4f94a8_Tx: ComBitPosition=16, ComBitSize=8, ComSignalInitValue=0, ComSignalType=UINT8, ComSystemTemplateSystemSignalRef=DET_MH_CYCLE_COUNTER_149_152
            DET_MH_SCAN_INDEX_4LSB_149_152_oRDR_DETECTION_149_152_oPCAN_RADAR_d365b124_Tx: ComBitPosition=476, ComBitSize=4, ComSignalInitValue=0, ComSignalType=UINT8, ComSystemTemplateSystemSignalRef=DET_MH_SCAN_INDEX_4LSB_149_152
            DET_MTD_149_oRDR_DETECTION_149_152_oPCAN_RADAR_7881d5ac_Tx: ComBitPosition=47, ComBitSize=1, ComSignalInitValue=0, ComSignalType=BOOLEAN, ComSystemTemplateSystemSignalRef=DET_MTD_149
            DET_MTD_150_oRDR_DETECTION_149_152_oPCAN_RADAR_1da1a708_Tx: ComBitPosition=159, ComBitSize=1, ComSignalInitValue=0, ComSignalType=BOOLEAN, ComSystemTemplateSystemSignalRef=DET_MTD_150
            DET_MTD_151_oRDR_DETECTION_149_152_oPCAN_RADAR_88d1739d_Tx: ComBitPosition=271, ComBitSize=1, ComSignalInitValue=0, ComSignalType=BOOLEAN, ComSystemTemplateSystemSignalRef=DET_MTD_151
            DET_MTD_152_oRDR_DETECTION_149_152_oPCAN_RADAR_ec310863_Tx: ComBitPosition=383, ComBitSize=1, ComSignalInitValue=0, ComSignalType=BOOLEAN, ComSystemTemplateSystemSignalRef=DET_MTD_152
            DET_PROB_1STAZHYPO_149_oRDR_DETECTION_149_152_oPCAN_RADAR_eb353d61_Tx: ComBitPosition=103, ComBitSize=1, ComSignalInitValue=0, ComSignalType=BOOLEAN, ComSystemTemplateSystemSignalRef=DET_PROB_1STAZHYPO_149
            DET_PROB_1STAZHYPO_150_oRDR_DETECTION_149_152_oPCAN_RADAR_8e154fc5_Tx: ComBitPosition=215, ComBitSize=1, ComSignalInitValue=0, ComSignalType=BOOLEAN, ComSystemTemplateSystemSignalRef=DET_PROB_1STAZHYPO_150
            DET_PROB_1STAZHYPO_151_oRDR_DETECTION_149_152_oPCAN_RADAR_1b659b50_Tx: ComBitPosition=327, ComBitSize=1, ComSignalInitValue=0, ComSignalType=BOOLEAN, ComSystemTemplateSystemSignalRef=DET_PROB_1STAZHYPO_151
            DET_PROB_1STAZHYPO_152_oRDR_DETECTION_149_152_oPCAN_RADAR_7f85e0ae_Tx: ComBitPosition=439, ComBitSize=1, ComSignalInitValue=0, ComSignalType=BOOLEAN, ComSystemTemplateSystemSignalRef=DET_PROB_1STAZHYPO_152
            DET_RANGE_149_oRDR_DETECTION_149_152_oPCAN_RADAR_e09ade17_Tx: ComBitPosition=24, ComBitSize=15, ComSignalInitValue=0, ComSignalType=UINT16, ComSystemTemplateSystemSignalRef=DET_RANGE_149
            DET_RANGE_150_oRDR_DETECTION_149_152_oPCAN_RADAR_85baacb3_Tx: ComBitPosition=136, ComBitSize=15, ComSignalInitValue=0, ComSignalType=UINT16, ComSystemTemplateSystemSignalRef=DET_RANGE_150
            DET_RANGE_151_oRDR_DETECTION_149_152_oPCAN_RADAR_10ca7826_Tx: ComBitPosition=248, ComBitSize=15, ComSignalInitValue=0, ComSignalType=UINT16, ComSystemTemplateSystemSignalRef=DET_RANGE_151
            DET_RANGE_152_oRDR_DETECTION_149_152_oPCAN_RADAR_742a03d8_Tx: ComBitPosition=360, ComBitSize=15, ComSignalInitValue=0, ComSignalType=UINT16, ComSystemTemplateSystemSignalRef=DET_RANGE_152
            DET_RANGE_ERR_149_oRDR_DETECTION_149_152_oPCAN_RADAR_4772647e_Tx: ComBitPosition=40, ComBitSize=7, ComSignalInitValue=0, ComSignalType=UINT8, ComSystemTemplateSystemSignalRef=DET_RANGE_ERR_149
            DET_RANGE_ERR_150_oRDR_DETECTION_149_152_oPCAN_RADAR_225216da_Tx: ComBitPosition=152, ComBitSize=7, ComSignalInitValue=0, ComSignalType=UINT8, ComSystemTemplateSystemSignalRef=DET_RANGE_ERR_150
            DET_RANGE_ERR_151_oRDR_DETECTION_149_152_oPCAN_RADAR_b722c24f_Tx: ComBitPosition=264, ComBitSize=7, ComSignalInitValue=0, ComSignalType=UINT8, ComSystemTemplateSystemSignalRef=DET_RANGE_ERR_151
            DET_RANGE_ERR_152_oRDR_DETECTION_149_152_oPCAN_RADAR_d3c2b9b1_Tx: ComBitPosition=376, ComBitSize=7, ComSignalInitValue=0, ComSignalType=UINT8, ComSystemTemplateSystemSignalRef=DET_RANGE_ERR_152
            DET_RANGE_VELOCITY_149_oRDR_DETECTION_149_152_oPCAN_RADAR_953c1c32_Tx: ComBitPosition=48, ComBitSize=15, ComSignalInitValue=16384, ComSignalType=UINT16, ComSystemTemplateSystemSignalRef=DET_RANGE_VELOCITY_149
            DET_RANGE_VELOCITY_150_oRDR_DETECTION_149_152_oPCAN_RADAR_f01c6e96_Tx: ComBitPosition=160, ComBitSize=15, ComSignalInitValue=16384, ComSignalType=UINT16, ComSystemTemplateSystemSignalRef=DET_RANGE_VELOCITY_150
            DET_RANGE_VELOCITY_151_oRDR_DETECTION_149_152_oPCAN_RADAR_656cba03_Tx: ComBitPosition=272, ComBitSize=15, ComSignalInitValue=16384, ComSignalType=UINT16, ComSystemTemplateSystemSignalRef=DET_RANGE_VELOCITY_151
            DET_RANGE_VELOCITY_152_oRDR_DETECTION_149_152_oPCAN_RADAR_018cc1fd_Tx: ComBitPosition=384, ComBitSize=15, ComSignalInitValue=16384, ComSignalType=UINT16, ComSystemTemplateSystemSignalRef=DET_RANGE_VELOCITY_152
            DET_RANGE_VELOCITY_ERR_149_oRDR_DETECTION_149_152_oPCAN_RADAR_9a87e780_Tx: ComBitPosition=64, ComBitSize=8, ComSignalInitValue=0, ComSignalType=UINT8, ComSystemTemplateSystemSignalRef=DET_RANGE_VELOCITY_ERR_149
            DET_RANGE_VELOCITY_ERR_150_oRDR_DETECTION_149_152_oPCAN_RADAR_ffa79524_Tx: ComBitPosition=176, ComBitSize=8, ComSignalInitValue=0, ComSignalType=UINT8, ComSystemTemplateSystemSignalRef=DET_RANGE_VELOCITY_ERR_150
            DET_RANGE_VELOCITY_ERR_151_oRDR_DETECTION_149_152_oPCAN_RADAR_6ad741b1_Tx: ComBitPosition=288, ComBitSize=8, ComSignalInitValue=0, ComSignalType=UINT8, ComSystemTemplateSystemSignalRef=DET_RANGE_VELOCITY_ERR_151
            DET_RANGE_VELOCITY_ERR_152_oRDR_DETECTION_149_152_oPCAN_RADAR_0e373a4f_Tx: ComBitPosition=400, ComBitSize=8, ComSignalInitValue=0, ComSignalType=UINT8, ComSystemTemplateSystemSignalRef=DET_RANGE_VELOCITY_ERR_152
            DET_RCS_149_oRDR_DETECTION_149_152_oPCAN_RADAR_12bc2b68_Tx: ComBitPosition=128, ComBitSize=8, ComSignalInitValue=128, ComSignalType=UINT8, ComSystemTemplateSystemSignalRef=DET_RCS_149
            DET_RCS_150_oRDR_DETECTION_149_152_oPCAN_RADAR_779c59cc_Tx: ComBitPosition=240, ComBitSize=8, ComSignalInitValue=128, ComSignalType=UINT8, ComSystemTemplateSystemSignalRef=DET_RCS_150
            DET_RCS_151_oRDR_DETECTION_149_152_oPCAN_RADAR_e2ec8d59_Tx: ComBitPosition=352, ComBitSize=8, ComSignalInitValue=128, ComSignalType=UINT8, ComSystemTemplateSystemSignalRef=DET_RCS_151
            DET_RCS_152_oRDR_DETECTION_149_152_oPCAN_RADAR_860cf6a7_Tx: ComBitPosition=464, ComBitSize=8, ComSignalInitValue=128, ComSignalType=UINT8, ComSystemTemplateSystemSignalRef=DET_RCS_152
            DET_SNR_149_oRDR_DETECTION_149_152_oPCAN_RADAR_cf127f6a_Tx: ComBitPosition=120, ComBitSize=8, ComSignalInitValue=0, ComSignalType=UINT8, ComSystemTemplateSystemSignalRef=DET_SNR_149
            DET_SNR_150_oRDR_DETECTION_149_152_oPCAN_RADAR_aa320dce_Tx: ComBitPosition=232, ComBitSize=8, ComSignalInitValue=0, ComSignalType=UINT8, ComSystemTemplateSystemSignalRef=DET_SNR_150
            DET_SNR_151_oRDR_DETECTION_149_152_oPCAN_RADAR_3f42d95b_Tx: ComBitPosition=344, ComBitSize=8, ComSignalInitValue=0, ComSignalType=UINT8, ComSystemTemplateSystemSignalRef=DET_SNR_151
            DET_SNR_152_oRDR_DETECTION_149_152_oPCAN_RADAR_5ba2a2a5_Tx: ComBitPosition=456, ComBitSize=8, ComSignalInitValue=0, ComSignalType=UINT8, ComSystemTemplateSystemSignalRef=DET_SNR_152
            DET_SUPER_RES_TARGET_149_oRDR_DETECTION_149_152_oPCAN_RADAR_fe8b570f_Tx: ComBitPosition=87, ComBitSize=1, ComSignalInitValue=0, ComSignalType=BOOLEAN, ComSystemTemplateSystemSignalRef=DET_SUPER_RES_TARGET_149
            DET_SUPER_RES_TARGET_150_oRDR_DETECTION_149_152_oPCAN_RADAR_9bab25ab_Tx: ComBitPosition=199, ComBitSize=1, ComSignalInitValue=0, ComSignalType=BOOLEAN, ComSystemTemplateSystemSignalRef=DET_SUPER_RES_TARGET_150
            DET_SUPER_RES_TARGET_151_oRDR_DETECTION_149_152_oPCAN_RADAR_0edbf13e_Tx: ComBitPosition=311, ComBitSize=1, ComSignalInitValue=0, ComSignalType=BOOLEAN, ComSystemTemplateSystemSignalRef=DET_SUPER_RES_TARGET_151
            DET_SUPER_RES_TARGET_152_oRDR_DETECTION_149_152_oPCAN_RADAR_6a3b8ac0_Tx: ComBitPosition=423, ComBitSize=1, ComSignalInitValue=0, ComSignalType=BOOLEAN, ComSystemTemplateSystemSignalRef=DET_SUPER_RES_TARGET_152
