[part 1 of 24: package /InitialEcuC]
AUTOSAR XML (schema 00053)
package /InitialEcuC
  ecuc value collection InitialEcuC
    ecuc-values:
      Can
      CanIf
      CanSM
      CanTp
      Com
      ComM
      Dcm
      Dem
      EcuC
      EcuM
      Eth
      EthIf
      EthSM
      IpduM
      J1939Nm
      J1939Rm
      J1939Tp
      LdCom
      Nm
      PduR
      Sd
      SoAd
      SomeIpTp
      TcpIp
  module config Can
    CanConfigSet
      CT_PCAN_RADAR_a3a0f56c (CanController): CanControllerActivation=true, CanControllerDefaultBaudrate=CT_PCAN_RADAR_a3a0f56c/CanControllerBaudrateConfig
        CanControllerBaudrateConfig: CanControllerBaudRate=500
          CanControllerFdBaudrateConfig: CanControllerFdBaudRate=2000
      CT_VCAN_RADAR_aebe852b (CanController): CanControllerActivation=true, CanControllerDefaultBaudrate=CT_VCAN_RADAR_aebe852b/CanControllerBaudrateConfig
        CanControllerBaudrateConfig
      5 x CanHardwareObject, all with CanHandleType=BASIC:
        CN_PCAN_RADAR_458ff0f1_Tx: CanObjectType=TRANSMIT, CanControllerRef=CanConfigSet/CT_PCAN_RADAR_a3a0f56c
        CN_PCAN_RADAR_92639a04_Rx: CanIdType=EXTENDED, CanObjectType=RECEIVE, CanControllerRef=CanConfigSet/CT_PCAN_RADAR_a3a0f56c
        CN_PCAN_RADAR_a729ccfc_Rx: CanIdType=STANDARD, CanObjectType=RECEIVE, CanControllerRef=CanConfigSet/CT_PCAN_RADAR_a3a0f56c
        CN_VCAN_RADAR_0fbf9117_Rx: CanIdType=EXTENDED, CanObjectType=RECEIVE, CanControllerRef=CanConfigSet/CT_VCAN_RADAR_aebe852b
        CN_VCAN_RADAR_489180b6_Tx: CanObjectType=TRANSMIT, CanControllerRef=CanConfigSet/CT_VCAN_RADAR_aebe852b
    CanGeneral: CanIndex=0
  module config CanIf
    CanIfCtrlDrvCfg_7d254554 (CanIfCtrlDrvCfg): CanIfCtrlDrvInitHohConfigRef=CanIfInitHohCfg, CanIfCtrlDrvNameRef=CanGeneral
      CT_PCAN_RADAR_a3a0f56c (CanIfCtrlCfg): CanIfCtrlCanCtrlRef=CanConfigSet/CT_PCAN_RADAR_a3a0f56c
      CT_VCAN_RADAR_aebe852b (CanIfCtrlCfg): CanIfCtrlCanCtrlRef=CanConfigSet/CT_VCAN_RADAR_aebe852b
    CanIfInitCfg
      CHNL_0829f689 (CanIfBufferCfg): CanIfBufferSize=0, CanIfBufferHthRef=CanIfInitHohCfg/CN_VCAN_RADAR_489180b6_Tx
      CHNL_2ad3227b (CanIfBufferCfg): CanIfBufferSize=0, CanIfBufferHthRef=CanIfInitHohCfg/CN_PCAN_RADAR_458ff0f1_Tx
      CanIfInitHohCfg: CanIfInitRefCfgSet=CanConfigSet
        3 x CanIfHrhCfg:
          CN_PCAN_RADAR_92639a04_Rx: CanIfHrhCanCtrlIdRef=CanIfCtrlDrvCfg_7d254554/CT_PCAN_RADAR_a3a0f56c, CanIfHrhIdSymRef=CanConfigSet/CN_PCAN_RADAR_92639a04_Rx
          CN_PCAN_RADAR_a729ccfc_Rx: CanIfHrhCanCtrlIdRef=CanIfCtrlDrvCfg_7d254554/CT_PCAN_RADAR_a3a0f56c, CanIfHrhIdSymRef=CanConfigSet/CN_PCAN_RADAR_a729ccfc_Rx
          CN_VCAN_RADAR_0fbf9117_Rx: CanIfHrhCanCtrlIdRef=CanIfCtrlDrvCfg_7d254554/CT_VCAN_RADAR_aebe852b, CanIfHrhIdSymRef=CanConfigSet/CN_VCAN_RADAR_0fbf9117_Rx
        CN_PCAN_RADAR_458ff0f1_Tx (CanIfHthCfg): CanIfHthCanCtrlIdRef=CanIfCtrlDrvCfg_7d254554/CT_PCAN_RADAR_a3a0f56c, CanIfHthIdSymRef=CanConfigSet/CN_PCAN_RADAR_458ff0f1_Tx
        CN_VCAN_RADAR_489180b6_Tx (CanIfHthCfg): CanIfHthCanCtrlIdRef=CanIfCtrlDrvCfg_7d254554/CT_VCAN_RADAR_aebe852b, CanIfHthIdSymRef=CanConfigSet/CN_VCAN_RADAR_489180b6_Tx
      116 x CanIfRxPduCfg:
        ADAS_FN_Enable_disable_sts_oVCAN_RADAR_12bee21f_Rx: CanIfRxPduCanId=218073111, CanIfRxPduCanIdMask=67108863, CanIfRxPduCanIdType=EXTENDED_CAN, CanIfRxPduDlc=8, CanIfRxPduUserRxIndicationName=PduR_CanIfRxIndication, CanIfRxPduUserRxIndicationUL=PDUR, CanIfRxPduHrhIdRef=CanIfInitHohCfg/CN_VCAN_RADAR_0fbf9117_Rx, CanIfRxPduRef=EcucPduCollection/ADAS_FN_Enable_disable_sts_oVCAN_RADAR_3f57de57_Rx
        CCVS1_oVCAN_RADAR_2823bd01_Rx: CanIfRxPduCanId=419361024, CanIfRxPduCanIdMask=67108863, CanIfRxPduCanIdType=EXTENDED_CAN, CanIfRxPduDlc=8, CanIfRxPduUserRxIndicationName=PduR_CanIfRxIndication, CanIfRxPduUserRxIndicationUL=PDUR, CanIfRxPduHrhIdRef=CanIfInitHohCfg/CN_VCAN_RADAR_0fbf9117_Rx, CanIfRxPduRef=EcucPduCollection/CCVS1_oVCAN_RADAR_e4df8c5f_Rx
        CLS_Tx_16_oVCAN_RADAR_b5bd9e87_Rx: CanIfRxPduCanId=419365143, CanIfRxPduCanIdMask=67108863, CanIfRxPduCanIdType=EXTENDED_CAN, CanIfRxPduDlc=8, CanIfRxPduUserRxIndicationName=PduR_CanIfRxIndication, CanIfRxPduUserRxIndicationUL=PDUR, CanIfRxPduHrhIdRef=CanIfInitHohCfg/CN_VCAN_RADAR_0fbf9117_Rx, CanIfRxPduRef=EcucPduCollection/CLS_Tx_16_oVCAN_RADAR_afa2b499_Rx
        CLS_Tx_4_oVCAN_RADAR_86e16ec0_Rx: CanIfRxPduCanId=419385367, CanIfRxPduCanIdMask=67108863, CanIfRxPduCanIdType=EXTENDED_CAN, CanIfRxPduDlc=8, CanIfRxPduUserRxIndicationName=PduR_CanIfRxIndication, CanIfRxPduUserRxIndicationUL=PDUR, CanIfRxPduHrhIdRef=CanIfInitHohCfg/CN_VCAN_RADAR_0fbf9117_Rx, CanIfRxPduRef=EcucPduCollection/CLS_Tx_4_oVCAN_RADAR_e4fced07_Rx
        DIAG_REQ_FNC_OBD1_Tp_oVCAN_RADAR_6a2825b2_Rx: CanIfRxPduCanId=417018864, CanIfRxPduCanIdType=EXTENDED_CAN, CanIfRxPduDlc=8, CanIfRxPduUserRxIndicationName=CanTp_RxIndication, CanIfRxPduUserRxIndicationType=PDUID_PDUINFOPTR, CanIfRxPduUserRxIndicationUL=CAN_TP, CanIfRxPduHrhIdRef=CanIfInitHohCfg/CN_VCAN_RADAR_0fbf9117_Rx, CanIfRxPduRef=DIAG_REQ_FNC_OBD1_Tp_oVCAN_RADAR_260cec9f_Rx
        DIAG_REQ_FNC_OBD2_Tp_oVCAN_RADAR_f27c52d9_Rx: CanIfRxPduCanId=417018865, CanIfRxPduCanIdType=EXTENDED_CAN, CanIfRxPduDlc=8, CanIfRxPduUserRxIndicationName=CanTp_RxIndication, CanIfRxPduUserRxIndicationType=PDUID_PDUINFOPTR, CanIfRxPduUserRxIndicationUL=CAN_TP, CanIfRxPduHrhIdRef=CanIfInitHohCfg/CN_VCAN_RADAR_0fbf9117_Rx, CanIfRxPduRef=DIAG_REQ_FNC_OBD2_Tp_oVCAN_RADAR_42ec9761_Rx
        DIAG_REQ_FNC_OTA_Tp_oVCAN_RADAR_99d98f80_Rx: CanIfRxPduCanId=417018868, CanIfRxPduCanIdType=EXTENDED_CAN, CanIfRxPduDlc=8, CanIfRxPduUserRxIndicationName=CanTp_RxIndication, CanIfRxPduUserRxIndicationType=PDUID_PDUINFOPTR, CanIfRxPduUserRxIndicationUL=CAN_TP, CanIfRxPduHrhIdRef=CanIfInitHohCfg/CN_VCAN_RADAR_0fbf9117_Rx, CanIfRxPduRef=DIAG_REQ_FNC_OTA_Tp_oVCAN_RADAR_6f75a08a_Rx
        DIAG_REQ_FNC_PLANT_Tp_oVCAN_RADAR_db883021_Rx: CanIfRxPduCanId=417018869, CanIfRxPduCanIdType=EXTENDED_CAN, CanIfRxPduDlc=8, CanIfRxPduUserRxIndicationName=CanTp_RxIndication, CanIfRxPduUserRxIndicationType=PDUID_PDUINFOPTR, CanIfRxPduUserRxIndicationUL=CAN_TP, CanIfRxPduHrhIdRef=CanIfInitHohCfg/CN_VCAN_RADAR_0fbf9117_Rx, CanIfRxPduRef=DIAG_REQ_FNC_PLANT_Tp_oVCAN_RADAR_d6304422_Rx
        DM1_B0_Rx_oPCAN_RADAR_a5672d71_Rx: CanIfRxPduCanId=419351216, CanIfRxPduCanIdType=STANDARD_CAN, CanIfRxPduDlc=22, CanIfRxPduUserRxIndicationUL=CDD, CanIfRxPduHrhIdRef=CanIfInitHohCfg/CN_PCAN_RADAR_a729ccfc_Rx, CanIfRxPduRef=DM1_B0_Rx_oPCAN_RADAR_6b6541a3_Rx
        DM1_B1_Rx_oPCAN_RADAR_1c7ee3a2_Rx: CanIfRxPduCanId=419351217, CanIfRxPduCanIdType=STANDARD_CAN, CanIfRxPduDlc=22, CanIfRxPduUserRxIndicationUL=CDD, CanIfRxPduHrhIdRef=CanIfInitHohCfg/CN_PCAN_RADAR_a729ccfc_Rx, CanIfRxPduRef=DM1_B1_Rx_oPCAN_RADAR_fe159536_Rx
        ETC2_00_oVCAN_RADAR_bceeb942_Rx: CanIfRxPduCanId=418383104, CanIfRxPduCanIdMask=67108863, CanIfRxPduCanIdType=EXTENDED_CAN, CanIfRxPduDlc=8, CanIfRxPduUserRxIndicationName=PduR_CanIfRxIndication, CanIfRxPduUserRxIndicationUL=PDUR, CanIfRxPduHrhIdRef=CanIfInitHohCfg/CN_VCAN_RADAR_0fbf9117_Rx, CanIfRxPduRef=EcucPduCollection/ETC2_00_oVCAN_RADAR_fd8cfcd0_Rx
        ETC2_03_oVCAN_RADAR_6f7e9f8c_Rx: CanIfRxPduCanId=418383107, CanIfRxPduCanIdMask=67108863, CanIfRxPduCanIdType=EXTENDED_CAN, CanIfRxPduDlc=8, CanIfRxPduUserRxIndicationName=PduR_CanIfRxIndication, CanIfRxPduUserRxIndicationUL=PDUR, CanIfRxPduHrhIdRef=CanIfInitHohCfg/CN_VCAN_RADAR_0fbf9117_Rx, CanIfRxPduRef=EcucPduCollection/ETC2_03_oVCAN_RADAR_a69b4dc5_Rx
        FR_DIAG_REQ_PHY_OBD1_Tp_oVCAN_RADAR_ecc1c765_Rx: CanIfRxPduCanId=416993520, CanIfRxPduCanIdType=EXTENDED_CAN, CanIfRxPduDlc=8, CanIfRxPduUserRxIndicationName=CanTp_RxIndication, CanIfRxPduUserRxIndicationType=PDUID_PDUINFOPTR, CanIfRxPduUserRxIndicationUL=CAN_TP, CanIfRxPduHrhIdRef=CanIfInitHohCfg/CN_VCAN_RADAR_0fbf9117_Rx, CanIfRxPduRef=FR_DIAG_REQ_PHY_OBD1_Tp_oVCAN_RADAR_ddfa31cf_Rx
        FR_DIAG_REQ_PHY_OBD2_Tp_oVCAN_RADAR_2f8767b4_Rx: CanIfRxPduCanId=416993521, CanIfRxPduCanIdType=EXTENDED_CAN, CanIfRxPduDlc=8, CanIfRxPduUserRxIndicationName=CanTp_RxIndication, CanIfRxPduUserRxIndicationType=PDUID_PDUINFOPTR, CanIfRxPduUserRxIndicationUL=CAN_TP, CanIfRxPduHrhIdRef=CanIfInitHohCfg/CN_VCAN_RADAR_0fbf9117_Rx, CanIfRxPduRef=FR_DIAG_REQ_PHY_OBD2_Tp_oVCAN_RADAR_b91a4a31_Rx
        FR_DIAG_REQ_PHY_OTA_Tp_oVCAN_RADAR_a23061a0_Rx: CanIfRxPduCanId=416993524, CanIfRxPduCanIdType=EXTENDED_CAN, CanIfRxPduDlc=8, CanIfRxPduUserRxIndicationName=CanTp_RxIndication, CanIfRxPduUserRxIndicationType=PDUID_PDUINFOPTR, CanIfRxPduUserRxIndicationUL=CAN_TP, CanIfRxPduHrhIdRef=CanIfInitHohCfg/CN_VCAN_RADAR_0fbf9117_Rx, CanIfRxPduRef=FR_DIAG_REQ_PHY_OTA_Tp_oVCAN_RADAR_4de495d5_Rx
        FR_DIAG_REQ_PHY_PLANT_Tp_oVCAN_RADAR_4a486df0_Rx: CanIfRxPduCanId=416993525, CanIfRxPduCanIdType=EXTENDED_CAN, CanIfRxPduDlc=8, CanIfRxPduUserRxIndicationName=CanTp_RxIndication, CanIfRxPduUserRxIndicationType=PDUID_PDUINFOPTR, CanIfRxPduUserRxIndicationUL=CAN_TP, CanIfRxPduHrhIdRef=CanIfInitHohCfg/CN_VCAN_RADAR_0fbf9117_Rx, CanIfRxPduRef=FR_DIAG_REQ_PHY_PLANT_Tp_oVCAN_RADAR_bda0e30b_Rx
        GW_ADAS_FN_Enable_disable_sts_oPCAN_RADAR_e7ed2761_Rx: CanIfRxPduCanId=218073111, CanIfRxPduCanIdType=EXTENDED_CAN, CanIfRxPduDlc=8, CanIfRxPduUserRxIndicationName=PduR_CanIfRxIndication, CanIfRxPduUserRxIndicationUL=PDUR, CanIfRxPduHrhIdRef=CanIfInitHohCfg/CN_PCAN_RADAR_92639a04_Rx, CanIfRxPduRef=EcucPduCollection/GW_ADAS_FN_Enable_disable_sts_oPCAN_RADAR_781ac753_Rx
        GW_CCVS1_oPCAN_RADAR_dee05550_Rx: CanIfRxPduCanId=419361024, CanIfRxPduCanIdType=EXTENDED_CAN, CanIfRxPduDlc=8, CanIfRxPduUserRxIndicationName=PduR_CanIfRxIndication, CanIfRxPduUserRxIndicationUL=PDUR, CanIfRxPduHrhIdRef=CanIfInitHohCfg/CN_PCAN_RADAR_92639a04_Rx, CanIfRxPduRef=EcucPduCollection/GW_CCVS1_oPCAN_RADAR_d10adaab_Rx
        GW_CLS_Tx_16_oPCAN_RADAR_5cbae8ef_Rx: CanIfRxPduCanId=419365143, CanIfRxPduCanIdType=EXTENDED_CAN, CanIfRxPduDlc=8, CanIfRxPduUserRxIndicationName=PduR_CanIfRxIndication, CanIfRxPduUserRxIndicationUL=PDUR, CanIfRxPduHrhIdRef=CanIfInitHohCfg/CN_PCAN_RADAR_92639a04_Rx, CanIfRxPduRef=EcucPduCollection/GW_CLS_Tx_16_oPCAN_RADAR_c3f80567_Rx
        GW_CLS_Tx_4_oPCAN_RADAR_2550d3a5_Rx: CanIfRxPduCanId=419385367, CanIfRxPduCanIdType=EXTENDED_CAN, CanIfRxPduDlc=8, CanIfRxPduUserRxIndicationName=PduR_CanIfRxIndication, CanIfRxPduUserRxIndicationUL=PDUR, CanIfRxPduHrhIdRef=CanIfInitHohCfg/CN_PCAN_RADAR_92639a04_Rx, CanIfRxPduRef=EcucPduCollection/GW_CLS_Tx_4_oPCAN_RADAR_deff6d37_Rx
        GW_ETC2_03_oPCAN_RADAR_c594f99d_Rx: CanIfRxPduCanId=418383107, CanIfRxPduCanIdType=EXTENDED_CAN, CanIfRxPduDlc=8, CanIfRxPduUserRxIndicationName=PduR_CanIfRxIndication, CanIfRxPduUserRxIndicationUL=PDUR, CanIfRxPduHrhIdRef=CanIfInitHohCfg/CN_PCAN_RADAR_92639a04_Rx, CanIfRxPduRef=EcucPduCollection/GW_ETC2_03_oPCAN_RADAR_766d20c0_Rx
        GW_ETC2_oPCAN_RADAR_71fbc026_Rx: CanIfRxPduCanId=418383104, CanIfRxPduCanIdType=EXTENDED_CAN, CanIfRxPduDlc=8, CanIfRxPduUserRxIndicationName=PduR_CanIfRxIndication, CanIfRxPduUserRxIndicationUL=PDUR, CanIfRxPduHrhIdRef=CanIfInitHohCfg/CN_PCAN_RADAR_92639a04_Rx, CanIfRxPduRef=EcucPduCollection/GW_ETC2_oPCAN_RADAR_57f17119_Rx
        GW_OEL_oPCAN_RADAR_072b70f3_Rx: CanIfRxPduCanId=217959447, CanIfRxPduCanIdType=EXTENDED_CAN, CanIfRxPduDlc=8, CanIfRxPduUserRxIndicationName=PduR_CanIfRxIndication, CanIfRxPduUserRxIndicationUL=PDUR, CanIfRxPduHrhIdRef=CanIfInitHohCfg/CN_PCAN_RADAR_92639a04_Rx, CanIfRxPduRef=EcucPduCollection/GW_OEL_oPCAN_RADAR_4c06edea_Rx
        GW_SAS_oPCAN_RADAR_e942763a_Rx: CanIfRxPduCanId=418389476, CanIfRxPduCanIdType=EXTENDED_CAN, CanIfRxPduDlc=8, CanIfRxPduUserRxIndicationName=PduR_CanIfRxIndication, CanIfRxPduUserRxIndicationUL=PDUR, CanIfRxPduHrhIdRef=CanIfInitHohCfg/CN_PCAN_RADAR_92639a04_Rx, CanIfRxPduRef=EcucPduCollection/GW_SAS_oPCAN_RADAR_e6d96f6c_Rx
        GW_TD_oPCAN_RADAR_8d3696b8_Rx: CanIfRxPduCanId=419358231, CanIfRxPduCanIdType=EXTENDED_CAN, CanIfRxPduDlc=8, CanIfRxPduUserRxIndicationName=PduR_CanIfRxIndication, CanIfRxPduUserRxIndicationUL=PDUR, CanIfRxPduHrhIdRef=CanIfInitHohCfg/CN_PCAN_RADAR_92639a04_Rx, CanIfRxPduRef=EcucPduCollection/GW_TD_oPCAN_RADAR_a04f08f1_Rx
        GW_VDC2_oPCAN_RADAR_aaaa415e_Rx: CanIfRxPduCanId=418384139, CanIfRxPduCanIdType=EXTENDED_CAN, CanIfRxPduDlc=8, CanIfRxPduUserRxIndicationName=PduR_CanIfRxIndication, CanIfRxPduUserRxIndicationUL=PDUR, CanIfRxPduHrhIdRef=CanIfInitHohCfg/CN_PCAN_RADAR_92639a04_Rx, CanIfRxPduRef=EcucPduCollection/GW_VDC2_oPCAN_RADAR_9daa2cf0_Rx
        GW_VD_oPCAN_RADAR_c4632d82_Rx: CanIfRxPduCanId=419356672, CanIfRxPduCanIdType=EXTENDED_CAN, CanIfRxPduDlc=8, CanIfRxPduUserRxIndicationName=PduR_CanIfRxIndication, CanIfRxPduUserRxIndicationUL=PDUR, CanIfRxPduHrhIdRef=CanIfInitHohCfg/CN_PCAN_RADAR_92639a04_Rx, CanIfRxPduRef=EcucPduCollection/GW_VD_oPCAN_RADAR_e94baa9d_Rx
        GW_VI_oPCAN_RADAR_50142625_Rx: CanIfRxPduCanId=419359781, CanIfRxPduCanIdType=EXTENDED_CAN, CanIfRxPduDlc=8, CanIfRxPduUserRxIndicationName=PduR_CanIfRxIndication, CanIfRxPduUserRxIndicationUL=PDUR, CanIfRxPduHrhIdRef=CanIfInitHohCfg/CN_PCAN_RADAR_92639a04_Rx, CanIfRxPduRef=EcucPduCollection/GW_VI_oPCAN_RADAR_6896f87b_Rx
        OEL_oVCAN_RADAR_8850ccda_Rx: CanIfRxPduCanId=217959447, CanIfRxPduCanIdMask=67108863, CanIfRxPduCanIdType=EXTENDED_CAN, CanIfRxPduDlc=8, CanIfRxPduUserRxIndicationName=PduR_CanIfRxIndication, CanIfRxPduUserRxIndicationUL=PDUR, CanIfRxPduHrhIdRef=CanIfInitHohCfg/CN_VCAN_RADAR_0fbf9117_Rx, CanIfRxPduRef=EcucPduCollection/OEL_oVCAN_RADAR_45092dcb_Rx
        PCAN_DIAG_REQ_FUNC_OBD1_Tp_oPCAN_RADAR_20_be38c2c7_Rx: CanIfRxPduCanId=417018864 if post-build-variant-condition{matching-criterion=RDR_POS, value=0}, CanIfRxPduCanIdType=EXTENDED_NO_FD_CAN, CanIfRxPduDlc=8, CanIfRxPduUserRxIndicationName=CanTp_RxIndication, CanIfRxPduUserRxIndicationType=PDUID_PDUINFOPTR, CanIfRxPduUserRxIndicationUL=CAN_TP, CanIfRxPduCanId=417001679 if post-build-variant-condition{matching-criterion=RDR_POS, value=4}, CanIfRxPduCanId=417018864 if post-build-variant-condition{matching-criterion=RDR_POS, value=1}, CanIfRxPduCanId=417018864 if post-build-variant-condition{matching-criterion=RDR_POS, value=2}, CanIfRxPduCanId=417018864 if post-build-variant-condition{matching-criterion=RDR_POS, value=3}, CanIfRxPduCanId=417018864 if post-build-variant-condition{matching-criterion=RDR_POS, value=5}, CanIfRxPduCanId=417018864 if post-build-variant-condition{matching-criterion=RDR_POS, value=6}, CanIfRxPduCanId=417018864 if post-build-variant-condition{matching-criterion=RDR_POS, value=7}, CanIfRxPduHrhIdRef=CanIfInitHohCfg/CN_PCAN_RADAR_92639a04_Rx, CanIfRxPduRef=PCAN_DIAG_REQ_FUNC_OBD1_Tp_oPCAN_RADAR_20_9397638b_Rx
        PCAN_DIAG_REQ_FUNC_OBD1_Tp_oPCAN_RADAR_a49340df_Rx: CanIfRxPduCanId=417018864 if post-build-variant-condition{matching-criterion=RDR_POS, value=0}, CanIfRxPduCanIdType=EXTENDED_FD_CAN, CanIfRxPduDlc=64, CanIfRxPduUserRxIndicationName=CanTp_RxIndication, CanIfRxPduUserRxIndicationType=PDUID_PDUINFOPTR, CanIfRxPduUserRxIndicationUL=CAN_TP, CanIfRxPduCanId=417001679 if post-build-variant-condition{matching-criterion=RDR_POS, value=4}, CanIfRxPduCanId=417018864 if post-build-variant-condition{matching-criterion=RDR_POS, value=1}, CanIfRxPduCanId=417018864 if post-build-variant-condition{matching-criterion=RDR_POS, value=2}, CanIfRxPduCanId=417018864 if post-build-variant-condition{matching-criterion=RDR_POS, value=3}, CanIfRxPduCanId=417018864 if post-build-variant-condition{matching-criterion=RDR_POS, value=5}, CanIfRxPduCanId=417018864 if post-build-variant-condition{matching-criterion=RDR_POS, value=6}, CanIfRxPduCanId=417018864 if post-build-variant-condition{matching-criterion=RDR_POS, value=7}, CanIfRxPduHrhIdRef=CanIfInitHohCfg/CN_PCAN_RADAR_92639a04_Rx, CanIfRxPduRef=PCAN_DIAG_REQ_FUNC_OBD1_Tp_oPCAN_RADAR_ba721e23_Rx
        PCAN_DIAG_REQ_FUNC_OBD2_Tp_oPCAN_RADAR_20_5e2c4885_Rx: CanIfRxPduCanId=417018865 if post-build-variant-condition{matching-criterion=RDR_POS, value=0}, CanIfRxPduCanIdType=EXTENDED_NO_FD_CAN, CanIfRxPduDlc=8, CanIfRxPduUserRxIndicationName=CanTp_RxIndication, CanIfRxPduUserRxIndicationType=PDUID_PDUINFOPTR, CanIfRxPduUserRxIndicationUL=CAN_TP, CanIfRxPduCanId=417001935 if post-build-variant-condition{matching-criterion=RDR_POS, value=4}, CanIfRxPduCanId=417018865 if post-build-variant-condition{matching-criterion=RDR_POS, value=1}, CanIfRxPduCanId=417018865 if post-build-variant-condition{matching-criterion=RDR_POS, value=2}, CanIfRxPduCanId=417018865 if post-build-variant-condition{matching-criterion=RDR_POS, value=3}, CanIfRxPduCanId=417018865 if post-build-variant-condition{matching-criterion=RDR_POS, value=5}, CanIfRxPduCanId=417018865 if post-build-variant-condition{matching-criterion=RDR_POS, value=6}, CanIfRxPduCanId=417018865 if post-build-variant-condition{matching-criterion=RDR_POS, value=7}, CanIfRxPduHrhIdRef=CanIfInitHohCfg/CN_PCAN_RADAR_92639a04_Rx, CanIfRxPduRef=PCAN_DIAG_REQ_FUNC_OBD2_Tp_oPCAN_RADAR_20_400c7f70_Rx
        PCAN_DIAG_REQ_FUNC_OBD2_Tp_oPCAN_RADAR_92dcb903_Rx: CanIfRxPduCanId=417018865 if post-build-variant-condition{matching-criterion=RDR_POS, value=0}, CanIfRxPduCanIdType=EXTENDED_FD_CAN, CanIfRxPduDlc=64, CanIfRxPduUserRxIndicationName=CanTp_RxIndication, CanIfRxPduUserRxIndicationType=PDUID_PDUINFOPTR, CanIfRxPduUserRxIndicationUL=CAN_TP, CanIfRxPduCanId=417001935 if post-build-variant-condition{matching-criterion=RDR_POS, value=4}, CanIfRxPduCanId=417018865 if post-build-variant-condition{matching-criterion=RDR_POS, value=1}, CanIfRxPduCanId=417018865 if post-build-variant-condition{matching-criterion=RDR_POS, value=2}, CanIfRxPduCanId=417018865 if post-build-variant-condition{matching-criterion=RDR_POS, value=3}, CanIfRxPduCanId=417018865 if post-build-variant-condition{matching-criterion=RDR_POS, value=5}, CanIfRxPduCanId=417018865 if post-build-variant-condition{matching-criterion=RDR_POS, value=6}, CanIfRxPduCanId=417018865 if post-build-variant-condition{matching-criterion=RDR_POS, value=7}, CanIfRxPduHrhIdRef=CanIfInitHohCfg/CN_PCAN_RADAR_92639a04_Rx, CanIfRxPduRef=PCAN_DIAG_REQ_FUNC_OBD2_Tp_oPCAN_RADAR_de9265dd_Rx
        PCAN_DIAG_REQ_FUNC_OTA_Tp_oPCAN_RADAR_0aa5e66e_Rx: CanIfRxPduCanId=417018868 if post-build-variant-condition{matching-criterion=RDR_POS, value=0}, CanIfRxPduCanIdType=EXTENDED_FD_CAN, CanIfRxPduDlc=64, CanIfRxPduUserRxIndicationName=CanTp_RxIndication, CanIfRxPduUserRxIndicationType=PDUID_PDUINFOPTR, CanIfRxPduUserRxIndicationUL=CAN_TP, CanIfRxPduCanId=417002603 if post-build-variant-condition{matching-criterion=RDR_POS, value=4}, CanIfRxPduCanId=417018868 if post-build-variant-condition{matching-criterion=RDR_POS, value=1}, CanIfRxPduCanId=417018868 if post-build-variant-condition{matching-criterion=RDR_POS, value=2}, CanIfRxPduCanId=417018868 if post-build-variant-condition{matching-criterion=RDR_POS, value=3}, CanIfRxPduCanId=417018868 if post-build-variant-condition{matching-criterion=RDR_POS, value=5}, CanIfRxPduCanId=417018868 if post-build-variant-condition{matching-criterion=RDR_POS, value=6}, CanIfRxPduCanId=417018868 if post-build-variant-condition{matching-criterion=RDR_POS, value=7}, CanIfRxPduHrhIdRef=CanIfInitHohCfg/CN_PCAN_RADAR_92639a04_Rx, CanIfRxPduRef=PCAN_DIAG_REQ_FUNC_OTA_Tp_oPCAN_RADAR_7ea6262a_Rx
        PCAN_DIAG_REQ_FUNC_OTA_Tp_oPCAN_RADAR_20_8f3fcd60_Rx: CanIfRxPduCanId=417018868 if post-build-variant-condition{matching-criterion=RDR_POS, value=0}, CanIfRxPduCanIdType=EXTENDED_NO_FD_CAN, CanIfRxPduDlc=8, CanIfRxPduUserRxIndicationName=CanTp_RxIndication, CanIfRxPduUserRxIndicationType=PDUID_PDUINFOPTR, CanIfRxPduUserRxIndicationUL=CAN_TP, CanIfRxPduCanId=417002603 if post-build-variant-condition{matching-criterion=RDR_POS, value=4}, CanIfRxPduCanId=417018868 if post-build-variant-condition{matching-criterion=RDR_POS, value=1}, CanIfRxPduCanId=417018868 if post-build-variant-condition{matching-criterion=RDR_POS, value=2}, CanIfRxPduCanId=417018868 if post-build-variant-condition{matching-criterion=RDR_POS, value=3}, CanIfRxPduCanId=417018868 if post-build-variant-condition{matching-criterion=RDR_POS, value=5}, CanIfRxPduCanId=417018868 if post-build-variant-condition{matching-criterion=RDR_POS, value=6}, CanIfRxPduCanId=417018868 if post-build-variant-condition{matching-criterion=RDR_POS, value=7}, CanIfRxPduHrhIdRef=CanIfInitHohCfg/CN_PCAN_RADAR_92639a04_Rx, CanIfRxPduRef=PCAN_DIAG_REQ_FUNC_OTA_Tp_oPCAN_RADAR_20_0a67f2f6_Rx
        PCAN_DIAG_REQ_FUNC_PLANT_Tp_oPCAN_RADAR_20_f0f9d98a_Rx: CanIfRxPduCanId=417018869 if post-build-variant-condition{matching-criterion=RDR_POS, value=0}, CanIfRxPduCanIdType=EXTENDED_NO_FD_CAN, CanIfRxPduDlc=8, CanIfRxPduUserRxIndicationName=CanTp_RxIndication, CanIfRxPduUserRxIndicationType=PDUID_PDUINFOPTR, CanIfRxPduUserRxIndicationUL=CAN_TP, CanIfRxPduCanId=417002959 if post-build-variant-condition{matching-criterion=RDR_POS, value=4}, CanIfRxPduCanId=417018869 if post-build-variant-condition{matching-criterion=RDR_POS, value=1}, CanIfRxPduCanId=417018869 if post-build-variant-condition{matching-criterion=RDR_POS, value=2}, CanIfRxPduCanId=417018869 if post-build-variant-condition{matching-criterion=RDR_POS, value=3}, CanIfRxPduCanId=417018869 if post-build-variant-condition{matching-criterion=RDR_POS, value=5}, CanIfRxPduCanId=417018869 if post-build-variant-condition{matching-criterion=RDR_POS, value=6}, CanIfRxPduCanId=417018869 if post-build-variant-condition{matching-criterion=RDR_POS, value=7}, CanIfRxPduHrhIdRef=CanIfInitHohCfg/CN_PCAN_RADAR_92639a04_Rx, CanIfRxPduRef=PCAN_DIAG_REQ_FUNC_PLANT_Tp_oPCAN_RADAR_20_d63751cc_Rx
        PCAN_DIAG_REQ_FUNC_PLANT_Tp_oPCAN_RADAR_7e247c91_Rx: CanIfRxPduCanId=417018869 if post-build-variant-condition{matching-criterion=RDR_POS, value=0}, CanIfRxPduCanIdType=EXTENDED_FD_CAN, CanIfRxPduDlc=64, CanIfRxPduUserRxIndicationName=CanTp_RxIndication, CanIfRxPduUserRxIndicationType=PDUID_PDUINFOPTR, CanIfRxPduUserRxIndicationUL=CAN_TP, CanIfRxPduCanId=417002959 if post-build-variant-condition{matching-criterion=RDR_POS, value=4}, CanIfRxPduCanId=417018869 if post-build-variant-condition{matching-criterion=RDR_POS, value=1}, CanIfRxPduCanId=417018869 if post-build-variant-condition{matching-criterion=RDR_POS, value=2}, CanIfRxPduCanId=417018869 if post-build-variant-condition{matching-criterion=RDR_POS, value=3}, CanIfRxPduCanId=417018869 if post-build-variant-condition{matching-criterion=RDR_POS, value=5}, CanIfRxPduCanId=417018869 if post-build-variant-condition{matching-criterion=RDR_POS, value=6}, CanIfRxPduCanId=417018869 if post-build-variant-condition{matching-criterion=RDR_POS, value=7}, CanIfRxPduHrhIdRef=CanIfInitHohCfg/CN_PCAN_RADAR_92639a04_Rx, CanIfRxPduRef=PCAN_DIAG_REQ_FUNC_PLANT_Tp_oPCAN_RADAR_5ec247a5_Rx
        PCAN_DIAG_REQ_PHYS_OBD1_Tp_oPCAN_RADAR_20_31a2624c_Rx: CanIfRxPduCanId=417001669, CanIfRxPduCanIdType=EXTENDED_NO_FD_CAN, CanIfRxPduDlc=8, CanIfRxPduUserRxIndicationName=CanTp_RxIndication, CanIfRxPduUserRxIndicationType=PDUID_PDUINFOPTR, CanIfRxPduUserRxIndicationUL=CAN_TP, CanIfRxPduHrhIdRef=CanIfInitHohCfg/CN_PCAN_RADAR_92639a04_Rx, CanIfRxPduRef=PCAN_DIAG_REQ_PHYS_OBD1_Tp_oPCAN_RADAR_20_b6648efa_Rx
        PCAN_DIAG_REQ_PHYS_OBD1_Tp_oPCAN_RADAR_dcf5a9e3_Rx: CanIfRxPduCanId=417001669, CanIfRxPduCanIdType=EXTENDED_FD_CAN, CanIfRxPduDlc=64, CanIfRxPduUserRxIndicationName=CanTp_RxIndication, CanIfRxPduUserRxIndicationType=PDUID_PDUINFOPTR, CanIfRxPduUserRxIndicationUL=CAN_TP, CanIfRxPduHrhIdRef=CanIfInitHohCfg/CN_PCAN_RADAR_92639a04_Rx, CanIfRxPduRef=PCAN_DIAG_REQ_PHYS_OBD1_Tp_oPCAN_RADAR_6e232c89_Rx
        PCAN_DIAG_REQ_PHYS_OBD2_Tp_oPCAN_RADAR_20_d1b6e80e_Rx: CanIfRxPduCanId=417001925, CanIfRxPduCanIdType=EXTENDED_NO_FD_CAN, CanIfRxPduDlc=8, CanIfRxPduUserRxIndicationName=CanTp_RxIndication, CanIfRxPduUserRxIndicationType=PDUID_PDUINFOPTR, CanIfRxPduUserRxIndicationUL=CAN_TP, CanIfRxPduHrhIdRef=CanIfInitHohCfg/CN_PCAN_RADAR_92639a04_Rx, CanIfRxPduRef=PCAN_DIAG_REQ_PHYS_OBD2_Tp_oPCAN_RADAR_20_65ff9201_Rx
        PCAN_DIAG_REQ_PHYS_OBD2_Tp_oPCAN_RADAR_eaba503f_Rx: CanIfRxPduCanId=417001925, CanIfRxPduCanIdType=EXTENDED_FD_CAN, CanIfRxPduDlc=64, CanIfRxPduUserRxIndicationName=CanTp_RxIndication, CanIfRxPduUserRxIndicationType=PDUID_PDUINFOPTR, CanIfRxPduUserRxIndicationUL=CAN_TP, CanIfRxPduHrhIdRef=CanIfInitHohCfg/CN_PCAN_RADAR_92639a04_Rx, CanIfRxPduRef=PCAN_DIAG_REQ_PHYS_OBD2_Tp_oPCAN_RADAR_0ac35777_Rx
        PCAN_DIAG_REQ_PHYS_OTA_Tp_oPCAN_RADAR_20_f8b78b8f_Rx: CanIfRxPduCanId=417002693, CanIfRxPduCanIdType=EXTENDED_NO_FD_CAN, CanIfRxPduDlc=8, CanIfRxPduUserRxIndicationName=CanTp_RxIndication, CanIfRxPduUserRxIndicationType=PDUID_PDUINFOPTR, CanIfRxPduUserRxIndicationUL=CAN_TP, CanIfRxPduHrhIdRef=CanIfInitHohCfg/CN_PCAN_RADAR_92639a04_Rx, CanIfRxPduRef=PCAN_DIAG_REQ_PHYS_OTA_Tp_oPCAN_RADAR_20_96582344_Rx
        PCAN_DIAG_REQ_PHYS_OTA_Tp_oPCAN_RADAR_bab5b90f_Rx: CanIfRxPduCanId=417002693, CanIfRxPduCanIdType=EXTENDED_FD_CAN, CanIfRxPduDlc=64, CanIfRxPduUserRxIndicationName=CanTp_RxIndication, CanIfRxPduUserRxIndicationType=PDUID_PDUINFOPTR, CanIfRxPduUserRxIndicationUL=CAN_TP, CanIfRxPduHrhIdRef=CanIfInitHohCfg/CN_PCAN_RADAR_92639a04_Rx, CanIfRxPduRef=PCAN_DIAG_REQ_PHYS_OTA_Tp_oPCAN_RADAR_94a46e49_Rx
        PCAN_DIAG_REQ_PHYS_PLANT_Tp_oPCAN_RADAR_20_6343000b_Rx: CanIfRxPduCanId=417002949, CanIfRxPduCanIdType=EXTENDED_NO_FD_CAN, CanIfRxPduDlc=8, CanIfRxPduUserRxIndicationName=CanTp_RxIndication, CanIfRxPduUserRxIndicationType=PDUID_PDUINFOPTR, CanIfRxPduUserRxIndicationUL=CAN_TP, CanIfRxPduHrhIdRef=CanIfInitHohCfg/CN_PCAN_RADAR_92639a04_Rx, CanIfRxPduRef=PCAN_DIAG_REQ_PHYS_PLANT_Tp_oPCAN_RADAR_20_f110e38b_Rx
        PCAN_DIAG_REQ_PHYS_PLANT_Tp_oPCAN_RADAR_9297cde2_Rx: CanIfRxPduCanId=417002949, CanIfRxPduCanIdType=EXTENDED_FD_CAN, CanIfRxPduDlc=64, CanIfRxPduUserRxIndicationName=CanTp_RxIndication, CanIfRxPduUserRxIndicationType=PDUID_PDUINFOPTR, CanIfRxPduUserRxIndicationUL=CAN_TP, CanIfRxPduHrhIdRef=CanIfInitHohCfg/CN_PCAN_RADAR_92639a04_Rx, CanIfRxPduRef=PCAN_DIAG_REQ_PHYS_PLANT_Tp_oPCAN_RADAR_68155c61_Rx
        RDR_BSD1_oPCAN_RADAR_04bcead5_Rx: CanIfRxPduCanId=217188094 if post-build-variant-condition{matching-criterion=RDR_POS, value=0}, CanIfRxPduCanIdType=EXTENDED_CAN, CanIfRxPduDlc=8, CanIfRxPduUserRxIndicationUL=CDD, CanIfRxPduCanId=217188016 if post-build-variant-condition{matching-criterion=RDR_POS, value=4}, CanIfRxPduCanId=217188094 if post-build-variant-condition{matching-criterion=RDR_POS, value=1}, CanIfRxPduCanId=217188094 if post-build-variant-condition{matching-criterion=RDR_POS, value=2}, CanIfRxPduCanId=217188094 if post-build-variant-condition{matching-criterion=RDR_POS, value=3}, CanIfRxPduCanId=217188094 if post-build-variant-condition{matching-criterion=RDR_POS, value=5}, CanIfRxPduCanId=217188094 if post-build-variant-condition{matching-criterion=RDR_POS, value=6}, CanIfRxPduCanId=217188094 if post-build-variant-condition{matching-criterion=RDR_POS, value=7}, CanIfRxPduHrhIdRef=CanIfInitHohCfg/CN_PCAN_RADAR_92639a04_Rx, CanIfRxPduRef=EcucPduCollection/RDR_BSD1_oPCAN_RADAR_03d8d8bd_Rx
        RDR_CM_B0_Rx_oPCAN_RADAR_e767bdf0_Rx: CanIfRxPduCanId=417151126, CanIfRxPduCanIdType=EXTENDED_CAN, CanIfRxPduDlc=8, CanIfRxPduUserRxIndicationUL=CDD, CanIfRxPduHrhIdRef=CanIfInitHohCfg/CN_PCAN_RADAR_92639a04_Rx, CanIfRxPduRef=EcucPduCollection/RDR_CM_B0_Rx_oPCAN_RADAR_3544966f_Rx
        RDR_CM_B1_Rx_oPCAN_RADAR_477108f1_Rx: CanIfRxPduCanId=417151125, CanIfRxPduCanIdType=EXTENDED_CAN, CanIfRxPduDlc=8, CanIfRxPduUserRxIndicationUL=CDD, CanIfRxPduHrhIdRef=CanIfInitHohCfg/CN_PCAN_RADAR_92639a04_Rx, CanIfRxPduRef=EcucPduCollection/RDR_CM_B1_Rx_oPCAN_RADAR_a03442fa_Rx
        RDR_DIAG_REQ_PHYS_Tp_oPCAN_RADAR_20_a814379d_Rx: CanIfRxPduCanId=19 if post-build-variant-condition{matching-criterion=RDR_POS, value=0}, CanIfRxPduCanIdType=STANDARD_NO_FD_CAN, CanIfRxPduDlc=8, CanIfRxPduUserRxIndicationUL=CDD, CanIfRxPduCanId=27 if post-build-variant-condition{matching-criterion=RDR_POS, value=1}, CanIfRxPduCanId=35 if post-build-variant-condition{matching-criterion=RDR_POS, value=2}, CanIfRxPduCanId=43 if post-build-variant-condition{matching-criterion=RDR_POS, value=3}, CanIfRxPduCanId=51 if post-build-variant-condition{matching-criterion=RDR_POS, value=4}, CanIfRxPduCanId=59 if post-build-variant-condition{matching-criterion=RDR_POS, value=5}, CanIfRxPduCanId=67 if post-build-variant-condition{matching-criterion=RDR_POS, value=6}, CanIfRxPduCanId=75 if post-build-variant-condition{matching-criterion=RDR_POS, value=7}, CanIfRxPduHrhIdRef=CanIfInitHohCfg/CN_PCAN_RADAR_a729ccfc_Rx, CanIfRxPduRef=RDR_DIAG_REQ_PHYS_Tp_oPCAN_RADAR_20_e3912bde_Rx
        RDR_DIAG_REQ_PHYS_Tp_oPCAN_RADAR_f69b9b16_Rx: CanIfRxPduCanId=19 if post-build-variant-condition{matching-criterion=RDR_POS, value=0}, CanIfRxPduCanIdType=STANDARD_FD_CAN, CanIfRxPduDlc=64, CanIfRxPduUserRxIndicationUL=CDD, CanIfRxPduCanId=27 if post-build-variant-condition{matching-criterion=RDR_POS, value=1}, CanIfRxPduCanId=35 if post-build-variant-condition{matching-criterion=RDR_POS, value=2}, CanIfRxPduCanId=43 if post-build-variant-condition{matching-criterion=RDR_POS, value=3}, CanIfRxPduCanId=51 if post-build-variant-condition{matching-criterion=RDR_POS, value=4}, CanIfRxPduCanId=59 if post-build-variant-condition{matching-criterion=RDR_POS, value=5}, CanIfRxPduCanId=67 if post-build-variant-condition{matching-criterion=RDR_POS, value=6}, CanIfRxPduCanId=75 if post-build-variant-condition{matching-criterion=RDR_POS, value=7}, CanIfRxPduHrhIdRef=CanIfInitHohCfg/CN_PCAN_RADAR_a729ccfc_Rx, CanIfRxPduRef=RDR_DIAG_REQ_PHYS_Tp_oPCAN_RADAR_25ac4fd7_Rx
        RDR_DT_B0_Rx_oPCAN_RADAR_842ebd81_Rx: CanIfRxPduCanId=418219600, CanIfRxPduCanIdType=EXTENDED_CAN, CanIfRxPduDlc=8, CanIfRxPduUserRxIndicationUL=CDD, CanIfRxPduHrhIdRef=CanIfInitHohCfg/CN_PCAN_RADAR_92639a04_Rx, CanIfRxPduRef=EcucPduCollection/RDR_DT_B0_Rx_oPCAN_RADAR_ab9d960c_Rx
        RDR_DT_B1_Rx_oPCAN_RADAR_24380880_Rx: CanIfRxPduCanId=418219601, CanIfRxPduCanIdType=EXTENDED_CAN, CanIfRxPduDlc=8, CanIfRxPduUserRxIndicationUL=CDD, CanIfRxPduHrhIdRef=CanIfInitHohCfg/CN_PCAN_RADAR_92639a04_Rx, CanIfRxPduRef=EcucPduCollection/RDR_DT_B1_Rx_oPCAN_RADAR_3eed4299_Rx
        RDR_FUSION_ALIGNMENT_STATUS_001_oPCAN_RADAR_3c4e871e_Rx: CanIfRxPduCanId=157 if post-build-variant-condition{matching-criterion=RDR_POS, value=0}, CanIfRxPduCanIdType=STANDARD_CAN, CanIfRxPduDlc=64, CanIfRxPduUserRxIndicationName=PduR_CanIfRxIndication, CanIfRxPduUserRxIndicationUL=PDUR, CanIfRxPduCanId=149 if post-build-variant-condition{matching-criterion=RDR_POS, value=1}, CanIfRxPduCanId=141 if post-build-variant-condition{matching-criterion=RDR_POS, value=2}, CanIfRxPduCanId=133 if post-build-variant-condition{matching-criterion=RDR_POS, value=3}, CanIfRxPduCanId=133 if post-build-variant-condition{matching-criterion=RDR_POS, value=4}, CanIfRxPduCanId=165 if post-build-variant-condition{matching-criterion=RDR_POS, value=5}, CanIfRxPduCanId=189 if post-build-variant-condition{matching-criterion=RDR_POS, value=6}, CanIfRxPduCanId=181 if post-build-variant-condition{matching-criterion=RDR_POS, value=7}, CanIfRxPduHrhIdRef=CanIfInitHohCfg/CN_PCAN_RADAR_a729ccfc_Rx, CanIfRxPduRef=EcucPduCollection/RDR_FUSION_ALIGNMENT_STATUS_001_oPCAN_RADAR_e2456918_Rx
        RDR_FUSION_ALIGNMENT_STATUS_002_oPCAN_RADAR_666234f7_Rx: CanIfRxPduCanId=158 if post-build-variant-condition{matching-criterion=RDR_POS, value=0}, CanIfRxPduCanIdType=STANDARD_CAN, CanIfRxPduDlc=64, CanIfRxPduUserRxIndicationName=PduR_CanIfRxIndication, CanIfRxPduUserRxIndicationUL=PDUR, CanIfRxPduCanId=150 if post-build-variant-condition{matching-criterion=RDR_POS, value=1}, CanIfRxPduCanId=142 if post-build-variant-condition{matching-criterion=RDR_POS, value=2}, CanIfRxPduCanId=134 if post-build-variant-condition{matching-criterion=RDR_POS, value=3}, CanIfRxPduCanId=134 if post-build-variant-condition{matching-criterion=RDR_POS, value=4}, CanIfRxPduCanId=166 if post-build-variant-condition{matching-criterion=RDR_POS, value=5}, CanIfRxPduCanId=190 if post-build-variant-condition{matching-criterion=RDR_POS, value=6}, CanIfRxPduCanId=182 if post-build-variant-condition{matching-criterion=RDR_POS, value=7}, CanIfRxPduHrhIdRef=CanIfInitHohCfg/CN_PCAN_RADAR_a729ccfc_Rx, CanIfRxPduRef=EcucPduCollection/RDR_FUSION_ALIGNMENT_STATUS_002_oPCAN_RADAR_b952d80d_Rx
        RDR_FUSION_CAPABILITY_oPCAN_RADAR_11f796c7_Rx: CanIfRxPduCanId=159 if post-build-variant-condition{matching-criterion=RDR_POS, value=0}, CanIfRxPduCanIdType=STANDARD_CAN, CanIfRxPduDlc=64, CanIfRxPduUserRxIndicationName=PduR_CanIfRxIndication, CanIfRxPduUserRxIndicationUL=PDUR, CanIfRxPduCanId=151 if post-build-variant-condition{matching-criterion=RDR_POS, value=1}, CanIfRxPduCanId=143 if post-build-variant-condition{matching-criterion=RDR_POS, value=2}, CanIfRxPduCanId=135 if post-build-variant-condition{matching-criterion=RDR_POS, value=3}, CanIfRxPduCanId=135 if post-build-variant-condition{matching-criterion=RDR_POS, value=4}, CanIfRxPduCanId=167 if post-build-variant-condition{matching-criterion=RDR_POS, value=5}, CanIfRxPduCanId=191 if post-build-variant-condition{matching-criterion=RDR_POS, value=6}, CanIfRxPduCanId=183 if post-build-variant-condition{matching-criterion=RDR_POS, value=7}, CanIfRxPduHrhIdRef=CanIfInitHohCfg/CN_PCAN_RADAR_a729ccfc_Rx, CanIfRxPduRef=EcucPduCollection/RDR_FUSION_CAPABILITY_oPCAN_RADAR_2f1662f1_Rx
        RDR_FUSION_DET_001_004_oPCAN_RADAR_4b7989b8_Rx: CanIfRxPduCanId=640 if post-build-variant-condition{matching-criterion=RDR_POS, value=0}, CanIfRxPduCanIdType=STANDARD_CAN, CanIfRxPduDlc=64, CanIfRxPduUserRxIndicationName=PduR_CanIfRxIndication, CanIfRxPduUserRxIndicationUL=PDUR, CanIfRxPduCanId=512 if post-build-variant-condition{matching-criterion=RDR_POS, value=1}, CanIfRxPduCanId=384 if post-build-variant-condition{matching-criterion=RDR_POS, value=2}, CanIfRxPduCanId=256 if post-build-variant-condition{matching-criterion=RDR_POS, value=3}, CanIfRxPduCanId=256 if post-build-variant-condition{matching-criterion=RDR_POS, value=4}, CanIfRxPduCanId=768 if post-build-variant-condition{matching-criterion=RDR_POS, value=5}, CanIfRxPduCanId=1152 if post-build-variant-condition{matching-criterion=RDR_POS, value=6}, CanIfRxPduCanId=1024 if post-build-variant-condition{matching-criterion=RDR_POS, value=7}, CanIfRxPduHrhIdRef=CanIfInitHohCfg/CN_PCAN_RADAR_a729ccfc_Rx, CanIfRxPduRef=EcucPduCollection/RDR_FUSION_DET_001_004_oPCAN_RADAR_d9a9ebb4_Rx
        RDR_FUSION_DET_005_008_oPCAN_RADAR_0b00c023_Rx: CanIfRxPduCanId=641 if post-build-variant-condition{matching-criterion=RDR_POS, value=0}, CanIfRxPduCanIdType=STANDARD_CAN, CanIfRxPduDlc=64, CanIfRxPduUserRxIndicationName=PduR_CanIfRxIndication, CanIfRxPduUserRxIndicationUL=PDUR, CanIfRxPduCanId=513 if post-build-variant-condition{matching-criterion=RDR_POS, value=1}, CanIfRxPduCanId=385 if post-build-variant-condition{matching-criterion=RDR_POS, value=2}, CanIfRxPduCanId=257 if post-build-variant-condition{matching-criterion=RDR_POS, value=3}, CanIfRxPduCanId=257 if post-build-variant-condition{matching-criterion=RDR_POS, value=4}, CanIfRxPduCanId=769 if post-build-variant-condition{matching-criterion=RDR_POS, value=5}, CanIfRxPduCanId=1153 if post-build-variant-condition{matching-criterion=RDR_POS, value=6}, CanIfRxPduCanId=1025 if post-build-variant-condition{matching-criterion=RDR_POS, value=7}, CanIfRxPduHrhIdRef=CanIfInitHohCfg/CN_PCAN_RADAR_a729ccfc_Rx, CanIfRxPduRef=EcucPduCollection/RDR_FUSION_DET_005_008_oPCAN_RADAR_00d57f1e_Rx
        RDR_FUSION_DET_009_012_oPCAN_RADAR_00c92885_Rx: CanIfRxPduCanId=642 if post-build-variant-condition{matching-criterion=RDR_POS, value=0}, CanIfRxPduCanIdType=STANDARD_CAN, CanIfRxPduDlc=64, CanIfRxPduUserRxIndicationName=PduR_CanIfRxIndication, CanIfRxPduUserRxIndicationUL=PDUR, CanIfRxPduCanId=514 if post-build-variant-condition{matching-criterion=RDR_POS, value=1}, CanIfRxPduCanId=386 if post-build-variant-condition{matching-criterion=RDR_POS, value=2}, CanIfRxPduCanId=258 if post-build-variant-condition{matching-criterion=RDR_POS, value=3}, CanIfRxPduCanId=258 if post-build-variant-condition{matching-criterion=RDR_POS, value=4}, CanIfRxPduCanId=770 if post-build-variant-condition{matching-criterion=RDR_POS, value=5}, CanIfRxPduCanId=1154 if post-build-variant-condition{matching-criterion=RDR_POS, value=6}, CanIfRxPduCanId=1026 if post-build-variant-condition{matching-criterion=RDR_POS, value=7}, CanIfRxPduHrhIdRef=CanIfInitHohCfg/CN_PCAN_RADAR_a729ccfc_Rx, CanIfRxPduRef=EcucPduCollection/RDR_FUSION_DET_009_012_oPCAN_RADAR_97a275d6_Rx
        RDR_FUSION_DET_013_016_oPCAN_RADAR_577f1aa5_Rx: CanIfRxPduCanId=643 if post-build-variant-condition{matching-criterion=RDR_POS, value=0}, CanIfRxPduCanIdType=STANDARD_CAN, CanIfRxPduDlc=64, CanIfRxPduUserRxIndicationName=PduR_CanIfRxIndication, CanIfRxPduUserRxIndicationUL=PDUR, CanIfRxPduCanId=515 if post-build-variant-condition{matching-criterion=RDR_POS, value=1}, CanIfRxPduCanId=387 if post-build-variant-condition{matching-criterion=RDR_POS, value=2}, CanIfRxPduCanId=259 if post-build-variant-condition{matching-criterion=RDR_POS, value=3}, CanIfRxPduCanId=259 if post-build-variant-condition{matching-criterion=RDR_POS, value=4}, CanIfRxPduCanId=771 if post-build-variant-condition{matching-criterion=RDR_POS, value=5}, CanIfRxPduCanId=1155 if post-build-variant-condition{matching-criterion=RDR_POS, value=6}, CanIfRxPduCanId=1027 if post-build-variant-condition{matching-criterion=RDR_POS, value=7}, CanIfRxPduHrhIdRef=CanIfInitHohCfg/CN_PCAN_RADAR_a729ccfc_Rx, CanIfRxPduRef=EcucPduCollection/RDR_FUSION_DET_013_016_oPCAN_RADAR_c7d74ef9_Rx
        RDR_FUSION_DET_017_020_oPCAN_RADAR_e1253ccd_Rx: CanIfRxPduCanId=644 if post-build-variant-condition{matching-criterion=RDR_POS, value=0}, CanIfRxPduCanIdType=STANDARD_CAN, CanIfRxPduDlc=64, CanIfRxPduUserRxIndicationName=PduR_CanIfRxIndication, CanIfRxPduUserRxIndicationUL=PDUR, CanIfRxPduCanId=516 if post-build-variant-condition{matching-criterion=RDR_POS, value=1}, CanIfRxPduCanId=388 if post-build-variant-condition{matching-criterion=RDR_POS, value=2}, CanIfRxPduCanId=260 if post-build-variant-condition{matching-criterion=RDR_POS, value=3}, CanIfRxPduCanId=260 if post-build-variant-condition{matching-criterion=RDR_POS, value=4}, CanIfRxPduCanId=772 if post-build-variant-condition{matching-criterion=RDR_POS, value=5}, CanIfRxPduCanId=1156 if post-build-variant-condition{matching-criterion=RDR_POS, value=6}, CanIfRxPduCanId=1028 if post-build-variant-condition{matching-criterion=RDR_POS, value=7}, CanIfRxPduHrhIdRef=CanIfInitHohCfg/CN_PCAN_RADAR_a729ccfc_Rx, CanIfRxPduRef=EcucPduCollection/RDR_FUSION_DET_017_020_oPCAN_RADAR_722d8936_Rx
        RDR_FUSION_DET_021_024_oPCAN_RADAR_9f591705_Rx: CanIfRxPduCanId=645 if post-build-variant-condition{matching-criterion=RDR_POS, value=0}, CanIfRxPduCanIdType=STANDARD_CAN, CanIfRxPduDlc=64, CanIfRxPduUserRxIndicationName=PduR_CanIfRxIndication, CanIfRxPduUserRxIndicationUL=PDUR, CanIfRxPduCanId=517 if post-build-variant-condition{matching-criterion=RDR_POS, value=1}, CanIfRxPduCanId=389 if post-build-variant-condition{matching-criterion=RDR_POS, value=2}, CanIfRxPduCanId=261 if post-build-variant-condition{matching-criterion=RDR_POS, value=3}, CanIfRxPduCanId=261 if post-build-variant-condition{matching-criterion=RDR_POS, value=4}, CanIfRxPduCanId=773 if post-build-variant-condition{matching-criterion=RDR_POS, value=5}, CanIfRxPduCanId=1157 if post-build-variant-condition{matching-criterion=RDR_POS, value=6}, CanIfRxPduCanId=1029 if post-build-variant-condition{matching-criterion=RDR_POS, value=7}, CanIfRxPduHrhIdRef=CanIfInitHohCfg/CN_PCAN_RADAR_a729ccfc_Rx, CanIfRxPduRef=EcucPduCollection/RDR_FUSION_DET_021_024_oPCAN_RADAR_50cdb45d_Rx
        RDR_FUSION_DET_025_028_oPCAN_RADAR_df205e9e_Rx: CanIfRxPduCanId=646 if post-build-variant-condition{matching-criterion=RDR_POS, value=0}, CanIfRxPduCanIdType=STANDARD_CAN, CanIfRxPduDlc=64, CanIfRxPduUserRxIndicationName=PduR_CanIfRxIndication, CanIfRxPduUserRxIndicationUL=PDUR, CanIfRxPduCanId=518 if post-build-variant-condition{matching-criterion=RDR_POS, value=1}, CanIfRxPduCanId=390 if post-build-variant-condition{matching-criterion=RDR_POS, value=2}, CanIfRxPduCanId=262 if post-build-variant-condition{matching-criterion=RDR_POS, value=3}, CanIfRxPduCanId=262 if post-build-variant-condition{matching-criterion=RDR_POS, value=4}, CanIfRxPduCanId=774 if post-build-variant-condition{matching-criterion=RDR_POS, value=5}, CanIfRxPduCanId=1158 if post-build-variant-condition{matching-criterion=RDR_POS, value=6}, CanIfRxPduCanId=1030 if post-build-variant-condition{matching-criterion=RDR_POS, value=7}, CanIfRxPduHrhIdRef=CanIfInitHohCfg/CN_PCAN_RADAR_a729ccfc_Rx, CanIfRxPduRef=EcucPduCollection/RDR_FUSION_DET_025_028_oPCAN_RADAR_89b120f7_Rx
        RDR_FUSION_DET_029_032_oPCAN_RADAR_d4e9b638_Rx: CanIfRxPduCanId=647 if post-build-variant-condition{matching-criterion=RDR_POS, value=0}, CanIfRxPduCanIdType=STANDARD_CAN, CanIfRxPduDlc=64, CanIfRxPduUserRxIndicationName=PduR_CanIfRxIndication, CanIfRxPduUserRxIndicationUL=PDUR, CanIfRxPduCanId=519 if post-build-variant-condition{matching-criterion=RDR_POS, value=1}, CanIfRxPduCanId=391 if post-build-variant-condition{matching-criterion=RDR_POS, value=2}, CanIfRxPduCanId=263 if post-build-variant-condition{matching-criterion=RDR_POS, value=3}, CanIfRxPduCanId=263 if post-build-variant-condition{matching-criterion=RDR_POS, value=4}, CanIfRxPduCanId=775 if post-build-variant-condition{matching-criterion=RDR_POS, value=5}, CanIfRxPduCanId=1159 if post-build-variant-condition{matching-criterion=RDR_POS, value=6}, CanIfRxPduCanId=1031 if post-build-variant-condition{matching-criterion=RDR_POS, value=7}, CanIfRxPduHrhIdRef=CanIfInitHohCfg/CN_PCAN_RADAR_a729ccfc_Rx, CanIfRxPduRef=EcucPduCollection/RDR_FUSION_DET_029_032_oPCAN_RADAR_1ec62a3f_Rx
        RDR_FUSION_DET_033_036_oPCAN_RADAR_835f8418_Rx: CanIfRxPduCanId=648 if post-build-variant-condition{matching-criterion=RDR_POS, value=0}, CanIfRxPduCanIdType=STANDARD_CAN, CanIfRxPduDlc=64, CanIfRxPduUserRxIndicationName=PduR_CanIfRxIndication, CanIfRxPduUserRxIndicationUL=PDUR, CanIfRxPduCanId=520 if post-build-variant-condition{matching-criterion=RDR_POS, value=1}, CanIfRxPduCanId=392 if post-build-variant-condition{matching-criterion=RDR_POS, value=2}, CanIfRxPduCanId=264 if post-build-variant-condition{matching-criterion=RDR_POS, value=3}, CanIfRxPduCanId=264 if post-build-variant-condition{matching-criterion=RDR_POS, value=4}, CanIfRxPduCanId=776 if post-build-variant-condition{matching-criterion=RDR_POS, value=5}, CanIfRxPduCanId=1160 if post-build-variant-condition{matching-criterion=RDR_POS, value=6}, CanIfRxPduCanId=1032 if post-build-variant-condition{matching-criterion=RDR_POS, value=7}, CanIfRxPduHrhIdRef=CanIfInitHohCfg/CN_PCAN_RADAR_a729ccfc_Rx, CanIfRxPduRef=EcucPduCollection/RDR_FUSION_DET_033_036_oPCAN_RADAR_4eb31110_Rx
        RDR_FUSION_DET_037_040_oPCAN_RADAR_3f53262f_Rx: CanIfRxPduCanId=649 if post-build-variant-condition{matching-criterion=RDR_POS, value=0}, CanIfRxPduCanIdType=STANDARD_CAN, CanIfRxPduDlc=64, CanIfRxPduUserRxIndicationName=PduR_CanIfRxIndication, CanIfRxPduUserRxIndicationUL=PDUR, CanIfRxPduCanId=521 if post-build-variant-condition{matching-criterion=RDR_POS, value=1}, CanIfRxPduCanId=393 if post-build-variant-condition{matching-criterion=RDR_POS, value=2}, CanIfRxPduCanId=265 if post-build-variant-condition{matching-criterion=RDR_POS, value=3}, CanIfRxPduCanId=265 if post-build-variant-condition{matching-criterion=RDR_POS, value=4}, CanIfRxPduCanId=777 if post-build-variant-condition{matching-criterion=RDR_POS, value=5}, CanIfRxPduCanId=1161 if post-build-variant-condition{matching-criterion=RDR_POS, value=6}, CanIfRxPduCanId=1033 if post-build-variant-condition{matching-criterion=RDR_POS, value=7}, CanIfRxPduHrhIdRef=CanIfInitHohCfg/CN_PCAN_RADAR_a729ccfc_Rx, CanIfRxPduRef=EcucPduCollection/RDR_FUSION_DET_037_040_oPCAN_RADAR_69409207_Rx
        RDR_FUSION_DET_041_044_oPCAN_RADAR_3849b283_Rx: CanIfRxPduCanId=650 if post-build-variant-condition{matching-criterion=RDR_POS, value=0}, CanIfRxPduCanIdType=STANDARD_CAN, CanIfRxPduDlc=64, CanIfRxPduUserRxIndicationName=PduR_CanIfRxIndication, CanIfRxPduUserRxIndicationUL=PDUR, CanIfRxPduCanId=522 if post-build-variant-condition{matching-criterion=RDR_POS, value=1}, CanIfRxPduCanId=394 if post-build-variant-condition{matching-criterion=RDR_POS, value=2}, CanIfRxPduCanId=266 if post-build-variant-condition{matching-criterion=RDR_POS, value=3}, CanIfRxPduCanId=266 if post-build-variant-condition{matching-criterion=RDR_POS, value=4}, CanIfRxPduCanId=778 if post-build-variant-condition{matching-criterion=RDR_POS, value=5}, CanIfRxPduCanId=1162 if post-build-variant-condition{matching-criterion=RDR_POS, value=6}, CanIfRxPduCanId=1034 if post-build-variant-condition{matching-criterion=RDR_POS, value=7}, CanIfRxPduHrhIdRef=CanIfInitHohCfg/CN_PCAN_RADAR_a729ccfc_Rx, CanIfRxPduRef=EcucPduCollection/RDR_FUSION_DET_041_044_oPCAN_RADAR_10105227_Rx
        RDR_FUSION_DET_045_048_oPCAN_RADAR_7830fb18_Rx: CanIfRxPduCanId=651 if post-build-variant-condition{matching-criterion=RDR_POS, value=0}, CanIfRxPduCanIdType=STANDARD_CAN, CanIfRxPduDlc=64, CanIfRxPduUserRxIndicationName=PduR_CanIfRxIndication, CanIfRxPduUserRxIndicationUL=PDUR, CanIfRxPduCanId=523 if post-build-variant-condition{matching-criterion=RDR_POS, value=1}, CanIfRxPduCanId=395 if post-build-variant-condition{matching-criterion=RDR_POS, value=2}, CanIfRxPduCanId=267 if post-build-variant-condition{matching-criterion=RDR_POS, value=3}, CanIfRxPduCanId=267 if post-build-variant-condition{matching-criterion=RDR_POS, value=4}, CanIfRxPduCanId=779 if post-build-variant-condition{matching-criterion=RDR_POS, value=5}, CanIfRxPduCanId=1163 if post-build-variant-condition{matching-criterion=RDR_POS, value=6}, CanIfRxPduCanId=1035 if post-build-variant-condition{matching-criterion=RDR_POS, value=7}, CanIfRxPduHrhIdRef=CanIfInitHohCfg/CN_PCAN_RADAR_a729ccfc_Rx, CanIfRxPduRef=EcucPduCollection/RDR_FUSION_DET_045_048_oPCAN_RADAR_c96cc68d_Rx
        RDR_FUSION_DET_049_052_oPCAN_RADAR_73f913be_Rx: CanIfRxPduCanId=652 if post-build-variant-condition{matching-criterion=RDR_POS, value=0}, CanIfRxPduCanIdType=STANDARD_CAN, CanIfRxPduDlc=64, CanIfRxPduUserRxIndicationName=PduR_CanIfRxIndication, CanIfRxPduUserRxIndicationUL=PDUR, CanIfRxPduCanId=524 if post-build-variant-condition{matching-criterion=RDR_POS, value=1}, CanIfRxPduCanId=396 if post-build-variant-condition{matching-criterion=RDR_POS, value=2}, CanIfRxPduCanId=268 if post-build-variant-condition{matching-criterion=RDR_POS, value=3}, CanIfRxPduCanId=268 if post-build-variant-condition{matching-criterion=RDR_POS, value=4}, CanIfRxPduCanId=780 if post-build-variant-condition{matching-criterion=RDR_POS, value=5}, CanIfRxPduCanId=1164 if post-build-variant-condition{matching-criterion=RDR_POS, value=6}, CanIfRxPduCanId=1036 if post-build-variant-condition{matching-criterion=RDR_POS, value=7}, CanIfRxPduHrhIdRef=CanIfInitHohCfg/CN_PCAN_RADAR_a729ccfc_Rx, CanIfRxPduRef=EcucPduCollection/RDR_FUSION_DET_049_052_oPCAN_RADAR_5e1bcc45_Rx
        RDR_FUSION_DET_053_056_oPCAN_RADAR_244f219e_Rx: CanIfRxPduCanId=653 if post-build-variant-condition{matching-criterion=RDR_POS, value=0}, CanIfRxPduCanIdType=STANDARD_CAN, CanIfRxPduDlc=64, CanIfRxPduUserRxIndicationName=PduR_CanIfRxIndication, CanIfRxPduUserRxIndicationUL=PDUR, CanIfRxPduCanId=525 if post-build-variant-condition{matching-criterion=RDR_POS, value=1}, CanIfRxPduCanId=397 if post-build-variant-condition{matching-criterion=RDR_POS, value=2}, CanIfRxPduCanId=269 if post-build-variant-condition{matching-criterion=RDR_POS, value=3}, CanIfRxPduCanId=269 if post-build-variant-condition{matching-criterion=RDR_POS, value=4}, CanIfRxPduCanId=781 if post-build-variant-condition{matching-criterion=RDR_POS, value=5}, CanIfRxPduCanId=1165 if post-build-variant-condition{matching-criterion=RDR_POS, value=6}, CanIfRxPduCanId=1037 if post-build-variant-condition{matching-criterion=RDR_POS, value=7}, CanIfRxPduHrhIdRef=CanIfInitHohCfg/CN_PCAN_RADAR_a729ccfc_Rx, CanIfRxPduRef=EcucPduCollection/RDR_FUSION_DET_053_056_oPCAN_RADAR_0e6ef76a_Rx
        RDR_FUSION_DET_057_060_oPCAN_RADAR_921507f6_Rx: CanIfRxPduCanId=654 if post-build-variant-condition{matching-criterion=RDR_POS, value=0}, CanIfRxPduCanIdType=STANDARD_CAN, CanIfRxPduDlc=64, CanIfRxPduUserRxIndicationName=PduR_CanIfRxIndication, CanIfRxPduUserRxIndicationUL=PDUR, CanIfRxPduCanId=526 if post-build-variant-condition{matching-criterion=RDR_POS, value=1}, CanIfRxPduCanId=398 if post-build-variant-condition{matching-criterion=RDR_POS, value=2}, CanIfRxPduCanId=270 if post-build-variant-condition{matching-criterion=RDR_POS, value=3}, CanIfRxPduCanId=270 if post-build-variant-condition{matching-criterion=RDR_POS, value=4}, CanIfRxPduCanId=782 if post-build-variant-condition{matching-criterion=RDR_POS, value=5}, CanIfRxPduCanId=1166 if post-build-variant-condition{matching-criterion=RDR_POS, value=6}, CanIfRxPduCanId=1038 if post-build-variant-condition{matching-criterion=RDR_POS, value=7}, CanIfRxPduHrhIdRef=CanIfInitHohCfg/CN_PCAN_RADAR_a729ccfc_Rx, CanIfRxPduRef=EcucPduCollection/RDR_FUSION_DET_057_060_oPCAN_RADAR_bb9430a5_Rx
        RDR_FUSION_DET_061_064_oPCAN_RADAR_ec692c3e_Rx: CanIfRxPduCanId=655 if post-build-variant-condition{matching-criterion=RDR_POS, value=0}, CanIfRxPduCanIdType=STANDARD_CAN, CanIfRxPduDlc=64, CanIfRxPduUserRxIndicationName=PduR_CanIfRxIndication, CanIfRxPduUserRxIndicationUL=PDUR, CanIfRxPduCanId=527 if post-build-variant-condition{matching-criterion=RDR_POS, value=1}, CanIfRxPduCanId=399 if post-build-variant-condition{matching-criterion=RDR_POS, value=2}, CanIfRxPduCanId=271 if post-build-variant-condition{matching-criterion=RDR_POS, value=3}, CanIfRxPduCanId=271 if post-build-variant-condition{matching-criterion=RDR_POS, value=4}, CanIfRxPduCanId=783 if post-build-variant-condition{matching-criterion=RDR_POS, value=5}, CanIfRxPduCanId=1167 if post-build-variant-condition{matching-criterion=RDR_POS, value=6}, CanIfRxPduCanId=1039 if post-build-variant-condition{matching-criterion=RDR_POS, value=7}, CanIfRxPduHrhIdRef=CanIfInitHohCfg/CN_PCAN_RADAR_a729ccfc_Rx, CanIfRxPduRef=EcucPduCollection/RDR_FUSION_DET_061_064_oPCAN_RADAR_99740dce_Rx
        RDR_FUSION_DET_065_068_oPCAN_RADAR_ac1065a5_Rx: CanIfRxPduCanId=656 if post-build-variant-condition{matching-criterion=RDR_POS, value=0}, CanIfRxPduCanIdType=STANDARD_CAN, CanIfRxPduDlc=64, CanIfRxPduUserRxIndicationName=PduR_CanIfRxIndication, CanIfRxPduUserRxIndicationUL=PDUR, CanIfRxPduCanId=528 if post-build-variant-condition{matching-criterion=RDR_POS, value=1}, CanIfRxPduCanId=400 if post-build-variant-condition{matching-criterion=RDR_POS, value=2}, CanIfRxPduCanId=272 if post-build-variant-condition{matching-criterion=RDR_POS, value=3}, CanIfRxPduCanId=272 if post-build-variant-condition{matching-criterion=RDR_POS, value=4}, CanIfRxPduCanId=784 if post-build-variant-condition{matching-criterion=RDR_POS, value=5}, CanIfRxPduCanId=1168 if post-build-variant-condition{matching-criterion=RDR_POS, value=6}, CanIfRxPduCanId=1040 if post-build-variant-condition{matching-criterion=RDR_POS, value=7}, CanIfRxPduHrhIdRef=CanIfInitHohCfg/CN_PCAN_RADAR_a729ccfc_Rx, CanIfRxPduRef=EcucPduCollection/RDR_FUSION_DET_065_068_oPCAN_RADAR_40089964_Rx
        RDR_FUSION_DET_069_072_oPCAN_RADAR_a7d98d03_Rx: CanIfRxPduCanId=657 if post-build-variant-condition{matching-criterion=RDR_POS, value=0}, CanIfRxPduCanIdType=STANDARD_CAN, CanIfRxPduDlc=64, CanIfRxPduUserRxIndicationName=PduR_CanIfRxIndication, CanIfRxPduUserRxIndicationUL=PDUR, CanIfRxPduCanId=529 if post-build-variant-condition{matching-criterion=RDR_POS, value=1}, CanIfRxPduCanId=401 if post-build-variant-condition{matching-criterion=RDR_POS, value=2}, CanIfRxPduCanId=273 if post-build-variant-condition{matching-criterion=RDR_POS, value=3}, CanIfRxPduCanId=273 if post-build-variant-condition{matching-criterion=RDR_POS, value=4}, CanIfRxPduCanId=785 if post-build-variant-condition{matching-criterion=RDR_POS, value=5}, CanIfRxPduCanId=1169 if post-build-variant-condition{matching-criterion=RDR_POS, value=6}, CanIfRxPduCanId=1041 if post-build-variant-condition{matching-criterion=RDR_POS, value=7}, CanIfRxPduHrhIdRef=CanIfInitHohCfg/CN_PCAN_RADAR_a729ccfc_Rx, CanIfRxPduRef=EcucPduCollection/RDR_FUSION_DET_069_072_oPCAN_RADAR_d77f93ac_Rx
        RDR_FUSION_DET_073_076_oPCAN_RADAR_f06fbf23_Rx: CanIfRxPduCanId=658 if post-build-variant-condition{matching-criterion=RDR_POS, value=0}, CanIfRxPduCanIdType=STANDARD_CAN, CanIfRxPduDlc=64, CanIfRxPduUserRxIndicationName=PduR_CanIfRxIndication, CanIfRxPduUserRxIndicationUL=PDUR, CanIfRxPduCanId=530 if post-build-variant-condition{matching-criterion=RDR_POS, value=1}, CanIfRxPduCanId=402 if post-build-variant-condition{matching-criterion=RDR_POS, value=2}, CanIfRxPduCanId=274 if post-build-variant-condition{matching-criterion=RDR_POS, value=3}, CanIfRxPduCanId=274 if post-build-variant-condition{matching-criterion=RDR_POS, value=4}, CanIfRxPduCanId=786 if post-build-variant-condition{matching-criterion=RDR_POS, value=5}, CanIfRxPduCanId=1170 if post-build-variant-condition{matching-criterion=RDR_POS, value=6}, CanIfRxPduCanId=1042 if post-build-variant-condition{matching-criterion=RDR_POS, value=7}, CanIfRxPduHrhIdRef=CanIfInitHohCfg/CN_PCAN_RADAR_a729ccfc_Rx, CanIfRxPduRef=EcucPduCollection/RDR_FUSION_DET_073_076_oPCAN_RADAR_870aa883_Rx
        RDR_FUSION_DET_077_080_oPCAN_RADAR_58ce15aa_Rx: CanIfRxPduCanId=659 if post-build-variant-condition{matching-criterion=RDR_POS, value=0}, CanIfRxPduCanIdType=STANDARD_CAN, CanIfRxPduDlc=64, CanIfRxPduUserRxIndicationName=PduR_CanIfRxIndication, CanIfRxPduUserRxIndicationUL=PDUR, CanIfRxPduCanId=531 if post-build-variant-condition{matching-criterion=RDR_POS, value=1}, CanIfRxPduCanId=403 if post-build-variant-condition{matching-criterion=RDR_POS, value=2}, CanIfRxPduCanId=275 if post-build-variant-condition{matching-criterion=RDR_POS, value=3}, CanIfRxPduCanId=275 if post-build-variant-condition{matching-criterion=RDR_POS, value=4}, CanIfRxPduCanId=787 if post-build-variant-condition{matching-criterion=RDR_POS, value=5}, CanIfRxPduCanId=1171 if post-build-variant-condition{matching-criterion=RDR_POS, value=6}, CanIfRxPduCanId=1043 if post-build-variant-condition{matching-criterion=RDR_POS, value=7}, CanIfRxPduHrhIdRef=CanIfInitHohCfg/CN_PCAN_RADAR_a729ccfc_Rx, CanIfRxPduRef=EcucPduCollection/RDR_FUSION_DET_077_080_oPCAN_RADAR_5f9aa465_Rx
        RDR_FUSION_DET_081_084_oPCAN_RADAR_ad19ffce_Rx: CanIfRxPduCanId=660 if post-build-variant-condition{matching-criterion=RDR_POS, value=0}, CanIfRxPduCanIdType=STANDARD_CAN, CanIfRxPduDlc=64, CanIfRxPduUserRxIndicationName=PduR_CanIfRxIndication, CanIfRxPduUserRxIndicationUL=PDUR, CanIfRxPduCanId=532 if post-build-variant-condition{matching-criterion=RDR_POS, value=1}, CanIfRxPduCanId=404 if post-build-variant-condition{matching-criterion=RDR_POS, value=2}, CanIfRxPduCanId=276 if post-build-variant-condition{matching-criterion=RDR_POS, value=3}, CanIfRxPduCanId=276 if post-build-variant-condition{matching-criterion=RDR_POS, value=4}, CanIfRxPduCanId=788 if post-build-variant-condition{matching-criterion=RDR_POS, value=5}, CanIfRxPduCanId=1172 if post-build-variant-condition{matching-criterion=RDR_POS, value=6}, CanIfRxPduCanId=1044 if post-build-variant-condition{matching-criterion=RDR_POS, value=7}, CanIfRxPduHrhIdRef=CanIfInitHohCfg/CN_PCAN_RADAR_a729ccfc_Rx, CanIfRxPduRef=EcucPduCollection/RDR_FUSION_DET_081_084_oPCAN_RADAR_91ab9ed3_Rx
        RDR_FUSION_DET_085_088_oPCAN_RADAR_ed60b655_Rx: CanIfRxPduCanId=661 if post-build-variant-condition{matching-criterion=RDR_POS, value=0}, CanIfRxPduCanIdType=STANDARD_CAN, CanIfRxPduDlc=64, CanIfRxPduUserRxIndicationName=PduR_CanIfRxIndication, CanIfRxPduUserRxIndicationUL=PDUR, CanIfRxPduCanId=533 if post-build-variant-condition{matching-criterion=RDR_POS, value=1}, CanIfRxPduCanId=405 if post-build-variant-condition{matching-criterion=RDR_POS, value=2}, CanIfRxPduCanId=277 if post-build-variant-condition{matching-criterion=RDR_POS, value=3}, CanIfRxPduCanId=277 if post-build-variant-condition{matching-criterion=RDR_POS, value=4}, CanIfRxPduCanId=789 if post-build-variant-condition{matching-criterion=RDR_POS, value=5}, CanIfRxPduCanId=1173 if post-build-variant-condition{matching-criterion=RDR_POS, value=6}, CanIfRxPduCanId=1045 if post-build-variant-condition{matching-criterion=RDR_POS, value=7}, CanIfRxPduHrhIdRef=CanIfInitHohCfg/CN_PCAN_RADAR_a729ccfc_Rx, CanIfRxPduRef=EcucPduCollection/RDR_FUSION_DET_085_088_oPCAN_RADAR_48d70a79_Rx
        RDR_FUSION_DET_089_092_oPCAN_RADAR_e6a95ef3_Rx: CanIfRxPduCanId=662 if post-build-variant-condition{matching-criterion=RDR_POS, value=0}, CanIfRxPduCanIdType=STANDARD_CAN, CanIfRxPduDlc=64, CanIfRxPduUserRxIndicationName=PduR_CanIfRxIndication, CanIfRxPduUserRxIndicationUL=PDUR, CanIfRxPduCanId=534 if post-build-variant-condition{matching-criterion=RDR_POS, value=1}, CanIfRxPduCanId=406 if post-build-variant-condition{matching-criterion=RDR_POS, value=2}, CanIfRxPduCanId=278 if post-build-variant-condition{matching-criterion=RDR_POS, value=3}, CanIfRxPduCanId=278 if post-build-variant-condition{matching-criterion=RDR_POS, value=4}, CanIfRxPduCanId=790 if post-build-variant-condition{matching-criterion=RDR_POS, value=5}, CanIfRxPduCanId=1174 if post-build-variant-condition{matching-criterion=RDR_POS, value=6}, CanIfRxPduCanId=1046 if post-build-variant-condition{matching-criterion=RDR_POS, value=7}, CanIfRxPduHrhIdRef=CanIfInitHohCfg/CN_PCAN_RADAR_a729ccfc_Rx, CanIfRxPduRef=EcucPduCollection/RDR_FUSION_DET_089_092_oPCAN_RADAR_dfa000b1_Rx
        RDR_FUSION_DET_093_096_oPCAN_RADAR_b11f6cd3_Rx: CanIfRxPduCanId=663 if post-build-variant-condition{matching-criterion=RDR_POS, value=0}, CanIfRxPduCanIdType=STANDARD_CAN, CanIfRxPduDlc=64, CanIfRxPduUserRxIndicationName=PduR_CanIfRxIndication, CanIfRxPduUserRxIndicationUL=PDUR, CanIfRxPduCanId=535 if post-build-variant-condition{matching-criterion=RDR_POS, value=1}, CanIfRxPduCanId=407 if post-build-variant-condition{matching-criterion=RDR_POS, value=2}, CanIfRxPduCanId=279 if post-build-variant-condition{matching-criterion=RDR_POS, value=3}, CanIfRxPduCanId=279 if post-build-variant-condition{matching-criterion=RDR_POS, value=4}, CanIfRxPduCanId=791 if post-build-variant-condition{matching-criterion=RDR_POS, value=5}, CanIfRxPduCanId=1175 if post-build-variant-condition{matching-criterion=RDR_POS, value=6}, CanIfRxPduCanId=1047 if post-build-variant-condition{matching-criterion=RDR_POS, value=7}, CanIfRxPduHrhIdRef=CanIfInitHohCfg/CN_PCAN_RADAR_a729ccfc_Rx, CanIfRxPduRef=EcucPduCollection/RDR_FUSION_DET_093_096_oPCAN_RADAR_8fd53b9e_Rx
        RDR_FUSION_DET_097_100_oPCAN_RADAR_b3504422_Rx: CanIfRxPduCanId=664 if post-build-variant-condition{matching-criterion=RDR_POS, value=0}, CanIfRxPduCanIdType=STANDARD_CAN, CanIfRxPduDlc=64, CanIfRxPduUserRxIndicationName=PduR_CanIfRxIndication, CanIfRxPduUserRxIndicationUL=PDUR, CanIfRxPduCanId=536 if post-build-variant-condition{matching-criterion=RDR_POS, value=1}, CanIfRxPduCanId=408 if post-build-variant-condition{matching-criterion=RDR_POS, value=2}, CanIfRxPduCanId=280 if post-build-variant-condition{matching-criterion=RDR_POS, value=3}, CanIfRxPduCanId=280 if post-build-variant-condition{matching-criterion=RDR_POS, value=4}, CanIfRxPduCanId=792 if post-build-variant-condition{matching-criterion=RDR_POS, value=5}, CanIfRxPduCanId=1176 if post-build-variant-condition{matching-criterion=RDR_POS, value=6}, CanIfRxPduCanId=1048 if post-build-variant-condition{matching-criterion=RDR_POS, value=7}, CanIfRxPduHrhIdRef=CanIfInitHohCfg/CN_PCAN_RADAR_a729ccfc_Rx, CanIfRxPduRef=EcucPduCollection/RDR_FUSION_DET_097_100_oPCAN_RADAR_43d6c604_Rx
        RDR_FUSION_DET_101_104_oPCAN_RADAR_fc437d4f_Rx: CanIfRxPduCanId=665 if post-build-variant-condition{matching-criterion=RDR_POS, value=0}, CanIfRxPduCanIdType=STANDARD_CAN, CanIfRxPduDlc=64, CanIfRxPduUserRxIndicationName=PduR_CanIfRxIndication, CanIfRxPduUserRxIndicationUL=PDUR, CanIfRxPduCanId=537 if post-build-variant-condition{matching-criterion=RDR_POS, value=1}, CanIfRxPduCanId=409 if post-build-variant-condition{matching-criterion=RDR_POS, value=2}, CanIfRxPduCanId=281 if post-build-variant-condition{matching-criterion=RDR_POS, value=3}, CanIfRxPduCanId=281 if post-build-variant-condition{matching-criterion=RDR_POS, value=4}, CanIfRxPduCanId=793 if post-build-variant-condition{matching-criterion=RDR_POS, value=5}, CanIfRxPduCanId=1177 if post-build-variant-condition{matching-criterion=RDR_POS, value=6}, CanIfRxPduCanId=1049 if post-build-variant-condition{matching-criterion=RDR_POS, value=7}, CanIfRxPduHrhIdRef=CanIfInitHohCfg/CN_PCAN_RADAR_a729ccfc_Rx, CanIfRxPduRef=EcucPduCollection/RDR_FUSION_DET_101_104_oPCAN_RADAR_58bef7d5_Rx
        RDR_FUSION_DET_105_108_oPCAN_RADAR_bc3a34d4_Rx: CanIfRxPduCanId=666 if post-build-variant-condition{matching-criterion=RDR_POS, value=0}, CanIfRxPduCanIdType=STANDARD_CAN, CanIfRxPduDlc=64, CanIfRxPduUserRxIndicationName=PduR_CanIfRxIndication, CanIfRxPduUserRxIndicationUL=PDUR, CanIfRxPduCanId=538 if post-build-variant-condition{matching-criterion=RDR_POS, value=1}, CanIfRxPduCanId=410 if post-build-variant-condition{matching-criterion=RDR_POS, value=2}, CanIfRxPduCanId=282 if post-build-variant-condition{matching-criterion=RDR_POS, value=3}, CanIfRxPduCanId=282 if post-build-variant-condition{matching-criterion=RDR_POS, value=4}, CanIfRxPduCanId=794 if post-build-variant-condition{matching-criterion=RDR_POS, value=5}, CanIfRxPduCanId=1178 if post-build-variant-condition{matching-criterion=RDR_POS, value=6}, CanIfRxPduCanId=1050 if post-build-variant-condition{matching-criterion=RDR_POS, value=7}, CanIfRxPduHrhIdRef=CanIfInitHohCfg/CN_PCAN_RADAR_a729ccfc_Rx, CanIfRxPduRef=EcucPduCollection/RDR_FUSION_DET_105_108_oPCAN_RADAR_81c2637f_Rx
        RDR_FUSION_DET_109_112_oPCAN_RADAR_b7f3dc72_Rx: CanIfRxPduCanId=667 if post-build-variant-condition{matching-criterion=RDR_POS, value=0}, CanIfRxPduCanIdType=STANDARD_CAN, CanIfRxPduDlc=64, CanIfRxPduUserRxIndicationName=PduR_CanIfRxIndication, CanIfRxPduUserRxIndicationUL=PDUR, CanIfRxPduCanId=539 if post-build-variant-condition{matching-criterion=RDR_POS, value=1}, CanIfRxPduCanId=411 if post-build-variant-condition{matching-criterion=RDR_POS, value=2}, CanIfRxPduCanId=283 if post-build-variant-condition{matching-criterion=RDR_POS, value=3}, CanIfRxPduCanId=283 if post-build-variant-condition{matching-criterion=RDR_POS, value=4}, CanIfRxPduCanId=795 if post-build-variant-condition{matching-criterion=RDR_POS, value=5}, CanIfRxPduCanId=1179 if post-build-variant-condition{matching-criterion=RDR_POS, value=6}, CanIfRxPduCanId=1051 if post-build-variant-condition{matching-criterion=RDR_POS, value=7}, CanIfRxPduHrhIdRef=CanIfInitHohCfg/CN_PCAN_RADAR_a729ccfc_Rx, CanIfRxPduRef=EcucPduCollection/RDR_FUSION_DET_109_112_oPCAN_RADAR_16b569b7_Rx
        RDR_FUSION_DET_113_116_oPCAN_RADAR_e045ee52_Rx: CanIfRxPduCanId=668 if post-build-variant-condition{matching-criterion=RDR_POS, value=0}, CanIfRxPduCanIdType=STANDARD_CAN, CanIfRxPduDlc=64, CanIfRxPduUserRxIndicationName=PduR_CanIfRxIndication, CanIfRxPduUserRxIndicationUL=PDUR, CanIfRxPduCanId=540 if post-build-variant-condition{matching-criterion=RDR_POS, value=1}, CanIfRxPduCanId=412 if post-build-variant-condition{matching-criterion=RDR_POS, value=2}, CanIfRxPduCanId=284 if post-build-variant-condition{matching-criterion=RDR_POS, value=3}, CanIfRxPduCanId=284 if post-build-variant-condition{matching-criterion=RDR_POS, value=4}, CanIfRxPduCanId=796 if post-build-variant-condition{matching-criterion=RDR_POS, value=5}, CanIfRxPduCanId=1180 if post-build-variant-condition{matching-criterion=RDR_POS, value=6}, CanIfRxPduCanId=1052 if post-build-variant-condition{matching-criterion=RDR_POS, value=7}, CanIfRxPduHrhIdRef=CanIfInitHohCfg/CN_PCAN_RADAR_a729ccfc_Rx, CanIfRxPduRef=EcucPduCollection/RDR_FUSION_DET_113_116_oPCAN_RADAR_46c05298_Rx
        RDR_FUSION_DET_117_120_oPCAN_RADAR_561fc83a_Rx: CanIfRxPduCanId=669 if post-build-variant-condition{matching-criterion=RDR_POS, value=0}, CanIfRxPduCanIdType=STANDARD_CAN, CanIfRxPduDlc=64, CanIfRxPduUserRxIndicationName=PduR_CanIfRxIndication, CanIfRxPduUserRxIndicationUL=PDUR, CanIfRxPduCanId=541 if post-build-variant-condition{matching-criterion=RDR_POS, value=1}, CanIfRxPduCanId=413 if post-build-variant-condition{matching-criterion=RDR_POS, value=2}, CanIfRxPduCanId=285 if post-build-variant-condition{matching-criterion=RDR_POS, value=3}, CanIfRxPduCanId=285 if post-build-variant-condition{matching-criterion=RDR_POS, value=4}, CanIfRxPduCanId=797 if post-build-variant-condition{matching-criterion=RDR_POS, value=5}, CanIfRxPduCanId=1181 if post-build-variant-condition{matching-criterion=RDR_POS, value=6}, CanIfRxPduCanId=1053 if post-build-variant-condition{matching-criterion=RDR_POS, value=7}, CanIfRxPduHrhIdRef=CanIfInitHohCfg/CN_PCAN_RADAR_a729ccfc_Rx, CanIfRxPduRef=EcucPduCollection/RDR_FUSION_DET_117_120_oPCAN_RADAR_f33a9557_Rx
        RDR_FUSION_DET_121_124_oPCAN_RADAR_2863e3f2_Rx: CanIfRxPduCanId=670 if post-build-variant-condition{matching-criterion=RDR_POS, value=0}, CanIfRxPduCanIdType=STANDARD_CAN, CanIfRxPduDlc=64, CanIfRxPduUserRxIndicationName=PduR_CanIfRxIndication, CanIfRxPduUserRxIndicationUL=PDUR, CanIfRxPduCanId=542 if post-build-variant-condition{matching-criterion=RDR_POS, value=1}, CanIfRxPduCanId=414 if post-build-variant-condition{matching-criterion=RDR_POS, value=2}, CanIfRxPduCanId=286 if post-build-variant-condition{matching-criterion=RDR_POS, value=3}, CanIfRxPduCanId=286 if post-build-variant-condition{matching-criterion=RDR_POS, value=4}, CanIfRxPduCanId=798 if post-build-variant-condition{matching-criterion=RDR_POS, value=5}, CanIfRxPduCanId=1182 if post-build-variant-condition{matching-criterion=RDR_POS, value=6}, CanIfRxPduCanId=1054 if post-build-variant-condition{matching-criterion=RDR_POS, value=7}, CanIfRxPduHrhIdRef=CanIfInitHohCfg/CN_PCAN_RADAR_a729ccfc_Rx, CanIfRxPduRef=EcucPduCollection/RDR_FUSION_DET_121_124_oPCAN_RADAR_d1daa83c_Rx
        RDR_FUSION_DET_125_128_oPCAN_RADAR_681aaa69_Rx: CanIfRxPduCanId=671 if post-build-variant-condition{matching-criterion=RDR_POS, value=0}, CanIfRxPduCanIdType=STANDARD_CAN, CanIfRxPduDlc=64, CanIfRxPduUserRxIndicationName=PduR_CanIfRxIndication, CanIfRxPduUserRxIndicationUL=PDUR, CanIfRxPduCanId=543 if post-build-variant-condition{matching-criterion=RDR_POS, value=1}, CanIfRxPduCanId=415 if post-build-variant-condition{matching-criterion=RDR_POS, value=2}, CanIfRxPduCanId=287 if post-build-variant-condition{matching-criterion=RDR_POS, value=3}, CanIfRxPduCanId=287 if post-build-variant-condition{matching-criterion=RDR_POS, value=4}, CanIfRxPduCanId=799 if post-build-variant-condition{matching-criterion=RDR_POS, value=5}, CanIfRxPduCanId=1183 if post-build-variant-condition{matching-criterion=RDR_POS, value=6}, CanIfRxPduCanId=1055 if post-build-variant-condition{matching-criterion=RDR_POS, value=7}, CanIfRxPduHrhIdRef=CanIfInitHohCfg/CN_PCAN_RADAR_a729ccfc_Rx, CanIfRxPduRef=EcucPduCollection/RDR_FUSION_DET_125_128_oPCAN_RADAR_08a63c96_Rx
        RDR_FUSION_HEADER_001_oPCAN_RADAR_9f0679aa_Rx: CanIfRxPduCanId=152 if post-build-variant-condition{matching-criterion=RDR_POS, value=0}, CanIfRxPduCanIdType=STANDARD_CAN, CanIfRxPduDlc=64, CanIfRxPduUserRxIndicationName=PduR_CanIfRxIndication, CanIfRxPduUserRxIndicationUL=PDUR, CanIfRxPduCanId=144 if post-build-variant-condition{matching-criterion=RDR_POS, value=1}, CanIfRxPduCanId=136 if post-build-variant-condition{matching-criterion=RDR_POS, value=2}, CanIfRxPduCanId=128 if post-build-variant-condition{matching-criterion=RDR_POS, value=3}, CanIfRxPduCanId=128 if post-build-variant-condition{matching-criterion=RDR_POS, value=4}, CanIfRxPduCanId=160 if post-build-variant-condition{matching-criterion=RDR_POS, value=5}, CanIfRxPduCanId=184 if post-build-variant-condition{matching-criterion=RDR_POS, value=6}, CanIfRxPduCanId=176 if post-build-variant-condition{matching-criterion=RDR_POS, value=7}, CanIfRxPduHrhIdRef=CanIfInitHohCfg/CN_PCAN_RADAR_a729ccfc_Rx, CanIfRxPduRef=EcucPduCollection/RDR_FUSION_HEADER_001_oPCAN_RADAR_204bf532_Rx
        RDR_FUSION_STATUS_001_oPCAN_RADAR_5a3f0fa3_Rx: CanIfRxPduCanId=155 if post-build-variant-condition{matching-criterion=RDR_POS, value=0}, CanIfRxPduCanIdType=STANDARD_CAN, CanIfRxPduDlc=64, CanIfRxPduUserRxIndicationName=PduR_CanIfRxIndication, CanIfRxPduUserRxIndicationUL=PDUR, CanIfRxPduCanId=147 if post-build-variant-condition{matching-criterion=RDR_POS, value=1}, CanIfRxPduCanId=139 if post-build-variant-condition{matching-criterion=RDR_POS, value=2}, CanIfRxPduCanId=131 if post-build-variant-condition{matching-criterion=RDR_POS, value=3}, CanIfRxPduCanId=131 if post-build-variant-condition{matching-criterion=RDR_POS, value=4}, CanIfRxPduCanId=163 if post-build-variant-condition{matching-criterion=RDR_POS, value=5}, CanIfRxPduCanId=187 if post-build-variant-condition{matching-criterion=RDR_POS, value=6}, CanIfRxPduCanId=179 if post-build-variant-condition{matching-criterion=RDR_POS, value=7}, CanIfRxPduHrhIdRef=CanIfInitHohCfg/CN_PCAN_RADAR_a729ccfc_Rx, CanIfRxPduRef=EcucPduCollection/RDR_FUSION_STATUS_001_oPCAN_RADAR_b6cfc045_Rx
        RDR_FUSION_STATUS_002_oPCAN_RADAR_32e3e17d_Rx: CanIfRxPduCanId=156 if post-build-variant-condition{matching-criterion=RDR_POS, value=0}, CanIfRxPduCanIdType=STANDARD_CAN, CanIfRxPduDlc=64, CanIfRxPduUserRxIndicationName=PduR_CanIfRxIndication, CanIfRxPduUserRxIndicationUL=PDUR, CanIfRxPduCanId=148 if post-build-variant-condition{matching-criterion=RDR_POS, value=1}, CanIfRxPduCanId=140 if post-build-variant-condition{matching-criterion=RDR_POS, value=2}, CanIfRxPduCanId=132 if post-build-variant-condition{matching-criterion=RDR_POS, value=3}, CanIfRxPduCanId=132 if post-build-variant-condition{matching-criterion=RDR_POS, value=4}, CanIfRxPduCanId=164 if post-build-variant-condition{matching-criterion=RDR_POS, value=5}, CanIfRxPduCanId=188 if post-build-variant-condition{matching-criterion=RDR_POS, value=6}, CanIfRxPduCanId=180 if post-build-variant-condition{matching-criterion=RDR_POS, value=7}, CanIfRxPduHrhIdRef=CanIfInitHohCfg/CN_PCAN_RADAR_a729ccfc_Rx, CanIfRxPduRef=EcucPduCollection/RDR_FUSION_STATUS_002_oPCAN_RADAR_edd87150_Rx
        RDR_XCP_CTO_REQ_oPCAN_RADAR_90586adf_Rx: CanIfRxPduCanId=16 if post-build-variant-condition{matching-criterion=RDR_POS, value=0}, CanIfRxPduCanIdType=STANDARD_CAN, CanIfRxPduDlc=64, CanIfRxPduUserRxIndicationName=PduR_CanIfRxIndication, CanIfRxPduUserRxIndicationUL=PDUR, CanIfRxPduCanId=24 if post-build-variant-condition{matching-criterion=RDR_POS, value=1}, CanIfRxPduCanId=32 if post-build-variant-condition{matching-criterion=RDR_POS, value=2}, CanIfRxPduCanId=40 if post-build-variant-condition{matching-criterion=RDR_POS, value=3}, CanIfRxPduCanId=48 if post-build-variant-condition{matching-criterion=RDR_POS, value=4}, CanIfRxPduCanId=56 if post-build-variant-condition{matching-criterion=RDR_POS, value=5}, CanIfRxPduCanId=64 if post-build-variant-condition{matching-criterion=RDR_POS, value=6}, CanIfRxPduCanId=72 if post-build-variant-condition{matching-criterion=RDR_POS, value=7}, CanIfRxPduHrhIdRef=CanIfInitHohCfg/CN_PCAN_RADAR_a729ccfc_Rx, CanIfRxPduRef=EcucPduCollection/RDR_XCP_CTO_REQ_oPCAN_RADAR_5b59bad2_Rx
        RDR_prop_ADAS_BSIS_info_oPCAN_RADAR_1b1aa0fc_Rx: CanIfRxPduCanId=419407025, CanIfRxPduCanIdType=EXTENDED_CAN, CanIfRxPduDlc=8, CanIfRxPduUserRxIndicationUL=CDD, CanIfRxPduHrhIdRef=CanIfInitHohCfg/CN_PCAN_RADAR_92639a04_Rx, CanIfRxPduRef=RDR_prop_ADAS_BSIS_info_oPCAN_RADAR_e19e3fbb_Rx
        SAS_oVCAN_RADAR_0befc4d7_Rx: CanIfRxPduCanId=418389476, CanIfRxPduCanIdMask=67108863, CanIfRxPduCanIdType=EXTENDED_CAN, CanIfRxPduDlc=8, CanIfRxPduUserRxIndicationName=PduR_CanIfRxIndication, CanIfRxPduUserRxIndicationUL=PDUR, CanIfRxPduHrhIdRef=CanIfInitHohCfg/CN_VCAN_RADAR_0fbf9117_Rx, CanIfRxPduRef=EcucPduCollection/SAS_oVCAN_RADAR_efd6af4d_Rx
        SR1_DIAG_REQ_PHY_OBD1_oVCAN_RADAR_d087a8f3_Rx: CanIfRxPduCanId=416985584, CanIfRxPduCanIdMask=67108863, CanIfRxPduCanIdType=EXTENDED_CAN, CanIfRxPduDlc=8, CanIfRxPduUserRxIndicationUL=CDD, CanIfRxPduHrhIdRef=CanIfInitHohCfg/CN_VCAN_RADAR_0fbf9117_Rx, CanIfRxPduRef=EcucPduCollection/SR1_DIAG_REQ_PHY_OBD1_oVCAN_RADAR_ff3ad7b0_Rx
        SR1_DIAG_REQ_PHY_OBD2_oVCAN_RADAR_b85b462d_Rx: CanIfRxPduCanId=416985585, CanIfRxPduCanIdMask=67108863, CanIfRxPduCanIdType=EXTENDED_CAN, CanIfRxPduDlc=8, CanIfRxPduUserRxIndicationUL=CDD, CanIfRxPduHrhIdRef=CanIfInitHohCfg/CN_VCAN_RADAR_0fbf9117_Rx, CanIfRxPduRef=EcucPduCollection/SR1_DIAG_REQ_PHY_OBD2_oVCAN_RADAR_a42d66a5_Rx
        SR1_DIAG_REQ_PHY_OTA_oVCAN_RADAR_2599cadf_Rx: CanIfRxPduCanId=416985588, CanIfRxPduCanIdMask=67108863, CanIfRxPduCanIdType=EXTENDED_CAN, CanIfRxPduDlc=8, CanIfRxPduUserRxIndicationUL=CDD, CanIfRxPduHrhIdRef=CanIfInitHohCfg/CN_VCAN_RADAR_0fbf9117_Rx, CanIfRxPduRef=EcucPduCollection/SR1_DIAG_REQ_PHY_OTA_oVCAN_RADAR_3fc015f5_Rx
        SR1_DIAG_REQ_PHY_PLANT_oVCAN_RADAR_5b5133c5_Rx: CanIfRxPduCanId=416985589, CanIfRxPduCanIdMask=67108863, CanIfRxPduCanIdType=EXTENDED_CAN, CanIfRxPduDlc=8, CanIfRxPduUserRxIndicationUL=CDD, CanIfRxPduHrhIdRef=CanIfInitHohCfg/CN_VCAN_RADAR_0fbf9117_Rx, CanIfRxPduRef=EcucPduCollection/SR1_DIAG_REQ_PHY_PLANT_oVCAN_RADAR_14d98d55_Rx
        SR2_DIAG_REQ_PHY_OBD1_oVCAN_RADAR_c5936bcf_Rx: CanIfRxPduCanId=416985328, CanIfRxPduCanIdMask=67108863, CanIfRxPduCanIdType=EXTENDED_CAN, CanIfRxPduDlc=8, CanIfRxPduUserRxIndicationUL=CDD, CanIfRxPduHrhIdRef=CanIfInitHohCfg/CN_VCAN_RADAR_0fbf9117_Rx, CanIfRxPduRef=EcucPduCollection/SR2_DIAG_REQ_PHY_OBD1_oVCAN_RADAR_7a08c544_Rx
        SR2_DIAG_REQ_PHY_OBD2_oVCAN_RADAR_ad4f8511_Rx: CanIfRxPduCanId=416985329, CanIfRxPduCanIdMask=67108863, CanIfRxPduCanIdType=EXTENDED_CAN, CanIfRxPduDlc=8, CanIfRxPduUserRxIndicationUL=CDD, CanIfRxPduHrhIdRef=CanIfInitHohCfg/CN_VCAN_RADAR_0fbf9117_Rx, CanIfRxPduRef=EcucPduCollection/SR2_DIAG_REQ_PHY_OBD2_oVCAN_RADAR_211f7451_Rx
        SR2_DIAG_REQ_PHY_OTA_oVCAN_RADAR_13148e4e_Rx: CanIfRxPduCanId=416985332, CanIfRxPduCanIdMask=67108863, CanIfRxPduCanIdType=EXTENDED_CAN, CanIfRxPduDlc=8, CanIfRxPduUserRxIndicationUL=CDD, CanIfRxPduHrhIdRef=CanIfInitHohCfg/CN_VCAN_RADAR_0fbf9117_Rx, CanIfRxPduRef=EcucPduCollection/SR2_DIAG_REQ_PHY_OTA_oVCAN_RADAR_68e239a7_Rx
        SR2_DIAG_REQ_PHY_PLANT_oVCAN_RADAR_fe78030d_Rx: CanIfRxPduCanId=416985333, CanIfRxPduCanIdMask=67108863, CanIfRxPduCanIdType=EXTENDED_CAN, CanIfRxPduDlc=8, CanIfRxPduUserRxIndicationUL=CDD, CanIfRxPduHrhIdRef=CanIfInitHohCfg/CN_VCAN_RADAR_0fbf9117_Rx, CanIfRxPduRef=EcucPduCollection/SR2_DIAG_REQ_PHY_PLANT_oVCAN_RADAR_ae8c8942_Rx
        SRR_FL_DIAG_RESP_PHYS_OBD1_Rx_oPCAN_RADAR_09ba8005_Rx: CanIfRxPduCanId=417001649, CanIfRxPduCanIdType=STANDARD_CAN, CanIfRxPduDlc=64, CanIfRxPduUserRxIndicationUL=CDD, CanIfRxPduHrhIdRef=CanIfInitHohCfg/CN_PCAN_RADAR_a729ccfc_Rx, CanIfRxPduRef=SRR_FL_DIAG_RESP_PHYS_OBD1_Rx_oPCAN_RADAR_1a7b5ebf_Rx
        SRR_FL_DIAG_RESP_PHYS_OBD2_Rx_oPCAN_RADAR_e9ae0a47_Rx: CanIfRxPduCanId=417001905, CanIfRxPduCanIdType=STANDARD_CAN if post-build-variant-condition{matching-criterion=RDR_POS, value=0}, CanIfRxPduDlc=64, CanIfRxPduUserRxIndicationUL=CDD, CanIfRxPduCanIdType=EXTENDED_CAN if post-build-variant-condition{matching-criterion=RDR_POS, value=1}, CanIfRxPduCanIdType=EXTENDED_CAN if post-build-variant-condition{matching-criterion=RDR_POS, value=2}, CanIfRxPduCanIdType=EXTENDED_CAN if post-build-variant-condition{matching-criterion=RDR_POS, value=3}, CanIfRxPduCanIdType=EXTENDED_CAN if post-build-variant-condition{matching-criterion=RDR_POS, value=4}, CanIfRxPduCanIdType=EXTENDED_CAN if post-build-variant-condition{matching-criterion=RDR_POS, value=5}, CanIfRxPduCanIdType=EXTENDED_CAN if post-build-variant-condition{matching-criterion=RDR_POS, value=6}, CanIfRxPduCanIdType=EXTENDED_CAN if post-build-variant-condition{matching-criterion=RDR_POS, value=7}, CanIfRxPduHrhIdRef=CanIfInitHohCfg/CN_PCAN_RADAR_a729ccfc_Rx if post-build-variant-condition{matching-criterion=RDR_POS, value=0}, CanIfRxPduRef=SRR_FL_DIAG_RESP_PHYS_OBD2_Rx_oPCAN_RADAR_7e9b2541_Rx, CanIfRxPduHrhIdRef=CanIfInitHohCfg/CN_PCAN_RADAR_92639a04_Rx if post-build-variant-condition{matching-criterion=RDR_POS, value=1}, CanIfRxPduHrhIdRef=CanIfInitHohCfg/CN_PCAN_RADAR_92639a04_Rx if post-build-variant-condition{matching-criterion=RDR_POS, value=2}, CanIfRxPduHrhIdRef=CanIfInitHohCfg/CN_PCAN_RADAR_92639a04_Rx if post-build-variant-condition{matching-criterion=RDR_POS, value=3}, CanIfRxPduHrhIdRef=CanIfInitHohCfg/CN_PCAN_RADAR_92639a04_Rx if post-build-variant-condition{matching-criterion=RDR_POS, value=4}, CanIfRxPduHrhIdRef=CanIfInitHohCfg/CN_PCAN_RADAR_92639a04_Rx if post-build-variant-condition{matching-criterion=RDR_POS, value=5}, CanIfRxPduHrhIdRef=CanIfInitHohCfg/CN_PCAN_RADAR_92639a04_Rx if post-build-variant-condition{matching-criterion=RDR_POS, value=6}, CanIfRxPduHrhIdRef=CanIfInitHohCfg/CN_PCAN_RADAR_92639a04_Rx if post-build-variant-condition{matching-criterion=RDR_POS, value=7}
        SRR_FL_DIAG_RESP_PHYS_OTA_Rx_oPCAN_RADAR_f82256d0_Rx: CanIfRxPduCanId=417002673, CanIfRxPduCanIdType=STANDARD_CAN if post-build-variant-condition{matching-criterion=RDR_POS, value=0}, CanIfRxPduDlc=64, CanIfRxPduUserRxIndicationUL=CDD, CanIfRxPduCanIdType=EXTENDED_CAN if post-build-variant-condition{matching-criterion=RDR_POS, value=1}, CanIfRxPduCanIdType=EXTENDED_CAN if post-build-variant-condition{matching-criterion=RDR_POS, value=2}, CanIfRxPduCanIdType=EXTENDED_CAN if post-build-variant-condition{matching-criterion=RDR_POS, value=3}, CanIfRxPduCanIdType=EXTENDED_CAN if post-build-variant-condition{matching-criterion=RDR_POS, value=4}, CanIfRxPduCanIdType=EXTENDED_CAN if post-build-variant-condition{matching-criterion=RDR_POS, value=5}, CanIfRxPduCanIdType=EXTENDED_CAN if post-build-variant-condition{matching-criterion=RDR_POS, value=6}, CanIfRxPduCanIdType=EXTENDED_CAN if post-build-variant-condition{matching-criterion=RDR_POS, value=7}, CanIfRxPduHrhIdRef=CanIfInitHohCfg/CN_PCAN_RADAR_a729ccfc_Rx if post-build-variant-condition{matching-criterion=RDR_POS, value=0}, CanIfRxPduRef=SRR_FL_DIAG_RESP_PHYS_OTA_Rx_oPCAN_RADAR_9fd7f3d9_Rx, CanIfRxPduHrhIdRef=CanIfInitHohCfg/CN_PCAN_RADAR_92639a04_Rx if post-build-variant-condition{matching-criterion=RDR_POS, value=1}, CanIfRxPduHrhIdRef=CanIfInitHohCfg/CN_PCAN_RADAR_92639a04_Rx if post-build-variant-condition{matching-criterion=RDR_POS, value=2}, CanIfRxPduHrhIdRef=CanIfInitHohCfg/CN_PCAN_RADAR_92639a04_Rx if post-build-variant-condition{matching-criterion=RDR_POS, value=3}, CanIfRxPduHrhIdRef=CanIfInitHohCfg/CN_PCAN_RADAR_92639a04_Rx if post-build-variant-condition{matching-criterion=RDR_POS, value=4}, CanIfRxPduHrhIdRef=CanIfInitHohCfg/CN_PCAN_RADAR_92639a04_Rx if post-build-variant-condition{matching-criterion=RDR_POS, value=5}, CanIfRxPduHrhIdRef=CanIfInitHohCfg/CN_PCAN_RADAR_92639a04_Rx if post-build-variant-condition{matching-criterion=RDR_POS, value=6}, CanIfRxPduHrhIdRef=CanIfInitHohCfg/CN_PCAN_RADAR_92639a04_Rx if post-build-variant-condition{matching-criterion=RDR_POS, value=7}
        SRR_FL_DIAG_RESP_PHYS_PLANT_Rx_oPCAN_RADAR_3f679b05_Rx: CanIfRxPduCanId=417002929, CanIfRxPduCanIdType=STANDARD_CAN if post-build-variant-condition{matching-criterion=RDR_POS, value=0}, CanIfRxPduDlc=64, CanIfRxPduUserRxIndicationUL=CDD, CanIfRxPduCanIdType=EXTENDED_CAN if post-build-variant-condition{matching-criterion=RDR_POS, value=1}, CanIfRxPduCanIdType=EXTENDED_CAN if post-build-variant-condition{matching-criterion=RDR_POS, value=2}, CanIfRxPduCanIdType=EXTENDED_CAN if post-build-variant-condition{matching-criterion=RDR_POS, value=3}, CanIfRxPduCanIdType=EXTENDED_CAN if post-build-variant-condition{matching-criterion=RDR_POS, value=4}, CanIfRxPduCanIdType=EXTENDED_CAN if post-build-variant-condition{matching-criterion=RDR_POS, value=5}, CanIfRxPduCanIdType=EXTENDED_CAN if post-build-variant-condition{matching-criterion=RDR_POS, value=6}, CanIfRxPduCanIdType=EXTENDED_CAN if post-build-variant-condition{matching-criterion=RDR_POS, value=7}, CanIfRxPduHrhIdRef=CanIfInitHohCfg/CN_PCAN_RADAR_a729ccfc_Rx if post-build-variant-condition{matching-criterion=RDR_POS, value=0}, CanIfRxPduRef=SRR_FL_DIAG_RESP_PHYS_PLANT_Rx_oPCAN_RADAR_23870365_Rx, CanIfRxPduHrhIdRef=CanIfInitHohCfg/CN_PCAN_RADAR_92639a04_Rx if post-build-variant-condition{matching-criterion=RDR_POS, value=1}, CanIfRxPduHrhIdRef=CanIfInitHohCfg/CN_PCAN_RADAR_92639a04_Rx if post-build-variant-condition{matching-criterion=RDR_POS, value=2}, CanIfRxPduHrhIdRef=CanIfInitHohCfg/CN_PCAN_RADAR_92639a04_Rx if post-build-variant-condition{matching-criterion=RDR_POS, value=3}, CanIfRxPduHrhIdRef=CanIfInitHohCfg/CN_PCAN_RADAR_92639a04_Rx if post-build-variant-condition{matching-criterion=RDR_POS, value=4}, CanIfRxPduHrhIdRef=CanIfInitHohCfg/CN_PCAN_RADAR_92639a04_Rx if post-build-variant-condition{matching-criterion=RDR_POS, value=5}, CanIfRxPduHrhIdRef=CanIfInitHohCfg/CN_PCAN_RADAR_92639a04_Rx if post-build-variant-condition{matching-criterion=RDR_POS, value=6}, CanIfRxPduHrhIdRef=CanIfInitHohCfg/CN_PCAN_RADAR_92639a04_Rx if post-build-variant-condition{matching-criterion=RDR_POS, value=7}
        SRR_RL_DIAG_RESP_PHYS_OBD1_Rx_oPCAN_RADAR_387ce8e4_Rx: CanIfRxPduCanId=417001648, CanIfRxPduCanIdType=STANDARD_CAN, CanIfRxPduDlc=64, CanIfRxPduUserRxIndicationUL=CDD, CanIfRxPduHrhIdRef=CanIfInitHohCfg/CN_PCAN_RADAR_a729ccfc_Rx, CanIfRxPduRef=SRR_RL_DIAG_RESP_PHYS_OBD1_Rx_oPCAN_RADAR_290c372e_Rx
        SRR_RL_DIAG_RESP_PHYS_OBD2_Rx_oPCAN_RADAR_d86862a6_Rx: CanIfRxPduCanId=417001904, CanIfRxPduCanIdType=EXTENDED_CAN if post-build-variant-condition{matching-criterion=RDR_POS, value=0}, CanIfRxPduDlc=64, CanIfRxPduUserRxIndicationUL=CDD, CanIfRxPduCanIdType=STANDARD_CAN if post-build-variant-condition{matching-criterion=RDR_POS, value=1}, CanIfRxPduCanIdType=STANDARD_CAN if post-build-variant-condition{matching-criterion=RDR_POS, value=2}, CanIfRxPduCanIdType=STANDARD_CAN if post-build-variant-condition{matching-criterion=RDR_POS, value=3}, CanIfRxPduCanIdType=STANDARD_CAN if post-build-variant-condition{matching-criterion=RDR_POS, value=4}, CanIfRxPduCanIdType=STANDARD_CAN if post-build-variant-condition{matching-criterion=RDR_POS, value=5}, CanIfRxPduCanIdType=STANDARD_CAN if post-build-variant-condition{matching-criterion=RDR_POS, value=6}, CanIfRxPduCanIdType=STANDARD_CAN if post-build-variant-condition{matching-criterion=RDR_POS, value=7}, CanIfRxPduHrhIdRef=CanIfInitHohCfg/CN_PCAN_RADAR_92639a04_Rx if post-build-variant-condition{matching-criterion=RDR_POS, value=0}, CanIfRxPduRef=SRR_RL_DIAG_RESP_PHYS_OBD2_Rx_oPCAN_RADAR_4dec4cd0_Rx, CanIfRxPduHrhIdRef=CanIfInitHohCfg/CN_PCAN_RADAR_a729ccfc_Rx if post-build-variant-condition{matching-criterion=RDR_POS, value=1}, CanIfRxPduHrhIdRef=CanIfInitHohCfg/CN_PCAN_RADAR_a729ccfc_Rx if post-build-variant-condition{matching-criterion=RDR_POS, value=2}, CanIfRxPduHrhIdRef=CanIfInitHohCfg/CN_PCAN_RADAR_a729ccfc_Rx if post-build-variant-condition{matching-criterion=RDR_POS, value=3}, CanIfRxPduHrhIdRef=CanIfInitHohCfg/CN_PCAN_RADAR_a729ccfc_Rx if post-build-variant-condition{matching-criterion=RDR_POS, value=4}, CanIfRxPduHrhIdRef=CanIfInitHohCfg/CN_PCAN_RADAR_a729ccfc_Rx if post-build-variant-condition{matching-criterion=RDR_POS, value=5}, CanIfRxPduHrhIdRef=CanIfInitHohCfg/CN_PCAN_RADAR_a729ccfc_Rx if post-build-variant-condition{matching-criterion=RDR_POS, value=6}, CanIfRxPduHrhIdRef=CanIfInitHohCfg/CN_PCAN_RADAR_a729ccfc_Rx if post-build-variant-condition{matching-criterion=RDR_POS, value=7}
        SRR_RL_DIAG_RESP_PHYS_OTA_Rx_oPCAN_RADAR_6eb06bc0_Rx: CanIfRxPduCanId=417002672, CanIfRxPduCanIdType=EXTENDED_CAN if post-build-variant-condition{matching-criterion=RDR_POS, value=0}, CanIfRxPduDlc=64, CanIfRxPduUserRxIndicationUL=CDD, CanIfRxPduCanIdType=STANDARD_CAN if post-build-variant-condition{matching-criterion=RDR_POS, value=1}, CanIfRxPduCanIdType=STANDARD_CAN if post-build-variant-condition{matching-criterion=RDR_POS, value=2}, CanIfRxPduCanIdType=STANDARD_CAN if post-build-variant-condition{matching-criterion=RDR_POS, value=3}, CanIfRxPduCanIdType=STANDARD_CAN if post-build-variant-condition{matching-criterion=RDR_POS, value=4}, CanIfRxPduCanIdType=STANDARD_CAN if post-build-variant-condition{matching-criterion=RDR_POS, value=5}, CanIfRxPduCanIdType=STANDARD_CAN if post-build-variant-condition{matching-criterion=RDR_POS, value=6}, CanIfRxPduCanIdType=STANDARD_CAN if post-build-variant-condition{matching-criterion=RDR_POS, value=7}, CanIfRxPduHrhIdRef=CanIfInitHohCfg/CN_PCAN_RADAR_92639a04_Rx if post-build-variant-condition{matching-criterion=RDR_POS, value=0}, CanIfRxPduRef=SRR_RL_DIAG_RESP_PHYS_OTA_Rx_oPCAN_RADAR_eba387b4_Rx, CanIfRxPduHrhIdRef=CanIfInitHohCfg/CN_PCAN_RADAR_a729ccfc_Rx if post-build-variant-condition{matching-criterion=RDR_POS, value=1}, CanIfRxPduHrhIdRef=CanIfInitHohCfg/CN_PCAN_RADAR_a729ccfc_Rx if post-build-variant-condition{matching-criterion=RDR_POS, value=2}, CanIfRxPduHrhIdRef=CanIfInitHohCfg/CN_PCAN_RADAR_a729ccfc_Rx if post-build-variant-condition{matching-criterion=RDR_POS, value=3}, CanIfRxPduHrhIdRef=CanIfInitHohCfg/CN_PCAN_RADAR_a729ccfc_Rx if post-build-variant-condition{matching-criterion=RDR_POS, value=4}, CanIfRxPduHrhIdRef=CanIfInitHohCfg/CN_PCAN_RADAR_a729ccfc_Rx if post-build-variant-condition{matching-criterion=RDR_POS, value=5}, CanIfRxPduHrhIdRef=CanIfInitHohCfg/CN_PCAN_RADAR_a729ccfc_Rx if post-build-variant-condition{matching-criterion=RDR_POS, value=6}, CanIfRxPduHrhIdRef=CanIfInitHohCfg/CN_PCAN_RADAR_a729ccfc_Rx if post-build-variant-condition{matching-criterion=RDR_POS, value=7}
        SRR_RL_DIAG_RESP_PHYS_PLANT_Rx_oPCAN_RADAR_84988cb2_Rx: CanIfRxPduCanId=417002928, CanIfRxPduCanIdType=EXTENDED_CAN if post-build-variant-condition{matching-criterion=RDR_POS, value=0}, CanIfRxPduDlc=64, CanIfRxPduUserRxIndicationUL=CDD, CanIfRxPduCanIdType=STANDARD_CAN if post-build-variant-condition{matching-criterion=RDR_POS, value=1}, CanIfRxPduCanIdType=STANDARD_CAN if post-build-variant-condition{matching-criterion=RDR_POS, value=2}, CanIfRxPduCanIdType=STANDARD_CAN if post-build-variant-condition{matching-criterion=RDR_POS, value=3}, CanIfRxPduCanIdType=STANDARD_CAN if post-build-variant-condition{matching-criterion=RDR_POS, value=4}, CanIfRxPduCanIdType=STANDARD_CAN if post-build-variant-condition{matching-criterion=RDR_POS, value=5}, CanIfRxPduCanIdType=STANDARD_CAN if post-build-variant-condition{matching-criterion=RDR_POS, value=6}, CanIfRxPduCanIdType=STANDARD_CAN if post-build-variant-condition{matching-criterion=RDR_POS, value=7}, CanIfRxPduHrhIdRef=CanIfInitHohCfg/CN_PCAN_RADAR_92639a04_Rx if post-build-variant-condition{matching-criterion=RDR_POS, value=0}, CanIfRxPduRef=SRR_RL_DIAG_RESP_PHYS_PLANT_Rx_oPCAN_RADAR_a4bcd7de_Rx, CanIfRxPduHrhIdRef=CanIfInitHohCfg/CN_PCAN_RADAR_a729ccfc_Rx if post-build-variant-condition{matching-criterion=RDR_POS, value=1}, CanIfRxPduHrhIdRef=CanIfInitHohCfg/CN_PCAN_RADAR_a729ccfc_Rx if post-build-variant-condition{matching-criterion=RDR_POS, value=2}, CanIfRxPduHrhIdRef=CanIfInitHohCfg/CN_PCAN_RADAR_a729ccfc_Rx if post-build-variant-condition{matching-criterion=RDR_POS, value=3}, CanIfRxPduHrhIdRef=CanIfInitHohCfg/CN_PCAN_RADAR_a729ccfc_Rx if post-build-variant-condition{matching-criterion=RDR_POS, value=4}, CanIfRxPduHrhIdRef=CanIfInitHohCfg/CN_PCAN_RADAR_a729ccfc_Rx if post-build-variant-condition{matching-criterion=RDR_POS, value=5}, CanIfRxPduHrhIdRef=CanIfInitHohCfg/CN_PCAN_RADAR_a729ccfc_Rx if post-build-variant-condition{matching-criterion=RDR_POS, value=6}, CanIfRxPduHrhIdRef=CanIfInitHohCfg/CN_PCAN_RADAR_a729ccfc_Rx if post-build-variant-condition{matching-criterion=RDR_POS, value=7}
        SYS_NM_oPCAN_RADAR_94e546a6_Rx: CanIfRxPduCanId=1280, CanIfRxPduCanIdType=STANDARD_CAN, CanIfRxPduDlc=64, CanIfRxPduUserRxIndicationName=CanNm_RxIndication, CanIfRxPduUserRxIndicationUL=CAN_NM, CanIfRxPduHrhIdRef=CanIfInitHohCfg/CN_PCAN_RADAR_a729ccfc_Rx, CanIfRxPduRef=SYS_NM_oPCAN_RADAR_697d71d8_Rx
        SYS_TIME_SYNC_oPCAN_RADAR_231d6bb9_Rx: CanIfRxPduCanId=1, CanIfRxPduCanIdType=STANDARD_CAN, CanIfRxPduDlc=8, CanIfRxPduUserRxIndicationName=PduR_CanIfRxIndication, CanIfRxPduUserRxIndicationUL=PDUR, CanIfRxPduHrhIdRef=CanIfInitHohCfg/CN_PCAN_RADAR_a729ccfc_Rx, CanIfRxPduRef=EcucPduCollection/SYS_TIME_SYNC_oPCAN_RADAR_ba7b9b28_Rx, variation-point=post-build-variant-condition{matching-criterion=RDR_POS, value=0}
        SYS_VEHICLE_STATUS_oPCAN_RADAR_877cfaa4_Rx: CanIfRxPduCanId=2, CanIfRxPduCanIdType=STANDARD_CAN, CanIfRxPduDlc=64, CanIfRxPduUserRxIndicationName=PduR_CanIfRxIndication, CanIfRxPduUserRxIndicationUL=PDUR, CanIfRxPduHrhIdRef=CanIfInitHohCfg/CN_PCAN_RADAR_a729ccfc_Rx, CanIfRxPduRef=EcucPduCollection/SYS_VEHICLE_STATUS_oPCAN_RADAR_9bbcdf4b_Rx
        TD_oVCAN_RADAR_e2a191e5_Rx: CanIfRxPduCanId=419358231, CanIfRxPduCanIdMask=67108863, CanIfRxPduCanIdType=EXTENDED_CAN, CanIfRxPduDlc=8, CanIfRxPduUserRxIndicationName=PduR_CanIfRxIndication, CanIfRxPduUserRxIndicationUL=PDUR, CanIfRxPduHrhIdRef=CanIfInitHohCfg/CN_VCAN_RADAR_0fbf9117_Rx, CanIfRxPduRef=EcucPduCollection/TD_oVCAN_RADAR_7fe49199_Rx
        VDC2_oVCAN_RADAR_2417bb2a_Rx: CanIfRxPduCanId=418384139, CanIfRxPduCanIdMask=67108863, CanIfRxPduCanIdType=EXTENDED_CAN, CanIfRxPduDlc=8, CanIfRxPduUserRxIndicationName=PduR_CanIfRxIndication, CanIfRxPduUserRxIndicationUL=PDUR, CanIfRxPduHrhIdRef=CanIfInitHohCfg/CN_VCAN_RADAR_0fbf9117_Rx, CanIfRxPduRef=EcucPduCollection/VDC2_oVCAN_RADAR_9b73b1bc_Rx
        VD_oVCAN_RADAR_4ccaa5be_Rx: CanIfRxPduCanId=419356672, CanIfRxPduCanIdMask=67108863, CanIfRxPduCanIdType=EXTENDED_CAN, CanIfRxPduDlc=8, CanIfRxPduUserRxIndicationName=PduR_CanIfRxIndication, CanIfRxPduUserRxIndicationUL=PDUR, CanIfRxPduHrhIdRef=CanIfInitHohCfg/CN_VCAN_RADAR_0fbf9117_Rx, CanIfRxPduRef=EcucPduCollection/VD_oVCAN_RADAR_36e033f5_Rx
        VI_oVCAN_RADAR_3ac3c5b8_Rx: CanIfRxPduCanId=419359781, CanIfRxPduCanIdMask=67108863, CanIfRxPduCanIdType=EXTENDED_CAN, CanIfRxPduDlc=8, CanIfRxPduUserRxIndicationName=PduR_CanIfRxIndication, CanIfRxPduUserRxIndicationUL=PDUR, CanIfRxPduHrhIdRef=CanIfInitHohCfg/CN_VCAN_RADAR_0fbf9117_Rx, CanIfRxPduRef=EcucPduCollection/VI_oVCAN_RADAR_b73d6113_Rx
      238 x CanIfTxPduCfg:
        BSD1_oVCAN_RADAR_64acbe01_Tx: CanIfTxPduCanId=217188016, CanIfTxPduCanIdType=EXTENDED_CAN, CanIfTxPduDlc=8, CanIfTxPduUserTxConfirmationUL=CDD, CanIfTxPduBufferRef=CanIfInitCfg/CHNL_0829f689, CanIfTxPduRef=EcucPduCollection/BSD1_oVCAN_RADAR_aa49a410_Tx
        DM1_B0_oVCAN_RADAR_8817cb52_Tx: CanIfTxPduCanId=419351216, CanIfTxPduCanIdType=EXTENDED_CAN, CanIfTxPduDlc=8, CanIfTxPduBufferRef=CanIfInitCfg/CHNL_0829f689, CanIfTxPduRef=EcucPduCollection/DM1_B0_oVCAN_RADAR_15753e9e_Tx
        DM1_B1_oVCAN_RADAR_c2a11718_Tx: CanIfTxPduCanId=419351217, CanIfTxPduCanIdType=EXTENDED_CAN, CanIfTxPduDlc=8, CanIfTxPduBufferRef=CanIfInitCfg/CHNL_0829f689, CanIfTxPduRef=EcucPduCollection/DM1_B1_oVCAN_RADAR_2387ae6d_Tx
        FR_DIAG_RES_PHY_OBD1_Tp_oVCAN_RADAR_fddad3af_Tx: CanIfTxPduCanId=417001680, CanIfTxPduCanIdType=EXTENDED_CAN, CanIfTxPduDlc=8, CanIfTxPduUserTxConfirmationName=CanTp_TxConfirmation, CanIfTxPduUserTxConfirmationUL=CAN_TP, CanIfTxPduBufferRef=CanIfInitCfg/CHNL_0829f689, CanIfTxPduRef=FR_DIAG_RES_PHY_OBD1_Tp_oVCAN_RADAR_41a76716_Tx
        FR_DIAG_RES_PHY_OBD2_Tp_oVCAN_RADAR_3e9c737e_Tx: CanIfTxPduCanId=417001936, CanIfTxPduCanIdType=EXTENDED_CAN, CanIfTxPduDlc=8, CanIfTxPduUserTxConfirmationName=CanTp_TxConfirmation, CanIfTxPduUserTxConfirmationUL=CAN_TP, CanIfTxPduBufferRef=CanIfInitCfg/CHNL_0829f689, CanIfTxPduRef=FR_DIAG_RES_PHY_OBD2_Tp_oVCAN_RADAR_25471ce8_Tx
        FR_DIAG_RES_PHY_OTA_Tp_oVCAN_RADAR_0ba1e84f_Tx: CanIfTxPduCanId=417002704, CanIfTxPduCanIdType=EXTENDED_CAN, CanIfTxPduDlc=8, CanIfTxPduUserTxConfirmationName=CanTp_TxConfirmation, CanIfTxPduUserTxConfirmationUL=CAN_TP, CanIfTxPduBufferRef=CanIfInitCfg/CHNL_0829f689, CanIfTxPduRef=FR_DIAG_RES_PHY_OTA_Tp_oVCAN_RADAR_19b4e511_Tx
        FR_DIAG_RES_PHY_PLANT_Tp_oVCAN_RADAR_d5d0b00c_Tx: CanIfTxPduCanId=417002960, CanIfTxPduCanIdType=EXTENDED_CAN, CanIfTxPduDlc=8, CanIfTxPduUserTxConfirmationName=CanTp_TxConfirmation, CanIfTxPduUserTxConfirmationUL=CAN_TP, CanIfTxPduBufferRef=CanIfInitCfg/CHNL_0829f689, CanIfTxPduRef=FR_DIAG_RES_PHY_PLANT_Tp_oVCAN_RADAR_4233d42d_Tx
        GW_ADAS_FN_Enable_disable_sts_Tx_oPCAN_RADAR_b3ed1cbc_Tx: CanIfTxPduCanId=218073112, CanIfTxPduCanIdType=STANDARD_FD_CAN, CanIfTxPduDlc=8, CanIfTxPduUserTxConfirmationUL=CDD, CanIfTxPduBufferRef=CanIfInitCfg/CHNL_2ad3227b, CanIfTxPduRef=GW_ADAS_FN_Enable_disable_sts_Tx_oPCAN_RADAR_27a639a3_Tx
        GW_CCVS1_Tx_oPCAN_RADAR_de02a585_Tx: CanIfTxPduCanId=419361025, CanIfTxPduCanIdType=STANDARD_FD_CAN, CanIfTxPduDlc=8, CanIfTxPduUserTxConfirmationUL=CDD, CanIfTxPduBufferRef=CanIfInitCfg/CHNL_2ad3227b, CanIfTxPduRef=GW_CCVS1_Tx_oPCAN_RADAR_7eaa671a_Tx
        GW_CLS_Tx_16_Tx_oPCAN_RADAR_9dad2921_Tx: CanIfTxPduCanId=419365144, CanIfTxPduCanIdType=STANDARD_FD_CAN, CanIfTxPduDlc=8, CanIfTxPduUserTxConfirmationUL=CDD, CanIfTxPduBufferRef=CanIfInitCfg/CHNL_2ad3227b, CanIfTxPduRef=GW_CLS_Tx_16_Tx_oPCAN_RADAR_b30c42cc_Tx
        GW_CLS_Tx_4_Tx_oPCAN_RADAR_33bc88fd_Tx: CanIfTxPduCanId=419385368, CanIfTxPduCanIdType=STANDARD_FD_CAN, CanIfTxPduDlc=8, CanIfTxPduUserTxConfirmationUL=CDD, CanIfTxPduBufferRef=CanIfInitCfg/CHNL_2ad3227b, CanIfTxPduRef=GW_CLS_Tx_4_Tx_oPCAN_RADAR_ecf0186d_Tx
        GW_DIAG_REQ_FUNC_OBD1_Tx_oPCAN_RADAR_a79e59ca_Tx: CanIfTxPduCanId=417050864, CanIfTxPduCanIdType=STANDARD_FD_CAN, CanIfTxPduDlc=64, CanIfTxPduUserTxConfirmationUL=CDD, CanIfTxPduBufferRef=CanIfInitCfg/CHNL_2ad3227b, CanIfTxPduRef=GW_DIAG_REQ_FUNC_OBD1_Tx_oPCAN_RADAR_922af4be_Tx
        GW_DIAG_REQ_FUNC_OBD2_Tx_oPCAN_RADAR_115574e1_Tx: CanIfTxPduCanId=417050865, CanIfTxPduCanIdType=STANDARD_FD_CAN, CanIfTxPduDlc=64, CanIfTxPduUserTxConfirmationUL=CDD, CanIfTxPduBufferRef=CanIfInitCfg/CHNL_2ad3227b, CanIfTxPduRef=GW_DIAG_REQ_FUNC_OBD2_Tx_oPCAN_RADAR_f6ca8f40_Tx
        GW_DIAG_REQ_FUNC_OTA_Tx_oPCAN_RADAR_b41207c2_Tx: CanIfTxPduCanId=417050868, CanIfTxPduCanIdType=STANDARD_FD_CAN, CanIfTxPduDlc=64, CanIfTxPduUserTxConfirmationUL=CDD, CanIfTxPduBufferRef=CanIfInitCfg/CHNL_2ad3227b, CanIfTxPduRef=GW_DIAG_REQ_FUNC_OTA_Tx_oPCAN_RADAR_ab05909f_Tx
        GW_DIAG_REQ_FUNC_PLANT_Tx_oPCAN_RADAR_2bc8ea30_Tx: CanIfTxPduCanId=417050869, CanIfTxPduCanIdType=STANDARD_FD_CAN, CanIfTxPduDlc=64, CanIfTxPduUserTxConfirmationUL=CDD, CanIfTxPduBufferRef=CanIfInitCfg/CHNL_2ad3227b, CanIfTxPduRef=GW_DIAG_REQ_FUNC_PLANT_Tx_oPCAN_RADAR_43d2fe9e_Tx
        GW_ETC2_03_Tx_oPCAN_RADAR_6fe44ee0_Tx: CanIfTxPduCanId=418383106, CanIfTxPduCanIdType=STANDARD_FD_CAN, CanIfTxPduDlc=8, CanIfTxPduUserTxConfirmationUL=CDD, CanIfTxPduBufferRef=CanIfInitCfg/CHNL_2ad3227b, CanIfTxPduRef=GW_ETC2_03_Tx_oPCAN_RADAR_07adbeb0_Tx
        GW_ETC2_Tx_oPCAN_RADAR_5963dc30_Tx: CanIfTxPduCanId=418383105, CanIfTxPduCanIdType=STANDARD_FD_CAN, CanIfTxPduDlc=8, CanIfTxPduUserTxConfirmationUL=CDD, CanIfTxPduBufferRef=CanIfInitCfg/CHNL_2ad3227b, CanIfTxPduRef=GW_ETC2_Tx_oPCAN_RADAR_dfec0354_Tx
        GW_OEL_Tx_oPCAN_RADAR_a8245947_Tx: CanIfTxPduCanId=217959448, CanIfTxPduCanIdType=STANDARD_FD_CAN, CanIfTxPduDlc=8, CanIfTxPduUserTxConfirmationUL=CDD, CanIfTxPduBufferRef=CanIfInitCfg/CHNL_2ad3227b, CanIfTxPduRef=GW_OEL_Tx_oPCAN_RADAR_96436c6f_Tx
        GW_SAS_Tx_oPCAN_RADAR_2217d6e9_Tx: CanIfTxPduCanId=418389477, CanIfTxPduCanIdType=STANDARD_FD_CAN, CanIfTxPduDlc=8, CanIfTxPduUserTxConfirmationUL=CDD, CanIfTxPduBufferRef=CanIfInitCfg/CHNL_2ad3227b, CanIfTxPduRef=GW_SAS_Tx_oPCAN_RADAR_6c223e7b_Tx
        GW_TD_Tx_oPCAN_RADAR_2f7068b5_Tx: CanIfTxPduCanId=419358232, CanIfTxPduCanIdType=STANDARD_FD_CAN, CanIfTxPduDlc=8, CanIfTxPduUserTxConfirmationUL=CDD, CanIfTxPduBufferRef=CanIfInitCfg/CHNL_2ad3227b, CanIfTxPduRef=GW_TD_Tx_oPCAN_RADAR_aa39de8f_Tx
        GW_VDC2_Tx_oPCAN_RADAR_f54084fa_Tx: CanIfTxPduCanId=418384130, CanIfTxPduCanIdType=STANDARD_FD_CAN, CanIfTxPduDlc=8, CanIfTxPduUserTxConfirmationUL=CDD, CanIfTxPduBufferRef=CanIfInitCfg/CHNL_2ad3227b, CanIfTxPduRef=GW_VDC2_Tx_oPCAN_RADAR_8a7343d4_Tx
        GW_VD_Tx_oPCAN_RADAR_56fb68b9_Tx: CanIfTxPduCanId=419356673, CanIfTxPduCanIdType=STANDARD_FD_CAN, CanIfTxPduDlc=8, CanIfTxPduUserTxConfirmationUL=CDD, CanIfTxPduBufferRef=CanIfInitCfg/CHNL_2ad3227b, CanIfTxPduRef=GW_VD_Tx_oPCAN_RADAR_70a8f6f0_Tx
        GW_VI_Tx_oPCAN_RADAR_ba7d49ea_Tx: CanIfTxPduCanId=419359782, CanIfTxPduCanIdType=STANDARD_FD_CAN, CanIfTxPduDlc=8, CanIfTxPduUserTxConfirmationUL=CDD, CanIfTxPduBufferRef=CanIfInitCfg/CHNL_2ad3227b, CanIfTxPduRef=GW_VI_Tx_oPCAN_RADAR_ad28cbdc_Tx
        GW_prop_ADAS_BSIS_info_oPCAN_RADAR_14d3ec96_Tx: CanIfTxPduCanId=419407024, CanIfTxPduCanIdType=EXTENDED_FD_CAN, CanIfTxPduDlc=8, CanIfTxPduUserTxConfirmationName=PduR_CanIfTxConfirmation, CanIfTxPduUserTxConfirmationUL=PDUR, CanIfTxPduBufferRef=CanIfInitCfg/CHNL_2ad3227b, CanIfTxPduRef=EcucPduCollection/GW_prop_ADAS_BSIS_info_oPCAN_RADAR_2b91b919_Tx
        MOIS_oVCAN_RADAR_edd3b80a_Tx: CanIfTxPduCanId=218057424, CanIfTxPduCanIdType=EXTENDED_CAN, CanIfTxPduDlc=8, CanIfTxPduUserTxConfirmationName=PduR_CanIfTxConfirmation, CanIfTxPduUserTxConfirmationUL=PDUR, CanIfTxPduBufferRef=CanIfInitCfg/CHNL_0829f689, CanIfTxPduRef=EcucPduCollection/MOIS_oVCAN_RADAR_1658382d_Tx
        PCAN_DIAG_RESP_PHYS_OBD1_Tp_oPCAN_RADAR_20_317d1888_Tx: CanIfTxPduCanId=417001659, CanIfTxPduCanIdType=EXTENDED_CAN, CanIfTxPduDlc=8, CanIfTxPduUserTxConfirmationName=CanTp_TxConfirmation, CanIfTxPduUserTxConfirmationUL=CAN_TP, CanIfTxPduBufferRef=CanIfInitCfg/CHNL_2ad3227b, CanIfTxPduRef=PCAN_DIAG_RESP_PHYS_OBD1_Tp_oPCAN_RADAR_20_f6415fa5_Tx
        PCAN_DIAG_RESP_PHYS_OBD1_Tp_oPCAN_RADAR_8c240349_Tx: CanIfTxPduCanId=417001659, CanIfTxPduCanIdType=EXTENDED_FD_CAN, CanIfTxPduDlc=64, CanIfTxPduUserTxConfirmationName=CanTp_TxConfirmation, CanIfTxPduUserTxConfirmationUL=CAN_TP, CanIfTxPduBufferRef=CanIfInitCfg/CHNL_2ad3227b, CanIfTxPduRef=PCAN_DIAG_RESP_PHYS_OBD1_Tp_oPCAN_RADAR_0aebd6ab_Tx
        PCAN_DIAG_RESP_PHYS_OBD2_Tp_oPCAN_RADAR_20_fc5af980_Tx: CanIfTxPduCanId=417001915, CanIfTxPduCanIdType=EXTENDED_CAN, CanIfTxPduDlc=8, CanIfTxPduUserTxConfirmationName=CanTp_TxConfirmation, CanIfTxPduUserTxConfirmationUL=CAN_TP, CanIfTxPduBufferRef=CanIfInitCfg/CHNL_2ad3227b, CanIfTxPduRef=PCAN_DIAG_RESP_PHYS_OBD2_Tp_oPCAN_RADAR_20_25da435e_Tx
        PCAN_DIAG_RESP_PHYS_OBD2_Tp_oPCAN_RADAR_b153d036_Tx: CanIfTxPduCanId=417001915, CanIfTxPduCanIdType=EXTENDED_FD_CAN, CanIfTxPduDlc=64, CanIfTxPduUserTxConfirmationName=CanTp_TxConfirmation, CanIfTxPduUserTxConfirmationUL=CAN_TP, CanIfTxPduBufferRef=CanIfInitCfg/CHNL_2ad3227b, CanIfTxPduRef=PCAN_DIAG_RESP_PHYS_OBD2_Tp_oPCAN_RADAR_6e0bad55_Tx
        PCAN_DIAG_RESP_PHYS_OTA_Tp_oPCAN_RADAR_20_07246a50_Tx: CanIfTxPduCanId=417002683, CanIfTxPduCanIdType=EXTENDED_CAN, CanIfTxPduDlc=8, CanIfTxPduUserTxConfirmationName=CanTp_TxConfirmation, CanIfTxPduUserTxConfirmationUL=CAN_TP, CanIfTxPduBufferRef=CanIfInitCfg/CHNL_2ad3227b, CanIfTxPduRef=PCAN_DIAG_RESP_PHYS_OTA_Tp_oPCAN_RADAR_20_6c821aae_Tx
        PCAN_DIAG_RESP_PHYS_OTA_Tp_oPCAN_RADAR_c2db48e7_Tx: CanIfTxPduCanId=417002683, CanIfTxPduCanIdType=EXTENDED_FD_CAN, CanIfTxPduDlc=64, CanIfTxPduUserTxConfirmationName=CanTp_TxConfirmation, CanIfTxPduUserTxConfirmationUL=CAN_TP, CanIfTxPduBufferRef=CanIfInitCfg/CHNL_2ad3227b, CanIfTxPduRef=PCAN_DIAG_RESP_PHYS_OTA_Tp_oPCAN_RADAR_37f68c50_Tx
        PCAN_DIAG_RESP_PHYS_PLANT_Tp_oPCAN_RADAR_20_656ccdb7_Tx: CanIfTxPduCanId=417002939, CanIfTxPduCanIdType=EXTENDED_CAN, CanIfTxPduDlc=8, CanIfTxPduUserTxConfirmationName=CanTp_TxConfirmation, CanIfTxPduUserTxConfirmationUL=CAN_TP, CanIfTxPduBufferRef=CanIfInitCfg/CHNL_2ad3227b, CanIfTxPduRef=PCAN_DIAG_RESP_PHYS_PLANT_Tp_oPCAN_RADAR_20_0a848a3f_Tx
        PCAN_DIAG_RESP_PHYS_PLANT_Tp_oPCAN_RADAR_2ddb0a0a_Tx: CanIfTxPduCanId=417002939, CanIfTxPduCanIdType=EXTENDED_FD_CAN, CanIfTxPduDlc=64, CanIfTxPduUserTxConfirmationName=CanTp_TxConfirmation, CanIfTxPduUserTxConfirmationUL=CAN_TP, CanIfTxPduBufferRef=CanIfInitCfg/CHNL_2ad3227b, CanIfTxPduRef=PCAN_DIAG_RESP_PHYS_PLANT_Tp_oPCAN_RADAR_bd11d57f_Tx
        RDR_ALIGNMENT_STATUS_001_oPCAN_RADAR_caaee0a2_Tx: CanIfTxPduCanId=133 if post-build-variant-condition{matching-criterion=RDR_POS, value=0}, CanIfTxPduCanIdType=STANDARD_FD_CAN, CanIfTxPduDlc=64, CanIfTxPduUserTxConfirmationName=PduR_CanIfTxConfirmation, CanIfTxPduUserTxConfirmationUL=PDUR, CanIfTxPduCanId=141 if post-build-variant-condition{matching-criterion=RDR_POS, value=1}, CanIfTxPduCanId=149 if post-build-variant-condition{matching-criterion=RDR_POS, value=2}, CanIfTxPduCanId=157 if post-build-variant-condition{matching-criterion=RDR_POS, value=3}, CanIfTxPduCanId=165 if post-build-variant-condition{matching-criterion=RDR_POS, value=4}, CanIfTxPduCanId=173 if post-build-variant-condition{matching-criterion=RDR_POS, value=5}, CanIfTxPduCanId=181 if post-build-variant-condition{matching-criterion=RDR_POS, value=6}, CanIfTxPduCanId=189 if post-build-variant-condition{matching-criterion=RDR_POS, value=7}, CanIfTxPduBufferRef=CanIfInitCfg/CHNL_2ad3227b, CanIfTxPduRef=EcucPduCollection/RDR_ALIGNMENT_STATUS_001_oPCAN_RADAR_4f94d655_Tx
        RDR_ALIGNMENT_STATUS_002_oPCAN_RADAR_899d4639_Tx: CanIfTxPduCanId=134 if post-build-variant-condition{matching-criterion=RDR_POS, value=0}, CanIfTxPduCanIdType=STANDARD_FD_CAN, CanIfTxPduDlc=64, CanIfTxPduUserTxConfirmationName=PduR_CanIfTxConfirmation, CanIfTxPduUserTxConfirmationUL=PDUR, CanIfTxPduCanId=142 if post-build-variant-condition{matching-criterion=RDR_POS, value=1}, CanIfTxPduCanId=150 if post-build-variant-condition{matching-criterion=RDR_POS, value=2}, CanIfTxPduCanId=158 if post-build-variant-condition{matching-criterion=RDR_POS, value=3}, CanIfTxPduCanId=166 if post-build-variant-condition{matching-criterion=RDR_POS, value=4}, CanIfTxPduCanId=174 if post-build-variant-condition{matching-criterion=RDR_POS, value=5}, CanIfTxPduCanId=182 if post-build-variant-condition{matching-criterion=RDR_POS, value=6}, CanIfTxPduCanId=190 if post-build-variant-condition{matching-criterion=RDR_POS, value=7}, CanIfTxPduBufferRef=CanIfInitCfg/CHNL_2ad3227b, CanIfTxPduRef=EcucPduCollection/RDR_ALIGNMENT_STATUS_002_oPCAN_RADAR_14836740_Tx
        RDR_BSD1_Tx_oPCAN_RADAR_ec8026a7_Tx: CanIfTxPduCanId=217188016 if post-build-variant-condition{matching-criterion=RDR_POS, value=0}, CanIfTxPduCanIdType=STANDARD_FD_CAN if post-build-variant-condition{matching-criterion=RDR_POS, value=0}, CanIfTxPduDlc=8, CanIfTxPduUserTxConfirmationName=PduR_CanIfTxConfirmation, CanIfTxPduUserTxConfirmationUL=PDUR, CanIfTxPduCanId=217188032 if post-build-variant-condition{matching-criterion=RDR_POS, value=4}, CanIfTxPduCanId=217188016 if post-build-variant-condition{matching-criterion=RDR_POS, value=1}, CanIfTxPduCanId=217188016 if post-build-variant-condition{matching-criterion=RDR_POS, value=2}, CanIfTxPduCanId=217188016 if post-build-variant-condition{matching-criterion=RDR_POS, value=3}, CanIfTxPduCanIdType=EXTENDED_CAN if post-build-variant-condition{matching-criterion=RDR_POS, value=4}, CanIfTxPduCanIdType=STANDARD_FD_CAN if post-build-variant-condition{matching-criterion=RDR_POS, value=1}, CanIfTxPduCanIdType=STANDARD_FD_CAN if post-build-variant-condition{matching-criterion=RDR_POS, value=2}, CanIfTxPduCanIdType=STANDARD_FD_CAN if post-build-variant-condition{matching-criterion=RDR_POS, value=3}, CanIfTxPduCanId=217188017 if post-build-variant-condition{matching-criterion=RDR_POS, value=5}, CanIfTxPduCanIdType=STANDARD_FD_CAN if post-build-variant-condition{matching-criterion=RDR_POS, value=5}, CanIfTxPduCanId=217188017 if post-build-variant-condition{matching-criterion=RDR_POS, value=6}, CanIfTxPduCanIdType=STANDARD_FD_CAN if post-build-variant-condition{matching-criterion=RDR_POS, value=6}, CanIfTxPduCanId=217188017 if post-build-variant-condition{matching-criterion=RDR_POS, value=7}, CanIfTxPduCanIdType=STANDARD_FD_CAN if post-build-variant-condition{matching-criterion=RDR_POS, value=7}, CanIfTxPduBufferRef=CanIfInitCfg/CHNL_2ad3227b, CanIfTxPduRef=EcucPduCollection/RDR_BSD1_Tx_oPCAN_RADAR_3cea6970_Tx
        RDR_CAPABILITY_oPCAN_RADAR_834d4809_Tx: CanIfTxPduCanId=135 if post-build-variant-condition{matching-criterion=RDR_POS, value=0}, CanIfTxPduCanIdType=STANDARD_FD_CAN, CanIfTxPduDlc=64, CanIfTxPduUserTxConfirmationName=PduR_CanIfTxConfirmation, CanIfTxPduUserTxConfirmationUL=PDUR, CanIfTxPduCanId=143 if post-build-variant-condition{matching-criterion=RDR_POS, value=1}, CanIfTxPduCanId=151 if post-build-variant-condition{matching-criterion=RDR_POS, value=2}, CanIfTxPduCanId=159 if post-build-variant-condition{matching-criterion=RDR_POS, value=3}, CanIfTxPduCanId=167 if post-build-variant-condition{matching-criterion=RDR_POS, value=4}, CanIfTxPduCanId=175 if post-build-variant-condition{matching-criterion=RDR_POS, value=5}, CanIfTxPduCanId=183 if post-build-variant-condition{matching-criterion=RDR_POS, value=6}, CanIfTxPduCanId=191 if post-build-variant-condition{matching-criterion=RDR_POS, value=7}, CanIfTxPduBufferRef=CanIfInitCfg/CHNL_2ad3227b, CanIfTxPduRef=EcucPduCollection/RDR_CAPABILITY_oPCAN_RADAR_476dda7e_Tx
        RDR_DETECTION_001_004_oPCAN_RADAR_456a1641_Tx: CanIfTxPduCanId=256 if post-build-variant-condition{matching-criterion=RDR_POS, value=0}, CanIfTxPduCanIdType=STANDARD_FD_CAN, CanIfTxPduDlc=64, CanIfTxPduUserTxConfirmationName=PduR_CanIfTxConfirmation, CanIfTxPduUserTxConfirmationUL=PDUR, CanIfTxPduCanId=384 if post-build-variant-condition{matching-criterion=RDR_POS, value=1}, CanIfTxPduCanId=512 if post-build-variant-condition{matching-criterion=RDR_POS, value=2}, CanIfTxPduCanId=640 if post-build-variant-condition{matching-criterion=RDR_POS, value=3}, CanIfTxPduCanId=768 if post-build-variant-condition{matching-criterion=RDR_POS, value=4}, CanIfTxPduCanId=896 if post-build-variant-condition{matching-criterion=RDR_POS, value=5}, CanIfTxPduCanId=1024 if post-build-variant-condition{matching-criterion=RDR_POS, value=6}, CanIfTxPduCanId=1152 if post-build-variant-condition{matching-criterion=RDR_POS, value=7}, CanIfTxPduBufferRef=CanIfInitCfg/CHNL_2ad3227b, CanIfTxPduRef=EcucPduCollection/RDR_DETECTION_001_004_oPCAN_RADAR_db6da1bd_Tx
        RDR_DETECTION_005_008_oPCAN_RADAR_907c961b_Tx: CanIfTxPduCanId=257 if post-build-variant-condition{matching-criterion=RDR_POS, value=0}, CanIfTxPduCanIdType=STANDARD_FD_CAN, CanIfTxPduDlc=64, CanIfTxPduUserTxConfirmationName=PduR_CanIfTxConfirmation, CanIfTxPduUserTxConfirmationUL=PDUR, CanIfTxPduCanId=385 if post-build-variant-condition{matching-criterion=RDR_POS, value=1}, CanIfTxPduCanId=513 if post-build-variant-condition{matching-criterion=RDR_POS, value=2}, CanIfTxPduCanId=641 if post-build-variant-condition{matching-criterion=RDR_POS, value=3}, CanIfTxPduCanId=769 if post-build-variant-condition{matching-criterion=RDR_POS, value=4}, CanIfTxPduCanId=897 if post-build-variant-condition{matching-criterion=RDR_POS, value=5}, CanIfTxPduCanId=1025 if post-build-variant-condition{matching-criterion=RDR_POS, value=6}, CanIfTxPduCanId=1153 if post-build-variant-condition{matching-criterion=RDR_POS, value=7}, CanIfTxPduBufferRef=CanIfInitCfg/CHNL_2ad3227b, CanIfTxPduRef=EcucPduCollection/RDR_DETECTION_005_008_oPCAN_RADAR_02113517_Tx
        RDR_DETECTION_009_012_oPCAN_RADAR_83a4abae_Tx: CanIfTxPduCanId=258 if post-build-variant-condition{matching-criterion=RDR_POS, value=0}, CanIfTxPduCanIdType=STANDARD_FD_CAN, CanIfTxPduDlc=64, CanIfTxPduUserTxConfirmationName=PduR_CanIfTxConfirmation, CanIfTxPduUserTxConfirmationUL=PDUR, CanIfTxPduCanId=386 if post-build-variant-condition{matching-criterion=RDR_POS, value=1}, CanIfTxPduCanId=514 if post-build-variant-condition{matching-criterion=RDR_POS, value=2}, CanIfTxPduCanId=642 if post-build-variant-condition{matching-criterion=RDR_POS, value=3}, CanIfTxPduCanId=770 if post-build-variant-condition{matching-criterion=RDR_POS, value=4}, CanIfTxPduCanId=898 if post-build-variant-condition{matching-criterion=RDR_POS, value=5}, CanIfTxPduCanId=1026 if post-build-variant-condition{matching-criterion=RDR_POS, value=6}, CanIfTxPduCanId=1154 if post-build-variant-condition{matching-criterion=RDR_POS, value=7}, CanIfTxPduBufferRef=CanIfInitCfg/CHNL_2ad3227b, CanIfTxPduRef=EcucPduCollection/RDR_DETECTION_009_012_oPCAN_RADAR_95663fdf_Tx
        RDR_DETECTION_013_016_oPCAN_RADAR_897f6817_Tx: CanIfTxPduCanId=259 if post-build-variant-condition{matching-criterion=RDR_POS, value=0}, CanIfTxPduCanIdType=STANDARD_FD_CAN, CanIfTxPduDlc=64, CanIfTxPduUserTxConfirmationName=PduR_CanIfTxConfirmation, CanIfTxPduUserTxConfirmationUL=PDUR, CanIfTxPduCanId=387 if post-build-variant-condition{matching-criterion=RDR_POS, value=1}, CanIfTxPduCanId=515 if post-build-variant-condition{matching-criterion=RDR_POS, value=2}, CanIfTxPduCanId=643 if post-build-variant-condition{matching-criterion=RDR_POS, value=3}, CanIfTxPduCanId=771 if post-build-variant-condition{matching-criterion=RDR_POS, value=4}, CanIfTxPduCanId=899 if post-build-variant-condition{matching-criterion=RDR_POS, value=5}, CanIfTxPduCanId=1027 if post-build-variant-condition{matching-criterion=RDR_POS, value=6}, CanIfTxPduCanId=1155 if post-build-variant-condition{matching-criterion=RDR_POS, value=7}, CanIfTxPduBufferRef=CanIfInitCfg/CHNL_2ad3227b, CanIfTxPduRef=EcucPduCollection/RDR_DETECTION_013_016_oPCAN_RADAR_c51304f0_Tx
        RDR_DETECTION_017_020_oPCAN_RADAR_94d1abf5_Tx: CanIfTxPduCanId=260 if post-build-variant-condition{matching-criterion=RDR_POS, value=0}, CanIfTxPduCanIdType=STANDARD_FD_CAN, CanIfTxPduDlc=64, CanIfTxPduUserTxConfirmationName=PduR_CanIfTxConfirmation, CanIfTxPduUserTxConfirmationUL=PDUR, CanIfTxPduCanId=388 if post-build-variant-condition{matching-criterion=RDR_POS, value=1}, CanIfTxPduCanId=516 if post-build-variant-condition{matching-criterion=RDR_POS, value=2}, CanIfTxPduCanId=644 if post-build-variant-condition{matching-criterion=RDR_POS, value=3}, CanIfTxPduCanId=772 if post-build-variant-condition{matching-criterion=RDR_POS, value=4}, CanIfTxPduCanId=900 if post-build-variant-condition{matching-criterion=RDR_POS, value=5}, CanIfTxPduCanId=1028 if post-build-variant-condition{matching-criterion=RDR_POS, value=6}, CanIfTxPduCanId=1156 if post-build-variant-condition{matching-criterion=RDR_POS, value=7}, CanIfTxPduBufferRef=CanIfInitCfg/CHNL_2ad3227b, CanIfTxPduRef=EcucPduCollection/RDR_DETECTION_017_020_oPCAN_RADAR_70e9c33f_Tx
        RDR_DETECTION_021_024_oPCAN_RADAR_35f4b8e7_Tx: CanIfTxPduCanId=261 if post-build-variant-condition{matching-criterion=RDR_POS, value=0}, CanIfTxPduCanIdType=STANDARD_FD_CAN, CanIfTxPduDlc=64, CanIfTxPduUserTxConfirmationName=PduR_CanIfTxConfirmation, CanIfTxPduUserTxConfirmationUL=PDUR, CanIfTxPduCanId=389 if post-build-variant-condition{matching-criterion=RDR_POS, value=1}, CanIfTxPduCanId=517 if post-build-variant-condition{matching-criterion=RDR_POS, value=2}, CanIfTxPduCanId=645 if post-build-variant-condition{matching-criterion=RDR_POS, value=3}, CanIfTxPduCanId=773 if post-build-variant-condition{matching-criterion=RDR_POS, value=4}, CanIfTxPduCanId=901 if post-build-variant-condition{matching-criterion=RDR_POS, value=5}, CanIfTxPduCanId=1029 if post-build-variant-condition{matching-criterion=RDR_POS, value=6}, CanIfTxPduCanId=1157 if post-build-variant-condition{matching-criterion=RDR_POS, value=7}, CanIfTxPduBufferRef=CanIfInitCfg/CHNL_2ad3227b, CanIfTxPduRef=EcucPduCollection/RDR_DETECTION_021_024_oPCAN_RADAR_5209fe54_Tx
        RDR_DETECTION_025_028_oPCAN_RADAR_e0e238bd_Tx: CanIfTxPduCanId=262 if post-build-variant-condition{matching-criterion=RDR_POS, value=0}, CanIfTxPduCanIdType=STANDARD_FD_CAN, CanIfTxPduDlc=64, CanIfTxPduUserTxConfirmationName=PduR_CanIfTxConfirmation, CanIfTxPduUserTxConfirmationUL=PDUR, CanIfTxPduCanId=390 if post-build-variant-condition{matching-criterion=RDR_POS, value=1}, CanIfTxPduCanId=518 if post-build-variant-condition{matching-criterion=RDR_POS, value=2}, CanIfTxPduCanId=646 if post-build-variant-condition{matching-criterion=RDR_POS, value=3}, CanIfTxPduCanId=774 if post-build-variant-condition{matching-criterion=RDR_POS, value=4}, CanIfTxPduCanId=902 if post-build-variant-condition{matching-criterion=RDR_POS, value=5}, CanIfTxPduCanId=1030 if post-build-variant-condition{matching-criterion=RDR_POS, value=6}, CanIfTxPduCanId=1158 if post-build-variant-condition{matching-criterion=RDR_POS, value=7}, CanIfTxPduBufferRef=CanIfInitCfg/CHNL_2ad3227b, CanIfTxPduRef=EcucPduCollection/RDR_DETECTION_025_028_oPCAN_RADAR_8b756afe_Tx
        RDR_DETECTION_029_032_oPCAN_RADAR_f33a0508_Tx: CanIfTxPduCanId=263 if post-build-variant-condition{matching-criterion=RDR_POS, value=0}, CanIfTxPduCanIdType=STANDARD_FD_CAN, CanIfTxPduDlc=64, CanIfTxPduUserTxConfirmationName=PduR_CanIfTxConfirmation, CanIfTxPduUserTxConfirmationUL=PDUR, CanIfTxPduCanId=391 if post-build-variant-condition{matching-criterion=RDR_POS, value=1}, CanIfTxPduCanId=519 if post-build-variant-condition{matching-criterion=RDR_POS, value=2}, CanIfTxPduCanId=647 if post-build-variant-condition{matching-criterion=RDR_POS, value=3}, CanIfTxPduCanId=775 if post-build-variant-condition{matching-criterion=RDR_POS, value=4}, CanIfTxPduCanId=903 if post-build-variant-condition{matching-criterion=RDR_POS, value=5}, CanIfTxPduCanId=1031 if post-build-variant-condition{matching-criterion=RDR_POS, value=6}, CanIfTxPduCanId=1159 if post-build-variant-condition{matching-criterion=RDR_POS, value=7}, CanIfTxPduBufferRef=CanIfInitCfg/CHNL_2ad3227b, CanIfTxPduRef=EcucPduCollection/RDR_DETECTION_029_032_oPCAN_RADAR_1c026036_Tx
        RDR_DETECTION_033_036_oPCAN_RADAR_f9e1c6b1_Tx: CanIfTxPduCanId=264 if post-build-variant-condition{matching-criterion=RDR_POS, value=0}, CanIfTxPduCanIdType=STANDARD_FD_CAN, CanIfTxPduDlc=64, CanIfTxPduUserTxConfirmationName=PduR_CanIfTxConfirmation, CanIfTxPduUserTxConfirmationUL=PDUR, CanIfTxPduCanId=392 if post-build-variant-condition{matching-criterion=RDR_POS, value=1}, CanIfTxPduCanId=520 if post-build-variant-condition{matching-criterion=RDR_POS, value=2}, CanIfTxPduCanId=648 if post-build-variant-condition{matching-criterion=RDR_POS, value=3}, CanIfTxPduCanId=776 if post-build-variant-condition{matching-criterion=RDR_POS, value=4}, CanIfTxPduCanId=904 if post-build-variant-condition{matching-criterion=RDR_POS, value=5}, CanIfTxPduCanId=1032 if post-build-variant-condition{matching-criterion=RDR_POS, value=6}, CanIfTxPduCanId=1160 if post-build-variant-condition{matching-criterion=RDR_POS, value=7}, CanIfTxPduBufferRef=CanIfInitCfg/CHNL_2ad3227b, CanIfTxPduRef=EcucPduCollection/RDR_DETECTION_033_036_oPCAN_RADAR_4c775b19_Tx
        RDR_DETECTION_037_040_oPCAN_RADAR_d1647cc0_Tx: CanIfTxPduCanId=265 if post-build-variant-condition{matching-criterion=RDR_POS, value=0}, CanIfTxPduCanIdType=STANDARD_FD_CAN, CanIfTxPduDlc=64, CanIfTxPduUserTxConfirmationName=PduR_CanIfTxConfirmation, CanIfTxPduUserTxConfirmationUL=PDUR, CanIfTxPduCanId=393 if post-build-variant-condition{matching-criterion=RDR_POS, value=1}, CanIfTxPduCanId=521 if post-build-variant-condition{matching-criterion=RDR_POS, value=2}, CanIfTxPduCanId=649 if post-build-variant-condition{matching-criterion=RDR_POS, value=3}, CanIfTxPduCanId=777 if post-build-variant-condition{matching-criterion=RDR_POS, value=4}, CanIfTxPduCanId=905 if post-build-variant-condition{matching-criterion=RDR_POS, value=5}, CanIfTxPduCanId=1033 if post-build-variant-condition{matching-criterion=RDR_POS, value=6}, CanIfTxPduCanId=1161 if post-build-variant-condition{matching-criterion=RDR_POS, value=7}, CanIfTxPduBufferRef=CanIfInitCfg/CHNL_2ad3227b, CanIfTxPduRef=EcucPduCollection/RDR_DETECTION_037_040_oPCAN_RADAR_6b84d80e_Tx
        RDR_DETECTION_041_044_oPCAN_RADAR_a4574b0d_Tx: CanIfTxPduCanId=266 if post-build-variant-condition{matching-criterion=RDR_POS, value=0}, CanIfTxPduCanIdType=STANDARD_FD_CAN, CanIfTxPduDlc=64, CanIfTxPduUserTxConfirmationName=PduR_CanIfTxConfirmation, CanIfTxPduUserTxConfirmationUL=PDUR, CanIfTxPduCanId=394 if post-build-variant-condition{matching-criterion=RDR_POS, value=1}, CanIfTxPduCanId=522 if post-build-variant-condition{matching-criterion=RDR_POS, value=2}, CanIfTxPduCanId=650 if post-build-variant-condition{matching-criterion=RDR_POS, value=3}, CanIfTxPduCanId=778 if post-build-variant-condition{matching-criterion=RDR_POS, value=4}, CanIfTxPduCanId=906 if post-build-variant-condition{matching-criterion=RDR_POS, value=5}, CanIfTxPduCanId=1034 if post-build-variant-condition{matching-criterion=RDR_POS, value=6}, CanIfTxPduCanId=1162 if post-build-variant-condition{matching-criterion=RDR_POS, value=7}, CanIfTxPduBufferRef=CanIfInitCfg/CHNL_2ad3227b, CanIfTxPduRef=EcucPduCollection/RDR_DETECTION_041_044_oPCAN_RADAR_12d4182e_Tx
        RDR_DETECTION_045_048_oPCAN_RADAR_7141cb57_Tx: CanIfTxPduCanId=267 if post-build-variant-condition{matching-criterion=RDR_POS, value=0}, CanIfTxPduCanIdType=STANDARD_FD_CAN, CanIfTxPduDlc=64, CanIfTxPduUserTxConfirmationName=PduR_CanIfTxConfirmation, CanIfTxPduUserTxConfirmationUL=PDUR, CanIfTxPduCanId=395 if post-build-variant-condition{matching-criterion=RDR_POS, value=1}, CanIfTxPduCanId=523 if post-build-variant-condition{matching-criterion=RDR_POS, value=2}, CanIfTxPduCanId=651 if post-build-variant-condition{matching-criterion=RDR_POS, value=3}, CanIfTxPduCanId=779 if post-build-variant-condition{matching-criterion=RDR_POS, value=4}, CanIfTxPduCanId=907 if post-build-variant-condition{matching-criterion=RDR_POS, value=5}, CanIfTxPduCanId=1035 if post-build-variant-condition{matching-criterion=RDR_POS, value=6}, CanIfTxPduCanId=1163 if post-build-variant-condition{matching-criterion=RDR_POS, value=7}, CanIfTxPduBufferRef=CanIfInitCfg/CHNL_2ad3227b, CanIfTxPduRef=EcucPduCollection/RDR_DETECTION_045_048_oPCAN_RADAR_cba88c84_Tx
        RDR_DETECTION_049_052_oPCAN_RADAR_6299f6e2_Tx: CanIfTxPduCanId=268 if post-build-variant-condition{matching-criterion=RDR_POS, value=0}, CanIfTxPduCanIdType=STANDARD_FD_CAN, CanIfTxPduDlc=64, CanIfTxPduUserTxConfirmationName=PduR_CanIfTxConfirmation, CanIfTxPduUserTxConfirmationUL=PDUR, CanIfTxPduCanId=396 if post-build-variant-condition{matching-criterion=RDR_POS, value=1}, CanIfTxPduCanId=524 if post-build-variant-condition{matching-criterion=RDR_POS, value=2}, CanIfTxPduCanId=652 if post-build-variant-condition{matching-criterion=RDR_POS, value=3}, CanIfTxPduCanId=780 if post-build-variant-condition{matching-criterion=RDR_POS, value=4}, CanIfTxPduCanId=908 if post-build-variant-condition{matching-criterion=RDR_POS, value=5}, CanIfTxPduCanId=1036 if post-build-variant-condition{matching-criterion=RDR_POS, value=6}, CanIfTxPduCanId=1164 if post-build-variant-condition{matching-criterion=RDR_POS, value=7}, CanIfTxPduBufferRef=CanIfInitCfg/CHNL_2ad3227b, CanIfTxPduRef=EcucPduCollection/RDR_DETECTION_049_052_oPCAN_RADAR_5cdf864c_Tx
        RDR_DETECTION_053_056_oPCAN_RADAR_6842355b_Tx: CanIfTxPduCanId=269 if post-build-variant-condition{matching-criterion=RDR_POS, value=0}, CanIfTxPduCanIdType=STANDARD_FD_CAN, CanIfTxPduDlc=64, CanIfTxPduUserTxConfirmationName=PduR_CanIfTxConfirmation, CanIfTxPduUserTxConfirmationUL=PDUR, CanIfTxPduCanId=397 if post-build-variant-condition{matching-criterion=RDR_POS, value=1}, CanIfTxPduCanId=525 if post-build-variant-condition{matching-criterion=RDR_POS, value=2}, CanIfTxPduCanId=653 if post-build-variant-condition{matching-criterion=RDR_POS, value=3}, CanIfTxPduCanId=781 if post-build-variant-condition{matching-criterion=RDR_POS, value=4}, CanIfTxPduCanId=909 if post-build-variant-condition{matching-criterion=RDR_POS, value=5}, CanIfTxPduCanId=1037 if post-build-variant-condition{matching-criterion=RDR_POS, value=6}, CanIfTxPduCanId=1165 if post-build-variant-condition{matching-criterion=RDR_POS, value=7}, CanIfTxPduBufferRef=CanIfInitCfg/CHNL_2ad3227b, CanIfTxPduRef=EcucPduCollection/RDR_DETECTION_053_056_oPCAN_RADAR_0caabd63_Tx
        RDR_DETECTION_057_060_oPCAN_RADAR_75ecf6b9_Tx: CanIfTxPduCanId=270 if post-build-variant-condition{matching-criterion=RDR_POS, value=0}, CanIfTxPduCanIdType=STANDARD_FD_CAN, CanIfTxPduDlc=64, CanIfTxPduUserTxConfirmationName=PduR_CanIfTxConfirmation, CanIfTxPduUserTxConfirmationUL=PDUR, CanIfTxPduCanId=398 if post-build-variant-condition{matching-criterion=RDR_POS, value=1}, CanIfTxPduCanId=526 if post-build-variant-condition{matching-criterion=RDR_POS, value=2}, CanIfTxPduCanId=654 if post-build-variant-condition{matching-criterion=RDR_POS, value=3}, CanIfTxPduCanId=782 if post-build-variant-condition{matching-criterion=RDR_POS, value=4}, CanIfTxPduCanId=910 if post-build-variant-condition{matching-criterion=RDR_POS, value=5}, CanIfTxPduCanId=1038 if post-build-variant-condition{matching-criterion=RDR_POS, value=6}, CanIfTxPduCanId=1166 if post-build-variant-condition{matching-criterion=RDR_POS, value=7}, CanIfTxPduBufferRef=CanIfInitCfg/CHNL_2ad3227b, CanIfTxPduRef=EcucPduCollection/RDR_DETECTION_057_060_oPCAN_RADAR_b9507aac_Tx
        RDR_DETECTION_061_064_oPCAN_RADAR_d4c9e5ab_Tx: CanIfTxPduCanId=271 if post-build-variant-condition{matching-criterion=RDR_POS, value=0}, CanIfTxPduCanIdType=STANDARD_FD_CAN, CanIfTxPduDlc=64, CanIfTxPduUserTxConfirmationName=PduR_CanIfTxConfirmation, CanIfTxPduUserTxConfirmationUL=PDUR, CanIfTxPduCanId=399 if post-build-variant-condition{matching-criterion=RDR_POS, value=1}, CanIfTxPduCanId=527 if post-build-variant-condition{matching-criterion=RDR_POS, value=2}, CanIfTxPduCanId=655 if post-build-variant-condition{matching-criterion=RDR_POS, value=3}, CanIfTxPduCanId=783 if post-build-variant-condition{matching-criterion=RDR_POS, value=4}, CanIfTxPduCanId=911 if post-build-variant-condition{matching-criterion=RDR_POS, value=5}, CanIfTxPduCanId=1039 if post-build-variant-condition{matching-criterion=RDR_POS, value=6}, CanIfTxPduCanId=1167 if post-build-variant-condition{matching-criterion=RDR_POS, value=7}, CanIfTxPduBufferRef=CanIfInitCfg/CHNL_2ad3227b, CanIfTxPduRef=EcucPduCollection/RDR_DETECTION_061_064_oPCAN_RADAR_9bb047c7_Tx
        RDR_DETECTION_065_068_oPCAN_RADAR_01df65f1_Tx: CanIfTxPduCanId=272 if post-build-variant-condition{matching-criterion=RDR_POS, value=0}, CanIfTxPduCanIdType=STANDARD_FD_CAN, CanIfTxPduDlc=64, CanIfTxPduUserTxConfirmationName=PduR_CanIfTxConfirmation, CanIfTxPduUserTxConfirmationUL=PDUR, CanIfTxPduCanId=400 if post-build-variant-condition{matching-criterion=RDR_POS, value=1}, CanIfTxPduCanId=528 if post-build-variant-condition{matching-criterion=RDR_POS, value=2}, CanIfTxPduCanId=656 if post-build-variant-condition{matching-criterion=RDR_POS, value=3}, CanIfTxPduCanId=784 if post-build-variant-condition{matching-criterion=RDR_POS, value=4}, CanIfTxPduCanId=912 if post-build-variant-condition{matching-criterion=RDR_POS, value=5}, CanIfTxPduCanId=1040 if post-build-variant-condition{matching-criterion=RDR_POS, value=6}, CanIfTxPduCanId=1168 if post-build-variant-condition{matching-criterion=RDR_POS, value=7}, CanIfTxPduBufferRef=CanIfInitCfg/CHNL_2ad3227b, CanIfTxPduRef=EcucPduCollection/RDR_DETECTION_065_068_oPCAN_RADAR_42ccd36d_Tx
        RDR_DETECTION_069_072_oPCAN_RADAR_12075844_Tx: CanIfTxPduCanId=273 if post-build-variant-condition{matching-criterion=RDR_POS, value=0}, CanIfTxPduCanIdType=STANDARD_FD_CAN, CanIfTxPduDlc=64, CanIfTxPduUserTxConfirmationName=PduR_CanIfTxConfirmation, CanIfTxPduUserTxConfirmationUL=PDUR, CanIfTxPduCanId=401 if post-build-variant-condition{matching-criterion=RDR_POS, value=1}, CanIfTxPduCanId=529 if post-build-variant-condition{matching-criterion=RDR_POS, value=2}, CanIfTxPduCanId=657 if post-build-variant-condition{matching-criterion=RDR_POS, value=3}, CanIfTxPduCanId=785 if post-build-variant-condition{matching-criterion=RDR_POS, value=4}, CanIfTxPduCanId=913 if post-build-variant-condition{matching-criterion=RDR_POS, value=5}, CanIfTxPduCanId=1041 if post-build-variant-condition{matching-criterion=RDR_POS, value=6}, CanIfTxPduCanId=1169 if post-build-variant-condition{matching-criterion=RDR_POS, value=7}, CanIfTxPduBufferRef=CanIfInitCfg/CHNL_2ad3227b, CanIfTxPduRef=EcucPduCollection/RDR_DETECTION_069_072_oPCAN_RADAR_d5bbd9a5_Tx
        RDR_DETECTION_073_076_oPCAN_RADAR_18dc9bfd_Tx: CanIfTxPduCanId=274 if post-build-variant-condition{matching-criterion=RDR_POS, value=0}, CanIfTxPduCanIdType=STANDARD_FD_CAN, CanIfTxPduDlc=64, CanIfTxPduUserTxConfirmationName=PduR_CanIfTxConfirmation, CanIfTxPduUserTxConfirmationUL=PDUR, CanIfTxPduCanId=402 if post-build-variant-condition{matching-criterion=RDR_POS, value=1}, CanIfTxPduCanId=530 if post-build-variant-condition{matching-criterion=RDR_POS, value=2}, CanIfTxPduCanId=658 if post-build-variant-condition{matching-criterion=RDR_POS, value=3}, CanIfTxPduCanId=786 if post-build-variant-condition{matching-criterion=RDR_POS, value=4}, CanIfTxPduCanId=914 if post-build-variant-condition{matching-criterion=RDR_POS, value=5}, CanIfTxPduCanId=1042 if post-build-variant-condition{matching-criterion=RDR_POS, value=6}, CanIfTxPduCanId=1170 if post-build-variant-condition{matching-criterion=RDR_POS, value=7}, CanIfTxPduBufferRef=CanIfInitCfg/CHNL_2ad3227b, CanIfTxPduRef=EcucPduCollection/RDR_DETECTION_073_076_oPCAN_RADAR_85cee28a_Tx
        RDR_DETECTION_077_080_oPCAN_RADAR_5a0fd2aa_Tx: CanIfTxPduCanId=275 if post-build-variant-condition{matching-criterion=RDR_POS, value=0}, CanIfTxPduCanIdType=STANDARD_FD_CAN, CanIfTxPduDlc=64, CanIfTxPduUserTxConfirmationName=PduR_CanIfTxConfirmation, CanIfTxPduUserTxConfirmationUL=PDUR, CanIfTxPduCanId=403 if post-build-variant-condition{matching-criterion=RDR_POS, value=1}, CanIfTxPduCanId=531 if post-build-variant-condition{matching-criterion=RDR_POS, value=2}, CanIfTxPduCanId=659 if post-build-variant-condition{matching-criterion=RDR_POS, value=3}, CanIfTxPduCanId=787 if post-build-variant-condition{matching-criterion=RDR_POS, value=4}, CanIfTxPduCanId=915 if post-build-variant-condition{matching-criterion=RDR_POS, value=5}, CanIfTxPduCanId=1043 if post-build-variant-condition{matching-criterion=RDR_POS, value=6}, CanIfTxPduCanId=1171 if post-build-variant-condition{matching-criterion=RDR_POS, value=7}, CanIfTxPduBufferRef=CanIfInitCfg/CHNL_2ad3227b, CanIfTxPduRef=EcucPduCollection/RDR_DETECTION_077_080_oPCAN_RADAR_5d5eee6c_Tx
        RDR_DETECTION_081_084_oPCAN_RADAR_5c61aa98_Tx: CanIfTxPduCanId=276 if post-build-variant-condition{matching-criterion=RDR_POS, value=0}, CanIfTxPduCanIdType=STANDARD_FD_CAN, CanIfTxPduDlc=64, CanIfTxPduUserTxConfirmationName=PduR_CanIfTxConfirmation, CanIfTxPduUserTxConfirmationUL=PDUR, CanIfTxPduCanId=404 if post-build-variant-condition{matching-criterion=RDR_POS, value=1}, CanIfTxPduCanId=532 if post-build-variant-condition{matching-criterion=RDR_POS, value=2}, CanIfTxPduCanId=660 if post-build-variant-condition{matching-criterion=RDR_POS, value=3}, CanIfTxPduCanId=788 if post-build-variant-condition{matching-criterion=RDR_POS, value=4}, CanIfTxPduCanId=916 if post-build-variant-condition{matching-criterion=RDR_POS, value=5}, CanIfTxPduCanId=1044 if post-build-variant-condition{matching-criterion=RDR_POS, value=6}, CanIfTxPduCanId=1172 if post-build-variant-condition{matching-criterion=RDR_POS, value=7}, CanIfTxPduBufferRef=CanIfInitCfg/CHNL_2ad3227b, CanIfTxPduRef=EcucPduCollection/RDR_DETECTION_081_084_oPCAN_RADAR_936fd4da_Tx
        RDR_DETECTION_085_088_oPCAN_RADAR_89772ac2_Tx: CanIfTxPduCanId=277 if post-build-variant-condition{matching-criterion=RDR_POS, value=0}, CanIfTxPduCanIdType=STANDARD_FD_CAN, CanIfTxPduDlc=64, CanIfTxPduUserTxConfirmationName=PduR_CanIfTxConfirmation, CanIfTxPduUserTxConfirmationUL=PDUR, CanIfTxPduCanId=405 if post-build-variant-condition{matching-criterion=RDR_POS, value=1}, CanIfTxPduCanId=533 if post-build-variant-condition{matching-criterion=RDR_POS, value=2}, CanIfTxPduCanId=661 if post-build-variant-condition{matching-criterion=RDR_POS, value=3}, CanIfTxPduCanId=789 if post-build-variant-condition{matching-criterion=RDR_POS, value=4}, CanIfTxPduCanId=917 if post-build-variant-condition{matching-criterion=RDR_POS, value=5}, CanIfTxPduCanId=1045 if post-build-variant-condition{matching-criterion=RDR_POS, value=6}, CanIfTxPduCanId=1173 if post-build-variant-condition{matching-criterion=RDR_POS, value=7}, CanIfTxPduBufferRef=CanIfInitCfg/CHNL_2ad3227b, CanIfTxPduRef=EcucPduCollection/RDR_DETECTION_085_088_oPCAN_RADAR_4a134070_Tx
        RDR_DETECTION_089_092_oPCAN_RADAR_9aaf1777_Tx: CanIfTxPduCanId=278 if post-build-variant-condition{matching-criterion=RDR_POS, value=0}, CanIfTxPduCanIdType=STANDARD_FD_CAN, CanIfTxPduDlc=64, CanIfTxPduUserTxConfirmationName=PduR_CanIfTxConfirmation, CanIfTxPduUserTxConfirmationUL=PDUR, CanIfTxPduCanId=406 if post-build-variant-condition{matching-criterion=RDR_POS, value=1}, CanIfTxPduCanId=534 if post-build-variant-condition{matching-criterion=RDR_POS, value=2}, CanIfTxPduCanId=662 if post-build-variant-condition{matching-criterion=RDR_POS, value=3}, CanIfTxPduCanId=790 if post-build-variant-condition{matching-criterion=RDR_POS, value=4}, CanIfTxPduCanId=918 if post-build-variant-condition{matching-criterion=RDR_POS, value=5}, CanIfTxPduCanId=1046 if post-build-variant-condition{matching-criterion=RDR_POS, value=6}, CanIfTxPduCanId=1174 if post-build-variant-condition{matching-criterion=RDR_POS, value=7}, CanIfTxPduBufferRef=CanIfInitCfg/CHNL_2ad3227b, CanIfTxPduRef=EcucPduCollection/RDR_DETECTION_089_092_oPCAN_RADAR_dd644ab8_Tx
        RDR_DETECTION_093_096_oPCAN_RADAR_9074d4ce_Tx: CanIfTxPduCanId=279 if post-build-variant-condition{matching-criterion=RDR_POS, value=0}, CanIfTxPduCanIdType=STANDARD_FD_CAN, CanIfTxPduDlc=64, CanIfTxPduUserTxConfirmationName=PduR_CanIfTxConfirmation, CanIfTxPduUserTxConfirmationUL=PDUR, CanIfTxPduCanId=407 if post-build-variant-condition{matching-criterion=RDR_POS, value=1}, CanIfTxPduCanId=535 if post-build-variant-condition{matching-criterion=RDR_POS, value=2}, CanIfTxPduCanId=663 if post-build-variant-condition{matching-criterion=RDR_POS, value=3}, CanIfTxPduCanId=791 if post-build-variant-condition{matching-criterion=RDR_POS, value=4}, CanIfTxPduCanId=919 if post-build-variant-condition{matching-criterion=RDR_POS, value=5}, CanIfTxPduCanId=1047 if post-build-variant-condition{matching-criterion=RDR_POS, value=6}, CanIfTxPduCanId=1175 if post-build-variant-condition{matching-criterion=RDR_POS, value=7}, CanIfTxPduBufferRef=CanIfInitCfg/CHNL_2ad3227b, CanIfTxPduRef=EcucPduCollection/RDR_DETECTION_093_096_oPCAN_RADAR_8d117197_Tx
        RDR_DETECTION_097_100_oPCAN_RADAR_9189e332_Tx: CanIfTxPduCanId=280 if post-build-variant-condition{matching-criterion=RDR_POS, value=0}, CanIfTxPduCanIdType=STANDARD_FD_CAN, CanIfTxPduDlc=64, CanIfTxPduUserTxConfirmationName=PduR_CanIfTxConfirmation, CanIfTxPduUserTxConfirmationUL=PDUR, CanIfTxPduCanId=408 if post-build-variant-condition{matching-criterion=RDR_POS, value=1}, CanIfTxPduCanId=536 if post-build-variant-condition{matching-criterion=RDR_POS, value=2}, CanIfTxPduCanId=664 if post-build-variant-condition{matching-criterion=RDR_POS, value=3}, CanIfTxPduCanId=792 if post-build-variant-condition{matching-criterion=RDR_POS, value=4}, CanIfTxPduCanId=920 if post-build-variant-condition{matching-criterion=RDR_POS, value=5}, CanIfTxPduCanId=1048 if post-build-variant-condition{matching-criterion=RDR_POS, value=6}, CanIfTxPduCanId=1176 if post-build-variant-condition{matching-criterion=RDR_POS, value=7}, CanIfTxPduBufferRef=CanIfInitCfg/CHNL_2ad3227b, CanIfTxPduRef=EcucPduCollection/RDR_DETECTION_097_100_oPCAN_RADAR_41128c0d_Tx
        RDR_DETECTION_101_104_oPCAN_RADAR_b7305958_Tx: CanIfTxPduCanId=281 if post-build-variant-condition{matching-criterion=RDR_POS, value=0}, CanIfTxPduCanIdType=STANDARD_FD_CAN, CanIfTxPduDlc=64, CanIfTxPduUserTxConfirmationName=PduR_CanIfTxConfirmation, CanIfTxPduUserTxConfirmationUL=PDUR, CanIfTxPduCanId=409 if post-build-variant-condition{matching-criterion=RDR_POS, value=1}, CanIfTxPduCanId=537 if post-build-variant-condition{matching-criterion=RDR_POS, value=2}, CanIfTxPduCanId=665 if post-build-variant-condition{matching-criterion=RDR_POS, value=3}, CanIfTxPduCanId=793 if post-build-variant-condition{matching-criterion=RDR_POS, value=4}, CanIfTxPduCanId=921 if post-build-variant-condition{matching-criterion=RDR_POS, value=5}, CanIfTxPduCanId=1049 if post-build-variant-condition{matching-criterion=RDR_POS, value=6}, CanIfTxPduCanId=1177 if post-build-variant-condition{matching-criterion=RDR_POS, value=7}, CanIfTxPduBufferRef=CanIfInitCfg/CHNL_2ad3227b, CanIfTxPduRef=EcucPduCollection/RDR_DETECTION_101_104_oPCAN_RADAR_5a7abddc_Tx
        RDR_DETECTION_105_108_oPCAN_RADAR_6226d902_Tx: CanIfTxPduCanId=282 if post-build-variant-condition{matching-criterion=RDR_POS, value=0}, CanIfTxPduCanIdType=STANDARD_FD_CAN, CanIfTxPduDlc=64, CanIfTxPduUserTxConfirmationName=PduR_CanIfTxConfirmation, CanIfTxPduUserTxConfirmationUL=PDUR, CanIfTxPduCanId=410 if post-build-variant-condition{matching-criterion=RDR_POS, value=1}, CanIfTxPduCanId=538 if post-build-variant-condition{matching-criterion=RDR_POS, value=2}, CanIfTxPduCanId=666 if post-build-variant-condition{matching-criterion=RDR_POS, value=3}, CanIfTxPduCanId=794 if post-build-variant-condition{matching-criterion=RDR_POS, value=4}, CanIfTxPduCanId=922 if post-build-variant-condition{matching-criterion=RDR_POS, value=5}, CanIfTxPduCanId=1050 if post-build-variant-condition{matching-criterion=RDR_POS, value=6}, CanIfTxPduCanId=1178 if post-build-variant-condition{matching-criterion=RDR_POS, value=7}, CanIfTxPduBufferRef=CanIfInitCfg/CHNL_2ad3227b, CanIfTxPduRef=EcucPduCollection/RDR_DETECTION_105_108_oPCAN_RADAR_83062976_Tx
        RDR_DETECTION_109_112_oPCAN_RADAR_71fee4b7_Tx: CanIfTxPduCanId=283 if post-build-variant-condition{matching-criterion=RDR_POS, value=0}, CanIfTxPduCanIdType=STANDARD_FD_CAN, CanIfTxPduDlc=64, CanIfTxPduUserTxConfirmationName=PduR_CanIfTxConfirmation, CanIfTxPduUserTxConfirmationUL=PDUR, CanIfTxPduCanId=411 if post-build-variant-condition{matching-criterion=RDR_POS, value=1}, CanIfTxPduCanId=539 if post-build-variant-condition{matching-criterion=RDR_POS, value=2}, CanIfTxPduCanId=667 if post-build-variant-condition{matching-criterion=RDR_POS, value=3}, CanIfTxPduCanId=795 if post-build-variant-condition{matching-criterion=RDR_POS, value=4}, CanIfTxPduCanId=923 if post-build-variant-condition{matching-criterion=RDR_POS, value=5}, CanIfTxPduCanId=1051 if post-build-variant-condition{matching-criterion=RDR_POS, value=6}, CanIfTxPduCanId=1179 if post-build-variant-condition{matching-criterion=RDR_POS, value=7}, CanIfTxPduBufferRef=CanIfInitCfg/CHNL_2ad3227b, CanIfTxPduRef=EcucPduCollection/RDR_DETECTION_109_112_oPCAN_RADAR_147123be_Tx
        RDR_DETECTION_113_116_oPCAN_RADAR_7b25270e_Tx: CanIfTxPduCanId=284 if post-build-variant-condition{matching-criterion=RDR_POS, value=0}, CanIfTxPduCanIdType=STANDARD_FD_CAN, CanIfTxPduDlc=64, CanIfTxPduUserTxConfirmationName=PduR_CanIfTxConfirmation, CanIfTxPduUserTxConfirmationUL=PDUR, CanIfTxPduCanId=412 if post-build-variant-condition{matching-criterion=RDR_POS, value=1}, CanIfTxPduCanId=540 if post-build-variant-condition{matching-criterion=RDR_POS, value=2}, CanIfTxPduCanId=668 if post-build-variant-condition{matching-criterion=RDR_POS, value=3}, CanIfTxPduCanId=796 if post-build-variant-condition{matching-criterion=RDR_POS, value=4}, CanIfTxPduCanId=924 if post-build-variant-condition{matching-criterion=RDR_POS, value=5}, CanIfTxPduCanId=1052 if post-build-variant-condition{matching-criterion=RDR_POS, value=6}, CanIfTxPduCanId=1180 if post-build-variant-condition{matching-criterion=RDR_POS, value=7}, CanIfTxPduBufferRef=CanIfInitCfg/CHNL_2ad3227b, CanIfTxPduRef=EcucPduCollection/RDR_DETECTION_113_116_oPCAN_RADAR_44041891_Tx
        RDR_DETECTION_117_120_oPCAN_RADAR_668be4ec_Tx: CanIfTxPduCanId=285 if post-build-variant-condition{matching-criterion=RDR_POS, value=0}, CanIfTxPduCanIdType=STANDARD_FD_CAN, CanIfTxPduDlc=64, CanIfTxPduUserTxConfirmationName=PduR_CanIfTxConfirmation, CanIfTxPduUserTxConfirmationUL=PDUR, CanIfTxPduCanId=413 if post-build-variant-condition{matching-criterion=RDR_POS, value=1}, CanIfTxPduCanId=541 if post-build-variant-condition{matching-criterion=RDR_POS, value=2}, CanIfTxPduCanId=669 if post-build-variant-condition{matching-criterion=RDR_POS, value=3}, CanIfTxPduCanId=797 if post-build-variant-condition{matching-criterion=RDR_POS, value=4}, CanIfTxPduCanId=925 if post-build-variant-condition{matching-criterion=RDR_POS, value=5}, CanIfTxPduCanId=1053 if post-build-variant-condition{matching-criterion=RDR_POS, value=6}, CanIfTxPduCanId=1181 if post-build-variant-condition{matching-criterion=RDR_POS, value=7}, CanIfTxPduBufferRef=CanIfInitCfg/CHNL_2ad3227b, CanIfTxPduRef=EcucPduCollection/RDR_DETECTION_117_120_oPCAN_RADAR_f1fedf5e_Tx
        RDR_DETECTION_121_124_oPCAN_RADAR_c7aef7fe_Tx: CanIfTxPduCanId=286 if post-build-variant-condition{matching-criterion=RDR_POS, value=0}, CanIfTxPduCanIdType=STANDARD_FD_CAN, CanIfTxPduDlc=64, CanIfTxPduUserTxConfirmationName=PduR_CanIfTxConfirmation, CanIfTxPduUserTxConfirmationUL=PDUR, CanIfTxPduCanId=414 if post-build-variant-condition{matching-criterion=RDR_POS, value=1}, CanIfTxPduCanId=542 if post-build-variant-condition{matching-criterion=RDR_POS, value=2}, CanIfTxPduCanId=670 if post-build-variant-condition{matching-criterion=RDR_POS, value=3}, CanIfTxPduCanId=798 if post-build-variant-condition{matching-criterion=RDR_POS, value=4}, CanIfTxPduCanId=926 if post-build-variant-condition{matching-criterion=RDR_POS, value=5}, CanIfTxPduCanId=1054 if post-build-variant-condition{matching-criterion=RDR_POS, value=6}, CanIfTxPduCanId=1182 if post-build-variant-condition{matching-criterion=RDR_POS, value=7}, CanIfTxPduBufferRef=CanIfInitCfg/CHNL_2ad3227b, CanIfTxPduRef=EcucPduCollection/RDR_DETECTION_121_124_oPCAN_RADAR_d31ee235_Tx
        RDR_DETECTION_125_128_oPCAN_RADAR_12b877a4_Tx: CanIfTxPduCanId=287 if post-build-variant-condition{matching-criterion=RDR_POS, value=0}, CanIfTxPduCanIdType=STANDARD_FD_CAN, CanIfTxPduDlc=64, CanIfTxPduUserTxConfirmationName=PduR_CanIfTxConfirmation, CanIfTxPduUserTxConfirmationUL=PDUR, CanIfTxPduCanId=415 if post-build-variant-condition{matching-criterion=RDR_POS, value=1}, CanIfTxPduCanId=543 if post-build-variant-condition{matching-criterion=RDR_POS, value=2}, CanIfTxPduCanId=671 if post-build-variant-condition{matching-criterion=RDR_POS, value=3}, CanIfTxPduCanId=799 if post-build-variant-condition{matching-criterion=RDR_POS, value=4}, CanIfTxPduCanId=927 if post-build-variant-condition{matching-criterion=RDR_POS, value=5}, CanIfTxPduCanId=1055 if post-build-variant-condition{matching-criterion=RDR_POS, value=6}, CanIfTxPduCanId=1183 if post-build-variant-condition{matching-criterion=RDR_POS, value=7}, CanIfTxPduBufferRef=CanIfInitCfg/CHNL_2ad3227b, CanIfTxPduRef=EcucPduCollection/RDR_DETECTION_125_128_oPCAN_RADAR_0a62769f_Tx
        RDR_DETECTION_129_132_oPCAN_RADAR_01604a11_Tx: CanIfTxPduCanId=288 if post-build-variant-condition{matching-criterion=RDR_POS, value=0}, CanIfTxPduCanIdType=STANDARD_FD_CAN, CanIfTxPduDlc=64, CanIfTxPduUserTxConfirmationName=PduR_CanIfTxConfirmation, CanIfTxPduUserTxConfirmationUL=PDUR, CanIfTxPduCanId=416 if post-build-variant-condition{matching-criterion=RDR_POS, value=1}, CanIfTxPduCanId=544 if post-build-variant-condition{matching-criterion=RDR_POS, value=2}, CanIfTxPduCanId=672 if post-build-variant-condition{matching-criterion=RDR_POS, value=3}, CanIfTxPduCanId=800 if post-build-variant-condition{matching-criterion=RDR_POS, value=4}, CanIfTxPduCanId=928 if post-build-variant-condition{matching-criterion=RDR_POS, value=5}, CanIfTxPduCanId=1056 if post-build-variant-condition{matching-criterion=RDR_POS, value=6}, CanIfTxPduCanId=1184 if post-build-variant-condition{matching-criterion=RDR_POS, value=7}, CanIfTxPduBufferRef=CanIfInitCfg/CHNL_2ad3227b, CanIfTxPduRef=EcucPduCollection/RDR_DETECTION_129_132_oPCAN_RADAR_9d157c57_Tx
        RDR_DETECTION_133_136_oPCAN_RADAR_0bbb89a8_Tx: CanIfTxPduCanId=289 if post-build-variant-condition{matching-criterion=RDR_POS, value=0}, CanIfTxPduCanIdType=STANDARD_FD_CAN, CanIfTxPduDlc=64, CanIfTxPduUserTxConfirmationName=PduR_CanIfTxConfirmation, CanIfTxPduUserTxConfirmationUL=PDUR, CanIfTxPduCanId=417 if post-build-variant-condition{matching-criterion=RDR_POS, value=1}, CanIfTxPduCanId=545 if post-build-variant-condition{matching-criterion=RDR_POS, value=2}, CanIfTxPduCanId=673 if post-build-variant-condition{matching-criterion=RDR_POS, value=3}, CanIfTxPduCanId=801 if post-build-variant-condition{matching-criterion=RDR_POS, value=4}, CanIfTxPduCanId=929 if post-build-variant-condition{matching-criterion=RDR_POS, value=5}, CanIfTxPduCanId=1057 if post-build-variant-condition{matching-criterion=RDR_POS, value=6}, CanIfTxPduCanId=1185 if post-build-variant-condition{matching-criterion=RDR_POS, value=7}, CanIfTxPduBufferRef=CanIfInitCfg/CHNL_2ad3227b, CanIfTxPduRef=EcucPduCollection/RDR_DETECTION_133_136_oPCAN_RADAR_cd604778_Tx
        RDR_DETECTION_137_140_oPCAN_RADAR_233e33d9_Tx: CanIfTxPduCanId=290 if post-build-variant-condition{matching-criterion=RDR_POS, value=0}, CanIfTxPduCanIdType=STANDARD_FD_CAN, CanIfTxPduDlc=64, CanIfTxPduUserTxConfirmationName=PduR_CanIfTxConfirmation, CanIfTxPduUserTxConfirmationUL=PDUR, CanIfTxPduCanId=418 if post-build-variant-condition{matching-criterion=RDR_POS, value=1}, CanIfTxPduCanId=546 if post-build-variant-condition{matching-criterion=RDR_POS, value=2}, CanIfTxPduCanId=674 if post-build-variant-condition{matching-criterion=RDR_POS, value=3}, CanIfTxPduCanId=802 if post-build-variant-condition{matching-criterion=RDR_POS, value=4}, CanIfTxPduCanId=930 if post-build-variant-condition{matching-criterion=RDR_POS, value=5}, CanIfTxPduCanId=1058 if post-build-variant-condition{matching-criterion=RDR_POS, value=6}, CanIfTxPduCanId=1186 if post-build-variant-condition{matching-criterion=RDR_POS, value=7}, CanIfTxPduBufferRef=CanIfInitCfg/CHNL_2ad3227b, CanIfTxPduRef=EcucPduCollection/RDR_DETECTION_137_140_oPCAN_RADAR_ea93c46f_Tx
        RDR_DETECTION_141_144_oPCAN_RADAR_560d0414_Tx: CanIfTxPduCanId=291 if post-build-variant-condition{matching-criterion=RDR_POS, value=0}, CanIfTxPduCanIdType=STANDARD_FD_CAN, CanIfTxPduDlc=64, CanIfTxPduUserTxConfirmationName=PduR_CanIfTxConfirmation, CanIfTxPduUserTxConfirmationUL=PDUR, CanIfTxPduCanId=419 if post-build-variant-condition{matching-criterion=RDR_POS, value=1}, CanIfTxPduCanId=547 if post-build-variant-condition{matching-criterion=RDR_POS, value=2}, CanIfTxPduCanId=675 if post-build-variant-condition{matching-criterion=RDR_POS, value=3}, CanIfTxPduCanId=803 if post-build-variant-condition{matching-criterion=RDR_POS, value=4}, CanIfTxPduCanId=931 if post-build-variant-condition{matching-criterion=RDR_POS, value=5}, CanIfTxPduCanId=1059 if post-build-variant-condition{matching-criterion=RDR_POS, value=6}, CanIfTxPduCanId=1187 if post-build-variant-condition{matching-criterion=RDR_POS, value=7}, CanIfTxPduBufferRef=CanIfInitCfg/CHNL_2ad3227b, CanIfTxPduRef=EcucPduCollection/RDR_DETECTION_141_144_oPCAN_RADAR_93c3044f_Tx
        RDR_DETECTION_145_148_oPCAN_RADAR_831b844e_Tx: CanIfTxPduCanId=292 if post-build-variant-condition{matching-criterion=RDR_POS, value=0}, CanIfTxPduCanIdType=STANDARD_FD_CAN, CanIfTxPduDlc=64, CanIfTxPduUserTxConfirmationName=PduR_CanIfTxConfirmation, CanIfTxPduUserTxConfirmationUL=PDUR, CanIfTxPduCanId=420 if post-build-variant-condition{matching-criterion=RDR_POS, value=1}, CanIfTxPduCanId=548 if post-build-variant-condition{matching-criterion=RDR_POS, value=2}, CanIfTxPduCanId=676 if post-build-variant-condition{matching-criterion=RDR_POS, value=3}, CanIfTxPduCanId=804 if post-build-variant-condition{matching-criterion=RDR_POS, value=4}, CanIfTxPduCanId=932 if post-build-variant-condition{matching-criterion=RDR_POS, value=5}, CanIfTxPduCanId=1060 if post-build-variant-condition{matching-criterion=RDR_POS, value=6}, CanIfTxPduCanId=1188 if post-build-variant-condition{matching-criterion=RDR_POS, value=7}, CanIfTxPduBufferRef=CanIfInitCfg/CHNL_2ad3227b, CanIfTxPduRef=EcucPduCollection/RDR_DETECTION_145_148_oPCAN_RADAR_4abf90e5_Tx
        RDR_DETECTION_149_152_oPCAN_RADAR_90c3b9fb_Tx: CanIfTxPduCanId=293 if post-build-variant-condition{matching-criterion=RDR_POS, value=0}, CanIfTxPduCanIdType=STANDARD_FD_CAN, CanIfTxPduDlc=64, CanIfTxPduUserTxConfirmationName=PduR_CanIfTxConfirmation, CanIfTxPduUserTxConfirmationUL=PDUR, CanIfTxPduCanId=421 if post-build-variant-condition{matching-criterion=RDR_POS, value=1}, CanIfTxPduCanId=549 if post-build-variant-condition{matching-criterion=RDR_POS, value=2}, CanIfTxPduCanId=677 if post-build-variant-condition{matching-criterion=RDR_POS, value=3}, CanIfTxPduCanId=805 if post-build-variant-condition{matching-criterion=RDR_POS, value=4}, CanIfTxPduCanId=933 if post-build-variant-condition{matching-criterion=RDR_POS, value=5}, CanIfTxPduCanId=1061 if post-build-variant-condition{matching-criterion=RDR_POS, value=6}, CanIfTxPduCanId=1189 if post-build-variant-condition{matching-criterion=RDR_POS, value=7}, CanIfTxPduBufferRef=CanIfInitCfg/CHNL_2ad3227b, CanIfTxPduRef=EcucPduCollection/RDR_DETECTION_149_152_oPCAN_RADAR_ddc89a2d_Tx
        RDR_DETECTION_153_156_oPCAN_RADAR_9a187a42_Tx: CanIfTxPduCanId=294 if post-build-variant-condition{matching-criterion=RDR_POS, value=0}, CanIfTxPduCanIdType=STANDARD_FD_CAN, CanIfTxPduDlc=64, CanIfTxPduUserTxConfirmationName=PduR_CanIfTxConfirmation, CanIfTxPduUserTxConfirmationUL=PDUR, CanIfTxPduCanId=422 if post-build-variant-condition{matching-criterion=RDR_POS, value=1}, CanIfTxPduCanId=550 if post-build-variant-condition{matching-criterion=RDR_POS, value=2}, CanIfTxPduCanId=678 if post-build-variant-condition{matching-criterion=RDR_POS, value=3}, CanIfTxPduCanId=806 if post-build-variant-condition{matching-criterion=RDR_POS, value=4}, CanIfTxPduCanId=934 if post-build-variant-condition{matching-criterion=RDR_POS, value=5}, CanIfTxPduCanId=1062 if post-build-variant-condition{matching-criterion=RDR_POS, value=6}, CanIfTxPduCanId=1190 if post-build-variant-condition{matching-criterion=RDR_POS, value=7}, CanIfTxPduBufferRef=CanIfInitCfg/CHNL_2ad3227b, CanIfTxPduRef=EcucPduCollection/RDR_DETECTION_153_156_oPCAN_RADAR_8dbda102_Tx
        RDR_DETECTION_157_160_oPCAN_RADAR_87b6b9a0_Tx: CanIfTxPduCanId=295 if post-build-variant-condition{matching-criterion=RDR_POS, value=0}, CanIfTxPduCanIdType=STANDARD_FD_CAN, CanIfTxPduDlc=64, CanIfTxPduUserTxConfirmationName=PduR_CanIfTxConfirmation, CanIfTxPduUserTxConfirmationUL=PDUR, CanIfTxPduCanId=423 if post-build-variant-condition{matching-criterion=RDR_POS, value=1}, CanIfTxPduCanId=551 if post-build-variant-condition{matching-criterion=RDR_POS, value=2}, CanIfTxPduCanId=679 if post-build-variant-condition{matching-criterion=RDR_POS, value=3}, CanIfTxPduCanId=807 if post-build-variant-condition{matching-criterion=RDR_POS, value=4}, CanIfTxPduCanId=935 if post-build-variant-condition{matching-criterion=RDR_POS, value=5}, CanIfTxPduCanId=1063 if post-build-variant-condition{matching-criterion=RDR_POS, value=6}, CanIfTxPduCanId=1191 if post-build-variant-condition{matching-criterion=RDR_POS, value=7}, CanIfTxPduBufferRef=CanIfInitCfg/CHNL_2ad3227b, CanIfTxPduRef=EcucPduCollection/RDR_DETECTION_157_160_oPCAN_RADAR_384766cd_Tx
        RDR_DETECTION_161_164_oPCAN_RADAR_2693aab2_Tx: CanIfTxPduCanId=296 if post-build-variant-condition{matching-criterion=RDR_POS, value=0}, CanIfTxPduCanIdType=STANDARD_FD_CAN, CanIfTxPduDlc=64, CanIfTxPduUserTxConfirmationName=PduR_CanIfTxConfirmation, CanIfTxPduUserTxConfirmationUL=PDUR, CanIfTxPduCanId=424 if post-build-variant-condition{matching-criterion=RDR_POS, value=1}, CanIfTxPduCanId=552 if post-build-variant-condition{matching-criterion=RDR_POS, value=2}, CanIfTxPduCanId=680 if post-build-variant-condition{matching-criterion=RDR_POS, value=3}, CanIfTxPduCanId=808 if post-build-variant-condition{matching-criterion=RDR_POS, value=4}, CanIfTxPduCanId=936 if post-build-variant-condition{matching-criterion=RDR_POS, value=5}, CanIfTxPduCanId=1064 if post-build-variant-condition{matching-criterion=RDR_POS, value=6}, CanIfTxPduCanId=1192 if post-build-variant-condition{matching-criterion=RDR_POS, value=7}, CanIfTxPduBufferRef=CanIfInitCfg/CHNL_2ad3227b, CanIfTxPduRef=EcucPduCollection/RDR_DETECTION_161_164_oPCAN_RADAR_1aa75ba6_Tx
        RDR_DETECTION_165_168_oPCAN_RADAR_f3852ae8_Tx: CanIfTxPduCanId=297 if post-build-variant-condition{matching-criterion=RDR_POS, value=0}, CanIfTxPduCanIdType=STANDARD_FD_CAN, CanIfTxPduDlc=64, CanIfTxPduUserTxConfirmationName=PduR_CanIfTxConfirmation, CanIfTxPduUserTxConfirmationUL=PDUR, CanIfTxPduCanId=425 if post-build-variant-condition{matching-criterion=RDR_POS, value=1}, CanIfTxPduCanId=553 if post-build-variant-condition{matching-criterion=RDR_POS, value=2}, CanIfTxPduCanId=681 if post-build-variant-condition{matching-criterion=RDR_POS, value=3}, CanIfTxPduCanId=809 if post-build-variant-condition{matching-criterion=RDR_POS, value=4}, CanIfTxPduCanId=937 if post-build-variant-condition{matching-criterion=RDR_POS, value=5}, CanIfTxPduCanId=1065 if post-build-variant-condition{matching-criterion=RDR_POS, value=6}, CanIfTxPduCanId=1193 if post-build-variant-condition{matching-criterion=RDR_POS, value=7}, CanIfTxPduBufferRef=CanIfInitCfg/CHNL_2ad3227b, CanIfTxPduRef=EcucPduCollection/RDR_DETECTION_165_168_oPCAN_RADAR_c3dbcf0c_Tx
        RDR_DETECTION_169_172_oPCAN_RADAR_e05d175d_Tx: CanIfTxPduCanId=298 if post-build-variant-condition{matching-criterion=RDR_POS, value=0}, CanIfTxPduCanIdType=STANDARD_FD_CAN, CanIfTxPduDlc=64, CanIfTxPduUserTxConfirmationName=PduR_CanIfTxConfirmation, CanIfTxPduUserTxConfirmationUL=PDUR, CanIfTxPduCanId=426 if post-build-variant-condition{matching-criterion=RDR_POS, value=1}, CanIfTxPduCanId=554 if post-build-variant-condition{matching-criterion=RDR_POS, value=2}, CanIfTxPduCanId=682 if post-build-variant-condition{matching-criterion=RDR_POS, value=3}, CanIfTxPduCanId=810 if post-build-variant-condition{matching-criterion=RDR_POS, value=4}, CanIfTxPduCanId=938 if post-build-variant-condition{matching-criterion=RDR_POS, value=5}, CanIfTxPduCanId=1066 if post-build-variant-condition{matching-criterion=RDR_POS, value=6}, CanIfTxPduCanId=1194 if post-build-variant-condition{matching-criterion=RDR_POS, value=7}, CanIfTxPduBufferRef=CanIfInitCfg/CHNL_2ad3227b, CanIfTxPduRef=EcucPduCollection/RDR_DETECTION_169_172_oPCAN_RADAR_54acc5c4_Tx
        RDR_DETECTION_173_176_oPCAN_RADAR_ea86d4e4_Tx: CanIfTxPduCanId=299 if post-build-variant-condition{matching-criterion=RDR_POS, value=0}, CanIfTxPduCanIdType=STANDARD_FD_CAN, CanIfTxPduDlc=64, CanIfTxPduUserTxConfirmationName=PduR_CanIfTxConfirmation, CanIfTxPduUserTxConfirmationUL=PDUR, CanIfTxPduCanId=427 if post-build-variant-condition{matching-criterion=RDR_POS, value=1}, CanIfTxPduCanId=555 if post-build-variant-condition{matching-criterion=RDR_POS, value=2}, CanIfTxPduCanId=683 if post-build-variant-condition{matching-criterion=RDR_POS, value=3}, CanIfTxPduCanId=811 if post-build-variant-condition{matching-criterion=RDR_POS, value=4}, CanIfTxPduCanId=939 if post-build-variant-condition{matching-criterion=RDR_POS, value=5}, CanIfTxPduCanId=1067 if post-build-variant-condition{matching-criterion=RDR_POS, value=6}, CanIfTxPduCanId=1195 if post-build-variant-condition{matching-criterion=RDR_POS, value=7}, CanIfTxPduBufferRef=CanIfInitCfg/CHNL_2ad3227b, CanIfTxPduRef=EcucPduCollection/RDR_DETECTION_173_176_oPCAN_RADAR_04d9feeb_Tx
        RDR_DETECTION_177_180_oPCAN_RADAR_a8559db3_Tx: CanIfTxPduCanId=300 if post-build-variant-condition{matching-criterion=RDR_POS, value=0}, CanIfTxPduCanIdType=STANDARD_FD_CAN, CanIfTxPduDlc=64, CanIfTxPduUserTxConfirmationName=PduR_CanIfTxConfirmation, CanIfTxPduUserTxConfirmationUL=PDUR, CanIfTxPduCanId=428 if post-build-variant-condition{matching-criterion=RDR_POS, value=1}, CanIfTxPduCanId=556 if post-build-variant-condition{matching-criterion=RDR_POS, value=2}, CanIfTxPduCanId=684 if post-build-variant-condition{matching-criterion=RDR_POS, value=3}, CanIfTxPduCanId=812 if post-build-variant-condition{matching-criterion=RDR_POS, value=4}, CanIfTxPduCanId=940 if post-build-variant-condition{matching-criterion=RDR_POS, value=5}, CanIfTxPduCanId=1068 if post-build-variant-condition{matching-criterion=RDR_POS, value=6}, CanIfTxPduCanId=1196 if post-build-variant-condition{matching-criterion=RDR_POS, value=7}, CanIfTxPduBufferRef=CanIfInitCfg/CHNL_2ad3227b, CanIfTxPduRef=EcucPduCollection/RDR_DETECTION_177_180_oPCAN_RADAR_dc49f20d_Tx
        RDR_DETECTION_181_184_oPCAN_RADAR_ae3be581_Tx: CanIfTxPduCanId=301 if post-build-variant-condition{matching-criterion=RDR_POS, value=0}, CanIfTxPduCanIdType=STANDARD_FD_CAN, CanIfTxPduDlc=64, CanIfTxPduUserTxConfirmationName=PduR_CanIfTxConfirmation, CanIfTxPduUserTxConfirmationUL=PDUR, CanIfTxPduCanId=429 if post-build-variant-condition{matching-criterion=RDR_POS, value=1}, CanIfTxPduCanId=557 if post-build-variant-condition{matching-criterion=RDR_POS, value=2}, CanIfTxPduCanId=685 if post-build-variant-condition{matching-criterion=RDR_POS, value=3}, CanIfTxPduCanId=813 if post-build-variant-condition{matching-criterion=RDR_POS, value=4}, CanIfTxPduCanId=941 if post-build-variant-condition{matching-criterion=RDR_POS, value=5}, CanIfTxPduCanId=1069 if post-build-variant-condition{matching-criterion=RDR_POS, value=6}, CanIfTxPduCanId=1197 if post-build-variant-condition{matching-criterion=RDR_POS, value=7}, CanIfTxPduBufferRef=CanIfInitCfg/CHNL_2ad3227b, CanIfTxPduRef=EcucPduCollection/RDR_DETECTION_181_184_oPCAN_RADAR_1278c8bb_Tx
        RDR_DETECTION_185_188_oPCAN_RADAR_7b2d65db_Tx: CanIfTxPduCanId=302 if post-build-variant-condition{matching-criterion=RDR_POS, value=0}, CanIfTxPduCanIdType=STANDARD_FD_CAN, CanIfTxPduDlc=64, CanIfTxPduUserTxConfirmationName=PduR_CanIfTxConfirmation, CanIfTxPduUserTxConfirmationUL=PDUR, CanIfTxPduCanId=430 if post-build-variant-condition{matching-criterion=RDR_POS, value=1}, CanIfTxPduCanId=558 if post-build-variant-condition{matching-criterion=RDR_POS, value=2}, CanIfTxPduCanId=686 if post-build-variant-condition{matching-criterion=RDR_POS, value=3}, CanIfTxPduCanId=814 if post-build-variant-condition{matching-criterion=RDR_POS, value=4}, CanIfTxPduCanId=942 if post-build-variant-condition{matching-criterion=RDR_POS, value=5}, CanIfTxPduCanId=1070 if post-build-variant-condition{matching-criterion=RDR_POS, value=6}, CanIfTxPduCanId=1198 if post-build-variant-condition{matching-criterion=RDR_POS, value=7}, CanIfTxPduBufferRef=CanIfInitCfg/CHNL_2ad3227b, CanIfTxPduRef=EcucPduCollection/RDR_DETECTION_185_188_oPCAN_RADAR_cb045c11_Tx
        RDR_DETECTION_189_192_oPCAN_RADAR_68f5586e_Tx: CanIfTxPduCanId=303 if post-build-variant-condition{matching-criterion=RDR_POS, value=0}, CanIfTxPduCanIdType=STANDARD_FD_CAN, CanIfTxPduDlc=64, CanIfTxPduUserTxConfirmationName=PduR_CanIfTxConfirmation, CanIfTxPduUserTxConfirmationUL=PDUR, CanIfTxPduCanId=431 if post-build-variant-condition{matching-criterion=RDR_POS, value=1}, CanIfTxPduCanId=559 if post-build-variant-condition{matching-criterion=RDR_POS, value=2}, CanIfTxPduCanId=687 if post-build-variant-condition{matching-criterion=RDR_POS, value=3}, CanIfTxPduCanId=815 if post-build-variant-condition{matching-criterion=RDR_POS, value=4}, CanIfTxPduCanId=943 if post-build-variant-condition{matching-criterion=RDR_POS, value=5}, CanIfTxPduCanId=1071 if post-build-variant-condition{matching-criterion=RDR_POS, value=6}, CanIfTxPduCanId=1199 if post-build-variant-condition{matching-criterion=RDR_POS, value=7}, CanIfTxPduBufferRef=CanIfInitCfg/CHNL_2ad3227b, CanIfTxPduRef=EcucPduCollection/RDR_DETECTION_189_192_oPCAN_RADAR_5c7356d9_Tx
        RDR_DETECTION_193_196_oPCAN_RADAR_622e9bd7_Tx: CanIfTxPduCanId=304 if post-build-variant-condition{matching-criterion=RDR_POS, value=0}, CanIfTxPduCanIdType=STANDARD_FD_CAN, CanIfTxPduDlc=64, CanIfTxPduUserTxConfirmationName=PduR_CanIfTxConfirmation, CanIfTxPduUserTxConfirmationUL=PDUR, CanIfTxPduCanId=432 if post-build-variant-condition{matching-criterion=RDR_POS, value=1}, CanIfTxPduCanId=560 if post-build-variant-condition{matching-criterion=RDR_POS, value=2}, CanIfTxPduCanId=688 if post-build-variant-condition{matching-criterion=RDR_POS, value=3}, CanIfTxPduCanId=816 if post-build-variant-condition{matching-criterion=RDR_POS, value=4}, CanIfTxPduCanId=944 if post-build-variant-condition{matching-criterion=RDR_POS, value=5}, CanIfTxPduCanId=1072 if post-build-variant-condition{matching-criterion=RDR_POS, value=6}, CanIfTxPduCanId=1200 if post-build-variant-condition{matching-criterion=RDR_POS, value=7}, CanIfTxPduBufferRef=CanIfInitCfg/CHNL_2ad3227b, CanIfTxPduRef=EcucPduCollection/RDR_DETECTION_193_196_oPCAN_RADAR_0c066df6_Tx
        RDR_DETECTION_197_200_oPCAN_RADAR_baf2dbc8_Tx: CanIfTxPduCanId=305 if post-build-variant-condition{matching-criterion=RDR_POS, value=0}, CanIfTxPduCanIdType=STANDARD_FD_CAN, CanIfTxPduDlc=64, CanIfTxPduUserTxConfirmationName=PduR_CanIfTxConfirmation, CanIfTxPduUserTxConfirmationUL=PDUR, CanIfTxPduCanId=433 if post-build-variant-condition{matching-criterion=RDR_POS, value=1}, CanIfTxPduCanId=561 if post-build-variant-condition{matching-criterion=RDR_POS, value=2}, CanIfTxPduCanId=689 if post-build-variant-condition{matching-criterion=RDR_POS, value=3}, CanIfTxPduCanId=817 if post-build-variant-condition{matching-criterion=RDR_POS, value=4}, CanIfTxPduCanId=945 if post-build-variant-condition{matching-criterion=RDR_POS, value=5}, CanIfTxPduCanId=1073 if post-build-variant-condition{matching-criterion=RDR_POS, value=6}, CanIfTxPduCanId=1201 if post-build-variant-condition{matching-criterion=RDR_POS, value=7}, CanIfTxPduBufferRef=CanIfInitCfg/CHNL_2ad3227b, CanIfTxPduRef=EcucPduCollection/RDR_DETECTION_197_200_oPCAN_RADAR_8448b9bd_Tx
        RDR_DETECTION_201_204_oPCAN_RADAR_7aaf8e32_Tx: CanIfTxPduCanId=306 if post-build-variant-condition{matching-criterion=RDR_POS, value=0}, CanIfTxPduCanIdType=STANDARD_FD_CAN, CanIfTxPduDlc=64, CanIfTxPduUserTxConfirmationName=PduR_CanIfTxConfirmation, CanIfTxPduUserTxConfirmationUL=PDUR, CanIfTxPduCanId=434 if post-build-variant-condition{matching-criterion=RDR_POS, value=1}, CanIfTxPduCanId=562 if post-build-variant-condition{matching-criterion=RDR_POS, value=2}, CanIfTxPduCanId=690 if post-build-variant-condition{matching-criterion=RDR_POS, value=3}, CanIfTxPduCanId=818 if post-build-variant-condition{matching-criterion=RDR_POS, value=4}, CanIfTxPduCanId=946 if post-build-variant-condition{matching-criterion=RDR_POS, value=5}, CanIfTxPduCanId=1074 if post-build-variant-condition{matching-criterion=RDR_POS, value=6}, CanIfTxPduCanId=1202 if post-build-variant-condition{matching-criterion=RDR_POS, value=7}, CanIfTxPduBufferRef=CanIfInitCfg/CHNL_2ad3227b, CanIfTxPduRef=EcucPduCollection/RDR_DETECTION_201_204_oPCAN_RADAR_02329f3e_Tx
        RDR_DETECTION_205_208_oPCAN_RADAR_afb90e68_Tx: CanIfTxPduCanId=307 if post-build-variant-condition{matching-criterion=RDR_POS, value=0}, CanIfTxPduCanIdType=STANDARD_FD_CAN, CanIfTxPduDlc=64, CanIfTxPduUserTxConfirmationName=PduR_CanIfTxConfirmation, CanIfTxPduUserTxConfirmationUL=PDUR, CanIfTxPduCanId=435 if post-build-variant-condition{matching-criterion=RDR_POS, value=1}, CanIfTxPduCanId=563 if post-build-variant-condition{matching-criterion=RDR_POS, value=2}, CanIfTxPduCanId=691 if post-build-variant-condition{matching-criterion=RDR_POS, value=3}, CanIfTxPduCanId=819 if post-build-variant-condition{matching-criterion=RDR_POS, value=4}, CanIfTxPduCanId=947 if post-build-variant-condition{matching-criterion=RDR_POS, value=5}, CanIfTxPduCanId=1075 if post-build-variant-condition{matching-criterion=RDR_POS, value=6}, CanIfTxPduCanId=1203 if post-build-variant-condition{matching-criterion=RDR_POS, value=7}, CanIfTxPduBufferRef=CanIfInitCfg/CHNL_2ad3227b, CanIfTxPduRef=EcucPduCollection/RDR_DETECTION_205_208_oPCAN_RADAR_db4e0b94_Tx
        RDR_DETECTION_209_212_oPCAN_RADAR_bc6133dd_Tx: CanIfTxPduCanId=308 if post-build-variant-condition{matching-criterion=RDR_POS, value=0}, CanIfTxPduCanIdType=STANDARD_FD_CAN, CanIfTxPduDlc=64, CanIfTxPduUserTxConfirmationName=PduR_CanIfTxConfirmation, CanIfTxPduUserTxConfirmationUL=PDUR, CanIfTxPduCanId=436 if post-build-variant-condition{matching-criterion=RDR_POS, value=1}, CanIfTxPduCanId=564 if post-build-variant-condition{matching-criterion=RDR_POS, value=2}, CanIfTxPduCanId=692 if post-build-variant-condition{matching-criterion=RDR_POS, value=3}, CanIfTxPduCanId=820 if post-build-variant-condition{matching-criterion=RDR_POS, value=4}, CanIfTxPduCanId=948 if post-build-variant-condition{matching-criterion=RDR_POS, value=5}, CanIfTxPduCanId=1076 if post-build-variant-condition{matching-criterion=RDR_POS, value=6}, CanIfTxPduCanId=1204 if post-build-variant-condition{matching-criterion=RDR_POS, value=7}, CanIfTxPduBufferRef=CanIfInitCfg/CHNL_2ad3227b, CanIfTxPduRef=EcucPduCollection/RDR_DETECTION_209_212_oPCAN_RADAR_4c39015c_Tx
        RDR_DETECTION_213_216_oPCAN_RADAR_b6baf064_Tx: CanIfTxPduCanId=309 if post-build-variant-condition{matching-criterion=RDR_POS, value=0}, CanIfTxPduCanIdType=STANDARD_FD_CAN, CanIfTxPduDlc=64, CanIfTxPduUserTxConfirmationName=PduR_CanIfTxConfirmation, CanIfTxPduUserTxConfirmationUL=PDUR, CanIfTxPduCanId=437 if post-build-variant-condition{matching-criterion=RDR_POS, value=1}, CanIfTxPduCanId=565 if post-build-variant-condition{matching-criterion=RDR_POS, value=2}, CanIfTxPduCanId=693 if post-build-variant-condition{matching-criterion=RDR_POS, value=3}, CanIfTxPduCanId=821 if post-build-variant-condition{matching-criterion=RDR_POS, value=4}, CanIfTxPduCanId=949 if post-build-variant-condition{matching-criterion=RDR_POS, value=5}, CanIfTxPduCanId=1077 if post-build-variant-condition{matching-criterion=RDR_POS, value=6}, CanIfTxPduCanId=1205 if post-build-variant-condition{matching-criterion=RDR_POS, value=7}, CanIfTxPduBufferRef=CanIfInitCfg/CHNL_2ad3227b, CanIfTxPduRef=EcucPduCollection/RDR_DETECTION_213_216_oPCAN_RADAR_1c4c3a73_Tx
        RDR_DETECTION_217_220_oPCAN_RADAR_ab143386_Tx: CanIfTxPduCanId=310 if post-build-variant-condition{matching-criterion=RDR_POS, value=0}, CanIfTxPduCanIdType=STANDARD_FD_CAN, CanIfTxPduDlc=64, CanIfTxPduUserTxConfirmationName=PduR_CanIfTxConfirmation, CanIfTxPduUserTxConfirmationUL=PDUR, CanIfTxPduCanId=438 if post-build-variant-condition{matching-criterion=RDR_POS, value=1}, CanIfTxPduCanId=566 if post-build-variant-condition{matching-criterion=RDR_POS, value=2}, CanIfTxPduCanId=694 if post-build-variant-condition{matching-criterion=RDR_POS, value=3}, CanIfTxPduCanId=822 if post-build-variant-condition{matching-criterion=RDR_POS, value=4}, CanIfTxPduCanId=950 if post-build-variant-condition{matching-criterion=RDR_POS, value=5}, CanIfTxPduCanId=1078 if post-build-variant-condition{matching-criterion=RDR_POS, value=6}, CanIfTxPduCanId=1206 if post-build-variant-condition{matching-criterion=RDR_POS, value=7}, CanIfTxPduBufferRef=CanIfInitCfg/CHNL_2ad3227b, CanIfTxPduRef=EcucPduCollection/RDR_DETECTION_217_220_oPCAN_RADAR_a9b6fdbc_Tx
        RDR_DETECTION_221_224_oPCAN_RADAR_0a312094_Tx: CanIfTxPduCanId=311 if post-build-variant-condition{matching-criterion=RDR_POS, value=0}, CanIfTxPduCanIdType=STANDARD_FD_CAN, CanIfTxPduDlc=64, CanIfTxPduUserTxConfirmationName=PduR_CanIfTxConfirmation, CanIfTxPduUserTxConfirmationUL=PDUR, CanIfTxPduCanId=439 if post-build-variant-condition{matching-criterion=RDR_POS, value=1}, CanIfTxPduCanId=567 if post-build-variant-condition{matching-criterion=RDR_POS, value=2}, CanIfTxPduCanId=695 if post-build-variant-condition{matching-criterion=RDR_POS, value=3}, CanIfTxPduCanId=823 if post-build-variant-condition{matching-criterion=RDR_POS, value=4}, CanIfTxPduCanId=951 if post-build-variant-condition{matching-criterion=RDR_POS, value=5}, CanIfTxPduCanId=1079 if post-build-variant-condition{matching-criterion=RDR_POS, value=6}, CanIfTxPduCanId=1207 if post-build-variant-condition{matching-criterion=RDR_POS, value=7}, CanIfTxPduBufferRef=CanIfInitCfg/CHNL_2ad3227b, CanIfTxPduRef=EcucPduCollection/RDR_DETECTION_221_224_oPCAN_RADAR_8b56c0d7_Tx
        RDR_DETECTION_225_228_oPCAN_RADAR_df27a0ce_Tx: CanIfTxPduCanId=312 if post-build-variant-condition{matching-criterion=RDR_POS, value=0}, CanIfTxPduCanIdType=STANDARD_FD_CAN, CanIfTxPduDlc=64, CanIfTxPduUserTxConfirmationName=PduR_CanIfTxConfirmation, CanIfTxPduUserTxConfirmationUL=PDUR, CanIfTxPduCanId=440 if post-build-variant-condition{matching-criterion=RDR_POS, value=1}, CanIfTxPduCanId=568 if post-build-variant-condition{matching-criterion=RDR_POS, value=2}, CanIfTxPduCanId=696 if post-build-variant-condition{matching-criterion=RDR_POS, value=3}, CanIfTxPduCanId=824 if post-build-variant-condition{matching-criterion=RDR_POS, value=4}, CanIfTxPduCanId=952 if post-build-variant-condition{matching-criterion=RDR_POS, value=5}, CanIfTxPduCanId=1080 if post-build-variant-condition{matching-criterion=RDR_POS, value=6}, CanIfTxPduCanId=1208 if post-build-variant-condition{matching-criterion=RDR_POS, value=7}, CanIfTxPduBufferRef=CanIfInitCfg/CHNL_2ad3227b, CanIfTxPduRef=EcucPduCollection/RDR_DETECTION_225_228_oPCAN_RADAR_522a547d_Tx
        RDR_DETECTION_229_232_oPCAN_RADAR_ccff9d7b_Tx: CanIfTxPduCanId=313 if post-build-variant-condition{matching-criterion=RDR_POS, value=0}, CanIfTxPduCanIdType=STANDARD_FD_CAN, CanIfTxPduDlc=64, CanIfTxPduUserTxConfirmationName=PduR_CanIfTxConfirmation, CanIfTxPduUserTxConfirmationUL=PDUR, CanIfTxPduCanId=441 if post-build-variant-condition{matching-criterion=RDR_POS, value=1}, CanIfTxPduCanId=569 if post-build-variant-condition{matching-criterion=RDR_POS, value=2}, CanIfTxPduCanId=697 if post-build-variant-condition{matching-criterion=RDR_POS, value=3}, CanIfTxPduCanId=825 if post-build-variant-condition{matching-criterion=RDR_POS, value=4}, CanIfTxPduCanId=953 if post-build-variant-condition{matching-criterion=RDR_POS, value=5}, CanIfTxPduCanId=1081 if post-build-variant-condition{matching-criterion=RDR_POS, value=6}, CanIfTxPduCanId=1209 if post-build-variant-condition{matching-criterion=RDR_POS, value=7}, CanIfTxPduBufferRef=CanIfInitCfg/CHNL_2ad3227b, CanIfTxPduRef=EcucPduCollection/RDR_DETECTION_229_232_oPCAN_RADAR_c55d5eb5_Tx
        RDR_DETECTION_233_236_oPCAN_RADAR_c6245ec2_Tx: CanIfTxPduCanId=314 if post-build-variant-condition{matching-criterion=RDR_POS, value=0}, CanIfTxPduCanIdType=STANDARD_FD_CAN, CanIfTxPduDlc=64, CanIfTxPduUserTxConfirmationName=PduR_CanIfTxConfirmation, CanIfTxPduUserTxConfirmationUL=PDUR, CanIfTxPduCanId=442 if post-build-variant-condition{matching-criterion=RDR_POS, value=1}, CanIfTxPduCanId=570 if post-build-variant-condition{matching-criterion=RDR_POS, value=2}, CanIfTxPduCanId=698 if post-build-variant-condition{matching-criterion=RDR_POS, value=3}, CanIfTxPduCanId=826 if post-build-variant-condition{matching-criterion=RDR_POS, value=4}, CanIfTxPduCanId=954 if post-build-variant-condition{matching-criterion=RDR_POS, value=5}, CanIfTxPduCanId=1082 if post-build-variant-condition{matching-criterion=RDR_POS, value=6}, CanIfTxPduCanId=1210 if post-build-variant-condition{matching-criterion=RDR_POS, value=7}, CanIfTxPduBufferRef=CanIfInitCfg/CHNL_2ad3227b, CanIfTxPduRef=EcucPduCollection/RDR_DETECTION_233_236_oPCAN_RADAR_9528659a_Tx
        RDR_DETECTION_237_240_oPCAN_RADAR_eea1e4b3_Tx: CanIfTxPduCanId=315 if post-build-variant-condition{matching-criterion=RDR_POS, value=0}, CanIfTxPduCanIdType=STANDARD_FD_CAN, CanIfTxPduDlc=64, CanIfTxPduUserTxConfirmationName=PduR_CanIfTxConfirmation, CanIfTxPduUserTxConfirmationUL=PDUR, CanIfTxPduCanId=443 if post-build-variant-condition{matching-criterion=RDR_POS, value=1}, CanIfTxPduCanId=571 if post-build-variant-condition{matching-criterion=RDR_POS, value=2}, CanIfTxPduCanId=699 if post-build-variant-condition{matching-criterion=RDR_POS, value=3}, CanIfTxPduCanId=827 if post-build-variant-condition{matching-criterion=RDR_POS, value=4}, CanIfTxPduCanId=955 if post-build-variant-condition{matching-criterion=RDR_POS, value=5}, CanIfTxPduCanId=1083 if post-build-variant-condition{matching-criterion=RDR_POS, value=6}, CanIfTxPduCanId=1211 if post-build-variant-condition{matching-criterion=RDR_POS, value=7}, CanIfTxPduBufferRef=CanIfInitCfg/CHNL_2ad3227b, CanIfTxPduRef=EcucPduCollection/RDR_DETECTION_237_240_oPCAN_RADAR_b2dbe68d_Tx
        RDR_DETECTION_241_244_oPCAN_RADAR_9b92d37e_Tx: CanIfTxPduCanId=316 if post-build-variant-condition{matching-criterion=RDR_POS, value=0}, CanIfTxPduCanIdType=STANDARD_FD_CAN, CanIfTxPduDlc=64, CanIfTxPduUserTxConfirmationName=PduR_CanIfTxConfirmation, CanIfTxPduUserTxConfirmationUL=PDUR, CanIfTxPduCanId=444 if post-build-variant-condition{matching-criterion=RDR_POS, value=1}, CanIfTxPduCanId=572 if post-build-variant-condition{matching-criterion=RDR_POS, value=2}, CanIfTxPduCanId=700 if post-build-variant-condition{matching-criterion=RDR_POS, value=3}, CanIfTxPduCanId=828 if post-build-variant-condition{matching-criterion=RDR_POS, value=4}, CanIfTxPduCanId=956 if post-build-variant-condition{matching-criterion=RDR_POS, value=5}, CanIfTxPduCanId=1084 if post-build-variant-condition{matching-criterion=RDR_POS, value=6}, CanIfTxPduCanId=1212 if post-build-variant-condition{matching-criterion=RDR_POS, value=7}, CanIfTxPduBufferRef=CanIfInitCfg/CHNL_2ad3227b, CanIfTxPduRef=EcucPduCollection/RDR_DETECTION_241_244_oPCAN_RADAR_cb8b26ad_Tx
        RDR_DETECTION_245_248_oPCAN_RADAR_4e845324_Tx: CanIfTxPduCanId=317 if post-build-variant-condition{matching-criterion=RDR_POS, value=0}, CanIfTxPduCanIdType=STANDARD_FD_CAN, CanIfTxPduDlc=64, CanIfTxPduUserTxConfirmationName=PduR_CanIfTxConfirmation, CanIfTxPduUserTxConfirmationUL=PDUR, CanIfTxPduCanId=445 if post-build-variant-condition{matching-criterion=RDR_POS, value=1}, CanIfTxPduCanId=573 if post-build-variant-condition{matching-criterion=RDR_POS, value=2}, CanIfTxPduCanId=701 if post-build-variant-condition{matching-criterion=RDR_POS, value=3}, CanIfTxPduCanId=829 if post-build-variant-condition{matching-criterion=RDR_POS, value=4}, CanIfTxPduCanId=957 if post-build-variant-condition{matching-criterion=RDR_POS, value=5}, CanIfTxPduCanId=1085 if post-build-variant-condition{matching-criterion=RDR_POS, value=6}, CanIfTxPduCanId=1213 if post-build-variant-condition{matching-criterion=RDR_POS, value=7}, CanIfTxPduBufferRef=CanIfInitCfg/CHNL_2ad3227b, CanIfTxPduRef=EcucPduCollection/RDR_DETECTION_245_248_oPCAN_RADAR_12f7b207_Tx
        RDR_DETECTION_249_252_oPCAN_RADAR_5d5c6e91_Tx: CanIfTxPduCanId=318 if post-build-variant-condition{matching-criterion=RDR_POS, value=0}, CanIfTxPduCanIdType=STANDARD_FD_CAN, CanIfTxPduDlc=64, CanIfTxPduUserTxConfirmationName=PduR_CanIfTxConfirmation, CanIfTxPduUserTxConfirmationUL=PDUR, CanIfTxPduCanId=446 if post-build-variant-condition{matching-criterion=RDR_POS, value=1}, CanIfTxPduCanId=574 if post-build-variant-condition{matching-criterion=RDR_POS, value=2}, CanIfTxPduCanId=702 if post-build-variant-condition{matching-criterion=RDR_POS, value=3}, CanIfTxPduCanId=830 if post-build-variant-condition{matching-criterion=RDR_POS, value=4}, CanIfTxPduCanId=958 if post-build-variant-condition{matching-criterion=RDR_POS, value=5}, CanIfTxPduCanId=1086 if post-build-variant-condition{matching-criterion=RDR_POS, value=6}, CanIfTxPduCanId=1214 if post-build-variant-condition{matching-criterion=RDR_POS, value=7}, CanIfTxPduBufferRef=CanIfInitCfg/CHNL_2ad3227b, CanIfTxPduRef=EcucPduCollection/RDR_DETECTION_249_252_oPCAN_RADAR_8580b8cf_Tx
        RDR_DETECTION_253_256_oPCAN_RADAR_5787ad28_Tx: CanIfTxPduCanId=319 if post-build-variant-condition{matching-criterion=RDR_POS, value=0}, CanIfTxPduCanIdType=STANDARD_FD_CAN, CanIfTxPduDlc=64, CanIfTxPduUserTxConfirmationName=PduR_CanIfTxConfirmation, CanIfTxPduUserTxConfirmationUL=PDUR, CanIfTxPduCanId=447 if post-build-variant-condition{matching-criterion=RDR_POS, value=1}, CanIfTxPduCanId=575 if post-build-variant-condition{matching-criterion=RDR_POS, value=2}, CanIfTxPduCanId=703 if post-build-variant-condition{matching-criterion=RDR_POS, value=3}, CanIfTxPduCanId=831 if post-build-variant-condition{matching-criterion=RDR_POS, value=4}, CanIfTxPduCanId=959 if post-build-variant-condition{matching-criterion=RDR_POS, value=5}, CanIfTxPduCanId=1087 if post-build-variant-condition{matching-criterion=RDR_POS, value=6}, CanIfTxPduCanId=1215 if post-build-variant-condition{matching-criterion=RDR_POS, value=7}, CanIfTxPduBufferRef=CanIfInitCfg/CHNL_2ad3227b, CanIfTxPduRef=EcucPduCollection/RDR_DETECTION_253_256_oPCAN_RADAR_d5f583e0_Tx
        RDR_DETECTION_257_260_oPCAN_RADAR_4a296eca_Tx: CanIfTxPduCanId=320 if post-build-variant-condition{matching-criterion=RDR_POS, value=0}, CanIfTxPduCanIdType=STANDARD_FD_CAN, CanIfTxPduDlc=64, CanIfTxPduUserTxConfirmationName=PduR_CanIfTxConfirmation, CanIfTxPduUserTxConfirmationUL=PDUR, CanIfTxPduCanId=448 if post-build-variant-condition{matching-criterion=RDR_POS, value=1}, CanIfTxPduCanId=576 if post-build-variant-condition{matching-criterion=RDR_POS, value=2}, CanIfTxPduCanId=704 if post-build-variant-condition{matching-criterion=RDR_POS, value=3}, CanIfTxPduCanId=832 if post-build-variant-condition{matching-criterion=RDR_POS, value=4}, CanIfTxPduCanId=960 if post-build-variant-condition{matching-criterion=RDR_POS, value=5}, CanIfTxPduCanId=1088 if post-build-variant-condition{matching-criterion=RDR_POS, value=6}, CanIfTxPduCanId=1216 if post-build-variant-condition{matching-criterion=RDR_POS, value=7}, CanIfTxPduBufferRef=CanIfInitCfg/CHNL_2ad3227b, CanIfTxPduRef=EcucPduCollection/RDR_DETECTION_257_260_oPCAN_RADAR_600f442f_Tx
        RDR_DETECTION_261_264_oPCAN_RADAR_eb0c7dd8_Tx: CanIfTxPduCanId=321 if post-build-variant-condition{matching-criterion=RDR_POS, value=0}, CanIfTxPduCanIdType=STANDARD_FD_CAN, CanIfTxPduDlc=64, CanIfTxPduUserTxConfirmationName=PduR_CanIfTxConfirmation, CanIfTxPduUserTxConfirmationUL=PDUR, CanIfTxPduCanId=449 if post-build-variant-condition{matching-criterion=RDR_POS, value=1}, CanIfTxPduCanId=577 if post-build-variant-condition{matching-criterion=RDR_POS, value=2}, CanIfTxPduCanId=705 if post-build-variant-condition{matching-criterion=RDR_POS, value=3}, CanIfTxPduCanId=833 if post-build-variant-condition{matching-criterion=RDR_POS, value=4}, CanIfTxPduCanId=961 if post-build-variant-condition{matching-criterion=RDR_POS, value=5}, CanIfTxPduCanId=1089 if post-build-variant-condition{matching-criterion=RDR_POS, value=6}, CanIfTxPduCanId=1217 if post-build-variant-condition{matching-criterion=RDR_POS, value=7}, CanIfTxPduBufferRef=CanIfInitCfg/CHNL_2ad3227b, CanIfTxPduRef=EcucPduCollection/RDR_DETECTION_261_264_oPCAN_RADAR_42ef7944_Tx
        RDR_DETECTION_265_268_oPCAN_RADAR_3e1afd82_Tx: CanIfTxPduCanId=322 if post-build-variant-condition{matching-criterion=RDR_POS, value=0}, CanIfTxPduCanIdType=STANDARD_FD_CAN, CanIfTxPduDlc=64, CanIfTxPduUserTxConfirmationName=PduR_CanIfTxConfirmation, CanIfTxPduUserTxConfirmationUL=PDUR, CanIfTxPduCanId=450 if post-build-variant-condition{matching-criterion=RDR_POS, value=1}, CanIfTxPduCanId=578 if post-build-variant-condition{matching-criterion=RDR_POS, value=2}, CanIfTxPduCanId=706 if post-build-variant-condition{matching-criterion=RDR_POS, value=3}, CanIfTxPduCanId=834 if post-build-variant-condition{matching-criterion=RDR_POS, value=4}, CanIfTxPduCanId=962 if post-build-variant-condition{matching-criterion=RDR_POS, value=5}, CanIfTxPduCanId=1090 if post-build-variant-condition{matching-criterion=RDR_POS, value=6}, CanIfTxPduCanId=1218 if post-build-variant-condition{matching-criterion=RDR_POS, value=7}, CanIfTxPduBufferRef=CanIfInitCfg/CHNL_2ad3227b, CanIfTxPduRef=EcucPduCollection/RDR_DETECTION_265_268_oPCAN_RADAR_9b93edee_Tx
        RDR_DETECTION_269_272_oPCAN_RADAR_2dc2c037_Tx: CanIfTxPduCanId=323 if post-build-variant-condition{matching-criterion=RDR_POS, value=0}, CanIfTxPduCanIdType=STANDARD_FD_CAN, CanIfTxPduDlc=64, CanIfTxPduUserTxConfirmationName=PduR_CanIfTxConfirmation, CanIfTxPduUserTxConfirmationUL=PDUR, CanIfTxPduCanId=451 if post-build-variant-condition{matching-criterion=RDR_POS, value=1}, CanIfTxPduCanId=579 if post-build-variant-condition{matching-criterion=RDR_POS, value=2}, CanIfTxPduCanId=707 if post-build-variant-condition{matching-criterion=RDR_POS, value=3}, CanIfTxPduCanId=835 if post-build-variant-condition{matching-criterion=RDR_POS, value=4}, CanIfTxPduCanId=963 if post-build-variant-condition{matching-criterion=RDR_POS, value=5}, CanIfTxPduCanId=1091 if post-build-variant-condition{matching-criterion=RDR_POS, value=6}, CanIfTxPduCanId=1219 if post-build-variant-condition{matching-criterion=RDR_POS, value=7}, CanIfTxPduBufferRef=CanIfInitCfg/CHNL_2ad3227b, CanIfTxPduRef=EcucPduCollection/RDR_DETECTION_269_272_oPCAN_RADAR_0ce4e726_Tx
        RDR_DETECTION_273_276_oPCAN_RADAR_2719038e_Tx: CanIfTxPduCanId=324 if post-build-variant-condition{matching-criterion=RDR_POS, value=0}, CanIfTxPduCanIdType=STANDARD_FD_CAN, CanIfTxPduDlc=64, CanIfTxPduUserTxConfirmationName=PduR_CanIfTxConfirmation, CanIfTxPduUserTxConfirmationUL=PDUR, CanIfTxPduCanId=452 if post-build-variant-condition{matching-criterion=RDR_POS, value=1}, CanIfTxPduCanId=580 if post-build-variant-condition{matching-criterion=RDR_POS, value=2}, CanIfTxPduCanId=708 if post-build-variant-condition{matching-criterion=RDR_POS, value=3}, CanIfTxPduCanId=836 if post-build-variant-condition{matching-criterion=RDR_POS, value=4}, CanIfTxPduCanId=964 if post-build-variant-condition{matching-criterion=RDR_POS, value=5}, CanIfTxPduCanId=1092 if post-build-variant-condition{matching-criterion=RDR_POS, value=6}, CanIfTxPduCanId=1220 if post-build-variant-condition{matching-criterion=RDR_POS, value=7}, CanIfTxPduBufferRef=CanIfInitCfg/CHNL_2ad3227b, CanIfTxPduRef=EcucPduCollection/RDR_DETECTION_273_276_oPCAN_RADAR_5c91dc09_Tx
        RDR_DETECTION_277_280_oPCAN_RADAR_65ca4ad9_Tx: CanIfTxPduCanId=325 if post-build-variant-condition{matching-criterion=RDR_POS, value=0}, CanIfTxPduCanIdType=STANDARD_FD_CAN, CanIfTxPduDlc=64, CanIfTxPduUserTxConfirmationName=PduR_CanIfTxConfirmation, CanIfTxPduUserTxConfirmationUL=PDUR, CanIfTxPduCanId=453 if post-build-variant-condition{matching-criterion=RDR_POS, value=1}, CanIfTxPduCanId=581 if post-build-variant-condition{matching-criterion=RDR_POS, value=2}, CanIfTxPduCanId=709 if post-build-variant-condition{matching-criterion=RDR_POS, value=3}, CanIfTxPduCanId=837 if post-build-variant-condition{matching-criterion=RDR_POS, value=4}, CanIfTxPduCanId=965 if post-build-variant-condition{matching-criterion=RDR_POS, value=5}, CanIfTxPduCanId=1093 if post-build-variant-condition{matching-criterion=RDR_POS, value=6}, CanIfTxPduCanId=1221 if post-build-variant-condition{matching-criterion=RDR_POS, value=7}, CanIfTxPduBufferRef=CanIfInitCfg/CHNL_2ad3227b, CanIfTxPduRef=EcucPduCollection/RDR_DETECTION_277_280_oPCAN_RADAR_8401d0ef_Tx
        RDR_DETECTION_281_284_oPCAN_RADAR_63a432eb_Tx: CanIfTxPduCanId=326 if post-build-variant-condition{matching-criterion=RDR_POS, value=0}, CanIfTxPduCanIdType=STANDARD_FD_CAN, CanIfTxPduDlc=64, CanIfTxPduUserTxConfirmationName=PduR_CanIfTxConfirmation, CanIfTxPduUserTxConfirmationUL=PDUR, CanIfTxPduCanId=454 if post-build-variant-condition{matching-criterion=RDR_POS, value=1}, CanIfTxPduCanId=582 if post-build-variant-condition{matching-criterion=RDR_POS, value=2}, CanIfTxPduCanId=710 if post-build-variant-condition{matching-criterion=RDR_POS, value=3}, CanIfTxPduCanId=838 if post-build-variant-condition{matching-criterion=RDR_POS, value=4}, CanIfTxPduCanId=966 if post-build-variant-condition{matching-criterion=RDR_POS, value=5}, CanIfTxPduCanId=1094 if post-build-variant-condition{matching-criterion=RDR_POS, value=6}, CanIfTxPduCanId=1222 if post-build-variant-condition{matching-criterion=RDR_POS, value=7}, CanIfTxPduBufferRef=CanIfInitCfg/CHNL_2ad3227b, CanIfTxPduRef=EcucPduCollection/RDR_DETECTION_281_284_oPCAN_RADAR_4a30ea59_Tx
        RDR_DETECTION_285_288_oPCAN_RADAR_b6b2b2b1_Tx: CanIfTxPduCanId=327 if post-build-variant-condition{matching-criterion=RDR_POS, value=0}, CanIfTxPduCanIdType=STANDARD_FD_CAN, CanIfTxPduDlc=64, CanIfTxPduUserTxConfirmationName=PduR_CanIfTxConfirmation, CanIfTxPduUserTxConfirmationUL=PDUR, CanIfTxPduCanId=455 if post-build-variant-condition{matching-criterion=RDR_POS, value=1}, CanIfTxPduCanId=583 if post-build-variant-condition{matching-criterion=RDR_POS, value=2}, CanIfTxPduCanId=711 if post-build-variant-condition{matching-criterion=RDR_POS, value=3}, CanIfTxPduCanId=839 if post-build-variant-condition{matching-criterion=RDR_POS, value=4}, CanIfTxPduCanId=967 if post-build-variant-condition{matching-criterion=RDR_POS, value=5}, CanIfTxPduCanId=1095 if post-build-variant-condition{matching-criterion=RDR_POS, value=6}, CanIfTxPduCanId=1223 if post-build-variant-condition{matching-criterion=RDR_POS, value=7}, CanIfTxPduBufferRef=CanIfInitCfg/CHNL_2ad3227b, CanIfTxPduRef=EcucPduCollection/RDR_DETECTION_285_288_oPCAN_RADAR_934c7ef3_Tx
        RDR_DETECTION_289_292_oPCAN_RADAR_a56a8f04_Tx: CanIfTxPduCanId=328 if post-build-variant-condition{matching-criterion=RDR_POS, value=0}, CanIfTxPduCanIdType=STANDARD_FD_CAN, CanIfTxPduDlc=64, CanIfTxPduUserTxConfirmationName=PduR_CanIfTxConfirmation, CanIfTxPduUserTxConfirmationUL=PDUR, CanIfTxPduCanId=456 if post-build-variant-condition{matching-criterion=RDR_POS, value=1}, CanIfTxPduCanId=584 if post-build-variant-condition{matching-criterion=RDR_POS, value=2}, CanIfTxPduCanId=712 if post-build-variant-condition{matching-criterion=RDR_POS, value=3}, CanIfTxPduCanId=840 if post-build-variant-condition{matching-criterion=RDR_POS, value=4}, CanIfTxPduCanId=968 if post-build-variant-condition{matching-criterion=RDR_POS, value=5}, CanIfTxPduCanId=1096 if post-build-variant-condition{matching-criterion=RDR_POS, value=6}, CanIfTxPduCanId=1224 if post-build-variant-condition{matching-criterion=RDR_POS, value=7}, CanIfTxPduBufferRef=CanIfInitCfg/CHNL_2ad3227b, CanIfTxPduRef=EcucPduCollection/RDR_DETECTION_289_292_oPCAN_RADAR_043b743b_Tx
        RDR_DETECTION_293_296_oPCAN_RADAR_afb14cbd_Tx: CanIfTxPduCanId=329 if post-build-variant-condition{matching-criterion=RDR_POS, value=0}, CanIfTxPduCanIdType=STANDARD_FD_CAN, CanIfTxPduDlc=64, CanIfTxPduUserTxConfirmationName=PduR_CanIfTxConfirmation, CanIfTxPduUserTxConfirmationUL=PDUR, CanIfTxPduCanId=457 if post-build-variant-condition{matching-criterion=RDR_POS, value=1}, CanIfTxPduCanId=585 if post-build-variant-condition{matching-criterion=RDR_POS, value=2}, CanIfTxPduCanId=713 if post-build-variant-condition{matching-criterion=RDR_POS, value=3}, CanIfTxPduCanId=841 if post-build-variant-condition{matching-criterion=RDR_POS, value=4}, CanIfTxPduCanId=969 if post-build-variant-condition{matching-criterion=RDR_POS, value=5}, CanIfTxPduCanId=1097 if post-build-variant-condition{matching-criterion=RDR_POS, value=6}, CanIfTxPduCanId=1225 if post-build-variant-condition{matching-criterion=RDR_POS, value=7}, CanIfTxPduBufferRef=CanIfInitCfg/CHNL_2ad3227b, CanIfTxPduRef=EcucPduCollection/RDR_DETECTION_293_296_oPCAN_RADAR_544e4f14_Tx
        RDR_DETECTION_297_300_oPCAN_RADAR_ae4c7b41_Tx: CanIfTxPduCanId=330 if post-build-variant-condition{matching-criterion=RDR_POS, value=0}, CanIfTxPduCanIdType=STANDARD_FD_CAN, CanIfTxPduDlc=64, CanIfTxPduUserTxConfirmationName=PduR_CanIfTxConfirmation, CanIfTxPduUserTxConfirmationUL=PDUR, CanIfTxPduCanId=458 if post-build-variant-condition{matching-criterion=RDR_POS, value=1}, CanIfTxPduCanId=586 if post-build-variant-condition{matching-criterion=RDR_POS, value=2}, CanIfTxPduCanId=714 if post-build-variant-condition{matching-criterion=RDR_POS, value=3}, CanIfTxPduCanId=842 if post-build-variant-condition{matching-criterion=RDR_POS, value=4}, CanIfTxPduCanId=970 if post-build-variant-condition{matching-criterion=RDR_POS, value=5}, CanIfTxPduCanId=1098 if post-build-variant-condition{matching-criterion=RDR_POS, value=6}, CanIfTxPduCanId=1226 if post-build-variant-condition{matching-criterion=RDR_POS, value=7}, CanIfTxPduBufferRef=CanIfInitCfg/CHNL_2ad3227b, CanIfTxPduRef=EcucPduCollection/RDR_DETECTION_297_300_oPCAN_RADAR_984db28e_Tx
        RDR_DETECTION_301_304_oPCAN_RADAR_88f5c12b_Tx: CanIfTxPduCanId=331 if post-build-variant-condition{matching-criterion=RDR_POS, value=0}, CanIfTxPduCanIdType=STANDARD_FD_CAN, CanIfTxPduDlc=64, CanIfTxPduUserTxConfirmationName=PduR_CanIfTxConfirmation, CanIfTxPduUserTxConfirmationUL=PDUR, CanIfTxPduCanId=459 if post-build-variant-condition{matching-criterion=RDR_POS, value=1}, CanIfTxPduCanId=587 if post-build-variant-condition{matching-criterion=RDR_POS, value=2}, CanIfTxPduCanId=715 if post-build-variant-condition{matching-criterion=RDR_POS, value=3}, CanIfTxPduCanId=843 if post-build-variant-condition{matching-criterion=RDR_POS, value=4}, CanIfTxPduCanId=971 if post-build-variant-condition{matching-criterion=RDR_POS, value=5}, CanIfTxPduCanId=1099 if post-build-variant-condition{matching-criterion=RDR_POS, value=6}, CanIfTxPduCanId=1227 if post-build-variant-condition{matching-criterion=RDR_POS, value=7}, CanIfTxPduBufferRef=CanIfInitCfg/CHNL_2ad3227b, CanIfTxPduRef=EcucPduCollection/RDR_DETECTION_301_304_oPCAN_RADAR_8325835f_Tx
        RDR_DETECTION_305_308_oPCAN_RADAR_5de34171_Tx: CanIfTxPduCanId=332 if post-build-variant-condition{matching-criterion=RDR_POS, value=0}, CanIfTxPduCanIdType=STANDARD_FD_CAN, CanIfTxPduDlc=64, CanIfTxPduUserTxConfirmationName=PduR_CanIfTxConfirmation, CanIfTxPduUserTxConfirmationUL=PDUR, CanIfTxPduCanId=460 if post-build-variant-condition{matching-criterion=RDR_POS, value=1}, CanIfTxPduCanId=588 if post-build-variant-condition{matching-criterion=RDR_POS, value=2}, CanIfTxPduCanId=716 if post-build-variant-condition{matching-criterion=RDR_POS, value=3}, CanIfTxPduCanId=844 if post-build-variant-condition{matching-criterion=RDR_POS, value=4}, CanIfTxPduCanId=972 if post-build-variant-condition{matching-criterion=RDR_POS, value=5}, CanIfTxPduCanId=1100 if post-build-variant-condition{matching-criterion=RDR_POS, value=6}, CanIfTxPduCanId=1228 if post-build-variant-condition{matching-criterion=RDR_POS, value=7}, CanIfTxPduBufferRef=CanIfInitCfg/CHNL_2ad3227b, CanIfTxPduRef=EcucPduCollection/RDR_DETECTION_305_308_oPCAN_RADAR_5a5917f5_Tx
        RDR_DETECTION_309_312_oPCAN_RADAR_4e3b7cc4_Tx: CanIfTxPduCanId=333 if post-build-variant-condition{matching-criterion=RDR_POS, value=0}, CanIfTxPduCanIdType=STANDARD_FD_CAN, CanIfTxPduDlc=64, CanIfTxPduUserTxConfirmationName=PduR_CanIfTxConfirmation, CanIfTxPduUserTxConfirmationUL=PDUR, CanIfTxPduCanId=461 if post-build-variant-condition{matching-criterion=RDR_POS, value=1}, CanIfTxPduCanId=589 if post-build-variant-condition{matching-criterion=RDR_POS, value=2}, CanIfTxPduCanId=717 if post-build-variant-condition{matching-criterion=RDR_POS, value=3}, CanIfTxPduCanId=845 if post-build-variant-condition{matching-criterion=RDR_POS, value=4}, CanIfTxPduCanId=973 if post-build-variant-condition{matching-criterion=RDR_POS, value=5}, CanIfTxPduCanId=1101 if post-build-variant-condition{matching-criterion=RDR_POS, value=6}, CanIfTxPduCanId=1229 if post-build-variant-condition{matching-criterion=RDR_POS, value=7}, CanIfTxPduBufferRef=CanIfInitCfg/CHNL_2ad3227b, CanIfTxPduRef=EcucPduCollection/RDR_DETECTION_309_312_oPCAN_RADAR_cd2e1d3d_Tx
        RDR_DETECTION_313_316_oPCAN_RADAR_44e0bf7d_Tx: CanIfTxPduCanId=334 if post-build-variant-condition{matching-criterion=RDR_POS, value=0}, CanIfTxPduCanIdType=STANDARD_FD_CAN, CanIfTxPduDlc=64, CanIfTxPduUserTxConfirmationName=PduR_CanIfTxConfirmation, CanIfTxPduUserTxConfirmationUL=PDUR, CanIfTxPduCanId=462 if post-build-variant-condition{matching-criterion=RDR_POS, value=1}, CanIfTxPduCanId=590 if post-build-variant-condition{matching-criterion=RDR_POS, value=2}, CanIfTxPduCanId=718 if post-build-variant-condition{matching-criterion=RDR_POS, value=3}, CanIfTxPduCanId=846 if post-build-variant-condition{matching-criterion=RDR_POS, value=4}, CanIfTxPduCanId=974 if post-build-variant-condition{matching-criterion=RDR_POS, value=5}, CanIfTxPduCanId=1102 if post-build-variant-condition{matching-criterion=RDR_POS, value=6}, CanIfTxPduCanId=1230 if post-build-variant-condition{matching-criterion=RDR_POS, value=7}, CanIfTxPduBufferRef=CanIfInitCfg/CHNL_2ad3227b, CanIfTxPduRef=EcucPduCollection/RDR_DETECTION_313_316_oPCAN_RADAR_9d5b2612_Tx
        RDR_DETECTION_317_320_oPCAN_RADAR_594e7c9f_Tx: CanIfTxPduCanId=335 if post-build-variant-condition{matching-criterion=RDR_POS, value=0}, CanIfTxPduCanIdType=STANDARD_FD_CAN, CanIfTxPduDlc=64, CanIfTxPduUserTxConfirmationName=PduR_CanIfTxConfirmation, CanIfTxPduUserTxConfirmationUL=PDUR, CanIfTxPduCanId=463 if post-build-variant-condition{matching-criterion=RDR_POS, value=1}, CanIfTxPduCanId=591 if post-build-variant-condition{matching-criterion=RDR_POS, value=2}, CanIfTxPduCanId=719 if post-build-variant-condition{matching-criterion=RDR_POS, value=3}, CanIfTxPduCanId=847 if post-build-variant-condition{matching-criterion=RDR_POS, value=4}, CanIfTxPduCanId=975 if post-build-variant-condition{matching-criterion=RDR_POS, value=5}, CanIfTxPduCanId=1103 if post-build-variant-condition{matching-criterion=RDR_POS, value=6}, CanIfTxPduCanId=1231 if post-build-variant-condition{matching-criterion=RDR_POS, value=7}, CanIfTxPduBufferRef=CanIfInitCfg/CHNL_2ad3227b, CanIfTxPduRef=EcucPduCollection/RDR_DETECTION_317_320_oPCAN_RADAR_28a1e1dd_Tx
        RDR_DETECTION_321_324_oPCAN_RADAR_f86b6f8d_Tx: CanIfTxPduCanId=336 if post-build-variant-condition{matching-criterion=RDR_POS, value=0}, CanIfTxPduCanIdType=STANDARD_FD_CAN, CanIfTxPduDlc=64, CanIfTxPduUserTxConfirmationName=PduR_CanIfTxConfirmation, CanIfTxPduUserTxConfirmationUL=PDUR, CanIfTxPduCanId=464 if post-build-variant-condition{matching-criterion=RDR_POS, value=1}, CanIfTxPduCanId=592 if post-build-variant-condition{matching-criterion=RDR_POS, value=2}, CanIfTxPduCanId=720 if post-build-variant-condition{matching-criterion=RDR_POS, value=3}, CanIfTxPduCanId=848 if post-build-variant-condition{matching-criterion=RDR_POS, value=4}, CanIfTxPduCanId=976 if post-build-variant-condition{matching-criterion=RDR_POS, value=5}, CanIfTxPduCanId=1104 if post-build-variant-condition{matching-criterion=RDR_POS, value=6}, CanIfTxPduCanId=1232 if post-build-variant-condition{matching-criterion=RDR_POS, value=7}, CanIfTxPduBufferRef=CanIfInitCfg/CHNL_2ad3227b, CanIfTxPduRef=EcucPduCollection/RDR_DETECTION_321_324_oPCAN_RADAR_0a41dcb6_Tx
        RDR_DETECTION_325_328_oPCAN_RADAR_2d7defd7_Tx: CanIfTxPduCanId=337 if post-build-variant-condition{matching-criterion=RDR_POS, value=0}, CanIfTxPduCanIdType=STANDARD_FD_CAN, CanIfTxPduDlc=64, CanIfTxPduUserTxConfirmationName=PduR_CanIfTxConfirmation, CanIfTxPduUserTxConfirmationUL=PDUR, CanIfTxPduCanId=465 if post-build-variant-condition{matching-criterion=RDR_POS, value=1}, CanIfTxPduCanId=593 if post-build-variant-condition{matching-criterion=RDR_POS, value=2}, CanIfTxPduCanId=721 if post-build-variant-condition{matching-criterion=RDR_POS, value=3}, CanIfTxPduCanId=849 if post-build-variant-condition{matching-criterion=RDR_POS, value=4}, CanIfTxPduCanId=977 if post-build-variant-condition{matching-criterion=RDR_POS, value=5}, CanIfTxPduCanId=1105 if post-build-variant-condition{matching-criterion=RDR_POS, value=6}, CanIfTxPduCanId=1233 if post-build-variant-condition{matching-criterion=RDR_POS, value=7}, CanIfTxPduBufferRef=CanIfInitCfg/CHNL_2ad3227b, CanIfTxPduRef=EcucPduCollection/RDR_DETECTION_325_328_oPCAN_RADAR_d33d481c_Tx
        RDR_DETECTION_329_332_oPCAN_RADAR_3ea5d262_Tx: CanIfTxPduCanId=338 if post-build-variant-condition{matching-criterion=RDR_POS, value=0}, CanIfTxPduCanIdType=STANDARD_FD_CAN, CanIfTxPduDlc=64, CanIfTxPduUserTxConfirmationName=PduR_CanIfTxConfirmation, CanIfTxPduUserTxConfirmationUL=PDUR, CanIfTxPduCanId=466 if post-build-variant-condition{matching-criterion=RDR_POS, value=1}, CanIfTxPduCanId=594 if post-build-variant-condition{matching-criterion=RDR_POS, value=2}, CanIfTxPduCanId=722 if post-build-variant-condition{matching-criterion=RDR_POS, value=3}, CanIfTxPduCanId=850 if post-build-variant-condition{matching-criterion=RDR_POS, value=4}, CanIfTxPduCanId=978 if post-build-variant-condition{matching-criterion=RDR_POS, value=5}, CanIfTxPduCanId=1106 if post-build-variant-condition{matching-criterion=RDR_POS, value=6}, CanIfTxPduCanId=1234 if post-build-variant-condition{matching-criterion=RDR_POS, value=7}, CanIfTxPduBufferRef=CanIfInitCfg/CHNL_2ad3227b, CanIfTxPduRef=EcucPduCollection/RDR_DETECTION_329_332_oPCAN_RADAR_444a42d4_Tx
        RDR_DETECTION_333_336_oPCAN_RADAR_347e11db_Tx: CanIfTxPduCanId=339 if post-build-variant-condition{matching-criterion=RDR_POS, value=0}, CanIfTxPduCanIdType=STANDARD_FD_CAN, CanIfTxPduDlc=64, CanIfTxPduUserTxConfirmationName=PduR_CanIfTxConfirmation, CanIfTxPduUserTxConfirmationUL=PDUR, CanIfTxPduCanId=467 if post-build-variant-condition{matching-criterion=RDR_POS, value=1}, CanIfTxPduCanId=595 if post-build-variant-condition{matching-criterion=RDR_POS, value=2}, CanIfTxPduCanId=723 if post-build-variant-condition{matching-criterion=RDR_POS, value=3}, CanIfTxPduCanId=851 if post-build-variant-condition{matching-criterion=RDR_POS, value=4}, CanIfTxPduCanId=979 if post-build-variant-condition{matching-criterion=RDR_POS, value=5}, CanIfTxPduCanId=1107 if post-build-variant-condition{matching-criterion=RDR_POS, value=6}, CanIfTxPduCanId=1235 if post-build-variant-condition{matching-criterion=RDR_POS, value=7}, CanIfTxPduBufferRef=CanIfInitCfg/CHNL_2ad3227b, CanIfTxPduRef=EcucPduCollection/RDR_DETECTION_333_336_oPCAN_RADAR_143f79fb_Tx
        RDR_DETECTION_337_340_oPCAN_RADAR_1cfbabaa_Tx: CanIfTxPduCanId=340 if post-build-variant-condition{matching-criterion=RDR_POS, value=0}, CanIfTxPduCanIdType=STANDARD_FD_CAN, CanIfTxPduDlc=64, CanIfTxPduUserTxConfirmationName=PduR_CanIfTxConfirmation, CanIfTxPduUserTxConfirmationUL=PDUR, CanIfTxPduCanId=468 if post-build-variant-condition{matching-criterion=RDR_POS, value=1}, CanIfTxPduCanId=596 if post-build-variant-condition{matching-criterion=RDR_POS, value=2}, CanIfTxPduCanId=724 if post-build-variant-condition{matching-criterion=RDR_POS, value=3}, CanIfTxPduCanId=852 if post-build-variant-condition{matching-criterion=RDR_POS, value=4}, CanIfTxPduCanId=980 if post-build-variant-condition{matching-criterion=RDR_POS, value=5}, CanIfTxPduCanId=1108 if post-build-variant-condition{matching-criterion=RDR_POS, value=6}, CanIfTxPduCanId=1236 if post-build-variant-condition{matching-criterion=RDR_POS, value=7}, CanIfTxPduBufferRef=CanIfInitCfg/CHNL_2ad3227b, CanIfTxPduRef=EcucPduCollection/RDR_DETECTION_337_340_oPCAN_RADAR_33ccfaec_Tx
