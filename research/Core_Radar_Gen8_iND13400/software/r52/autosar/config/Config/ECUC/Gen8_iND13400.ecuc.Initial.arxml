[part 21 of 24: package /InitialEcuC]
AUTOSAR XML (schema 00053)
package /InitialEcuC  (continued)
  module config Com  (continued)
    ComConfig  (continued)
      242 x ComSignalGroup, all with ComTransferProperty=PENDING:  (continued)
        SG_TrackerObject060_oRDR_TRACKER_OBJ_060_oPCAN_RADAR_68bfc7eb_Tx: ComSystemTemplateSignalGroupRef=SG_TrackerObject060
          49 x ComGroupSignal, all with ComSignalEndianness=BIG_ENDIAN, ComSignalInitValue=0, ComTransferProperty=PENDING:
            OBJ_ACCELERATION_LAT_060_oRDR_TRACKER_OBJ_060_oPCAN_RADAR_669b9c9c_Tx: ComBitPosition=177, ComBitSize=10, ComSignalType=UINT16, ComSystemTemplateSystemSignalRef=OBJ_ACCELERATION_LAT_060
            OBJ_ACCELERATION_LAT_ERR_060_oRDR_TRACKER_OBJ_060_oPCAN_RADAR_b36fa622_Tx: ComBitPosition=223, ComBitSize=8, ComSignalType=UINT8, ComSystemTemplateSystemSignalRef=OBJ_ACCELERATION_LAT_ERR_060
            OBJ_ACCELERATION_LONG_060_oRDR_TRACKER_OBJ_060_oPCAN_RADAR_146bc57c_Tx: ComBitPosition=193, ComBitSize=10, ComSignalType=UINT16, ComSystemTemplateSystemSignalRef=OBJ_ACCELERATION_LONG_060
            OBJ_ACCELERATION_LONG_ERR_060_oRDR_TRACKER_OBJ_060_oPCAN_RADAR_acca0388_Tx: ComBitPosition=215, ComBitSize=8, ComSignalType=UINT8, ComSystemTemplateSystemSignalRef=OBJ_ACCELERATION_LONG_ERR_060
            OBJ_ACCEL_ERR_CRR_COEF_060_oRDR_TRACKER_OBJ_060_oPCAN_RADAR_0c6922ee_Tx: ComBitPosition=431, ComBitSize=8, ComSignalType=UINT8, ComSystemTemplateSystemSignalRef=OBJ_ACCEL_ERR_CRR_COEF_060
            OBJ_ALIVE_TIME_060_oRDR_TRACKER_OBJ_060_oPCAN_RADAR_740a8ec0_Tx: ComBitPosition=255, ComBitSize=16, ComSignalType=UINT16, ComSystemTemplateSystemSignalRef=OBJ_ALIVE_TIME_060
            OBJ_CLS_TYPE1_060_oRDR_TRACKER_OBJ_060_oPCAN_RADAR_e3d16fe6_Tx: ComBitPosition=271, ComBitSize=4, ComSignalType=UINT8, ComSystemTemplateSystemSignalRef=OBJ_CLS_TYPE1_060
            OBJ_CLS_TYPE1_PROB_060_oRDR_TRACKER_OBJ_060_oPCAN_RADAR_4b89b815_Tx: ComBitPosition=303, ComBitSize=8, ComSignalType=UINT8, ComSystemTemplateSystemSignalRef=OBJ_CLS_TYPE1_PROB_060
            OBJ_CLS_TYPE2_060_oRDR_TRACKER_OBJ_060_oPCAN_RADAR_ae396f81_Tx: ComBitPosition=267, ComBitSize=4, ComSignalType=UINT8, ComSystemTemplateSystemSignalRef=OBJ_CLS_TYPE2_060
            OBJ_CLS_TYPE2_PROB_060_oRDR_TRACKER_OBJ_060_oPCAN_RADAR_82bda318_Tx: ComBitPosition=311, ComBitSize=8, ComSignalType=UINT8, ComSystemTemplateSystemSignalRef=OBJ_CLS_TYPE2_PROB_060
            OBJ_CLS_TYPE3_060_oRDR_TRACKER_OBJ_060_oPCAN_RADAR_23b19263_Tx: ComBitPosition=279, ComBitSize=4, ComSignalType=UINT8, ComSystemTemplateSystemSignalRef=OBJ_CLS_TYPE3_060
            OBJ_CLS_TYPE3_PROB_060_oRDR_TRACKER_OBJ_060_oPCAN_RADAR_c5ae55e3_Tx: ComBitPosition=319, ComBitSize=8, ComSignalType=UINT8, ComSystemTemplateSystemSignalRef=OBJ_CLS_TYPE3_PROB_060
            OBJ_CLS_TYPE4_060_oRDR_TRACKER_OBJ_060_oPCAN_RADAR_35e96f4f_Tx: ComBitPosition=275, ComBitSize=4, ComSignalType=UINT8, ComSystemTemplateSystemSignalRef=OBJ_CLS_TYPE4_060
            OBJ_CLS_TYPE4_PROB_060_oRDR_TRACKER_OBJ_060_oPCAN_RADAR_cba49343_Tx: ComBitPosition=327, ComBitSize=8, ComSignalType=UINT8, ComSystemTemplateSystemSignalRef=OBJ_CLS_TYPE4_PROB_060
            OBJ_CLS_TYPE5_060_oRDR_TRACKER_OBJ_060_oPCAN_RADAR_b86192ad_Tx: ComBitPosition=287, ComBitSize=4, ComSignalType=UINT8, ComSystemTemplateSystemSignalRef=OBJ_CLS_TYPE5_060
            OBJ_CLS_TYPE5_PROB_060_oRDR_TRACKER_OBJ_060_oPCAN_RADAR_8cb765b8_Tx: ComBitPosition=335, ComBitSize=8, ComSignalType=UINT8, ComSystemTemplateSystemSignalRef=OBJ_CLS_TYPE5_PROB_060
            OBJ_CLS_TYPE6_060_oRDR_TRACKER_OBJ_060_oPCAN_RADAR_f58992ca_Tx: ComBitPosition=282, ComBitSize=4, ComSignalType=UINT8, ComSystemTemplateSystemSignalRef=OBJ_CLS_TYPE6_060
            OBJ_CLS_TYPE6_PROB_060_oRDR_TRACKER_OBJ_060_oPCAN_RADAR_45837eb5_Tx: ComBitPosition=343, ComBitSize=8, ComSignalType=UINT8, ComSystemTemplateSystemSignalRef=OBJ_CLS_TYPE6_PROB_060
            OBJ_DIMENSION_LENGTH_060_oRDR_TRACKER_OBJ_060_oPCAN_RADAR_a14f3ca2_Tx: ComBitPosition=37, ComBitSize=12, ComSignalType=UINT16, ComSystemTemplateSystemSignalRef=OBJ_DIMENSION_LENGTH_060
            OBJ_DIMENSION_LENGTH_ERR_060_oRDR_TRACKER_OBJ_060_oPCAN_RADAR_9ab723d8_Tx: ComBitPosition=41, ComBitSize=10, ComSignalType=UINT16, ComSystemTemplateSystemSignalRef=OBJ_DIMENSION_LENGTH_ERR_060
            OBJ_DIMENSION_WIDTH_060_oRDR_TRACKER_OBJ_060_oPCAN_RADAR_8281cb0f_Tx: ComBitPosition=17, ComBitSize=10, ComSignalType=UINT16, ComSystemTemplateSystemSignalRef=OBJ_DIMENSION_WIDTH_060
            OBJ_DIMENSION_WIDTH_ERR_060_oRDR_TRACKER_OBJ_060_oPCAN_RADAR_62230ce7_Tx: ComBitPosition=23, ComBitSize=6, ComSignalType=UINT8, ComSystemTemplateSystemSignalRef=OBJ_DIMENSION_WIDTH_ERR_060
            OBJ_EXISTENCE_PROB_060_oRDR_TRACKER_OBJ_060_oPCAN_RADAR_893d4f32_Tx: ComBitPosition=229, ComBitSize=14, ComSignalType=UINT16, ComSystemTemplateSystemSignalRef=OBJ_EXISTENCE_PROB_060
            OBJ_GROUP_ID_060_oRDR_TRACKER_OBJ_060_oPCAN_RADAR_004f5b9f_Tx: ComBitPosition=405, ComBitSize=6, ComSignalType=UINT8, ComSystemTemplateSystemSignalRef=OBJ_GROUP_ID_060
            OBJ_ID_060_oRDR_TRACKER_OBJ_060_oPCAN_RADAR_f3617098_Tx: ComBitPosition=7, ComBitSize=8, ComSignalType=UINT8, ComSystemTemplateSystemSignalRef=OBJ_ID_060
            OBJ_MEASUREMENT_STATUS_060_oRDR_TRACKER_OBJ_060_oPCAN_RADAR_8cb30225_Tx: ComBitPosition=14, ComBitSize=3, ComSignalType=UINT8, ComSystemTemplateSystemSignalRef=OBJ_MEASUREMENT_STATUS_060
            OBJ_MH_CRC16_060_oRDR_TRACKER_OBJ_060_oPCAN_RADAR_f0d3b519_Tx: ComBitPosition=495, ComBitSize=16, ComSignalType=UINT16, ComSystemTemplateSystemSignalRef=OBJ_MH_CRC16_060
            OBJ_MH_CYCLE_COUNTER_060_oRDR_TRACKER_OBJ_060_oPCAN_RADAR_8137eff8_Tx: ComBitPosition=487, ComBitSize=8, ComSignalType=UINT8, ComSystemTemplateSystemSignalRef=OBJ_MH_CYCLE_COUNTER_060
            OBJ_MOVEMENT_STATUS_060_oRDR_TRACKER_OBJ_060_oPCAN_RADAR_a31d9769_Tx: ComBitPosition=196, ComBitSize=3, ComSignalType=UINT8, ComSystemTemplateSystemSignalRef=OBJ_MOVEMENT_STATUS_060
            OBJ_POS_ERR_CRR_COEF_060_oRDR_TRACKER_OBJ_060_oPCAN_RADAR_33625753_Tx: ComBitPosition=415, ComBitSize=8, ComSignalType=UINT8, ComSystemTemplateSystemSignalRef=OBJ_POS_ERR_CRR_COEF_060
            OBJ_POS_LAT_060_oRDR_TRACKER_OBJ_060_oPCAN_RADAR_d1cdaa1f_Tx: ComBitPosition=79, ComBitSize=16, ComSignalType=UINT16, ComSystemTemplateSystemSignalRef=OBJ_POS_LAT_060
            OBJ_POS_LAT_ERR_060_oRDR_TRACKER_OBJ_060_oPCAN_RADAR_d581fa28_Tx: ComBitPosition=103, ComBitSize=8, ComSignalType=UINT8, ComSystemTemplateSystemSignalRef=OBJ_POS_LAT_ERR_060
            OBJ_POS_LONG_060_oRDR_TRACKER_OBJ_060_oPCAN_RADAR_606d41d0_Tx: ComBitPosition=63, ComBitSize=16, ComSignalType=UINT16, ComSystemTemplateSystemSignalRef=OBJ_POS_LONG_060
            OBJ_POS_LONG_ERR_060_oRDR_TRACKER_OBJ_060_oPCAN_RADAR_4c7904ca_Tx: ComBitPosition=95, ComBitSize=8, ComSignalType=UINT8, ComSystemTemplateSystemSignalRef=OBJ_POS_LONG_ERR_060
            OBJ_RCS_060_oRDR_TRACKER_OBJ_060_oPCAN_RADAR_f302fc18_Tx: ComBitPosition=351, ComBitSize=7, ComSignalType=UINT8, ComSystemTemplateSystemSignalRef=OBJ_RCS_060
            OBJ_REF_PT_LAT_OFFSET_060_oRDR_TRACKER_OBJ_060_oPCAN_RADAR_063f976d_Tx: ComBitPosition=370, ComBitSize=14, ComSignalType=UINT16, ComSystemTemplateSystemSignalRef=OBJ_REF_PT_LAT_OFFSET_060
            OBJ_REF_PT_LONG_OFFSET_060_oRDR_TRACKER_OBJ_060_oPCAN_RADAR_496d676e_Tx: ComBitPosition=357, ComBitSize=14, ComSignalType=UINT16, ComSystemTemplateSystemSignalRef=OBJ_REF_PT_LONG_OFFSET_060
            OBJ_TIMESTAMP_OFFSET_060_oRDR_TRACKER_OBJ_060_oPCAN_RADAR_f3aefc4e_Tx: ComBitPosition=247, ComBitSize=8, ComSignalType=UINT8, ComSystemTemplateSystemSignalRef=OBJ_TIMESTAMP_OFFSET_060
            OBJ_TRACK_MOTION_MODEL_060_oRDR_TRACKER_OBJ_060_oPCAN_RADAR_3fadfd93_Tx: ComBitPosition=9, ComBitSize=2, ComSignalType=UINT8, ComSystemTemplateSystemSignalRef=OBJ_TRACK_MOTION_MODEL_060
            OBJ_VEH_TRACK_FLAG_060_oRDR_TRACKER_OBJ_060_oPCAN_RADAR_bd870bce_Tx: ComBitPosition=10, ComBitSize=1, ComSignalType=BOOLEAN, ComSystemTemplateSystemSignalRef=OBJ_VEH_TRACK_FLAG_060
            OBJ_VELOCITY_ERR_CRR_COEF_060_oRDR_TRACKER_OBJ_060_oPCAN_RADAR_9a186ab2_Tx: ComBitPosition=423, ComBitSize=8, ComSignalType=UINT8, ComSystemTemplateSystemSignalRef=OBJ_VELOCITY_ERR_CRR_COEF_060
            OBJ_VELOCITY_LAT_060_oRDR_TRACKER_OBJ_060_oPCAN_RADAR_95aeef38_Tx: ComBitPosition=126, ComBitSize=15, ComSignalType=UINT16, ComSystemTemplateSystemSignalRef=OBJ_VELOCITY_LAT_060
            OBJ_VELOCITY_LAT_ERR_060_oRDR_TRACKER_OBJ_060_oPCAN_RADAR_a1549f69_Tx: ComBitPosition=151, ComBitSize=8, ComSignalType=UINT8, ComSystemTemplateSystemSignalRef=OBJ_VELOCITY_LAT_ERR_060
            OBJ_VELOCITY_LONG_060_oRDR_TRACKER_OBJ_060_oPCAN_RADAR_c52397fe_Tx: ComBitPosition=110, ComBitSize=15, ComSignalType=UINT16, ComSystemTemplateSystemSignalRef=OBJ_VELOCITY_LONG_060
            OBJ_VELOCITY_LONG_ERR_060_oRDR_TRACKER_OBJ_060_oPCAN_RADAR_4dd6a0a9_Tx: ComBitPosition=143, ComBitSize=8, ComSignalType=UINT8, ComSystemTemplateSystemSignalRef=OBJ_VELOCITY_LONG_ERR_060
            OBJ_YAW_ANGLE_060_oRDR_TRACKER_OBJ_060_oPCAN_RADAR_7912ab78_Tx: ComBitPosition=155, ComBitSize=12, ComSignalType=UINT16, ComSystemTemplateSystemSignalRef=OBJ_YAW_ANGLE_060
            OBJ_YAW_ANGLE_ERR_060_oRDR_TRACKER_OBJ_060_oPCAN_RADAR_ac1fadaf_Tx: ComBitPosition=175, ComBitSize=7, ComSignalType=UINT8, ComSystemTemplateSystemSignalRef=OBJ_YAW_ANGLE_ERR_060
            OBJ_YAW_RATE_060_oRDR_TRACKER_OBJ_060_oPCAN_RADAR_5c9d8e3f_Tx: ComBitPosition=399, ComBitSize=10, ComSignalType=UINT16, ComSystemTemplateSystemSignalRef=OBJ_YAW_RATE_060
            OBJ_YAW_RATE_ERR_060_oRDR_TRACKER_OBJ_060_oPCAN_RADAR_634519e3_Tx: ComBitPosition=388, ComBitSize=5, ComSignalType=UINT8, ComSystemTemplateSystemSignalRef=OBJ_YAW_RATE_ERR_060
        SG_TrackerObject061_oRDR_TRACKER_OBJ_061_oPCAN_RADAR_91ab4f58_Tx: ComSystemTemplateSignalGroupRef=SG_TrackerObject061
          49 x ComGroupSignal, all with ComSignalEndianness=BIG_ENDIAN, ComSignalInitValue=0, ComTransferProperty=PENDING:
            OBJ_ACCELERATION_LAT_061_oRDR_TRACKER_OBJ_061_oPCAN_RADAR_9f8f142f_Tx: ComBitPosition=177, ComBitSize=10, ComSignalType=UINT16, ComSystemTemplateSystemSignalRef=OBJ_ACCELERATION_LAT_061
            OBJ_ACCELERATION_LAT_ERR_061_oRDR_TRACKER_OBJ_061_oPCAN_RADAR_4a7b2e91_Tx: ComBitPosition=223, ComBitSize=8, ComSignalType=UINT8, ComSystemTemplateSystemSignalRef=OBJ_ACCELERATION_LAT_ERR_061
            OBJ_ACCELERATION_LONG_061_oRDR_TRACKER_OBJ_061_oPCAN_RADAR_ed7f4dcf_Tx: ComBitPosition=193, ComBitSize=10, ComSignalType=UINT16, ComSystemTemplateSystemSignalRef=OBJ_ACCELERATION_LONG_061
            OBJ_ACCELERATION_LONG_ERR_061_oRDR_TRACKER_OBJ_061_oPCAN_RADAR_55de8b3b_Tx: ComBitPosition=215, ComBitSize=8, ComSignalType=UINT8, ComSystemTemplateSystemSignalRef=OBJ_ACCELERATION_LONG_ERR_061
            OBJ_ACCEL_ERR_CRR_COEF_061_oRDR_TRACKER_OBJ_061_oPCAN_RADAR_f57daa5d_Tx: ComBitPosition=431, ComBitSize=8, ComSignalType=UINT8, ComSystemTemplateSystemSignalRef=OBJ_ACCEL_ERR_CRR_COEF_061
            OBJ_ALIVE_TIME_061_oRDR_TRACKER_OBJ_061_oPCAN_RADAR_8d1e0673_Tx: ComBitPosition=255, ComBitSize=16, ComSignalType=UINT16, ComSystemTemplateSystemSignalRef=OBJ_ALIVE_TIME_061
            OBJ_CLS_TYPE1_061_oRDR_TRACKER_OBJ_061_oPCAN_RADAR_1ac5e755_Tx: ComBitPosition=271, ComBitSize=4, ComSignalType=UINT8, ComSystemTemplateSystemSignalRef=OBJ_CLS_TYPE1_061
            OBJ_CLS_TYPE1_PROB_061_oRDR_TRACKER_OBJ_061_oPCAN_RADAR_b29d30a6_Tx: ComBitPosition=303, ComBitSize=8, ComSignalType=UINT8, ComSystemTemplateSystemSignalRef=OBJ_CLS_TYPE1_PROB_061
            OBJ_CLS_TYPE2_061_oRDR_TRACKER_OBJ_061_oPCAN_RADAR_572de732_Tx: ComBitPosition=267, ComBitSize=4, ComSignalType=UINT8, ComSystemTemplateSystemSignalRef=OBJ_CLS_TYPE2_061
            OBJ_CLS_TYPE2_PROB_061_oRDR_TRACKER_OBJ_061_oPCAN_RADAR_7ba92bab_Tx: ComBitPosition=311, ComBitSize=8, ComSignalType=UINT8, ComSystemTemplateSystemSignalRef=OBJ_CLS_TYPE2_PROB_061
            OBJ_CLS_TYPE3_061_oRDR_TRACKER_OBJ_061_oPCAN_RADAR_daa51ad0_Tx: ComBitPosition=279, ComBitSize=4, ComSignalType=UINT8, ComSystemTemplateSystemSignalRef=OBJ_CLS_TYPE3_061
            OBJ_CLS_TYPE3_PROB_061_oRDR_TRACKER_OBJ_061_oPCAN_RADAR_3cbadd50_Tx: ComBitPosition=319, ComBitSize=8, ComSignalType=UINT8, ComSystemTemplateSystemSignalRef=OBJ_CLS_TYPE3_PROB_061
            OBJ_CLS_TYPE4_061_oRDR_TRACKER_OBJ_061_oPCAN_RADAR_ccfde7fc_Tx: ComBitPosition=275, ComBitSize=4, ComSignalType=UINT8, ComSystemTemplateSystemSignalRef=OBJ_CLS_TYPE4_061
            OBJ_CLS_TYPE4_PROB_061_oRDR_TRACKER_OBJ_061_oPCAN_RADAR_32b01bf0_Tx: ComBitPosition=327, ComBitSize=8, ComSignalType=UINT8, ComSystemTemplateSystemSignalRef=OBJ_CLS_TYPE4_PROB_061
            OBJ_CLS_TYPE5_061_oRDR_TRACKER_OBJ_061_oPCAN_RADAR_41751a1e_Tx: ComBitPosition=287, ComBitSize=4, ComSignalType=UINT8, ComSystemTemplateSystemSignalRef=OBJ_CLS_TYPE5_061
            OBJ_CLS_TYPE5_PROB_061_oRDR_TRACKER_OBJ_061_oPCAN_RADAR_75a3ed0b_Tx: ComBitPosition=335, ComBitSize=8, ComSignalType=UINT8, ComSystemTemplateSystemSignalRef=OBJ_CLS_TYPE5_PROB_061
            OBJ_CLS_TYPE6_061_oRDR_TRACKER_OBJ_061_oPCAN_RADAR_0c9d1a79_Tx: ComBitPosition=282, ComBitSize=4, ComSignalType=UINT8, ComSystemTemplateSystemSignalRef=OBJ_CLS_TYPE6_061
            OBJ_CLS_TYPE6_PROB_061_oRDR_TRACKER_OBJ_061_oPCAN_RADAR_bc97f606_Tx: ComBitPosition=343, ComBitSize=8, ComSignalType=UINT8, ComSystemTemplateSystemSignalRef=OBJ_CLS_TYPE6_PROB_061
            OBJ_DIMENSION_LENGTH_061_oRDR_TRACKER_OBJ_061_oPCAN_RADAR_585bb411_Tx: ComBitPosition=37, ComBitSize=12, ComSignalType=UINT16, ComSystemTemplateSystemSignalRef=OBJ_DIMENSION_LENGTH_061
            OBJ_DIMENSION_LENGTH_ERR_061_oRDR_TRACKER_OBJ_061_oPCAN_RADAR_63a3ab6b_Tx: ComBitPosition=41, ComBitSize=10, ComSignalType=UINT16, ComSystemTemplateSystemSignalRef=OBJ_DIMENSION_LENGTH_ERR_061
            OBJ_DIMENSION_WIDTH_061_oRDR_TRACKER_OBJ_061_oPCAN_RADAR_7b9543bc_Tx: ComBitPosition=17, ComBitSize=10, ComSignalType=UINT16, ComSystemTemplateSystemSignalRef=OBJ_DIMENSION_WIDTH_061
            OBJ_DIMENSION_WIDTH_ERR_061_oRDR_TRACKER_OBJ_061_oPCAN_RADAR_9b378454_Tx: ComBitPosition=23, ComBitSize=6, ComSignalType=UINT8, ComSystemTemplateSystemSignalRef=OBJ_DIMENSION_WIDTH_ERR_061
            OBJ_EXISTENCE_PROB_061_oRDR_TRACKER_OBJ_061_oPCAN_RADAR_7029c781_Tx: ComBitPosition=229, ComBitSize=14, ComSignalType=UINT16, ComSystemTemplateSystemSignalRef=OBJ_EXISTENCE_PROB_061
            OBJ_GROUP_ID_061_oRDR_TRACKER_OBJ_061_oPCAN_RADAR_f95bd32c_Tx: ComBitPosition=405, ComBitSize=6, ComSignalType=UINT8, ComSystemTemplateSystemSignalRef=OBJ_GROUP_ID_061
            OBJ_ID_061_oRDR_TRACKER_OBJ_061_oPCAN_RADAR_0a75f82b_Tx: ComBitPosition=7, ComBitSize=8, ComSignalType=UINT8, ComSystemTemplateSystemSignalRef=OBJ_ID_061
            OBJ_MEASUREMENT_STATUS_061_oRDR_TRACKER_OBJ_061_oPCAN_RADAR_75a78a96_Tx: ComBitPosition=14, ComBitSize=3, ComSignalType=UINT8, ComSystemTemplateSystemSignalRef=OBJ_MEASUREMENT_STATUS_061
            OBJ_MH_CRC16_061_oRDR_TRACKER_OBJ_061_oPCAN_RADAR_09c73daa_Tx: ComBitPosition=495, ComBitSize=16, ComSignalType=UINT16, ComSystemTemplateSystemSignalRef=OBJ_MH_CRC16_061
            OBJ_MH_CYCLE_COUNTER_061_oRDR_TRACKER_OBJ_061_oPCAN_RADAR_7823674b_Tx: ComBitPosition=487, ComBitSize=8, ComSignalType=UINT8, ComSystemTemplateSystemSignalRef=OBJ_MH_CYCLE_COUNTER_061
            OBJ_MOVEMENT_STATUS_061_oRDR_TRACKER_OBJ_061_oPCAN_RADAR_5a091fda_Tx: ComBitPosition=196, ComBitSize=3, ComSignalType=UINT8, ComSystemTemplateSystemSignalRef=OBJ_MOVEMENT_STATUS_061
            OBJ_POS_ERR_CRR_COEF_061_oRDR_TRACKER_OBJ_061_oPCAN_RADAR_ca76dfe0_Tx: ComBitPosition=415, ComBitSize=8, ComSignalType=UINT8, ComSystemTemplateSystemSignalRef=OBJ_POS_ERR_CRR_COEF_061
            OBJ_POS_LAT_061_oRDR_TRACKER_OBJ_061_oPCAN_RADAR_28d922ac_Tx: ComBitPosition=79, ComBitSize=16, ComSignalType=UINT16, ComSystemTemplateSystemSignalRef=OBJ_POS_LAT_061
            OBJ_POS_LAT_ERR_061_oRDR_TRACKER_OBJ_061_oPCAN_RADAR_2c95729b_Tx: ComBitPosition=103, ComBitSize=8, ComSignalType=UINT8, ComSystemTemplateSystemSignalRef=OBJ_POS_LAT_ERR_061
            OBJ_POS_LONG_061_oRDR_TRACKER_OBJ_061_oPCAN_RADAR_9979c963_Tx: ComBitPosition=63, ComBitSize=16, ComSignalType=UINT16, ComSystemTemplateSystemSignalRef=OBJ_POS_LONG_061
            OBJ_POS_LONG_ERR_061_oRDR_TRACKER_OBJ_061_oPCAN_RADAR_b56d8c79_Tx: ComBitPosition=95, ComBitSize=8, ComSignalType=UINT8, ComSystemTemplateSystemSignalRef=OBJ_POS_LONG_ERR_061
            OBJ_RCS_061_oRDR_TRACKER_OBJ_061_oPCAN_RADAR_0a1674ab_Tx: ComBitPosition=351, ComBitSize=7, ComSignalType=UINT8, ComSystemTemplateSystemSignalRef=OBJ_RCS_061
            OBJ_REF_PT_LAT_OFFSET_061_oRDR_TRACKER_OBJ_061_oPCAN_RADAR_ff2b1fde_Tx: ComBitPosition=370, ComBitSize=14, ComSignalType=UINT16, ComSystemTemplateSystemSignalRef=OBJ_REF_PT_LAT_OFFSET_061
            OBJ_REF_PT_LONG_OFFSET_061_oRDR_TRACKER_OBJ_061_oPCAN_RADAR_b079efdd_Tx: ComBitPosition=357, ComBitSize=14, ComSignalType=UINT16, ComSystemTemplateSystemSignalRef=OBJ_REF_PT_LONG_OFFSET_061
            OBJ_TIMESTAMP_OFFSET_061_oRDR_TRACKER_OBJ_061_oPCAN_RADAR_0aba74fd_Tx: ComBitPosition=247, ComBitSize=8, ComSignalType=UINT8, ComSystemTemplateSystemSignalRef=OBJ_TIMESTAMP_OFFSET_061
            OBJ_TRACK_MOTION_MODEL_061_oRDR_TRACKER_OBJ_061_oPCAN_RADAR_c6b97520_Tx: ComBitPosition=9, ComBitSize=2, ComSignalType=UINT8, ComSystemTemplateSystemSignalRef=OBJ_TRACK_MOTION_MODEL_061
            OBJ_VEH_TRACK_FLAG_061_oRDR_TRACKER_OBJ_061_oPCAN_RADAR_4493837d_Tx: ComBitPosition=10, ComBitSize=1, ComSignalType=BOOLEAN, ComSystemTemplateSystemSignalRef=OBJ_VEH_TRACK_FLAG_061
            OBJ_VELOCITY_ERR_CRR_COEF_061_oRDR_TRACKER_OBJ_061_oPCAN_RADAR_630ce201_Tx: ComBitPosition=423, ComBitSize=8, ComSignalType=UINT8, ComSystemTemplateSystemSignalRef=OBJ_VELOCITY_ERR_CRR_COEF_061
            OBJ_VELOCITY_LAT_061_oRDR_TRACKER_OBJ_061_oPCAN_RADAR_6cba678b_Tx: ComBitPosition=126, ComBitSize=15, ComSignalType=UINT16, ComSystemTemplateSystemSignalRef=OBJ_VELOCITY_LAT_061
            OBJ_VELOCITY_LAT_ERR_061_oRDR_TRACKER_OBJ_061_oPCAN_RADAR_584017da_Tx: ComBitPosition=151, ComBitSize=8, ComSignalType=UINT8, ComSystemTemplateSystemSignalRef=OBJ_VELOCITY_LAT_ERR_061
            OBJ_VELOCITY_LONG_061_oRDR_TRACKER_OBJ_061_oPCAN_RADAR_3c371f4d_Tx: ComBitPosition=110, ComBitSize=15, ComSignalType=UINT16, ComSystemTemplateSystemSignalRef=OBJ_VELOCITY_LONG_061
            OBJ_VELOCITY_LONG_ERR_061_oRDR_TRACKER_OBJ_061_oPCAN_RADAR_b4c2281a_Tx: ComBitPosition=143, ComBitSize=8, ComSignalType=UINT8, ComSystemTemplateSystemSignalRef=OBJ_VELOCITY_LONG_ERR_061
            OBJ_YAW_ANGLE_061_oRDR_TRACKER_OBJ_061_oPCAN_RADAR_800623cb_Tx: ComBitPosition=155, ComBitSize=12, ComSignalType=UINT16, ComSystemTemplateSystemSignalRef=OBJ_YAW_ANGLE_061
            OBJ_YAW_ANGLE_ERR_061_oRDR_TRACKER_OBJ_061_oPCAN_RADAR_550b251c_Tx: ComBitPosition=175, ComBitSize=7, ComSignalType=UINT8, ComSystemTemplateSystemSignalRef=OBJ_YAW_ANGLE_ERR_061
            OBJ_YAW_RATE_061_oRDR_TRACKER_OBJ_061_oPCAN_RADAR_a589068c_Tx: ComBitPosition=399, ComBitSize=10, ComSignalType=UINT16, ComSystemTemplateSystemSignalRef=OBJ_YAW_RATE_061
            OBJ_YAW_RATE_ERR_061_oRDR_TRACKER_OBJ_061_oPCAN_RADAR_9a519150_Tx: ComBitPosition=388, ComBitSize=5, ComSignalType=UINT8, ComSystemTemplateSystemSignalRef=OBJ_YAW_RATE_ERR_061
        SG_TrackerObject062_oRDR_TRACKER_OBJ_062_oPCAN_RADAR_41e7d0cc_Tx: ComSystemTemplateSignalGroupRef=SG_TrackerObject062
          49 x ComGroupSignal, all with ComSignalEndianness=BIG_ENDIAN, ComSignalInitValue=0, ComTransferProperty=PENDING:
            OBJ_ACCELERATION_LAT_062_oRDR_TRACKER_OBJ_062_oPCAN_RADAR_4fc38bbb_Tx: ComBitPosition=177, ComBitSize=10, ComSignalType=UINT16, ComSystemTemplateSystemSignalRef=OBJ_ACCELERATION_LAT_062
            OBJ_ACCELERATION_LAT_ERR_062_oRDR_TRACKER_OBJ_062_oPCAN_RADAR_9a37b105_Tx: ComBitPosition=223, ComBitSize=8, ComSignalType=UINT8, ComSystemTemplateSystemSignalRef=OBJ_ACCELERATION_LAT_ERR_062
            OBJ_ACCELERATION_LONG_062_oRDR_TRACKER_OBJ_062_oPCAN_RADAR_3d33d25b_Tx: ComBitPosition=193, ComBitSize=10, ComSignalType=UINT16, ComSystemTemplateSystemSignalRef=OBJ_ACCELERATION_LONG_062
            OBJ_ACCELERATION_LONG_ERR_062_oRDR_TRACKER_OBJ_062_oPCAN_RADAR_859214af_Tx: ComBitPosition=215, ComBitSize=8, ComSignalType=UINT8, ComSystemTemplateSystemSignalRef=OBJ_ACCELERATION_LONG_ERR_062
            OBJ_ACCEL_ERR_CRR_COEF_062_oRDR_TRACKER_OBJ_062_oPCAN_RADAR_253135c9_Tx: ComBitPosition=431, ComBitSize=8, ComSignalType=UINT8, ComSystemTemplateSystemSignalRef=OBJ_ACCEL_ERR_CRR_COEF_062
            OBJ_ALIVE_TIME_062_oRDR_TRACKER_OBJ_062_oPCAN_RADAR_5d5299e7_Tx: ComBitPosition=255, ComBitSize=16, ComSignalType=UINT16, ComSystemTemplateSystemSignalRef=OBJ_ALIVE_TIME_062
            OBJ_CLS_TYPE1_062_oRDR_TRACKER_OBJ_062_oPCAN_RADAR_ca8978c1_Tx: ComBitPosition=271, ComBitSize=4, ComSignalType=UINT8, ComSystemTemplateSystemSignalRef=OBJ_CLS_TYPE1_062
            OBJ_CLS_TYPE1_PROB_062_oRDR_TRACKER_OBJ_062_oPCAN_RADAR_62d1af32_Tx: ComBitPosition=303, ComBitSize=8, ComSignalType=UINT8, ComSystemTemplateSystemSignalRef=OBJ_CLS_TYPE1_PROB_062
            OBJ_CLS_TYPE2_062_oRDR_TRACKER_OBJ_062_oPCAN_RADAR_876178a6_Tx: ComBitPosition=267, ComBitSize=4, ComSignalType=UINT8, ComSystemTemplateSystemSignalRef=OBJ_CLS_TYPE2_062
            OBJ_CLS_TYPE2_PROB_062_oRDR_TRACKER_OBJ_062_oPCAN_RADAR_abe5b43f_Tx: ComBitPosition=311, ComBitSize=8, ComSignalType=UINT8, ComSystemTemplateSystemSignalRef=OBJ_CLS_TYPE2_PROB_062
            OBJ_CLS_TYPE3_062_oRDR_TRACKER_OBJ_062_oPCAN_RADAR_0ae98544_Tx: ComBitPosition=279, ComBitSize=4, ComSignalType=UINT8, ComSystemTemplateSystemSignalRef=OBJ_CLS_TYPE3_062
            OBJ_CLS_TYPE3_PROB_062_oRDR_TRACKER_OBJ_062_oPCAN_RADAR_ecf642c4_Tx: ComBitPosition=319, ComBitSize=8, ComSignalType=UINT8, ComSystemTemplateSystemSignalRef=OBJ_CLS_TYPE3_PROB_062
            OBJ_CLS_TYPE4_062_oRDR_TRACKER_OBJ_062_oPCAN_RADAR_1cb17868_Tx: ComBitPosition=275, ComBitSize=4, ComSignalType=UINT8, ComSystemTemplateSystemSignalRef=OBJ_CLS_TYPE4_062
            OBJ_CLS_TYPE4_PROB_062_oRDR_TRACKER_OBJ_062_oPCAN_RADAR_e2fc8464_Tx: ComBitPosition=327, ComBitSize=8, ComSignalType=UINT8, ComSystemTemplateSystemSignalRef=OBJ_CLS_TYPE4_PROB_062
            OBJ_CLS_TYPE5_062_oRDR_TRACKER_OBJ_062_oPCAN_RADAR_9139858a_Tx: ComBitPosition=287, ComBitSize=4, ComSignalType=UINT8, ComSystemTemplateSystemSignalRef=OBJ_CLS_TYPE5_062
            OBJ_CLS_TYPE5_PROB_062_oRDR_TRACKER_OBJ_062_oPCAN_RADAR_a5ef729f_Tx: ComBitPosition=335, ComBitSize=8, ComSignalType=UINT8, ComSystemTemplateSystemSignalRef=OBJ_CLS_TYPE5_PROB_062
            OBJ_CLS_TYPE6_062_oRDR_TRACKER_OBJ_062_oPCAN_RADAR_dcd185ed_Tx: ComBitPosition=282, ComBitSize=4, ComSignalType=UINT8, ComSystemTemplateSystemSignalRef=OBJ_CLS_TYPE6_062
            OBJ_CLS_TYPE6_PROB_062_oRDR_TRACKER_OBJ_062_oPCAN_RADAR_6cdb6992_Tx: ComBitPosition=343, ComBitSize=8, ComSignalType=UINT8, ComSystemTemplateSystemSignalRef=OBJ_CLS_TYPE6_PROB_062
            OBJ_DIMENSION_LENGTH_062_oRDR_TRACKER_OBJ_062_oPCAN_RADAR_88172b85_Tx: ComBitPosition=37, ComBitSize=12, ComSignalType=UINT16, ComSystemTemplateSystemSignalRef=OBJ_DIMENSION_LENGTH_062
            OBJ_DIMENSION_LENGTH_ERR_062_oRDR_TRACKER_OBJ_062_oPCAN_RADAR_b3ef34ff_Tx: ComBitPosition=41, ComBitSize=10, ComSignalType=UINT16, ComSystemTemplateSystemSignalRef=OBJ_DIMENSION_LENGTH_ERR_062
            OBJ_DIMENSION_WIDTH_062_oRDR_TRACKER_OBJ_062_oPCAN_RADAR_abd9dc28_Tx: ComBitPosition=17, ComBitSize=10, ComSignalType=UINT16, ComSystemTemplateSystemSignalRef=OBJ_DIMENSION_WIDTH_062
            OBJ_DIMENSION_WIDTH_ERR_062_oRDR_TRACKER_OBJ_062_oPCAN_RADAR_4b7b1bc0_Tx: ComBitPosition=23, ComBitSize=6, ComSignalType=UINT8, ComSystemTemplateSystemSignalRef=OBJ_DIMENSION_WIDTH_ERR_062
            OBJ_EXISTENCE_PROB_062_oRDR_TRACKER_OBJ_062_oPCAN_RADAR_a0655815_Tx: ComBitPosition=229, ComBitSize=14, ComSignalType=UINT16, ComSystemTemplateSystemSignalRef=OBJ_EXISTENCE_PROB_062
            OBJ_GROUP_ID_062_oRDR_TRACKER_OBJ_062_oPCAN_RADAR_29174cb8_Tx: ComBitPosition=405, ComBitSize=6, ComSignalType=UINT8, ComSystemTemplateSystemSignalRef=OBJ_GROUP_ID_062
            OBJ_ID_062_oRDR_TRACKER_OBJ_062_oPCAN_RADAR_da3967bf_Tx: ComBitPosition=7, ComBitSize=8, ComSignalType=UINT8, ComSystemTemplateSystemSignalRef=OBJ_ID_062
            OBJ_MEASUREMENT_STATUS_062_oRDR_TRACKER_OBJ_062_oPCAN_RADAR_a5eb1502_Tx: ComBitPosition=14, ComBitSize=3, ComSignalType=UINT8, ComSystemTemplateSystemSignalRef=OBJ_MEASUREMENT_STATUS_062
            OBJ_MH_CRC16_062_oRDR_TRACKER_OBJ_062_oPCAN_RADAR_d98ba23e_Tx: ComBitPosition=495, ComBitSize=16, ComSignalType=UINT16, ComSystemTemplateSystemSignalRef=OBJ_MH_CRC16_062
            OBJ_MH_CYCLE_COUNTER_062_oRDR_TRACKER_OBJ_062_oPCAN_RADAR_a86ff8df_Tx: ComBitPosition=487, ComBitSize=8, ComSignalType=UINT8, ComSystemTemplateSystemSignalRef=OBJ_MH_CYCLE_COUNTER_062
            OBJ_MOVEMENT_STATUS_062_oRDR_TRACKER_OBJ_062_oPCAN_RADAR_8a45804e_Tx: ComBitPosition=196, ComBitSize=3, ComSignalType=UINT8, ComSystemTemplateSystemSignalRef=OBJ_MOVEMENT_STATUS_062
            OBJ_POS_ERR_CRR_COEF_062_oRDR_TRACKER_OBJ_062_oPCAN_RADAR_1a3a4074_Tx: ComBitPosition=415, ComBitSize=8, ComSignalType=UINT8, ComSystemTemplateSystemSignalRef=OBJ_POS_ERR_CRR_COEF_062
            OBJ_POS_LAT_062_oRDR_TRACKER_OBJ_062_oPCAN_RADAR_f895bd38_Tx: ComBitPosition=79, ComBitSize=16, ComSignalType=UINT16, ComSystemTemplateSystemSignalRef=OBJ_POS_LAT_062
            OBJ_POS_LAT_ERR_062_oRDR_TRACKER_OBJ_062_oPCAN_RADAR_fcd9ed0f_Tx: ComBitPosition=103, ComBitSize=8, ComSignalType=UINT8, ComSystemTemplateSystemSignalRef=OBJ_POS_LAT_ERR_062
            OBJ_POS_LONG_062_oRDR_TRACKER_OBJ_062_oPCAN_RADAR_493556f7_Tx: ComBitPosition=63, ComBitSize=16, ComSignalType=UINT16, ComSystemTemplateSystemSignalRef=OBJ_POS_LONG_062
            OBJ_POS_LONG_ERR_062_oRDR_TRACKER_OBJ_062_oPCAN_RADAR_652113ed_Tx: ComBitPosition=95, ComBitSize=8, ComSignalType=UINT8, ComSystemTemplateSystemSignalRef=OBJ_POS_LONG_ERR_062
            OBJ_RCS_062_oRDR_TRACKER_OBJ_062_oPCAN_RADAR_da5aeb3f_Tx: ComBitPosition=351, ComBitSize=7, ComSignalType=UINT8, ComSystemTemplateSystemSignalRef=OBJ_RCS_062
            OBJ_REF_PT_LAT_OFFSET_062_oRDR_TRACKER_OBJ_062_oPCAN_RADAR_2f67804a_Tx: ComBitPosition=370, ComBitSize=14, ComSignalType=UINT16, ComSystemTemplateSystemSignalRef=OBJ_REF_PT_LAT_OFFSET_062
            OBJ_REF_PT_LONG_OFFSET_062_oRDR_TRACKER_OBJ_062_oPCAN_RADAR_60357049_Tx: ComBitPosition=357, ComBitSize=14, ComSignalType=UINT16, ComSystemTemplateSystemSignalRef=OBJ_REF_PT_LONG_OFFSET_062
            OBJ_TIMESTAMP_OFFSET_062_oRDR_TRACKER_OBJ_062_oPCAN_RADAR_daf6eb69_Tx: ComBitPosition=247, ComBitSize=8, ComSignalType=UINT8, ComSystemTemplateSystemSignalRef=OBJ_TIMESTAMP_OFFSET_062
            OBJ_TRACK_MOTION_MODEL_062_oRDR_TRACKER_OBJ_062_oPCAN_RADAR_16f5eab4_Tx: ComBitPosition=9, ComBitSize=2, ComSignalType=UINT8, ComSystemTemplateSystemSignalRef=OBJ_TRACK_MOTION_MODEL_062
            OBJ_VEH_TRACK_FLAG_062_oRDR_TRACKER_OBJ_062_oPCAN_RADAR_94df1ce9_Tx: ComBitPosition=10, ComBitSize=1, ComSignalType=BOOLEAN, ComSystemTemplateSystemSignalRef=OBJ_VEH_TRACK_FLAG_062
            OBJ_VELOCITY_ERR_CRR_COEF_062_oRDR_TRACKER_OBJ_062_oPCAN_RADAR_b3407d95_Tx: ComBitPosition=423, ComBitSize=8, ComSignalType=UINT8, ComSystemTemplateSystemSignalRef=OBJ_VELOCITY_ERR_CRR_COEF_062
            OBJ_VELOCITY_LAT_062_oRDR_TRACKER_OBJ_062_oPCAN_RADAR_bcf6f81f_Tx: ComBitPosition=126, ComBitSize=15, ComSignalType=UINT16, ComSystemTemplateSystemSignalRef=OBJ_VELOCITY_LAT_062
            OBJ_VELOCITY_LAT_ERR_062_oRDR_TRACKER_OBJ_062_oPCAN_RADAR_880c884e_Tx: ComBitPosition=151, ComBitSize=8, ComSignalType=UINT8, ComSystemTemplateSystemSignalRef=OBJ_VELOCITY_LAT_ERR_062
            OBJ_VELOCITY_LONG_062_oRDR_TRACKER_OBJ_062_oPCAN_RADAR_ec7b80d9_Tx: ComBitPosition=110, ComBitSize=15, ComSignalType=UINT16, ComSystemTemplateSystemSignalRef=OBJ_VELOCITY_LONG_062
            OBJ_VELOCITY_LONG_ERR_062_oRDR_TRACKER_OBJ_062_oPCAN_RADAR_648eb78e_Tx: ComBitPosition=143, ComBitSize=8, ComSignalType=UINT8, ComSystemTemplateSystemSignalRef=OBJ_VELOCITY_LONG_ERR_062
            OBJ_YAW_ANGLE_062_oRDR_TRACKER_OBJ_062_oPCAN_RADAR_504abc5f_Tx: ComBitPosition=155, ComBitSize=12, ComSignalType=UINT16, ComSystemTemplateSystemSignalRef=OBJ_YAW_ANGLE_062
            OBJ_YAW_ANGLE_ERR_062_oRDR_TRACKER_OBJ_062_oPCAN_RADAR_8547ba88_Tx: ComBitPosition=175, ComBitSize=7, ComSignalType=UINT8, ComSystemTemplateSystemSignalRef=OBJ_YAW_ANGLE_ERR_062
            OBJ_YAW_RATE_062_oRDR_TRACKER_OBJ_062_oPCAN_RADAR_75c59918_Tx: ComBitPosition=399, ComBitSize=10, ComSignalType=UINT16, ComSystemTemplateSystemSignalRef=OBJ_YAW_RATE_062
            OBJ_YAW_RATE_ERR_062_oRDR_TRACKER_OBJ_062_oPCAN_RADAR_4a1d0ec4_Tx: ComBitPosition=388, ComBitSize=5, ComSignalType=UINT8, ComSystemTemplateSystemSignalRef=OBJ_YAW_RATE_ERR_062
        SG_TrackerObject063_oRDR_TRACKER_OBJ_063_oPCAN_RADAR_b8f3587f_Tx: ComSystemTemplateSignalGroupRef=SG_TrackerObject063
          49 x ComGroupSignal, all with ComSignalEndianness=BIG_ENDIAN, ComSignalInitValue=0, ComTransferProperty=PENDING:
            OBJ_ACCELERATION_LAT_063_oRDR_TRACKER_OBJ_063_oPCAN_RADAR_b6d70308_Tx: ComBitPosition=177, ComBitSize=10, ComSignalType=UINT16, ComSystemTemplateSystemSignalRef=OBJ_ACCELERATION_LAT_063
            OBJ_ACCELERATION_LAT_ERR_063_oRDR_TRACKER_OBJ_063_oPCAN_RADAR_632339b6_Tx: ComBitPosition=223, ComBitSize=8, ComSignalType=UINT8, ComSystemTemplateSystemSignalRef=OBJ_ACCELERATION_LAT_ERR_063
            OBJ_ACCELERATION_LONG_063_oRDR_TRACKER_OBJ_063_oPCAN_RADAR_c4275ae8_Tx: ComBitPosition=193, ComBitSize=10, ComSignalType=UINT16, ComSystemTemplateSystemSignalRef=OBJ_ACCELERATION_LONG_063
            OBJ_ACCELERATION_LONG_ERR_063_oRDR_TRACKER_OBJ_063_oPCAN_RADAR_7c869c1c_Tx: ComBitPosition=215, ComBitSize=8, ComSignalType=UINT8, ComSystemTemplateSystemSignalRef=OBJ_ACCELERATION_LONG_ERR_063
            OBJ_ACCEL_ERR_CRR_COEF_063_oRDR_TRACKER_OBJ_063_oPCAN_RADAR_dc25bd7a_Tx: ComBitPosition=431, ComBitSize=8, ComSignalType=UINT8, ComSystemTemplateSystemSignalRef=OBJ_ACCEL_ERR_CRR_COEF_063
            OBJ_ALIVE_TIME_063_oRDR_TRACKER_OBJ_063_oPCAN_RADAR_a4461154_Tx: ComBitPosition=255, ComBitSize=16, ComSignalType=UINT16, ComSystemTemplateSystemSignalRef=OBJ_ALIVE_TIME_063
            OBJ_CLS_TYPE1_063_oRDR_TRACKER_OBJ_063_oPCAN_RADAR_339df072_Tx: ComBitPosition=271, ComBitSize=4, ComSignalType=UINT8, ComSystemTemplateSystemSignalRef=OBJ_CLS_TYPE1_063
            OBJ_CLS_TYPE1_PROB_063_oRDR_TRACKER_OBJ_063_oPCAN_RADAR_9bc52781_Tx: ComBitPosition=303, ComBitSize=8, ComSignalType=UINT8, ComSystemTemplateSystemSignalRef=OBJ_CLS_TYPE1_PROB_063
            OBJ_CLS_TYPE2_063_oRDR_TRACKER_OBJ_063_oPCAN_RADAR_7e75f015_Tx: ComBitPosition=267, ComBitSize=4, ComSignalType=UINT8, ComSystemTemplateSystemSignalRef=OBJ_CLS_TYPE2_063
            OBJ_CLS_TYPE2_PROB_063_oRDR_TRACKER_OBJ_063_oPCAN_RADAR_52f13c8c_Tx: ComBitPosition=311, ComBitSize=8, ComSignalType=UINT8, ComSystemTemplateSystemSignalRef=OBJ_CLS_TYPE2_PROB_063
            OBJ_CLS_TYPE3_063_oRDR_TRACKER_OBJ_063_oPCAN_RADAR_f3fd0df7_Tx: ComBitPosition=279, ComBitSize=4, ComSignalType=UINT8, ComSystemTemplateSystemSignalRef=OBJ_CLS_TYPE3_063
            OBJ_CLS_TYPE3_PROB_063_oRDR_TRACKER_OBJ_063_oPCAN_RADAR_15e2ca77_Tx: ComBitPosition=319, ComBitSize=8, ComSignalType=UINT8, ComSystemTemplateSystemSignalRef=OBJ_CLS_TYPE3_PROB_063
            OBJ_CLS_TYPE4_063_oRDR_TRACKER_OBJ_063_oPCAN_RADAR_e5a5f0db_Tx: ComBitPosition=275, ComBitSize=4, ComSignalType=UINT8, ComSystemTemplateSystemSignalRef=OBJ_CLS_TYPE4_063
            OBJ_CLS_TYPE4_PROB_063_oRDR_TRACKER_OBJ_063_oPCAN_RADAR_1be80cd7_Tx: ComBitPosition=327, ComBitSize=8, ComSignalType=UINT8, ComSystemTemplateSystemSignalRef=OBJ_CLS_TYPE4_PROB_063
            OBJ_CLS_TYPE5_063_oRDR_TRACKER_OBJ_063_oPCAN_RADAR_682d0d39_Tx: ComBitPosition=287, ComBitSize=4, ComSignalType=UINT8, ComSystemTemplateSystemSignalRef=OBJ_CLS_TYPE5_063
            OBJ_CLS_TYPE5_PROB_063_oRDR_TRACKER_OBJ_063_oPCAN_RADAR_5cfbfa2c_Tx: ComBitPosition=335, ComBitSize=8, ComSignalType=UINT8, ComSystemTemplateSystemSignalRef=OBJ_CLS_TYPE5_PROB_063
            OBJ_CLS_TYPE6_063_oRDR_TRACKER_OBJ_063_oPCAN_RADAR_25c50d5e_Tx: ComBitPosition=282, ComBitSize=4, ComSignalType=UINT8, ComSystemTemplateSystemSignalRef=OBJ_CLS_TYPE6_063
            OBJ_CLS_TYPE6_PROB_063_oRDR_TRACKER_OBJ_063_oPCAN_RADAR_95cfe121_Tx: ComBitPosition=343, ComBitSize=8, ComSignalType=UINT8, ComSystemTemplateSystemSignalRef=OBJ_CLS_TYPE6_PROB_063
            OBJ_DIMENSION_LENGTH_063_oRDR_TRACKER_OBJ_063_oPCAN_RADAR_7103a336_Tx: ComBitPosition=37, ComBitSize=12, ComSignalType=UINT16, ComSystemTemplateSystemSignalRef=OBJ_DIMENSION_LENGTH_063
            OBJ_DIMENSION_LENGTH_ERR_063_oRDR_TRACKER_OBJ_063_oPCAN_RADAR_4afbbc4c_Tx: ComBitPosition=41, ComBitSize=10, ComSignalType=UINT16, ComSystemTemplateSystemSignalRef=OBJ_DIMENSION_LENGTH_ERR_063
            OBJ_DIMENSION_WIDTH_063_oRDR_TRACKER_OBJ_063_oPCAN_RADAR_52cd549b_Tx: ComBitPosition=17, ComBitSize=10, ComSignalType=UINT16, ComSystemTemplateSystemSignalRef=OBJ_DIMENSION_WIDTH_063
            OBJ_DIMENSION_WIDTH_ERR_063_oRDR_TRACKER_OBJ_063_oPCAN_RADAR_b26f9373_Tx: ComBitPosition=23, ComBitSize=6, ComSignalType=UINT8, ComSystemTemplateSystemSignalRef=OBJ_DIMENSION_WIDTH_ERR_063
            OBJ_EXISTENCE_PROB_063_oRDR_TRACKER_OBJ_063_oPCAN_RADAR_5971d0a6_Tx: ComBitPosition=229, ComBitSize=14, ComSignalType=UINT16, ComSystemTemplateSystemSignalRef=OBJ_EXISTENCE_PROB_063
            OBJ_GROUP_ID_063_oRDR_TRACKER_OBJ_063_oPCAN_RADAR_d003c40b_Tx: ComBitPosition=405, ComBitSize=6, ComSignalType=UINT8, ComSystemTemplateSystemSignalRef=OBJ_GROUP_ID_063
            OBJ_ID_063_oRDR_TRACKER_OBJ_063_oPCAN_RADAR_232def0c_Tx: ComBitPosition=7, ComBitSize=8, ComSignalType=UINT8, ComSystemTemplateSystemSignalRef=OBJ_ID_063
            OBJ_MEASUREMENT_STATUS_063_oRDR_TRACKER_OBJ_063_oPCAN_RADAR_5cff9db1_Tx: ComBitPosition=14, ComBitSize=3, ComSignalType=UINT8, ComSystemTemplateSystemSignalRef=OBJ_MEASUREMENT_STATUS_063
            OBJ_MH_CRC16_063_oRDR_TRACKER_OBJ_063_oPCAN_RADAR_209f2a8d_Tx: ComBitPosition=495, ComBitSize=16, ComSignalType=UINT16, ComSystemTemplateSystemSignalRef=OBJ_MH_CRC16_063
            OBJ_MH_CYCLE_COUNTER_063_oRDR_TRACKER_OBJ_063_oPCAN_RADAR_517b706c_Tx: ComBitPosition=487, ComBitSize=8, ComSignalType=UINT8, ComSystemTemplateSystemSignalRef=OBJ_MH_CYCLE_COUNTER_063
            OBJ_MOVEMENT_STATUS_063_oRDR_TRACKER_OBJ_063_oPCAN_RADAR_735108fd_Tx: ComBitPosition=196, ComBitSize=3, ComSignalType=UINT8, ComSystemTemplateSystemSignalRef=OBJ_MOVEMENT_STATUS_063
            OBJ_POS_ERR_CRR_COEF_063_oRDR_TRACKER_OBJ_063_oPCAN_RADAR_e32ec8c7_Tx: ComBitPosition=415, ComBitSize=8, ComSignalType=UINT8, ComSystemTemplateSystemSignalRef=OBJ_POS_ERR_CRR_COEF_063
            OBJ_POS_LAT_063_oRDR_TRACKER_OBJ_063_oPCAN_RADAR_0181358b_Tx: ComBitPosition=79, ComBitSize=16, ComSignalType=UINT16, ComSystemTemplateSystemSignalRef=OBJ_POS_LAT_063
            OBJ_POS_LAT_ERR_063_oRDR_TRACKER_OBJ_063_oPCAN_RADAR_05cd65bc_Tx: ComBitPosition=103, ComBitSize=8, ComSignalType=UINT8, ComSystemTemplateSystemSignalRef=OBJ_POS_LAT_ERR_063
            OBJ_POS_LONG_063_oRDR_TRACKER_OBJ_063_oPCAN_RADAR_b021de44_Tx: ComBitPosition=63, ComBitSize=16, ComSignalType=UINT16, ComSystemTemplateSystemSignalRef=OBJ_POS_LONG_063
            OBJ_POS_LONG_ERR_063_oRDR_TRACKER_OBJ_063_oPCAN_RADAR_9c359b5e_Tx: ComBitPosition=95, ComBitSize=8, ComSignalType=UINT8, ComSystemTemplateSystemSignalRef=OBJ_POS_LONG_ERR_063
            OBJ_RCS_063_oRDR_TRACKER_OBJ_063_oPCAN_RADAR_234e638c_Tx: ComBitPosition=351, ComBitSize=7, ComSignalType=UINT8, ComSystemTemplateSystemSignalRef=OBJ_RCS_063
            OBJ_REF_PT_LAT_OFFSET_063_oRDR_TRACKER_OBJ_063_oPCAN_RADAR_d67308f9_Tx: ComBitPosition=370, ComBitSize=14, ComSignalType=UINT16, ComSystemTemplateSystemSignalRef=OBJ_REF_PT_LAT_OFFSET_063
            OBJ_REF_PT_LONG_OFFSET_063_oRDR_TRACKER_OBJ_063_oPCAN_RADAR_9921f8fa_Tx: ComBitPosition=357, ComBitSize=14, ComSignalType=UINT16, ComSystemTemplateSystemSignalRef=OBJ_REF_PT_LONG_OFFSET_063
            OBJ_TIMESTAMP_OFFSET_063_oRDR_TRACKER_OBJ_063_oPCAN_RADAR_23e263da_Tx: ComBitPosition=247, ComBitSize=8, ComSignalType=UINT8, ComSystemTemplateSystemSignalRef=OBJ_TIMESTAMP_OFFSET_063
            OBJ_TRACK_MOTION_MODEL_063_oRDR_TRACKER_OBJ_063_oPCAN_RADAR_efe16207_Tx: ComBitPosition=9, ComBitSize=2, ComSignalType=UINT8, ComSystemTemplateSystemSignalRef=OBJ_TRACK_MOTION_MODEL_063
            OBJ_VEH_TRACK_FLAG_063_oRDR_TRACKER_OBJ_063_oPCAN_RADAR_6dcb945a_Tx: ComBitPosition=10, ComBitSize=1, ComSignalType=BOOLEAN, ComSystemTemplateSystemSignalRef=OBJ_VEH_TRACK_FLAG_063
            OBJ_VELOCITY_ERR_CRR_COEF_063_oRDR_TRACKER_OBJ_063_oPCAN_RADAR_4a54f526_Tx: ComBitPosition=423, ComBitSize=8, ComSignalType=UINT8, ComSystemTemplateSystemSignalRef=OBJ_VELOCITY_ERR_CRR_COEF_063
            OBJ_VELOCITY_LAT_063_oRDR_TRACKER_OBJ_063_oPCAN_RADAR_45e270ac_Tx: ComBitPosition=126, ComBitSize=15, ComSignalType=UINT16, ComSystemTemplateSystemSignalRef=OBJ_VELOCITY_LAT_063
            OBJ_VELOCITY_LAT_ERR_063_oRDR_TRACKER_OBJ_063_oPCAN_RADAR_711800fd_Tx: ComBitPosition=151, ComBitSize=8, ComSignalType=UINT8, ComSystemTemplateSystemSignalRef=OBJ_VELOCITY_LAT_ERR_063
            OBJ_VELOCITY_LONG_063_oRDR_TRACKER_OBJ_063_oPCAN_RADAR_156f086a_Tx: ComBitPosition=110, ComBitSize=15, ComSignalType=UINT16, ComSystemTemplateSystemSignalRef=OBJ_VELOCITY_LONG_063
            OBJ_VELOCITY_LONG_ERR_063_oRDR_TRACKER_OBJ_063_oPCAN_RADAR_9d9a3f3d_Tx: ComBitPosition=143, ComBitSize=8, ComSignalType=UINT8, ComSystemTemplateSystemSignalRef=OBJ_VELOCITY_LONG_ERR_063
            OBJ_YAW_ANGLE_063_oRDR_TRACKER_OBJ_063_oPCAN_RADAR_a95e34ec_Tx: ComBitPosition=155, ComBitSize=12, ComSignalType=UINT16, ComSystemTemplateSystemSignalRef=OBJ_YAW_ANGLE_063
            OBJ_YAW_ANGLE_ERR_063_oRDR_TRACKER_OBJ_063_oPCAN_RADAR_7c53323b_Tx: ComBitPosition=175, ComBitSize=7, ComSignalType=UINT8, ComSystemTemplateSystemSignalRef=OBJ_YAW_ANGLE_ERR_063
            OBJ_YAW_RATE_063_oRDR_TRACKER_OBJ_063_oPCAN_RADAR_8cd111ab_Tx: ComBitPosition=399, ComBitSize=10, ComSignalType=UINT16, ComSystemTemplateSystemSignalRef=OBJ_YAW_RATE_063
            OBJ_YAW_RATE_ERR_063_oRDR_TRACKER_OBJ_063_oPCAN_RADAR_b3098677_Tx: ComBitPosition=388, ComBitSize=5, ComSignalType=UINT8, ComSystemTemplateSystemSignalRef=OBJ_YAW_RATE_ERR_063
        SG_TrackerObject064_oRDR_TRACKER_OBJ_064_oPCAN_RADAR_3a0fe9a5_Tx: ComSystemTemplateSignalGroupRef=SG_TrackerObject064
          49 x ComGroupSignal, all with ComSignalEndianness=BIG_ENDIAN, ComSignalInitValue=0, ComTransferProperty=PENDING:
            OBJ_ACCELERATION_LAT_064_oRDR_TRACKER_OBJ_064_oPCAN_RADAR_342bb2d2_Tx: ComBitPosition=177, ComBitSize=10, ComSignalType=UINT16, ComSystemTemplateSystemSignalRef=OBJ_ACCELERATION_LAT_064
            OBJ_ACCELERATION_LAT_ERR_064_oRDR_TRACKER_OBJ_064_oPCAN_RADAR_e1df886c_Tx: ComBitPosition=223, ComBitSize=8, ComSignalType=UINT8, ComSystemTemplateSystemSignalRef=OBJ_ACCELERATION_LAT_ERR_064
            OBJ_ACCELERATION_LONG_064_oRDR_TRACKER_OBJ_064_oPCAN_RADAR_46dbeb32_Tx: ComBitPosition=193, ComBitSize=10, ComSignalType=UINT16, ComSystemTemplateSystemSignalRef=OBJ_ACCELERATION_LONG_064
            OBJ_ACCELERATION_LONG_ERR_064_oRDR_TRACKER_OBJ_064_oPCAN_RADAR_fe7a2dc6_Tx: ComBitPosition=215, ComBitSize=8, ComSignalType=UINT8, ComSystemTemplateSystemSignalRef=OBJ_ACCELERATION_LONG_ERR_064
            OBJ_ACCEL_ERR_CRR_COEF_064_oRDR_TRACKER_OBJ_064_oPCAN_RADAR_5ed90ca0_Tx: ComBitPosition=431, ComBitSize=8, ComSignalType=UINT8, ComSystemTemplateSystemSignalRef=OBJ_ACCEL_ERR_CRR_COEF_064
            OBJ_ALIVE_TIME_064_oRDR_TRACKER_OBJ_064_oPCAN_RADAR_26baa08e_Tx: ComBitPosition=255, ComBitSize=16, ComSignalType=UINT16, ComSystemTemplateSystemSignalRef=OBJ_ALIVE_TIME_064
            OBJ_CLS_TYPE1_064_oRDR_TRACKER_OBJ_064_oPCAN_RADAR_b16141a8_Tx: ComBitPosition=271, ComBitSize=4, ComSignalType=UINT8, ComSystemTemplateSystemSignalRef=OBJ_CLS_TYPE1_064
            OBJ_CLS_TYPE1_PROB_064_oRDR_TRACKER_OBJ_064_oPCAN_RADAR_1939965b_Tx: ComBitPosition=303, ComBitSize=8, ComSignalType=UINT8, ComSystemTemplateSystemSignalRef=OBJ_CLS_TYPE1_PROB_064
            OBJ_CLS_TYPE2_064_oRDR_TRACKER_OBJ_064_oPCAN_RADAR_fc8941cf_Tx: ComBitPosition=267, ComBitSize=4, ComSignalType=UINT8, ComSystemTemplateSystemSignalRef=OBJ_CLS_TYPE2_064
            OBJ_CLS_TYPE2_PROB_064_oRDR_TRACKER_OBJ_064_oPCAN_RADAR_d00d8d56_Tx: ComBitPosition=311, ComBitSize=8, ComSignalType=UINT8, ComSystemTemplateSystemSignalRef=OBJ_CLS_TYPE2_PROB_064
            OBJ_CLS_TYPE3_064_oRDR_TRACKER_OBJ_064_oPCAN_RADAR_7101bc2d_Tx: ComBitPosition=279, ComBitSize=4, ComSignalType=UINT8, ComSystemTemplateSystemSignalRef=OBJ_CLS_TYPE3_064
            OBJ_CLS_TYPE3_PROB_064_oRDR_TRACKER_OBJ_064_oPCAN_RADAR_971e7bad_Tx: ComBitPosition=319, ComBitSize=8, ComSignalType=UINT8, ComSystemTemplateSystemSignalRef=OBJ_CLS_TYPE3_PROB_064
            OBJ_CLS_TYPE4_064_oRDR_TRACKER_OBJ_064_oPCAN_RADAR_67594101_Tx: ComBitPosition=275, ComBitSize=4, ComSignalType=UINT8, ComSystemTemplateSystemSignalRef=OBJ_CLS_TYPE4_064
            OBJ_CLS_TYPE4_PROB_064_oRDR_TRACKER_OBJ_064_oPCAN_RADAR_9914bd0d_Tx: ComBitPosition=327, ComBitSize=8, ComSignalType=UINT8, ComSystemTemplateSystemSignalRef=OBJ_CLS_TYPE4_PROB_064
            OBJ_CLS_TYPE5_064_oRDR_TRACKER_OBJ_064_oPCAN_RADAR_ead1bce3_Tx: ComBitPosition=287, ComBitSize=4, ComSignalType=UINT8, ComSystemTemplateSystemSignalRef=OBJ_CLS_TYPE5_064
            OBJ_CLS_TYPE5_PROB_064_oRDR_TRACKER_OBJ_064_oPCAN_RADAR_de074bf6_Tx: ComBitPosition=335, ComBitSize=8, ComSignalType=UINT8, ComSystemTemplateSystemSignalRef=OBJ_CLS_TYPE5_PROB_064
            OBJ_CLS_TYPE6_064_oRDR_TRACKER_OBJ_064_oPCAN_RADAR_a739bc84_Tx: ComBitPosition=282, ComBitSize=4, ComSignalType=UINT8, ComSystemTemplateSystemSignalRef=OBJ_CLS_TYPE6_064
            OBJ_CLS_TYPE6_PROB_064_oRDR_TRACKER_OBJ_064_oPCAN_RADAR_173350fb_Tx: ComBitPosition=343, ComBitSize=8, ComSignalType=UINT8, ComSystemTemplateSystemSignalRef=OBJ_CLS_TYPE6_PROB_064
            OBJ_DIMENSION_LENGTH_064_oRDR_TRACKER_OBJ_064_oPCAN_RADAR_f3ff12ec_Tx: ComBitPosition=37, ComBitSize=12, ComSignalType=UINT16, ComSystemTemplateSystemSignalRef=OBJ_DIMENSION_LENGTH_064
            OBJ_DIMENSION_LENGTH_ERR_064_oRDR_TRACKER_OBJ_064_oPCAN_RADAR_c8070d96_Tx: ComBitPosition=41, ComBitSize=10, ComSignalType=UINT16, ComSystemTemplateSystemSignalRef=OBJ_DIMENSION_LENGTH_ERR_064
            OBJ_DIMENSION_WIDTH_064_oRDR_TRACKER_OBJ_064_oPCAN_RADAR_d031e541_Tx: ComBitPosition=17, ComBitSize=10, ComSignalType=UINT16, ComSystemTemplateSystemSignalRef=OBJ_DIMENSION_WIDTH_064
            OBJ_DIMENSION_WIDTH_ERR_064_oRDR_TRACKER_OBJ_064_oPCAN_RADAR_309322a9_Tx: ComBitPosition=23, ComBitSize=6, ComSignalType=UINT8, ComSystemTemplateSystemSignalRef=OBJ_DIMENSION_WIDTH_ERR_064
            OBJ_EXISTENCE_PROB_064_oRDR_TRACKER_OBJ_064_oPCAN_RADAR_db8d617c_Tx: ComBitPosition=229, ComBitSize=14, ComSignalType=UINT16, ComSystemTemplateSystemSignalRef=OBJ_EXISTENCE_PROB_064
            OBJ_GROUP_ID_064_oRDR_TRACKER_OBJ_064_oPCAN_RADAR_52ff75d1_Tx: ComBitPosition=405, ComBitSize=6, ComSignalType=UINT8, ComSystemTemplateSystemSignalRef=OBJ_GROUP_ID_064
            OBJ_ID_064_oRDR_TRACKER_OBJ_064_oPCAN_RADAR_a1d15ed6_Tx: ComBitPosition=7, ComBitSize=8, ComSignalType=UINT8, ComSystemTemplateSystemSignalRef=OBJ_ID_064
            OBJ_MEASUREMENT_STATUS_064_oRDR_TRACKER_OBJ_064_oPCAN_RADAR_de032c6b_Tx: ComBitPosition=14, ComBitSize=3, ComSignalType=UINT8, ComSystemTemplateSystemSignalRef=OBJ_MEASUREMENT_STATUS_064
            OBJ_MH_CRC16_064_oRDR_TRACKER_OBJ_064_oPCAN_RADAR_a2639b57_Tx: ComBitPosition=495, ComBitSize=16, ComSignalType=UINT16, ComSystemTemplateSystemSignalRef=OBJ_MH_CRC16_064
            OBJ_MH_CYCLE_COUNTER_064_oRDR_TRACKER_OBJ_064_oPCAN_RADAR_d387c1b6_Tx: ComBitPosition=487, ComBitSize=8, ComSignalType=UINT8, ComSystemTemplateSystemSignalRef=OBJ_MH_CYCLE_COUNTER_064
            OBJ_MOVEMENT_STATUS_064_oRDR_TRACKER_OBJ_064_oPCAN_RADAR_f1adb927_Tx: ComBitPosition=196, ComBitSize=3, ComSignalType=UINT8, ComSystemTemplateSystemSignalRef=OBJ_MOVEMENT_STATUS_064
            OBJ_POS_ERR_CRR_COEF_064_oRDR_TRACKER_OBJ_064_oPCAN_RADAR_61d2791d_Tx: ComBitPosition=415, ComBitSize=8, ComSignalType=UINT8, ComSystemTemplateSystemSignalRef=OBJ_POS_ERR_CRR_COEF_064
            OBJ_POS_LAT_064_oRDR_TRACKER_OBJ_064_oPCAN_RADAR_837d8451_Tx: ComBitPosition=79, ComBitSize=16, ComSignalType=UINT16, ComSystemTemplateSystemSignalRef=OBJ_POS_LAT_064
            OBJ_POS_LAT_ERR_064_oRDR_TRACKER_OBJ_064_oPCAN_RADAR_8731d466_Tx: ComBitPosition=103, ComBitSize=8, ComSignalType=UINT8, ComSystemTemplateSystemSignalRef=OBJ_POS_LAT_ERR_064
            OBJ_POS_LONG_064_oRDR_TRACKER_OBJ_064_oPCAN_RADAR_32dd6f9e_Tx: ComBitPosition=63, ComBitSize=16, ComSignalType=UINT16, ComSystemTemplateSystemSignalRef=OBJ_POS_LONG_064
            OBJ_POS_LONG_ERR_064_oRDR_TRACKER_OBJ_064_oPCAN_RADAR_1ec92a84_Tx: ComBitPosition=95, ComBitSize=8, ComSignalType=UINT8, ComSystemTemplateSystemSignalRef=OBJ_POS_LONG_ERR_064
            OBJ_RCS_064_oRDR_TRACKER_OBJ_064_oPCAN_RADAR_a1b2d256_Tx: ComBitPosition=351, ComBitSize=7, ComSignalType=UINT8, ComSystemTemplateSystemSignalRef=OBJ_RCS_064
            OBJ_REF_PT_LAT_OFFSET_064_oRDR_TRACKER_OBJ_064_oPCAN_RADAR_548fb923_Tx: ComBitPosition=370, ComBitSize=14, ComSignalType=UINT16, ComSystemTemplateSystemSignalRef=OBJ_REF_PT_LAT_OFFSET_064
            OBJ_REF_PT_LONG_OFFSET_064_oRDR_TRACKER_OBJ_064_oPCAN_RADAR_1bdd4920_Tx: ComBitPosition=357, ComBitSize=14, ComSignalType=UINT16, ComSystemTemplateSystemSignalRef=OBJ_REF_PT_LONG_OFFSET_064
            OBJ_TIMESTAMP_OFFSET_064_oRDR_TRACKER_OBJ_064_oPCAN_RADAR_a11ed200_Tx: ComBitPosition=247, ComBitSize=8, ComSignalType=UINT8, ComSystemTemplateSystemSignalRef=OBJ_TIMESTAMP_OFFSET_064
            OBJ_TRACK_MOTION_MODEL_064_oRDR_TRACKER_OBJ_064_oPCAN_RADAR_6d1dd3dd_Tx: ComBitPosition=9, ComBitSize=2, ComSignalType=UINT8, ComSystemTemplateSystemSignalRef=OBJ_TRACK_MOTION_MODEL_064
            OBJ_VEH_TRACK_FLAG_064_oRDR_TRACKER_OBJ_064_oPCAN_RADAR_ef372580_Tx: ComBitPosition=10, ComBitSize=1, ComSignalType=BOOLEAN, ComSystemTemplateSystemSignalRef=OBJ_VEH_TRACK_FLAG_064
            OBJ_VELOCITY_ERR_CRR_COEF_064_oRDR_TRACKER_OBJ_064_oPCAN_RADAR_c8a844fc_Tx: ComBitPosition=423, ComBitSize=8, ComSignalType=UINT8, ComSystemTemplateSystemSignalRef=OBJ_VELOCITY_ERR_CRR_COEF_064
            OBJ_VELOCITY_LAT_064_oRDR_TRACKER_OBJ_064_oPCAN_RADAR_c71ec176_Tx: ComBitPosition=126, ComBitSize=15, ComSignalType=UINT16, ComSystemTemplateSystemSignalRef=OBJ_VELOCITY_LAT_064
            OBJ_VELOCITY_LAT_ERR_064_oRDR_TRACKER_OBJ_064_oPCAN_RADAR_f3e4b127_Tx: ComBitPosition=151, ComBitSize=8, ComSignalType=UINT8, ComSystemTemplateSystemSignalRef=OBJ_VELOCITY_LAT_ERR_064
            OBJ_VELOCITY_LONG_064_oRDR_TRACKER_OBJ_064_oPCAN_RADAR_9793b9b0_Tx: ComBitPosition=110, ComBitSize=15, ComSignalType=UINT16, ComSystemTemplateSystemSignalRef=OBJ_VELOCITY_LONG_064
            OBJ_VELOCITY_LONG_ERR_064_oRDR_TRACKER_OBJ_064_oPCAN_RADAR_1f668ee7_Tx: ComBitPosition=143, ComBitSize=8, ComSignalType=UINT8, ComSystemTemplateSystemSignalRef=OBJ_VELOCITY_LONG_ERR_064
            OBJ_YAW_ANGLE_064_oRDR_TRACKER_OBJ_064_oPCAN_RADAR_2ba28536_Tx: ComBitPosition=155, ComBitSize=12, ComSignalType=UINT16, ComSystemTemplateSystemSignalRef=OBJ_YAW_ANGLE_064
            OBJ_YAW_ANGLE_ERR_064_oRDR_TRACKER_OBJ_064_oPCAN_RADAR_feaf83e1_Tx: ComBitPosition=175, ComBitSize=7, ComSignalType=UINT8, ComSystemTemplateSystemSignalRef=OBJ_YAW_ANGLE_ERR_064
            OBJ_YAW_RATE_064_oRDR_TRACKER_OBJ_064_oPCAN_RADAR_0e2da071_Tx: ComBitPosition=399, ComBitSize=10, ComSignalType=UINT16, ComSystemTemplateSystemSignalRef=OBJ_YAW_RATE_064
            OBJ_YAW_RATE_ERR_064_oRDR_TRACKER_OBJ_064_oPCAN_RADAR_31f537ad_Tx: ComBitPosition=388, ComBitSize=5, ComSignalType=UINT8, ComSystemTemplateSystemSignalRef=OBJ_YAW_RATE_ERR_064
        SG_TrackerStatus_oRDR_OBJ_STATUS_003_oPCAN_RADAR_3d577421_Tx: ComSystemTemplateSignalGroupRef=SG_TrackerStatus
          8 x ComGroupSignal, all with ComSignalEndianness=BIG_ENDIAN, ComSignalInitValue=0, ComTransferProperty=PENDING:
            STS_MH_003_CRC16_oRDR_OBJ_STATUS_003_oPCAN_RADAR_358216b5_Tx: ComBitPosition=87, ComBitSize=16, ComSignalType=UINT16, ComSystemTemplateSystemSignalRef=STS_MH_003_CRC16
            STS_MH_003_CYCLE_COUNTER_oRDR_OBJ_STATUS_003_oPCAN_RADAR_49230fca_Tx: ComBitPosition=103, ComBitSize=8, ComSignalType=UINT8, ComSystemTemplateSystemSignalRef=STS_MH_003_CYCLE_COUNTER
            STS_OBJ_DBC_BASE_VER_MAJOR_oRDR_OBJ_STATUS_003_oPCAN_RADAR_9a35e806_Tx: ComBitPosition=71, ComBitSize=8, ComSignalType=UINT8, ComSystemTemplateSystemSignalRef=STS_OBJ_DBC_BASE_VER_MAJOR
            STS_OBJ_DBC_BASE_VER_MINOR_oRDR_OBJ_STATUS_003_oPCAN_RADAR_620f0a8a_Tx: ComBitPosition=79, ComBitSize=8, ComSignalType=UINT8, ComSystemTemplateSystemSignalRef=STS_OBJ_DBC_BASE_VER_MINOR
            STS_PERCEPTION_MODULE_ID_oRDR_OBJ_STATUS_003_oPCAN_RADAR_a04fe4df_Tx: ComBitPosition=31, ComBitSize=16, ComSignalType=UINT16, ComSystemTemplateSystemSignalRef=STS_PERCEPTION_MODULE_ID
            STS_TRKR_MAJOR_VERSION_oRDR_OBJ_STATUS_003_oPCAN_RADAR_04b44e02_Tx: ComBitPosition=7, ComBitSize=8, ComSignalType=UINT8, ComSystemTemplateSystemSignalRef=STS_TRKR_MAJOR_VERSION
            STS_TRKR_MINOR_VERSION_oRDR_OBJ_STATUS_003_oPCAN_RADAR_49ba56fe_Tx: ComBitPosition=15, ComBitSize=8, ComSignalType=UINT8, ComSystemTemplateSystemSignalRef=STS_TRKR_MINOR_VERSION
            STS_TRKR_PATCH_VERSION_oRDR_OBJ_STATUS_003_oPCAN_RADAR_4bf666f9_Tx: ComBitPosition=23, ComBitSize=8, ComSignalType=UINT8, ComSystemTemplateSystemSignalRef=STS_TRKR_PATCH_VERSION
        SG_VDC2_oVDC2_oVCAN_RADAR_06eddadd_Rx: ComSystemTemplateSignalGroupRef=SG_VDC2
          4 x ComGroupSignal, all with ComSignalEndianness=LITTLE_ENDIAN:
            LateralAcceleration_oVDC2_oVCAN_RADAR_b3e7a398_Rx: ComBitPosition=40, ComBitSize=16, ComSignalInitValue=32127, ComSignalType=UINT16, ComSystemTemplateSystemSignalRef=LateralAcceleration
            LongitudinalAcceleration_oVDC2_oVCAN_RADAR_f355ad7e_Rx: ComBitPosition=56, ComBitSize=8, ComSignalInitValue=125, ComSignalType=UINT8, ComSystemTemplateSystemSignalRef=LongitudinalAcceleration
            SteerWheelAngle_oVDC2_oVCAN_RADAR_c890bb33_Rx: ComBitPosition=0, ComBitSize=16, ComSignalInitValue=32127, ComSignalType=UINT16, ComSystemTemplateSystemSignalRef=SteerWheelAngle
            YawRate_oVDC2_oVCAN_RADAR_bf77bc8a_Rx: ComBitPosition=24, ComBitSize=16, ComSignalInitValue=32113, ComSignalType=UINT16, ComSystemTemplateSystemSignalRef=YawRate
        SG_VD_oVD_oVCAN_RADAR_27d322c3_Rx: ComSystemTemplateSignalGroupRef=SG_VD
          Total_vehicle_distance_oVD_oVCAN_RADAR_7583597c_Rx (ComGroupSignal):
            ComBitPosition = 32
            ComBitSize = 32
            ComSignalEndianness = LITTLE_ENDIAN
            ComSignalInitValue = 0
            ComSignalType = UINT32
            ComSystemTemplateSystemSignalRef = Total_vehicle_distance
        SG_VI_oVI_oVCAN_RADAR_7241e1af_Rx: ComSystemTemplateSignalGroupRef=SG_VI
          VehicleIdentification_oVI_oVCAN_RADAR_4b86485f_Rx (ComGroupSignal):
            ComBitPosition = 0
            ComBitSize = 8
            ComSignalEndianness = LITTLE_ENDIAN
            ComSignalInitValue = 0
            ComSignalType = UINT8
            ComSystemTemplateSystemSignalRef = VehicleIdentification
        SG_VehicleStatus_oSYS_VEHICLE_STATUS_oPCAN_RADAR_0411a809_Rx: ComTimeout=0, ComSystemTemplateSignalGroupRef=SG_VehicleStatus
          39 x ComGroupSignal:
            SSTS_CAN_PCAN_MAJOR_ADAS_oSYS_VEHICLE_STATUS_oPCAN_RADAR_7162c0e1_Rx: ComBitPosition=240, ComBitSize=8, ComSignalEndianness=LITTLE_ENDIAN, ComSignalInitValue=0, ComSignalType=UINT8, ComSystemTemplateSystemSignalRef=SSTS_CAN_PCAN_MAJOR_ADAS
            SSTS_CAN_PCAN_MINOR_ADAS_oSYS_VEHICLE_STATUS_oPCAN_RADAR_8c9b1f32_Rx: ComBitPosition=24, ComBitSize=8, ComSignalEndianness=LITTLE_ENDIAN, ComSignalInitValue=0, ComSignalType=UINT8, ComSystemTemplateSystemSignalRef=SSTS_CAN_PCAN_MINOR_ADAS
            SSTS_DRIVE_DIR_oSYS_VEHICLE_STATUS_oPCAN_RADAR_a5d0f7d2_Rx: ComBitPosition=78, ComBitSize=2, ComSignalEndianness=LITTLE_ENDIAN, ComSignalInitValue=0, ComSignalType=UINT8, ComSystemTemplateSystemSignalRef=SSTS_DRIVE_DIR
            SSTS_DRIVE_REVERSE_oSYS_VEHICLE_STATUS_oPCAN_RADAR_07d888b2_Rx: ComBitPosition=36, ComBitSize=1, ComSignalEndianness=LITTLE_ENDIAN, ComSignalInitValue=0, ComSignalType=BOOLEAN, ComSystemTemplateSystemSignalRef=SSTS_DRIVE_REVERSE
            SSTS_GEAR_POSITION_oSYS_VEHICLE_STATUS_oPCAN_RADAR_4533b983_Rx: ComBitPosition=148, ComBitSize=4, ComSignalEndianness=LITTLE_ENDIAN, ComSignalInitValue=0, ComSignalType=UINT8, ComSystemTemplateSystemSignalRef=SSTS_GEAR_POSITION
            SSTS_IGN_STATUS_oSYS_VEHICLE_STATUS_oPCAN_RADAR_59077970_Rx: ComBitPosition=88, ComBitSize=3, ComSignalEndianness=LITTLE_ENDIAN, ComSignalInitValue=0, ComSignalType=UINT8, ComSystemTemplateSystemSignalRef=SSTS_IGN_STATUS
            SSTS_MH_VS_CRC16_oSYS_VEHICLE_STATUS_oPCAN_RADAR_c31e8b64_Rx: ComBitPosition=0, ComBitSize=16, ComSignalEndianness=LITTLE_ENDIAN, ComSignalInitValue=0, ComSignalType=UINT16, ComSystemTemplateSystemSignalRef=SSTS_MH_VS_CRC16
            SSTS_MH_VS_CYCLE_COUNTER_oSYS_VEHICLE_STATUS_oPCAN_RADAR_0f7759f5_Rx: ComBitPosition=16, ComBitSize=8, ComSignalEndianness=LITTLE_ENDIAN, ComSignalInitValue=0, ComSignalType=UINT8, ComSystemTemplateSystemSignalRef=SSTS_MH_VS_CYCLE_COUNTER
            SSTS_STEERING_ANGLE_SIGN_oSYS_VEHICLE_STATUS_oPCAN_RADAR_2edd7885_Rx: ComBitPosition=37, ComBitSize=1, ComSignalEndianness=LITTLE_ENDIAN, ComSignalInitValue=0, ComSignalType=BOOLEAN, ComSystemTemplateSystemSignalRef=SSTS_STEERING_ANGLE_SIGN
            SSTS_STEERING_ANGLE_oSYS_VEHICLE_STATUS_oPCAN_RADAR_a73dd98d_Rx: ComBitPosition=104, ComBitSize=8, ComSignalEndianness=LITTLE_ENDIAN, ComSignalInitValue=0, ComSignalType=UINT8, ComSystemTemplateSystemSignalRef=SSTS_STEERING_ANGLE
            SSTS_SW_VERSION_ADAS_oSYS_VEHICLE_STATUS_oPCAN_RADAR_9ba50e45_Rx: ComBitPosition=248, ComBitSize=32, ComSignalEndianness=LITTLE_ENDIAN, ComSignalInitValue=0, ComSignalType=UINT32, ComSystemTemplateSystemSignalRef=SSTS_SW_VERSION_ADAS
            SSTS_VEHICLE_SPEED_CALC_QF_oSYS_VEHICLE_STATUS_oPCAN_RADAR_95d4c2d0_Rx: ComBitPosition=54, ComBitSize=2, ComSignalEndianness=LITTLE_ENDIAN, ComSignalInitValue=0, ComSignalType=UINT8, ComSystemTemplateSystemSignalRef=SSTS_VEHICLE_SPEED_CALC_QF
            SSTS_VEHICLE_SPEED_CALC_oSYS_VEHICLE_STATUS_oPCAN_RADAR_89c9a9e4_Rx: ComBitPosition=64, ComBitSize=14, ComSignalEndianness=LITTLE_ENDIAN, ComSignalInitValue=0, ComSignalType=UINT16, ComSystemTemplateSystemSignalRef=SSTS_VEHICLE_SPEED_CALC
            SSTS_VEHICLE_STATE_oSYS_VEHICLE_STATUS_oPCAN_RADAR_9637ee7e_Rx: ComBitPosition=85, ComBitSize=3, ComSignalEndianness=LITTLE_ENDIAN, ComSignalInitValue=0, ComSignalType=UINT8, ComSystemTemplateSystemSignalRef=SSTS_VEHICLE_STATE
            SSTS_VEH_AbsoluteTime_Day_oSYS_VEHICLE_STATUS_oPCAN_RADAR_98f8a460_Rx: ComBitPosition=80, ComBitSize=5, ComSignalEndianness=LITTLE_ENDIAN, ComSignalInitValue=1, ComSignalType=UINT8, ComSystemTemplateSystemSignalRef=SSTS_VEH_AbsoluteTime_Day
            SSTS_VEH_AbsoluteTime_Hour_oSYS_VEHICLE_STATUS_oPCAN_RADAR_711bf042_Rx: ComBitPosition=112, ComBitSize=5, ComSignalEndianness=LITTLE_ENDIAN, ComSignalInitValue=0, ComSignalType=UINT8, ComSystemTemplateSystemSignalRef=SSTS_VEH_AbsoluteTime_Hour
            SSTS_VEH_AbsoluteTime_Minute_oSYS_VEHICLE_STATUS_oPCAN_RADAR_13cd720f_Rx: ComBitPosition=120, ComBitSize=6, ComSignalEndianness=LITTLE_ENDIAN, ComSignalInitValue=0, ComSignalType=UINT8, ComSystemTemplateSystemSignalRef=SSTS_VEH_AbsoluteTime_Minute
            SSTS_VEH_AbsoluteTime_Month_oSYS_VEHICLE_STATUS_oPCAN_RADAR_649374da_Rx: ComBitPosition=92, ComBitSize=4, ComSignalEndianness=LITTLE_ENDIAN, ComSignalInitValue=1, ComSignalType=UINT8, ComSystemTemplateSystemSignalRef=SSTS_VEH_AbsoluteTime_Month
            SSTS_VEH_AbsoluteTime_Second_oSYS_VEHICLE_STATUS_oPCAN_RADAR_816ad585_Rx: ComBitPosition=96, ComBitSize=6, ComSignalEndianness=LITTLE_ENDIAN, ComSignalInitValue=0, ComSignalType=UINT8, ComSystemTemplateSystemSignalRef=SSTS_VEH_AbsoluteTime_Second
            SSTS_VEH_AbsoluteTime_Year_oSYS_VEHICLE_STATUS_oPCAN_RADAR_3c9d9324_Rx: ComBitPosition=168, ComBitSize=8, ComSignalEndianness=LITTLE_ENDIAN, ComSignalInitValue=0, ComSignalType=UINT8, ComSystemTemplateSystemSignalRef=SSTS_VEH_AbsoluteTime_Year
            SSTS_VEH_ODOMETER_oSYS_VEHICLE_STATUS_oPCAN_RADAR_751a6302_Rx: ComBitPosition=128, ComBitSize=20, ComSignalEndianness=LITTLE_ENDIAN, ComSignalInitValue=0, ComSignalType=UINT32, ComSystemTemplateSystemSignalRef=SSTS_VEH_ODOMETER
            SSTS_VEH_POWER_MODE_STATUS_oSYS_VEHICLE_STATUS_oPCAN_RADAR_73f4a72e_Rx: ComBitPosition=50, ComBitSize=3, ComSignalEndianness=LITTLE_ENDIAN, ComSignalInitValue=0, ComSignalType=UINT8, ComSystemTemplateSystemSignalRef=SSTS_VEH_POWER_MODE_STATUS
            SSTS_VEH_SPD_COMP_FACTOR_oSYS_VEHICLE_STATUS_oPCAN_RADAR_3da60ec4_Rx: ComBitPosition=56, ComBitSize=8, ComSignalEndianness=LITTLE_ENDIAN, ComSignalInitValue=0, ComSignalType=SINT8, ComSystemTemplateSystemSignalRef=SSTS_VEH_SPD_COMP_FACTOR
            SSTS_VEH_SYSTEM_VOLTAGE_oSYS_VEHICLE_STATUS_oPCAN_RADAR_1952d612_Rx: ComBitPosition=152, ComBitSize=12, ComSignalEndianness=LITTLE_ENDIAN, ComSignalInitValue=0, ComSignalType=UINT16, ComSystemTemplateSystemSignalRef=SSTS_VEH_SYSTEM_VOLTAGE
            SSTS_VEH_Status_CMAC_oSYS_VEHICLE_STATUS_oPCAN_RADAR_ac86c39a_Rx: ComBitPosition=472, ComSignalEndianness=opaque, ComSignalInitValue=0 0 0 0 0, ComSignalLength=5, ComSignalType=UINT8_N, ComSystemTemplateSystemSignalRef=SSTS_VEH_Status_CMAC
            SSTS_VEH_Status_FV_oSYS_VEHICLE_STATUS_oPCAN_RADAR_4df6f68e_Rx: ComBitPosition=416, ComSignalEndianness=opaque, ComSignalInitValue=0 0 0 0 0 0 0, ComSignalLength=7, ComSignalType=UINT8_N, ComSystemTemplateSystemSignalRef=SSTS_VEH_Status_FV
            SSTS_VEH_TRAILER_CONNECTED_oSYS_VEHICLE_STATUS_oPCAN_RADAR_377b66dd_Rx: ComBitPosition=53, ComBitSize=1, ComSignalEndianness=LITTLE_ENDIAN, ComSignalInitValue=0, ComSignalType=BOOLEAN, ComSystemTemplateSystemSignalRef=SSTS_VEH_TRAILER_CONNECTED
            SSTS_VEH_VARIANT_oSYS_VEHICLE_STATUS_oPCAN_RADAR_87a69a77_Rx: ComBitPosition=102, ComBitSize=2, ComSignalEndianness=LITTLE_ENDIAN, ComSignalInitValue=0, ComSignalType=UINT8, ComSystemTemplateSystemSignalRef=SSTS_VEH_VARIANT
            SSTS_VIN_Data_Byte0_oSYS_VEHICLE_STATUS_oPCAN_RADAR_7d65df3e_Rx: ComBitPosition=184, ComBitSize=8, ComSignalEndianness=LITTLE_ENDIAN, ComSignalInitValue=0, ComSignalType=UINT8, ComSystemTemplateSystemSignalRef=SSTS_VIN_Data_Byte0
            SSTS_VIN_Data_Byte1_oSYS_VEHICLE_STATUS_oPCAN_RADAR_4b974fcd_Rx: ComBitPosition=192, ComBitSize=8, ComSignalEndianness=LITTLE_ENDIAN, ComSignalInitValue=0, ComSignalType=UINT8, ComSystemTemplateSystemSignalRef=SSTS_VIN_Data_Byte1
            SSTS_VIN_Data_Byte2_oSYS_VEHICLE_STATUS_oPCAN_RADAR_1080fed8_Rx: ComBitPosition=200, ComBitSize=8, ComSignalEndianness=LITTLE_ENDIAN, ComSignalInitValue=0, ComSignalType=UINT8, ComSystemTemplateSystemSignalRef=SSTS_VIN_Data_Byte2
            SSTS_VIN_Data_Byte3_oSYS_VEHICLE_STATUS_oPCAN_RADAR_26726e2b_Rx: ComBitPosition=208, ComBitSize=8, ComSignalEndianness=LITTLE_ENDIAN, ComSignalInitValue=0, ComSignalType=UINT8, ComSystemTemplateSystemSignalRef=SSTS_VIN_Data_Byte3
            SSTS_VIN_Data_Byte4_oSYS_VEHICLE_STATUS_oPCAN_RADAR_a6af9cf2_Rx: ComBitPosition=216, ComBitSize=8, ComSignalEndianness=LITTLE_ENDIAN, ComSignalInitValue=0, ComSignalType=UINT8, ComSystemTemplateSystemSignalRef=SSTS_VIN_Data_Byte4
            SSTS_VIN_Data_Byte5_oSYS_VEHICLE_STATUS_oPCAN_RADAR_905d0c01_Rx: ComBitPosition=224, ComBitSize=8, ComSignalEndianness=LITTLE_ENDIAN, ComSignalInitValue=0, ComSignalType=UINT8, ComSystemTemplateSystemSignalRef=SSTS_VIN_Data_Byte5
            SSTS_VIN_Data_Byte6_oSYS_VEHICLE_STATUS_oPCAN_RADAR_cb4abd14_Rx: ComBitPosition=232, ComBitSize=8, ComSignalEndianness=LITTLE_ENDIAN, ComSignalInitValue=0, ComSignalType=UINT8, ComSystemTemplateSystemSignalRef=SSTS_VIN_Data_Byte6
            SSTS_VIN_FrameIdx_oSYS_VEHICLE_STATUS_oPCAN_RADAR_ef68cb69_Rx: ComBitPosition=176, ComBitSize=8, ComSignalEndianness=LITTLE_ENDIAN, ComSignalInitValue=0, ComSignalType=UINT8, ComSystemTemplateSystemSignalRef=SSTS_VIN_FrameIdx
            SSTS_YAW_RATE_BIAS_oSYS_VEHICLE_STATUS_oPCAN_RADAR_c81bff9c_Rx: ComBitPosition=32, ComBitSize=4, ComSignalEndianness=LITTLE_ENDIAN, ComSignalInitValue=0, ComSignalType=UINT8, ComSystemTemplateSystemSignalRef=SSTS_YAW_RATE_BIAS
            SSTS_YAW_RATE_CALC_QF_oSYS_VEHICLE_STATUS_oPCAN_RADAR_61a6cdee_Rx: ComBitPosition=48, ComBitSize=2, ComSignalEndianness=LITTLE_ENDIAN, ComSignalInitValue=0, ComSignalType=UINT8, ComSystemTemplateSystemSignalRef=SSTS_YAW_RATE_CALC_QF
            SSTS_YAW_RATE_CALC_oSYS_VEHICLE_STATUS_oPCAN_RADAR_070d13a1_Rx: ComBitPosition=38, ComBitSize=10, ComSignalEndianness=LITTLE_ENDIAN, ComSignalInitValue=448, ComSignalType=UINT16, ComSystemTemplateSystemSignalRef=SSTS_YAW_RATE_CALC
        SG_XcpCTOReq_oRDR_XCP_CTO_REQ_oPCAN_RADAR_95c22ef5_Rx: ComTimeout=0, ComSystemTemplateSignalGroupRef=SG_XcpCTOReq
          64 x ComGroupSignal, all with ComBitSize=8, ComSignalEndianness=BIG_ENDIAN, ComSignalInitValue=0, ComSignalType=UINT8:
            STS_PID_oRDR_XCP_CTO_REQ_oPCAN_RADAR_e07b7e21_Rx: ComBitPosition=7, ComSystemTemplateSystemSignalRef=STS_PID
            STS_XCP_REQ_CTO_Byte10_oRDR_XCP_CTO_REQ_oPCAN_RADAR_4b43d8dd_Rx: ComBitPosition=87, ComSystemTemplateSystemSignalRef=STS_XCP_REQ_CTO_Byte10
            STS_XCP_REQ_CTO_Byte11_oRDR_XCP_CTO_REQ_oPCAN_RADAR_77233bd5_Rx: ComBitPosition=95, ComSystemTemplateSystemSignalRef=STS_XCP_REQ_CTO_Byte11
            STS_XCP_REQ_CTO_Byte12_oRDR_XCP_CTO_REQ_oPCAN_RADAR_33821ecd_Rx: ComBitPosition=103, ComSystemTemplateSystemSignalRef=STS_XCP_REQ_CTO_Byte12
            STS_XCP_REQ_CTO_Byte13_oRDR_XCP_CTO_REQ_oPCAN_RADAR_0fe2fdc5_Rx: ComBitPosition=111, ComSystemTemplateSystemSignalRef=STS_XCP_REQ_CTO_Byte13
            STS_XCP_REQ_CTO_Byte14_oRDR_XCP_CTO_REQ_oPCAN_RADAR_bac054fd_Rx: ComBitPosition=119, ComSystemTemplateSystemSignalRef=STS_XCP_REQ_CTO_Byte14
            STS_XCP_REQ_CTO_Byte15_oRDR_XCP_CTO_REQ_oPCAN_RADAR_86a0b7f5_Rx: ComBitPosition=127, ComSystemTemplateSystemSignalRef=STS_XCP_REQ_CTO_Byte15
            STS_XCP_REQ_CTO_Byte16_oRDR_XCP_CTO_REQ_oPCAN_RADAR_c20192ed_Rx: ComBitPosition=135, ComSystemTemplateSystemSignalRef=STS_XCP_REQ_CTO_Byte16
            STS_XCP_REQ_CTO_Byte17_oRDR_XCP_CTO_REQ_oPCAN_RADAR_fe6171e5_Rx: ComBitPosition=143, ComSystemTemplateSystemSignalRef=STS_XCP_REQ_CTO_Byte17
            STS_XCP_REQ_CTO_Byte18_oRDR_XCP_CTO_REQ_oPCAN_RADAR_7335c6dc_Rx: ComBitPosition=151, ComSystemTemplateSystemSignalRef=STS_XCP_REQ_CTO_Byte18
            STS_XCP_REQ_CTO_Byte19_oRDR_XCP_CTO_REQ_oPCAN_RADAR_4f5525d4_Rx: ComBitPosition=159, ComSystemTemplateSystemSignalRef=STS_XCP_REQ_CTO_Byte19
            STS_XCP_REQ_CTO_Byte1_oRDR_XCP_CTO_REQ_oPCAN_RADAR_3ec3aa88_Rx: ComBitPosition=15, ComSystemTemplateSystemSignalRef=STS_XCP_REQ_CTO_Byte1
            STS_XCP_REQ_CTO_Byte20_oRDR_XCP_CTO_REQ_oPCAN_RADAR_586be1ae_Rx: ComBitPosition=167, ComSystemTemplateSystemSignalRef=STS_XCP_REQ_CTO_Byte20
            STS_XCP_REQ_CTO_Byte21_oRDR_XCP_CTO_REQ_oPCAN_RADAR_640b02a6_Rx: ComBitPosition=175, ComSystemTemplateSystemSignalRef=STS_XCP_REQ_CTO_Byte21
            STS_XCP_REQ_CTO_Byte22_oRDR_XCP_CTO_REQ_oPCAN_RADAR_20aa27be_Rx: ComBitPosition=183, ComSystemTemplateSystemSignalRef=STS_XCP_REQ_CTO_Byte22
            STS_XCP_REQ_CTO_Byte23_oRDR_XCP_CTO_REQ_oPCAN_RADAR_1ccac4b6_Rx: ComBitPosition=191, ComSystemTemplateSystemSignalRef=STS_XCP_REQ_CTO_Byte23
            STS_XCP_REQ_CTO_Byte24_oRDR_XCP_CTO_REQ_oPCAN_RADAR_a9e86d8e_Rx: ComBitPosition=199, ComSystemTemplateSystemSignalRef=STS_XCP_REQ_CTO_Byte24
            STS_XCP_REQ_CTO_Byte25_oRDR_XCP_CTO_REQ_oPCAN_RADAR_95888e86_Rx: ComBitPosition=207, ComSystemTemplateSystemSignalRef=STS_XCP_REQ_CTO_Byte25
            STS_XCP_REQ_CTO_Byte26_oRDR_XCP_CTO_REQ_oPCAN_RADAR_d129ab9e_Rx: ComBitPosition=215, ComSystemTemplateSystemSignalRef=STS_XCP_REQ_CTO_Byte26
            STS_XCP_REQ_CTO_Byte27_oRDR_XCP_CTO_REQ_oPCAN_RADAR_ed494896_Rx: ComBitPosition=223, ComSystemTemplateSystemSignalRef=STS_XCP_REQ_CTO_Byte27
            STS_XCP_REQ_CTO_Byte28_oRDR_XCP_CTO_REQ_oPCAN_RADAR_601dffaf_Rx: ComBitPosition=231, ComSystemTemplateSystemSignalRef=STS_XCP_REQ_CTO_Byte28
            STS_XCP_REQ_CTO_Byte29_oRDR_XCP_CTO_REQ_oPCAN_RADAR_5c7d1ca7_Rx: ComBitPosition=239, ComSystemTemplateSystemSignalRef=STS_XCP_REQ_CTO_Byte29
            STS_XCP_REQ_CTO_Byte2_oRDR_XCP_CTO_REQ_oPCAN_RADAR_7a628f90_Rx: ComBitPosition=23, ComSystemTemplateSystemSignalRef=STS_XCP_REQ_CTO_Byte2
            STS_XCP_REQ_CTO_Byte30_oRDR_XCP_CTO_REQ_oPCAN_RADAR_568c097f_Rx: ComBitPosition=247, ComSystemTemplateSystemSignalRef=STS_XCP_REQ_CTO_Byte30
            STS_XCP_REQ_CTO_Byte31_oRDR_XCP_CTO_REQ_oPCAN_RADAR_6aecea77_Rx: ComBitPosition=255, ComSystemTemplateSystemSignalRef=STS_XCP_REQ_CTO_Byte31
            STS_XCP_REQ_CTO_Byte32_oRDR_XCP_CTO_REQ_oPCAN_RADAR_2e4dcf6f_Rx: ComBitPosition=263, ComSystemTemplateSystemSignalRef=STS_XCP_REQ_CTO_Byte32
            STS_XCP_REQ_CTO_Byte33_oRDR_XCP_CTO_REQ_oPCAN_RADAR_122d2c67_Rx: ComBitPosition=271, ComSystemTemplateSystemSignalRef=STS_XCP_REQ_CTO_Byte33
            STS_XCP_REQ_CTO_Byte34_oRDR_XCP_CTO_REQ_oPCAN_RADAR_a70f855f_Rx: ComBitPosition=279, ComSystemTemplateSystemSignalRef=STS_XCP_REQ_CTO_Byte34
            STS_XCP_REQ_CTO_Byte35_oRDR_XCP_CTO_REQ_oPCAN_RADAR_9b6f6657_Rx: ComBitPosition=287, ComSystemTemplateSystemSignalRef=STS_XCP_REQ_CTO_Byte35
            STS_XCP_REQ_CTO_Byte36_oRDR_XCP_CTO_REQ_oPCAN_RADAR_dfce434f_Rx: ComBitPosition=295, ComSystemTemplateSystemSignalRef=STS_XCP_REQ_CTO_Byte36
            STS_XCP_REQ_CTO_Byte37_oRDR_XCP_CTO_REQ_oPCAN_RADAR_e3aea047_Rx: ComBitPosition=303, ComSystemTemplateSystemSignalRef=STS_XCP_REQ_CTO_Byte37
            STS_XCP_REQ_CTO_Byte38_oRDR_XCP_CTO_REQ_oPCAN_RADAR_6efa177e_Rx: ComBitPosition=311, ComSystemTemplateSystemSignalRef=STS_XCP_REQ_CTO_Byte38
            STS_XCP_REQ_CTO_Byte39_oRDR_XCP_CTO_REQ_oPCAN_RADAR_529af476_Rx: ComBitPosition=319, ComSystemTemplateSystemSignalRef=STS_XCP_REQ_CTO_Byte39
            STS_XCP_REQ_CTO_Byte3_oRDR_XCP_CTO_REQ_oPCAN_RADAR_46026c98_Rx: ComBitPosition=31, ComSystemTemplateSystemSignalRef=STS_XCP_REQ_CTO_Byte3
            STS_XCP_REQ_CTO_Byte40_oRDR_XCP_CTO_REQ_oPCAN_RADAR_7e3b9348_Rx: ComBitPosition=327, ComSystemTemplateSystemSignalRef=STS_XCP_REQ_CTO_Byte40
            STS_XCP_REQ_CTO_Byte41_oRDR_XCP_CTO_REQ_oPCAN_RADAR_425b7040_Rx: ComBitPosition=335, ComSystemTemplateSystemSignalRef=STS_XCP_REQ_CTO_Byte41
            STS_XCP_REQ_CTO_Byte42_oRDR_XCP_CTO_REQ_oPCAN_RADAR_06fa5558_Rx: ComBitPosition=343, ComSystemTemplateSystemSignalRef=STS_XCP_REQ_CTO_Byte42
            STS_XCP_REQ_CTO_Byte43_oRDR_XCP_CTO_REQ_oPCAN_RADAR_3a9ab650_Rx: ComBitPosition=351, ComSystemTemplateSystemSignalRef=STS_XCP_REQ_CTO_Byte43
            STS_XCP_REQ_CTO_Byte44_oRDR_XCP_CTO_REQ_oPCAN_RADAR_8fb81f68_Rx: ComBitPosition=359, ComSystemTemplateSystemSignalRef=STS_XCP_REQ_CTO_Byte44
            STS_XCP_REQ_CTO_Byte45_oRDR_XCP_CTO_REQ_oPCAN_RADAR_b3d8fc60_Rx: ComBitPosition=367, ComSystemTemplateSystemSignalRef=STS_XCP_REQ_CTO_Byte45
            STS_XCP_REQ_CTO_Byte46_oRDR_XCP_CTO_REQ_oPCAN_RADAR_f779d978_Rx: ComBitPosition=375, ComSystemTemplateSystemSignalRef=STS_XCP_REQ_CTO_Byte46
            STS_XCP_REQ_CTO_Byte47_oRDR_XCP_CTO_REQ_oPCAN_RADAR_cb193a70_Rx: ComBitPosition=383, ComSystemTemplateSystemSignalRef=STS_XCP_REQ_CTO_Byte47
            STS_XCP_REQ_CTO_Byte48_oRDR_XCP_CTO_REQ_oPCAN_RADAR_464d8d49_Rx: ComBitPosition=391, ComSystemTemplateSystemSignalRef=STS_XCP_REQ_CTO_Byte48
            STS_XCP_REQ_CTO_Byte49_oRDR_XCP_CTO_REQ_oPCAN_RADAR_7a2d6e41_Rx: ComBitPosition=399, ComSystemTemplateSystemSignalRef=STS_XCP_REQ_CTO_Byte49
            STS_XCP_REQ_CTO_Byte4_oRDR_XCP_CTO_REQ_oPCAN_RADAR_f320c5a0_Rx: ComBitPosition=39, ComSystemTemplateSystemSignalRef=STS_XCP_REQ_CTO_Byte4
            STS_XCP_REQ_CTO_Byte50_oRDR_XCP_CTO_REQ_oPCAN_RADAR_70dc7b99_Rx: ComBitPosition=407, ComSystemTemplateSystemSignalRef=STS_XCP_REQ_CTO_Byte50
            STS_XCP_REQ_CTO_Byte51_oRDR_XCP_CTO_REQ_oPCAN_RADAR_4cbc9891_Rx: ComBitPosition=415, ComSystemTemplateSystemSignalRef=STS_XCP_REQ_CTO_Byte51
            STS_XCP_REQ_CTO_Byte52_oRDR_XCP_CTO_REQ_oPCAN_RADAR_081dbd89_Rx: ComBitPosition=423, ComSystemTemplateSystemSignalRef=STS_XCP_REQ_CTO_Byte52
            STS_XCP_REQ_CTO_Byte53_oRDR_XCP_CTO_REQ_oPCAN_RADAR_347d5e81_Rx: ComBitPosition=431, ComSystemTemplateSystemSignalRef=STS_XCP_REQ_CTO_Byte53
            STS_XCP_REQ_CTO_Byte54_oRDR_XCP_CTO_REQ_oPCAN_RADAR_815ff7b9_Rx: ComBitPosition=439, ComSystemTemplateSystemSignalRef=STS_XCP_REQ_CTO_Byte54
            STS_XCP_REQ_CTO_Byte55_oRDR_XCP_CTO_REQ_oPCAN_RADAR_bd3f14b1_Rx: ComBitPosition=447, ComSystemTemplateSystemSignalRef=STS_XCP_REQ_CTO_Byte55
            STS_XCP_REQ_CTO_Byte56_oRDR_XCP_CTO_REQ_oPCAN_RADAR_f99e31a9_Rx: ComBitPosition=455, ComSystemTemplateSystemSignalRef=STS_XCP_REQ_CTO_Byte56
            STS_XCP_REQ_CTO_Byte57_oRDR_XCP_CTO_REQ_oPCAN_RADAR_c5fed2a1_Rx: ComBitPosition=463, ComSystemTemplateSystemSignalRef=STS_XCP_REQ_CTO_Byte57
            STS_XCP_REQ_CTO_Byte58_oRDR_XCP_CTO_REQ_oPCAN_RADAR_48aa6598_Rx: ComBitPosition=471, ComSystemTemplateSystemSignalRef=STS_XCP_REQ_CTO_Byte58
            STS_XCP_REQ_CTO_Byte59_oRDR_XCP_CTO_REQ_oPCAN_RADAR_74ca8690_Rx: ComBitPosition=479, ComSystemTemplateSystemSignalRef=STS_XCP_REQ_CTO_Byte59
            STS_XCP_REQ_CTO_Byte5_oRDR_XCP_CTO_REQ_oPCAN_RADAR_cf4026a8_Rx: ComBitPosition=47, ComSystemTemplateSystemSignalRef=STS_XCP_REQ_CTO_Byte5
            STS_XCP_REQ_CTO_Byte60_oRDR_XCP_CTO_REQ_oPCAN_RADAR_63f442ea_Rx: ComBitPosition=487, ComSystemTemplateSystemSignalRef=STS_XCP_REQ_CTO_Byte60
            STS_XCP_REQ_CTO_Byte61_oRDR_XCP_CTO_REQ_oPCAN_RADAR_5f94a1e2_Rx: ComBitPosition=495, ComSystemTemplateSystemSignalRef=STS_XCP_REQ_CTO_Byte61
            STS_XCP_REQ_CTO_Byte62_oRDR_XCP_CTO_REQ_oPCAN_RADAR_1b3584fa_Rx: ComBitPosition=503, ComSystemTemplateSystemSignalRef=STS_XCP_REQ_CTO_Byte62
            STS_XCP_REQ_CTO_Byte63_oRDR_XCP_CTO_REQ_oPCAN_RADAR_275567f2_Rx: ComBitPosition=511, ComSystemTemplateSystemSignalRef=STS_XCP_REQ_CTO_Byte63
            STS_XCP_REQ_CTO_Byte6_oRDR_XCP_CTO_REQ_oPCAN_RADAR_8be103b0_Rx: ComBitPosition=55, ComSystemTemplateSystemSignalRef=STS_XCP_REQ_CTO_Byte6
            STS_XCP_REQ_CTO_Byte7_oRDR_XCP_CTO_REQ_oPCAN_RADAR_b781e0b8_Rx: ComBitPosition=63, ComSystemTemplateSystemSignalRef=STS_XCP_REQ_CTO_Byte7
            STS_XCP_REQ_CTO_Byte8_oRDR_XCP_CTO_REQ_oPCAN_RADAR_3ad55781_Rx: ComBitPosition=71, ComSystemTemplateSystemSignalRef=STS_XCP_REQ_CTO_Byte8
            STS_XCP_REQ_CTO_Byte9_oRDR_XCP_CTO_REQ_oPCAN_RADAR_06b5b489_Rx: ComBitPosition=79, ComSystemTemplateSystemSignalRef=STS_XCP_REQ_CTO_Byte9
        SG_XcpCTOResp_oRDR_XCP_CTO_RESP_oPCAN_RADAR_b0b06e8a_Tx: ComSystemTemplateSignalGroupRef=SG_XcpCTOResp
          64 x ComGroupSignal, all with ComBitSize=8, ComSignalEndianness=BIG_ENDIAN, ComSignalInitValue=0, ComSignalType=UINT8, ComTransferProperty=PENDING:
            STS_XCP_RES_CTO_Byte0_oRDR_XCP_CTO_RESP_oPCAN_RADAR_e9e45a05_Tx: ComBitPosition=7, ComSystemTemplateSystemSignalRef=STS_XCP_RES_CTO_Byte0
            STS_XCP_RES_CTO_Byte10_oRDR_XCP_CTO_RESP_oPCAN_RADAR_6e2bbf43_Tx: ComBitPosition=87, ComSystemTemplateSystemSignalRef=STS_XCP_RES_CTO_Byte10
            STS_XCP_RES_CTO_Byte11_oRDR_XCP_CTO_RESP_oPCAN_RADAR_60cc5792_Tx: ComBitPosition=95, ComSystemTemplateSystemSignalRef=STS_XCP_RES_CTO_Byte11
            STS_XCP_RES_CTO_Byte12_oRDR_XCP_CTO_RESP_oPCAN_RADAR_73e46ee1_Tx: ComBitPosition=103, ComSystemTemplateSystemSignalRef=STS_XCP_RES_CTO_Byte12
            STS_XCP_RES_CTO_Byte13_oRDR_XCP_CTO_RESP_oPCAN_RADAR_7d038630_Tx: ComBitPosition=111, ComSystemTemplateSystemSignalRef=STS_XCP_RES_CTO_Byte13
            STS_XCP_RES_CTO_Byte14_oRDR_XCP_CTO_RESP_oPCAN_RADAR_55b41c07_Tx: ComBitPosition=119, ComSystemTemplateSystemSignalRef=STS_XCP_RES_CTO_Byte14
            STS_XCP_RES_CTO_Byte15_oRDR_XCP_CTO_RESP_oPCAN_RADAR_5b53f4d6_Tx: ComBitPosition=127, ComSystemTemplateSystemSignalRef=STS_XCP_RES_CTO_Byte15
            STS_XCP_RES_CTO_Byte16_oRDR_XCP_CTO_RESP_oPCAN_RADAR_487bcda5_Tx: ComBitPosition=135, ComSystemTemplateSystemSignalRef=STS_XCP_RES_CTO_Byte16
            STS_XCP_RES_CTO_Byte17_oRDR_XCP_CTO_RESP_oPCAN_RADAR_469c2574_Tx: ComBitPosition=143, ComSystemTemplateSystemSignalRef=STS_XCP_RES_CTO_Byte17
            STS_XCP_RES_CTO_Byte18_oRDR_XCP_CTO_RESP_oPCAN_RADAR_1914f9cb_Tx: ComBitPosition=151, ComSystemTemplateSystemSignalRef=STS_XCP_RES_CTO_Byte18
            STS_XCP_RES_CTO_Byte19_oRDR_XCP_CTO_RESP_oPCAN_RADAR_17f3111a_Tx: ComBitPosition=159, ComSystemTemplateSystemSignalRef=STS_XCP_RES_CTO_Byte19
            STS_XCP_RES_CTO_Byte1_oRDR_XCP_CTO_RESP_oPCAN_RADAR_e703b2d4_Tx: ComBitPosition=15, ComSystemTemplateSystemSignalRef=STS_XCP_RES_CTO_Byte1
            STS_XCP_RES_CTO_Byte20_oRDR_XCP_CTO_RESP_oPCAN_RADAR_a734b7fc_Tx: ComBitPosition=167, ComSystemTemplateSystemSignalRef=STS_XCP_RES_CTO_Byte20
            STS_XCP_RES_CTO_Byte21_oRDR_XCP_CTO_RESP_oPCAN_RADAR_a9d35f2d_Tx: ComBitPosition=175, ComSystemTemplateSystemSignalRef=STS_XCP_RES_CTO_Byte21
            STS_XCP_RES_CTO_Byte22_oRDR_XCP_CTO_RESP_oPCAN_RADAR_bafb665e_Tx: ComBitPosition=183, ComSystemTemplateSystemSignalRef=STS_XCP_RES_CTO_Byte22
            STS_XCP_RES_CTO_Byte23_oRDR_XCP_CTO_RESP_oPCAN_RADAR_b41c8e8f_Tx: ComBitPosition=191, ComSystemTemplateSystemSignalRef=STS_XCP_RES_CTO_Byte23
            STS_XCP_RES_CTO_Byte24_oRDR_XCP_CTO_RESP_oPCAN_RADAR_9cab14b8_Tx: ComBitPosition=199, ComSystemTemplateSystemSignalRef=STS_XCP_RES_CTO_Byte24
            STS_XCP_RES_CTO_Byte25_oRDR_XCP_CTO_RESP_oPCAN_RADAR_924cfc69_Tx: ComBitPosition=207, ComSystemTemplateSystemSignalRef=STS_XCP_RES_CTO_Byte25
            STS_XCP_RES_CTO_Byte26_oRDR_XCP_CTO_RESP_oPCAN_RADAR_8164c51a_Tx: ComBitPosition=215, ComSystemTemplateSystemSignalRef=STS_XCP_RES_CTO_Byte26
            STS_XCP_RES_CTO_Byte27_oRDR_XCP_CTO_RESP_oPCAN_RADAR_8f832dcb_Tx: ComBitPosition=223, ComSystemTemplateSystemSignalRef=STS_XCP_RES_CTO_Byte27
            STS_XCP_RES_CTO_Byte28_oRDR_XCP_CTO_RESP_oPCAN_RADAR_d00bf174_Tx: ComBitPosition=231, ComSystemTemplateSystemSignalRef=STS_XCP_RES_CTO_Byte28
            STS_XCP_RES_CTO_Byte29_oRDR_XCP_CTO_RESP_oPCAN_RADAR_deec19a5_Tx: ComBitPosition=239, ComSystemTemplateSystemSignalRef=STS_XCP_RES_CTO_Byte29
            STS_XCP_RES_CTO_Byte2_oRDR_XCP_CTO_RESP_oPCAN_RADAR_f42b8ba7_Tx: ComBitPosition=23, ComSystemTemplateSystemSignalRef=STS_XCP_RES_CTO_Byte2
            STS_XCP_RES_CTO_Byte30_oRDR_XCP_CTO_RESP_oPCAN_RADAR_56eeb256_Tx: ComBitPosition=247, ComSystemTemplateSystemSignalRef=STS_XCP_RES_CTO_Byte30
            STS_XCP_RES_CTO_Byte31_oRDR_XCP_CTO_RESP_oPCAN_RADAR_58095a87_Tx: ComBitPosition=255, ComSystemTemplateSystemSignalRef=STS_XCP_RES_CTO_Byte31
            STS_XCP_RES_CTO_Byte32_oRDR_XCP_CTO_RESP_oPCAN_RADAR_4b2163f4_Tx: ComBitPosition=263, ComSystemTemplateSystemSignalRef=STS_XCP_RES_CTO_Byte32
            STS_XCP_RES_CTO_Byte33_oRDR_XCP_CTO_RESP_oPCAN_RADAR_45c68b25_Tx: ComBitPosition=271, ComSystemTemplateSystemSignalRef=STS_XCP_RES_CTO_Byte33
            STS_XCP_RES_CTO_Byte34_oRDR_XCP_CTO_RESP_oPCAN_RADAR_6d711112_Tx: ComBitPosition=279, ComSystemTemplateSystemSignalRef=STS_XCP_RES_CTO_Byte34
            STS_XCP_RES_CTO_Byte35_oRDR_XCP_CTO_RESP_oPCAN_RADAR_6396f9c3_Tx: ComBitPosition=287, ComSystemTemplateSystemSignalRef=STS_XCP_RES_CTO_Byte35
            STS_XCP_RES_CTO_Byte36_oRDR_XCP_CTO_RESP_oPCAN_RADAR_70bec0b0_Tx: ComBitPosition=295, ComSystemTemplateSystemSignalRef=STS_XCP_RES_CTO_Byte36
            STS_XCP_RES_CTO_Byte37_oRDR_XCP_CTO_RESP_oPCAN_RADAR_7e592861_Tx: ComBitPosition=303, ComSystemTemplateSystemSignalRef=STS_XCP_RES_CTO_Byte37
            STS_XCP_RES_CTO_Byte38_oRDR_XCP_CTO_RESP_oPCAN_RADAR_21d1f4de_Tx: ComBitPosition=311, ComSystemTemplateSystemSignalRef=STS_XCP_RES_CTO_Byte38
            STS_XCP_RES_CTO_Byte39_oRDR_XCP_CTO_RESP_oPCAN_RADAR_2f361c0f_Tx: ComBitPosition=319, ComSystemTemplateSystemSignalRef=STS_XCP_RES_CTO_Byte39
            STS_XCP_RES_CTO_Byte3_oRDR_XCP_CTO_RESP_oPCAN_RADAR_facc6376_Tx: ComBitPosition=31, ComSystemTemplateSystemSignalRef=STS_XCP_RES_CTO_Byte3
            STS_XCP_RES_CTO_Byte40_oRDR_XCP_CTO_RESP_oPCAN_RADAR_ee7ba0c3_Tx: ComBitPosition=327, ComSystemTemplateSystemSignalRef=STS_XCP_RES_CTO_Byte40
            STS_XCP_RES_CTO_Byte41_oRDR_XCP_CTO_RESP_oPCAN_RADAR_e09c4812_Tx: ComBitPosition=335, ComSystemTemplateSystemSignalRef=STS_XCP_RES_CTO_Byte41
            STS_XCP_RES_CTO_Byte42_oRDR_XCP_CTO_RESP_oPCAN_RADAR_f3b47161_Tx: ComBitPosition=343, ComSystemTemplateSystemSignalRef=STS_XCP_RES_CTO_Byte42
            STS_XCP_RES_CTO_Byte43_oRDR_XCP_CTO_RESP_oPCAN_RADAR_fd5399b0_Tx: ComBitPosition=351, ComSystemTemplateSystemSignalRef=STS_XCP_RES_CTO_Byte43
            STS_XCP_RES_CTO_Byte44_oRDR_XCP_CTO_RESP_oPCAN_RADAR_d5e40387_Tx: ComBitPosition=359, ComSystemTemplateSystemSignalRef=STS_XCP_RES_CTO_Byte44
            STS_XCP_RES_CTO_Byte45_oRDR_XCP_CTO_RESP_oPCAN_RADAR_db03eb56_Tx: ComBitPosition=367, ComSystemTemplateSystemSignalRef=STS_XCP_RES_CTO_Byte45
            STS_XCP_RES_CTO_Byte46_oRDR_XCP_CTO_RESP_oPCAN_RADAR_c82bd225_Tx: ComBitPosition=375, ComSystemTemplateSystemSignalRef=STS_XCP_RES_CTO_Byte46
            STS_XCP_RES_CTO_Byte47_oRDR_XCP_CTO_RESP_oPCAN_RADAR_c6cc3af4_Tx: ComBitPosition=383, ComSystemTemplateSystemSignalRef=STS_XCP_RES_CTO_Byte47
            STS_XCP_RES_CTO_Byte48_oRDR_XCP_CTO_RESP_oPCAN_RADAR_9944e64b_Tx: ComBitPosition=391, ComSystemTemplateSystemSignalRef=STS_XCP_RES_CTO_Byte48
            STS_XCP_RES_CTO_Byte49_oRDR_XCP_CTO_RESP_oPCAN_RADAR_97a30e9a_Tx: ComBitPosition=399, ComSystemTemplateSystemSignalRef=STS_XCP_RES_CTO_Byte49
            STS_XCP_RES_CTO_Byte4_oRDR_XCP_CTO_RESP_oPCAN_RADAR_d27bf941_Tx: ComBitPosition=39, ComSystemTemplateSystemSignalRef=STS_XCP_RES_CTO_Byte4
            STS_XCP_RES_CTO_Byte50_oRDR_XCP_CTO_RESP_oPCAN_RADAR_1fa1a569_Tx: ComBitPosition=407, ComSystemTemplateSystemSignalRef=STS_XCP_RES_CTO_Byte50
            STS_XCP_RES_CTO_Byte51_oRDR_XCP_CTO_RESP_oPCAN_RADAR_11464db8_Tx: ComBitPosition=415, ComSystemTemplateSystemSignalRef=STS_XCP_RES_CTO_Byte51
            STS_XCP_RES_CTO_Byte52_oRDR_XCP_CTO_RESP_oPCAN_RADAR_026e74cb_Tx: ComBitPosition=423, ComSystemTemplateSystemSignalRef=STS_XCP_RES_CTO_Byte52
            STS_XCP_RES_CTO_Byte53_oRDR_XCP_CTO_RESP_oPCAN_RADAR_0c899c1a_Tx: ComBitPosition=431, ComSystemTemplateSystemSignalRef=STS_XCP_RES_CTO_Byte53
            STS_XCP_RES_CTO_Byte54_oRDR_XCP_CTO_RESP_oPCAN_RADAR_243e062d_Tx: ComBitPosition=439, ComSystemTemplateSystemSignalRef=STS_XCP_RES_CTO_Byte54
            STS_XCP_RES_CTO_Byte55_oRDR_XCP_CTO_RESP_oPCAN_RADAR_2ad9eefc_Tx: ComBitPosition=447, ComSystemTemplateSystemSignalRef=STS_XCP_RES_CTO_Byte55
            STS_XCP_RES_CTO_Byte56_oRDR_XCP_CTO_RESP_oPCAN_RADAR_39f1d78f_Tx: ComBitPosition=455, ComSystemTemplateSystemSignalRef=STS_XCP_RES_CTO_Byte56
            STS_XCP_RES_CTO_Byte57_oRDR_XCP_CTO_RESP_oPCAN_RADAR_37163f5e_Tx: ComBitPosition=463, ComSystemTemplateSystemSignalRef=STS_XCP_RES_CTO_Byte57
            STS_XCP_RES_CTO_Byte58_oRDR_XCP_CTO_RESP_oPCAN_RADAR_689ee3e1_Tx: ComBitPosition=471, ComSystemTemplateSystemSignalRef=STS_XCP_RES_CTO_Byte58
            STS_XCP_RES_CTO_Byte59_oRDR_XCP_CTO_RESP_oPCAN_RADAR_66790b30_Tx: ComBitPosition=479, ComSystemTemplateSystemSignalRef=STS_XCP_RES_CTO_Byte59
            STS_XCP_RES_CTO_Byte5_oRDR_XCP_CTO_RESP_oPCAN_RADAR_dc9c1190_Tx: ComBitPosition=47, ComSystemTemplateSystemSignalRef=STS_XCP_RES_CTO_Byte5
            STS_XCP_RES_CTO_Byte60_oRDR_XCP_CTO_RESP_oPCAN_RADAR_d6beadd6_Tx: ComBitPosition=487, ComSystemTemplateSystemSignalRef=STS_XCP_RES_CTO_Byte60
            STS_XCP_RES_CTO_Byte61_oRDR_XCP_CTO_RESP_oPCAN_RADAR_d8594507_Tx: ComBitPosition=495, ComSystemTemplateSystemSignalRef=STS_XCP_RES_CTO_Byte61
            STS_XCP_RES_CTO_Byte62_oRDR_XCP_CTO_RESP_oPCAN_RADAR_cb717c74_Tx: ComBitPosition=503, ComSystemTemplateSystemSignalRef=STS_XCP_RES_CTO_Byte62
            STS_XCP_RES_CTO_Byte63_oRDR_XCP_CTO_RESP_oPCAN_RADAR_c59694a5_Tx: ComBitPosition=511, ComSystemTemplateSystemSignalRef=STS_XCP_RES_CTO_Byte63
            STS_XCP_RES_CTO_Byte6_oRDR_XCP_CTO_RESP_oPCAN_RADAR_cfb428e3_Tx: ComBitPosition=55, ComSystemTemplateSystemSignalRef=STS_XCP_RES_CTO_Byte6
            STS_XCP_RES_CTO_Byte7_oRDR_XCP_CTO_RESP_oPCAN_RADAR_c153c032_Tx: ComBitPosition=63, ComSystemTemplateSystemSignalRef=STS_XCP_RES_CTO_Byte7
            STS_XCP_RES_CTO_Byte8_oRDR_XCP_CTO_RESP_oPCAN_RADAR_9edb1c8d_Tx: ComBitPosition=71, ComSystemTemplateSystemSignalRef=STS_XCP_RES_CTO_Byte8
            STS_XCP_RES_CTO_Byte9_oRDR_XCP_CTO_RESP_oPCAN_RADAR_903cf45c_Tx: ComBitPosition=79, ComSystemTemplateSystemSignalRef=STS_XCP_RES_CTO_Byte9
        SG_XcpDAQResp_oRDR_XCP_DAQ_RESP_oPCAN_RADAR_7a892884_Tx: ComSystemTemplateSignalGroupRef=SG_XcpDAQResp
          64 x ComGroupSignal, all with ComBitSize=8, ComSignalEndianness=BIG_ENDIAN, ComSignalInitValue=0, ComSignalType=UINT8, ComTransferProperty=PENDING:
            STS_XCP_RES_DAQ_Byte0_oRDR_XCP_DAQ_RESP_oPCAN_RADAR_49fa4c6e_Tx: ComBitPosition=7, ComSystemTemplateSystemSignalRef=STS_XCP_RES_DAQ_Byte0
            STS_XCP_RES_DAQ_Byte10_oRDR_XCP_DAQ_RESP_oPCAN_RADAR_6a7d97c9_Tx: ComBitPosition=87, ComSystemTemplateSystemSignalRef=STS_XCP_RES_DAQ_Byte10
            STS_XCP_RES_DAQ_Byte11_oRDR_XCP_DAQ_RESP_oPCAN_RADAR_649a7f18_Tx: ComBitPosition=95, ComSystemTemplateSystemSignalRef=STS_XCP_RES_DAQ_Byte11
            STS_XCP_RES_DAQ_Byte12_oRDR_XCP_DAQ_RESP_oPCAN_RADAR_77b2466b_Tx: ComBitPosition=103, ComSystemTemplateSystemSignalRef=STS_XCP_RES_DAQ_Byte12
            STS_XCP_RES_DAQ_Byte13_oRDR_XCP_DAQ_RESP_oPCAN_RADAR_7955aeba_Tx: ComBitPosition=111, ComSystemTemplateSystemSignalRef=STS_XCP_RES_DAQ_Byte13
            STS_XCP_RES_DAQ_Byte14_oRDR_XCP_DAQ_RESP_oPCAN_RADAR_51e2348d_Tx: ComBitPosition=119, ComSystemTemplateSystemSignalRef=STS_XCP_RES_DAQ_Byte14
            STS_XCP_RES_DAQ_Byte15_oRDR_XCP_DAQ_RESP_oPCAN_RADAR_5f05dc5c_Tx: ComBitPosition=127, ComSystemTemplateSystemSignalRef=STS_XCP_RES_DAQ_Byte15
            STS_XCP_RES_DAQ_Byte16_oRDR_XCP_DAQ_RESP_oPCAN_RADAR_4c2de52f_Tx: ComBitPosition=135, ComSystemTemplateSystemSignalRef=STS_XCP_RES_DAQ_Byte16
            STS_XCP_RES_DAQ_Byte17_oRDR_XCP_DAQ_RESP_oPCAN_RADAR_42ca0dfe_Tx: ComBitPosition=143, ComSystemTemplateSystemSignalRef=STS_XCP_RES_DAQ_Byte17
            STS_XCP_RES_DAQ_Byte18_oRDR_XCP_DAQ_RESP_oPCAN_RADAR_1d42d141_Tx: ComBitPosition=151, ComSystemTemplateSystemSignalRef=STS_XCP_RES_DAQ_Byte18
            STS_XCP_RES_DAQ_Byte19_oRDR_XCP_DAQ_RESP_oPCAN_RADAR_13a53990_Tx: ComBitPosition=159, ComSystemTemplateSystemSignalRef=STS_XCP_RES_DAQ_Byte19
            STS_XCP_RES_DAQ_Byte1_oRDR_XCP_DAQ_RESP_oPCAN_RADAR_471da4bf_Tx: ComBitPosition=15, ComSystemTemplateSystemSignalRef=STS_XCP_RES_DAQ_Byte1
            STS_XCP_RES_DAQ_Byte20_oRDR_XCP_DAQ_RESP_oPCAN_RADAR_a3629f76_Tx: ComBitPosition=167, ComSystemTemplateSystemSignalRef=STS_XCP_RES_DAQ_Byte20
            STS_XCP_RES_DAQ_Byte21_oRDR_XCP_DAQ_RESP_oPCAN_RADAR_ad8577a7_Tx: ComBitPosition=175, ComSystemTemplateSystemSignalRef=STS_XCP_RES_DAQ_Byte21
            STS_XCP_RES_DAQ_Byte22_oRDR_XCP_DAQ_RESP_oPCAN_RADAR_bead4ed4_Tx: ComBitPosition=183, ComSystemTemplateSystemSignalRef=STS_XCP_RES_DAQ_Byte22
            STS_XCP_RES_DAQ_Byte23_oRDR_XCP_DAQ_RESP_oPCAN_RADAR_b04aa605_Tx: ComBitPosition=191, ComSystemTemplateSystemSignalRef=STS_XCP_RES_DAQ_Byte23
            STS_XCP_RES_DAQ_Byte24_oRDR_XCP_DAQ_RESP_oPCAN_RADAR_98fd3c32_Tx: ComBitPosition=199, ComSystemTemplateSystemSignalRef=STS_XCP_RES_DAQ_Byte24
            STS_XCP_RES_DAQ_Byte25_oRDR_XCP_DAQ_RESP_oPCAN_RADAR_961ad4e3_Tx: ComBitPosition=207, ComSystemTemplateSystemSignalRef=STS_XCP_RES_DAQ_Byte25
            STS_XCP_RES_DAQ_Byte26_oRDR_XCP_DAQ_RESP_oPCAN_RADAR_8532ed90_Tx: ComBitPosition=215, ComSystemTemplateSystemSignalRef=STS_XCP_RES_DAQ_Byte26
            STS_XCP_RES_DAQ_Byte27_oRDR_XCP_DAQ_RESP_oPCAN_RADAR_8bd50541_Tx: ComBitPosition=223, ComSystemTemplateSystemSignalRef=STS_XCP_RES_DAQ_Byte27
            STS_XCP_RES_DAQ_Byte28_oRDR_XCP_DAQ_RESP_oPCAN_RADAR_d45dd9fe_Tx: ComBitPosition=231, ComSystemTemplateSystemSignalRef=STS_XCP_RES_DAQ_Byte28
            STS_XCP_RES_DAQ_Byte29_oRDR_XCP_DAQ_RESP_oPCAN_RADAR_daba312f_Tx: ComBitPosition=239, ComSystemTemplateSystemSignalRef=STS_XCP_RES_DAQ_Byte29
            STS_XCP_RES_DAQ_Byte2_oRDR_XCP_DAQ_RESP_oPCAN_RADAR_54359dcc_Tx: ComBitPosition=23, ComSystemTemplateSystemSignalRef=STS_XCP_RES_DAQ_Byte2
            STS_XCP_RES_DAQ_Byte30_oRDR_XCP_DAQ_RESP_oPCAN_RADAR_52b89adc_Tx: ComBitPosition=247, ComSystemTemplateSystemSignalRef=STS_XCP_RES_DAQ_Byte30
            STS_XCP_RES_DAQ_Byte31_oRDR_XCP_DAQ_RESP_oPCAN_RADAR_5c5f720d_Tx: ComBitPosition=255, ComSystemTemplateSystemSignalRef=STS_XCP_RES_DAQ_Byte31
            STS_XCP_RES_DAQ_Byte32_oRDR_XCP_DAQ_RESP_oPCAN_RADAR_4f774b7e_Tx: ComBitPosition=263, ComSystemTemplateSystemSignalRef=STS_XCP_RES_DAQ_Byte32
            STS_XCP_RES_DAQ_Byte33_oRDR_XCP_DAQ_RESP_oPCAN_RADAR_4190a3af_Tx: ComBitPosition=271, ComSystemTemplateSystemSignalRef=STS_XCP_RES_DAQ_Byte33
            STS_XCP_RES_DAQ_Byte34_oRDR_XCP_DAQ_RESP_oPCAN_RADAR_69273998_Tx: ComBitPosition=279, ComSystemTemplateSystemSignalRef=STS_XCP_RES_DAQ_Byte34
            STS_XCP_RES_DAQ_Byte35_oRDR_XCP_DAQ_RESP_oPCAN_RADAR_67c0d149_Tx: ComBitPosition=287, ComSystemTemplateSystemSignalRef=STS_XCP_RES_DAQ_Byte35
            STS_XCP_RES_DAQ_Byte36_oRDR_XCP_DAQ_RESP_oPCAN_RADAR_74e8e83a_Tx: ComBitPosition=295, ComSystemTemplateSystemSignalRef=STS_XCP_RES_DAQ_Byte36
            STS_XCP_RES_DAQ_Byte37_oRDR_XCP_DAQ_RESP_oPCAN_RADAR_7a0f00eb_Tx: ComBitPosition=303, ComSystemTemplateSystemSignalRef=STS_XCP_RES_DAQ_Byte37
            STS_XCP_RES_DAQ_Byte38_oRDR_XCP_DAQ_RESP_oPCAN_RADAR_2587dc54_Tx: ComBitPosition=311, ComSystemTemplateSystemSignalRef=STS_XCP_RES_DAQ_Byte38
            STS_XCP_RES_DAQ_Byte39_oRDR_XCP_DAQ_RESP_oPCAN_RADAR_2b603485_Tx: ComBitPosition=319, ComSystemTemplateSystemSignalRef=STS_XCP_RES_DAQ_Byte39
            STS_XCP_RES_DAQ_Byte3_oRDR_XCP_DAQ_RESP_oPCAN_RADAR_5ad2751d_Tx: ComBitPosition=31, ComSystemTemplateSystemSignalRef=STS_XCP_RES_DAQ_Byte3
            STS_XCP_RES_DAQ_Byte40_oRDR_XCP_DAQ_RESP_oPCAN_RADAR_ea2d8849_Tx: ComBitPosition=327, ComSystemTemplateSystemSignalRef=STS_XCP_RES_DAQ_Byte40
            STS_XCP_RES_DAQ_Byte41_oRDR_XCP_DAQ_RESP_oPCAN_RADAR_e4ca6098_Tx: ComBitPosition=335, ComSystemTemplateSystemSignalRef=STS_XCP_RES_DAQ_Byte41
            STS_XCP_RES_DAQ_Byte42_oRDR_XCP_DAQ_RESP_oPCAN_RADAR_f7e259eb_Tx: ComBitPosition=343, ComSystemTemplateSystemSignalRef=STS_XCP_RES_DAQ_Byte42
            STS_XCP_RES_DAQ_Byte43_oRDR_XCP_DAQ_RESP_oPCAN_RADAR_f905b13a_Tx: ComBitPosition=351, ComSystemTemplateSystemSignalRef=STS_XCP_RES_DAQ_Byte43
            STS_XCP_RES_DAQ_Byte44_oRDR_XCP_DAQ_RESP_oPCAN_RADAR_d1b22b0d_Tx: ComBitPosition=359, ComSystemTemplateSystemSignalRef=STS_XCP_RES_DAQ_Byte44
            STS_XCP_RES_DAQ_Byte45_oRDR_XCP_DAQ_RESP_oPCAN_RADAR_df55c3dc_Tx: ComBitPosition=367, ComSystemTemplateSystemSignalRef=STS_XCP_RES_DAQ_Byte45
            STS_XCP_RES_DAQ_Byte46_oRDR_XCP_DAQ_RESP_oPCAN_RADAR_cc7dfaaf_Tx: ComBitPosition=375, ComSystemTemplateSystemSignalRef=STS_XCP_RES_DAQ_Byte46
            STS_XCP_RES_DAQ_Byte47_oRDR_XCP_DAQ_RESP_oPCAN_RADAR_c29a127e_Tx: ComBitPosition=383, ComSystemTemplateSystemSignalRef=STS_XCP_RES_DAQ_Byte47
            STS_XCP_RES_DAQ_Byte48_oRDR_XCP_DAQ_RESP_oPCAN_RADAR_9d12cec1_Tx: ComBitPosition=391, ComSystemTemplateSystemSignalRef=STS_XCP_RES_DAQ_Byte48
            STS_XCP_RES_DAQ_Byte49_oRDR_XCP_DAQ_RESP_oPCAN_RADAR_93f52610_Tx: ComBitPosition=399, ComSystemTemplateSystemSignalRef=STS_XCP_RES_DAQ_Byte49
            STS_XCP_RES_DAQ_Byte4_oRDR_XCP_DAQ_RESP_oPCAN_RADAR_7265ef2a_Tx: ComBitPosition=39, ComSystemTemplateSystemSignalRef=STS_XCP_RES_DAQ_Byte4
            STS_XCP_RES_DAQ_Byte50_oRDR_XCP_DAQ_RESP_oPCAN_RADAR_1bf78de3_Tx: ComBitPosition=407, ComSystemTemplateSystemSignalRef=STS_XCP_RES_DAQ_Byte50
            STS_XCP_RES_DAQ_Byte51_oRDR_XCP_DAQ_RESP_oPCAN_RADAR_15106532_Tx: ComBitPosition=415, ComSystemTemplateSystemSignalRef=STS_XCP_RES_DAQ_Byte51
            STS_XCP_RES_DAQ_Byte52_oRDR_XCP_DAQ_RESP_oPCAN_RADAR_06385c41_Tx: ComBitPosition=423, ComSystemTemplateSystemSignalRef=STS_XCP_RES_DAQ_Byte52
            STS_XCP_RES_DAQ_Byte53_oRDR_XCP_DAQ_RESP_oPCAN_RADAR_08dfb490_Tx: ComBitPosition=431, ComSystemTemplateSystemSignalRef=STS_XCP_RES_DAQ_Byte53
            STS_XCP_RES_DAQ_Byte54_oRDR_XCP_DAQ_RESP_oPCAN_RADAR_20682ea7_Tx: ComBitPosition=439, ComSystemTemplateSystemSignalRef=STS_XCP_RES_DAQ_Byte54
            STS_XCP_RES_DAQ_Byte55_oRDR_XCP_DAQ_RESP_oPCAN_RADAR_2e8fc676_Tx: ComBitPosition=447, ComSystemTemplateSystemSignalRef=STS_XCP_RES_DAQ_Byte55
            STS_XCP_RES_DAQ_Byte56_oRDR_XCP_DAQ_RESP_oPCAN_RADAR_3da7ff05_Tx: ComBitPosition=455, ComSystemTemplateSystemSignalRef=STS_XCP_RES_DAQ_Byte56
            STS_XCP_RES_DAQ_Byte57_oRDR_XCP_DAQ_RESP_oPCAN_RADAR_334017d4_Tx: ComBitPosition=463, ComSystemTemplateSystemSignalRef=STS_XCP_RES_DAQ_Byte57
            STS_XCP_RES_DAQ_Byte58_oRDR_XCP_DAQ_RESP_oPCAN_RADAR_6cc8cb6b_Tx: ComBitPosition=471, ComSystemTemplateSystemSignalRef=STS_XCP_RES_DAQ_Byte58
            STS_XCP_RES_DAQ_Byte59_oRDR_XCP_DAQ_RESP_oPCAN_RADAR_622f23ba_Tx: ComBitPosition=479, ComSystemTemplateSystemSignalRef=STS_XCP_RES_DAQ_Byte59
            STS_XCP_RES_DAQ_Byte5_oRDR_XCP_DAQ_RESP_oPCAN_RADAR_7c8207fb_Tx: ComBitPosition=47, ComSystemTemplateSystemSignalRef=STS_XCP_RES_DAQ_Byte5
            STS_XCP_RES_DAQ_Byte60_oRDR_XCP_DAQ_RESP_oPCAN_RADAR_d2e8855c_Tx: ComBitPosition=487, ComSystemTemplateSystemSignalRef=STS_XCP_RES_DAQ_Byte60
            STS_XCP_RES_DAQ_Byte61_oRDR_XCP_DAQ_RESP_oPCAN_RADAR_dc0f6d8d_Tx: ComBitPosition=495, ComSystemTemplateSystemSignalRef=STS_XCP_RES_DAQ_Byte61
            STS_XCP_RES_DAQ_Byte62_oRDR_XCP_DAQ_RESP_oPCAN_RADAR_cf2754fe_Tx: ComBitPosition=503, ComSystemTemplateSystemSignalRef=STS_XCP_RES_DAQ_Byte62
            STS_XCP_RES_DAQ_Byte63_oRDR_XCP_DAQ_RESP_oPCAN_RADAR_c1c0bc2f_Tx: ComBitPosition=511, ComSystemTemplateSystemSignalRef=STS_XCP_RES_DAQ_Byte63
            STS_XCP_RES_DAQ_Byte6_oRDR_XCP_DAQ_RESP_oPCAN_RADAR_6faa3e88_Tx: ComBitPosition=55, ComSystemTemplateSystemSignalRef=STS_XCP_RES_DAQ_Byte6
            STS_XCP_RES_DAQ_Byte7_oRDR_XCP_DAQ_RESP_oPCAN_RADAR_614dd659_Tx: ComBitPosition=63, ComSystemTemplateSystemSignalRef=STS_XCP_RES_DAQ_Byte7
            STS_XCP_RES_DAQ_Byte8_oRDR_XCP_DAQ_RESP_oPCAN_RADAR_3ec50ae6_Tx: ComBitPosition=71, ComSystemTemplateSystemSignalRef=STS_XCP_RES_DAQ_Byte8
            STS_XCP_RES_DAQ_Byte9_oRDR_XCP_DAQ_RESP_oPCAN_RADAR_3022e237_Tx: ComBitPosition=79, ComSystemTemplateSystemSignalRef=STS_XCP_RES_DAQ_Byte9
        SG_prop_ADAS_MOIS_info_oprop_ADAS_MOIS_info_oVCAN_RADAR_cb191e50_Tx: ComSystemTemplateSignalGroupRef=SG_prop_ADAS_MOIS_info
          rdn_MOISCollisionWarningLevel_oprop_ADAS_MOIS_info_oVCAN_RADAR_9b3bdf39_Tx (ComGroupSignal):
            ComBitPosition = 4
            ComBitSize = 4
            ComSignalEndianness = LITTLE_ENDIAN
            ComSignalInitValue = 0
            ComSignalType = UINT8
            ComTransferProperty = PENDING
            ComSystemTemplateSystemSignalRef = rdn_MOISCollisionWarningLevel
          rdn_MovingObjectDetectionState_oprop_ADAS_MOIS_info_oVCAN_RADAR_f2d3c1fd_Tx (ComGroupSignal):
            ComBitPosition = 0
            ComBitSize = 4
            ComSignalEndianness = LITTLE_ENDIAN
            ComSignalInitValue = 0
            ComSignalType = UINT8
            ComTransferProperty = PENDING
            ComSystemTemplateSystemSignalRef = rdn_MovingObjectDetectionState
      12 x ComIPduGroup:
        RDR02_oPCAN_RADAR_Rx_c92fa313: variation-point=post-build-variant-condition{matching-criterion=RDR_POS, value=1}
        RDR02_oPCAN_RADAR_Tx_9f750495: variation-point=post-build-variant-condition{matching-criterion=RDR_POS, value=1}
        RDR02_oVCAN_RADAR_Rx_BC_d6312b45: variation-point=post-build-variant-condition{matching-criterion=RDR_POS, value=1}
        RDR02_oVCAN_RADAR_Tx_0xD0_587f6b3f: variation-point=post-build-variant-condition{matching-criterion=RDR_POS, value=1}
        RDR03_oPCAN_RADAR_Rx_67473282: variation-point=post-build-variant-condition{matching-criterion=RDR_POS, value=2}
        RDR03_oPCAN_RADAR_Tx_311d9504: variation-point=post-build-variant-condition{matching-criterion=RDR_POS, value=2}
        RDR03_oVCAN_RADAR_Rx_BC_01d3ab1d: variation-point=post-build-variant-condition{matching-criterion=RDR_POS, value=2}
        RDR03_oVCAN_RADAR_Tx_0xD0_c7a5e8a1: variation-point=post-build-variant-condition{matching-criterion=RDR_POS, value=2}
        RDR04_oPCAN_RADAR_Rx_9abecaf7: variation-point=post-build-variant-condition{matching-criterion=RDR_POS, value=3}
        RDR04_oPCAN_RADAR_Tx_cce46d71: variation-point=post-build-variant-condition{matching-criterion=RDR_POS, value=3}
        RDR04_oVCAN_RADAR_Rx_BC_4bed2056: variation-point=post-build-variant-condition{matching-criterion=RDR_POS, value=3}
        RDR04_oVCAN_RADAR_Tx_0xD0_ae426ef9: variation-point=post-build-variant-condition{matching-criterion=RDR_POS, value=3}
      3 x ComIPdu, all with ComIPduDirection=SEND, ComIPduType=NORMAL, ComIPduChannelRef=ComMConfigSet/CN_PCAN_RADAR_458ff0f1, ComIPduGroupRef=RDR05_oPCAN_RADAR_Tx_628cfce0, variation-point=post-build-variant-condition{matching-criterion=RDR_POS, value=4}:
        SYS_TIME_SYNC_Mx20_oPCAN_RADAR_7e798636_Tx: ComIPduSignalRef=TSYN_PDU_Mx20_oSYS_TIME_SYNC_oPCAN_RADAR_e2fd289b_Tx, ComIPduSignalRef=TSYN_SYNCTIME_SEC_Mx20_oSYS_TIME_SYNC_oPCAN_RADAR_eefbe385_Tx, ComIPduSignalRef=TSYN_USERBYTE_Mx20_oSYS_TIME_SYNC_oPCAN_RADAR_0d5c8681_Tx, ComPduIdRef=EcucPduCollection/SYS_TIME_SYNC_Mx20_oPCAN_RADAR_7e798636_Tx
          ComTxIPdu: ComMinimumDelayTime=0, ComTxIPduUnusedAreasDefault=0
            ComTxModeTrue
              ComTxMode: ComTxModeMode=PERIODIC, ComTxModeTimeOffset=0, ComTxModeTimePeriod=2
        SYS_TIME_SYNC_Mx28_oPCAN_RADAR_247a555b_Tx: ComIPduSignalRef=TSYN_OVS_Mx28_oSYS_TIME_SYNC_oPCAN_RADAR_b3399163_Tx, ComIPduSignalRef=TSYN_PDU_Mx28_oSYS_TIME_SYNC_oPCAN_RADAR_ef52c073_Tx, ComIPduSignalRef=TSYN_RESERVED_Mx28_oSYS_TIME_SYNC_oPCAN_RADAR_d2d8bdda_Tx, ComIPduSignalRef=TSYN_SGW_Mx28_oSYS_TIME_SYNC_oPCAN_RADAR_64e22cd6_Tx, ComIPduSignalRef=TSYN_SYNCTIME_NANOSEC_Mx28_oSYS_TIME_SYNC_oPCAN_RADAR_4ec44b38_Tx, ComPduIdRef=EcucPduCollection/SYS_TIME_SYNC_Mx28_oPCAN_RADAR_247a555b_Tx
          ComTxIPdu: ComMinimumDelayTime=0, ComTxIPduUnusedAreasDefault=0
            ComTxModeTrue
              ComTxMode: ComTxModeMode=PERIODIC, ComTxModeTimeOffset=1, ComTxModeTimePeriod=2
        SYS_TIME_SYNC_Mx_oPCAN_RADAR_91ffd000_Tx: ComIPduSignalRef=TSYNC_CRC_Mx_oSYS_TIME_SYNC_oPCAN_RADAR_860ba5d2_Tx, ComIPduSignalRef=TSYN_SEQUENCE_COUNTER_Mx_oSYS_TIME_SYNC_oPCAN_RADAR_b1c17f84_Tx, ComIPduSignalRef=TSYN_TIMEDOMAIN_Mx_oSYS_TIME_SYNC_oPCAN_RADAR_924f2426_Tx, ComPduIdRef=EcucPduCollection/SYS_TIME_SYNC_Mx_oPCAN_RADAR_91ffd000_Tx
          ComTxIPdu: ComMinimumDelayTime=0, ComTxIPduUnusedAreasDefault=0
            ComTxModeTrue
              ComTxMode: ComTxModeMode=DIRECT, ComTxModeNumberOfRepetitions=0, ComTxModeRepetitionPeriod=0
      4 x ComIPduGroup, all with variation-point=post-build-variant-condition{matching-criterion=RDR_POS, value=4}:
        RDR05_oPCAN_RADAR_Rx_34d65b66
        RDR05_oPCAN_RADAR_Tx_628cfce0
        RDR05_oVCAN_RADAR_Rx_BC_9c0fa00e
        RDR05_oVCAN_RADAR_Tx_0xD0_3198ed67
      11 x ComSignal, all with ComSignalEndianness=BIG_ENDIAN, variation-point=post-build-variant-condition{matching-criterion=RDR_POS, value=4}:
        TSYNC_CRC_Mx_oSYS_TIME_SYNC_oPCAN_RADAR_860ba5d2_Tx: ComBitPosition=15, ComBitSize=8, ComSignalInitValue=0, ComSignalType=UINT8, ComTransferProperty=TRIGGERED_WITHOUT_REPETITION, ComSystemTemplateSystemSignalRef=TSYNC_CRC
        TSYN_OVS_Mx28_oSYS_TIME_SYNC_oPCAN_RADAR_b3399163_Tx: ComBitPosition=25, ComBitSize=2, ComSignalInitValue=0, ComSignalType=UINT8, ComTransferProperty=PENDING, ComSystemTemplateSystemSignalRef=TSYN_OVS
        TSYN_PDU_Mx20_oSYS_TIME_SYNC_oPCAN_RADAR_e2fd289b_Tx: ComBitPosition=7, ComBitSize=8, ComSignalInitValue=32, ComSignalType=UINT8, ComTransferProperty=PENDING, ComSystemTemplateSystemSignalRef=TSYN_PDU
        TSYN_PDU_Mx28_oSYS_TIME_SYNC_oPCAN_RADAR_ef52c073_Tx: ComBitPosition=7, ComBitSize=8, ComSignalInitValue=40, ComSignalType=UINT8, ComTransferProperty=PENDING, ComSystemTemplateSystemSignalRef=TSYN_PDU
        TSYN_RESERVED_Mx28_oSYS_TIME_SYNC_oPCAN_RADAR_d2d8bdda_Tx: ComBitPosition=31, ComBitSize=5, ComSignalInitValue=0, ComSignalType=UINT8, ComTransferProperty=PENDING, ComSystemTemplateSystemSignalRef=TSYN_RESERVED
        TSYN_SEQUENCE_COUNTER_Mx_oSYS_TIME_SYNC_oPCAN_RADAR_b1c17f84_Tx: ComBitPosition=19, ComBitSize=4, ComSignalInitValue=0, ComSignalType=UINT8, ComTransferProperty=TRIGGERED_WITHOUT_REPETITION, ComSystemTemplateSystemSignalRef=TSYN_SEQUENCE_COUNTER
        TSYN_SGW_Mx28_oSYS_TIME_SYNC_oPCAN_RADAR_64e22cd6_Tx: ComBitPosition=26, ComBitSize=1, ComSignalInitValue=0, ComSignalType=BOOLEAN, ComTransferProperty=PENDING, ComSystemTemplateSystemSignalRef=TSYN_SGW
        TSYN_SYNCTIME_NANOSEC_Mx28_oSYS_TIME_SYNC_oPCAN_RADAR_4ec44b38_Tx: ComBitPosition=39, ComBitSize=32, ComSignalInitValue=0, ComSignalType=UINT32, ComTransferProperty=PENDING, ComSystemTemplateSystemSignalRef=TSYN_SYNCTIME_NANOSEC
        TSYN_SYNCTIME_SEC_Mx20_oSYS_TIME_SYNC_oPCAN_RADAR_eefbe385_Tx: ComBitPosition=39, ComBitSize=32, ComSignalInitValue=0, ComSignalType=UINT32, ComTransferProperty=PENDING, ComSystemTemplateSystemSignalRef=TSYN_SYNCTIME_SEC
        TSYN_TIMEDOMAIN_Mx_oSYS_TIME_SYNC_oPCAN_RADAR_924f2426_Tx: ComBitPosition=23, ComBitSize=4, ComSignalInitValue=0, ComSignalType=UINT8, ComTransferProperty=TRIGGERED_WITHOUT_REPETITION, ComSystemTemplateSystemSignalRef=TSYN_TIMEDOMAIN
        TSYN_USERBYTE_Mx20_oSYS_TIME_SYNC_oPCAN_RADAR_0d5c8681_Tx: ComBitPosition=31, ComBitSize=8, ComSignalInitValue=0, ComSignalType=UINT8, ComTransferProperty=PENDING, ComSystemTemplateSystemSignalRef=TSYN_USERBYTE
      9 x ComIPdu, all with ComIPduDirection=RECEIVE, ComIPduType=NORMAL, ComIPduChannelRef=ComMConfigSet/CN_PCAN_RADAR_458ff0f1:
        SYS_TIME_SYNC_Mx20_oPCAN_RADAR_7e798636_Rx: ComIPduSignalRef=ComConfig/TSYN_PDU_Mx20_oSYS_TIME_SYNC_oPCAN_RADAR_e2fd289b_Rx, ComIPduSignalRef=ComConfig/TSYN_SYNCTIME_SEC_Mx20_oSYS_TIME_SYNC_oPCAN_RADAR_eefbe385_Rx, ComIPduSignalRef=ComConfig/TSYN_USERBYTE_Mx20_oSYS_TIME_SYNC_oPCAN_RADAR_0d5c8681_Rx, ComPduIdRef=EcucPduCollection/SYS_TIME_SYNC_Mx20_oPCAN_RADAR_7e798636_Rx, ComIPduGroupRef=RDR02_oPCAN_RADAR_Rx_c92fa313, variation-point=post-build-variant-condition{matching-criterion=RDR_POS, value=1}
        SYS_TIME_SYNC_Mx20_oPCAN_RADAR_7e798636_Rx: ComIPduSignalRef=ComConfig/TSYN_PDU_Mx20_oSYS_TIME_SYNC_oPCAN_RADAR_e2fd289b_Rx, ComIPduSignalRef=ComConfig/TSYN_SYNCTIME_SEC_Mx20_oSYS_TIME_SYNC_oPCAN_RADAR_eefbe385_Rx, ComIPduSignalRef=ComConfig/TSYN_USERBYTE_Mx20_oSYS_TIME_SYNC_oPCAN_RADAR_0d5c8681_Rx, ComPduIdRef=EcucPduCollection/SYS_TIME_SYNC_Mx20_oPCAN_RADAR_7e798636_Rx, ComIPduGroupRef=RDR03_oPCAN_RADAR_Rx_67473282, variation-point=post-build-variant-condition{matching-criterion=RDR_POS, value=2}
        SYS_TIME_SYNC_Mx20_oPCAN_RADAR_7e798636_Rx: ComIPduSignalRef=ComConfig/TSYN_PDU_Mx20_oSYS_TIME_SYNC_oPCAN_RADAR_e2fd289b_Rx, ComIPduSignalRef=ComConfig/TSYN_SYNCTIME_SEC_Mx20_oSYS_TIME_SYNC_oPCAN_RADAR_eefbe385_Rx, ComIPduSignalRef=ComConfig/TSYN_USERBYTE_Mx20_oSYS_TIME_SYNC_oPCAN_RADAR_0d5c8681_Rx, ComPduIdRef=EcucPduCollection/SYS_TIME_SYNC_Mx20_oPCAN_RADAR_7e798636_Rx, ComIPduGroupRef=RDR04_oPCAN_RADAR_Rx_9abecaf7, variation-point=post-build-variant-condition{matching-criterion=RDR_POS, value=3}
        SYS_TIME_SYNC_Mx28_oPCAN_RADAR_247a555b_Rx: ComIPduSignalRef=ComConfig/TSYN_OVS_Mx28_oSYS_TIME_SYNC_oPCAN_RADAR_b3399163_Rx, ComIPduSignalRef=ComConfig/TSYN_PDU_Mx28_oSYS_TIME_SYNC_oPCAN_RADAR_ef52c073_Rx, ComIPduSignalRef=ComConfig/TSYN_RESERVED_Mx28_oSYS_TIME_SYNC_oPCAN_RADAR_d2d8bdda_Rx, ComIPduSignalRef=ComConfig/TSYN_SGW_Mx28_oSYS_TIME_SYNC_oPCAN_RADAR_64e22cd6_Rx, ComIPduSignalRef=ComConfig/TSYN_SYNCTIME_NANOSEC_Mx28_oSYS_TIME_SYNC_oPCAN_RADAR_4ec44b38_Rx, ComPduIdRef=EcucPduCollection/SYS_TIME_SYNC_Mx28_oPCAN_RADAR_247a555b_Rx, ComIPduGroupRef=RDR02_oPCAN_RADAR_Rx_c92fa313, variation-point=post-build-variant-condition{matching-criterion=RDR_POS, value=1}
        SYS_TIME_SYNC_Mx28_oPCAN_RADAR_247a555b_Rx: ComIPduSignalRef=ComConfig/TSYN_OVS_Mx28_oSYS_TIME_SYNC_oPCAN_RADAR_b3399163_Rx, ComIPduSignalRef=ComConfig/TSYN_PDU_Mx28_oSYS_TIME_SYNC_oPCAN_RADAR_ef52c073_Rx, ComIPduSignalRef=ComConfig/TSYN_RESERVED_Mx28_oSYS_TIME_SYNC_oPCAN_RADAR_d2d8bdda_Rx, ComIPduSignalRef=ComConfig/TSYN_SGW_Mx28_oSYS_TIME_SYNC_oPCAN_RADAR_64e22cd6_Rx, ComIPduSignalRef=ComConfig/TSYN_SYNCTIME_NANOSEC_Mx28_oSYS_TIME_SYNC_oPCAN_RADAR_4ec44b38_Rx, ComPduIdRef=EcucPduCollection/SYS_TIME_SYNC_Mx28_oPCAN_RADAR_247a555b_Rx, ComIPduGroupRef=RDR03_oPCAN_RADAR_Rx_67473282, variation-point=post-build-variant-condition{matching-criterion=RDR_POS, value=2}
        SYS_TIME_SYNC_Mx28_oPCAN_RADAR_247a555b_Rx: ComIPduSignalRef=ComConfig/TSYN_OVS_Mx28_oSYS_TIME_SYNC_oPCAN_RADAR_b3399163_Rx, ComIPduSignalRef=ComConfig/TSYN_PDU_Mx28_oSYS_TIME_SYNC_oPCAN_RADAR_ef52c073_Rx, ComIPduSignalRef=ComConfig/TSYN_RESERVED_Mx28_oSYS_TIME_SYNC_oPCAN_RADAR_d2d8bdda_Rx, ComIPduSignalRef=ComConfig/TSYN_SGW_Mx28_oSYS_TIME_SYNC_oPCAN_RADAR_64e22cd6_Rx, ComIPduSignalRef=ComConfig/TSYN_SYNCTIME_NANOSEC_Mx28_oSYS_TIME_SYNC_oPCAN_RADAR_4ec44b38_Rx, ComPduIdRef=EcucPduCollection/SYS_TIME_SYNC_Mx28_oPCAN_RADAR_247a555b_Rx, ComIPduGroupRef=RDR04_oPCAN_RADAR_Rx_9abecaf7, variation-point=post-build-variant-condition{matching-criterion=RDR_POS, value=3}
        SYS_TIME_SYNC_Mx_oPCAN_RADAR_91ffd000_Rx: ComIPduSignalRef=ComConfig/TSYNC_CRC_Mx_oSYS_TIME_SYNC_oPCAN_RADAR_860ba5d2_Rx, ComIPduSignalRef=ComConfig/TSYN_SEQUENCE_COUNTER_Mx_oSYS_TIME_SYNC_oPCAN_RADAR_b1c17f84_Rx, ComIPduSignalRef=ComConfig/TSYN_TIMEDOMAIN_Mx_oSYS_TIME_SYNC_oPCAN_RADAR_924f2426_Rx, ComPduIdRef=EcucPduCollection/SYS_TIME_SYNC_Mx_oPCAN_RADAR_91ffd000_Rx, ComIPduGroupRef=RDR02_oPCAN_RADAR_Rx_c92fa313, variation-point=post-build-variant-condition{matching-criterion=RDR_POS, value=1}
        SYS_TIME_SYNC_Mx_oPCAN_RADAR_91ffd000_Rx: ComIPduSignalRef=ComConfig/TSYNC_CRC_Mx_oSYS_TIME_SYNC_oPCAN_RADAR_860ba5d2_Rx, ComIPduSignalRef=ComConfig/TSYN_SEQUENCE_COUNTER_Mx_oSYS_TIME_SYNC_oPCAN_RADAR_b1c17f84_Rx, ComIPduSignalRef=ComConfig/TSYN_TIMEDOMAIN_Mx_oSYS_TIME_SYNC_oPCAN_RADAR_924f2426_Rx, ComPduIdRef=EcucPduCollection/SYS_TIME_SYNC_Mx_oPCAN_RADAR_91ffd000_Rx, ComIPduGroupRef=RDR03_oPCAN_RADAR_Rx_67473282, variation-point=post-build-variant-condition{matching-criterion=RDR_POS, value=2}
        SYS_TIME_SYNC_Mx_oPCAN_RADAR_91ffd000_Rx: ComIPduSignalRef=ComConfig/TSYNC_CRC_Mx_oSYS_TIME_SYNC_oPCAN_RADAR_860ba5d2_Rx, ComIPduSignalRef=ComConfig/TSYN_SEQUENCE_COUNTER_Mx_oSYS_TIME_SYNC_oPCAN_RADAR_b1c17f84_Rx, ComIPduSignalRef=ComConfig/TSYN_TIMEDOMAIN_Mx_oSYS_TIME_SYNC_oPCAN_RADAR_924f2426_Rx, ComPduIdRef=EcucPduCollection/SYS_TIME_SYNC_Mx_oPCAN_RADAR_91ffd000_Rx, ComIPduGroupRef=RDR04_oPCAN_RADAR_Rx_9abecaf7, variation-point=post-build-variant-condition{matching-criterion=RDR_POS, value=3}
      33 x ComSignal, all with ComSignalEndianness=BIG_ENDIAN, ComTimeout=0:
        TSYNC_CRC_Mx_oSYS_TIME_SYNC_oPCAN_RADAR_860ba5d2_Rx: ComBitPosition=15, ComBitSize=8, ComSignalInitValue=0, ComSignalType=UINT8, ComSystemTemplateSystemSignalRef=TSYNC_CRC, variation-point=post-build-variant-condition{matching-criterion=RDR_POS, value={1..3}}
        TSYN_OVS_Mx28_oSYS_TIME_SYNC_oPCAN_RADAR_b3399163_Rx: ComBitPosition=25, ComBitSize=2, ComSignalInitValue=0, ComSignalType=UINT8, ComSystemTemplateSystemSignalRef=TSYN_OVS, variation-point=post-build-variant-condition{matching-criterion=RDR_POS, value={1..3}}
        TSYN_PDU_Mx20_oSYS_TIME_SYNC_oPCAN_RADAR_e2fd289b_Rx: ComBitPosition=7, ComBitSize=8, ComSignalInitValue=32, ComSignalType=UINT8, ComSystemTemplateSystemSignalRef=TSYN_PDU, variation-point=post-build-variant-condition{matching-criterion=RDR_POS, value={1..3}}
        TSYN_PDU_Mx28_oSYS_TIME_SYNC_oPCAN_RADAR_ef52c073_Rx: ComBitPosition=7, ComBitSize=8, ComSignalInitValue=40, ComSignalType=UINT8, ComSystemTemplateSystemSignalRef=TSYN_PDU, variation-point=post-build-variant-condition{matching-criterion=RDR_POS, value={1..3}}
        TSYN_RESERVED_Mx28_oSYS_TIME_SYNC_oPCAN_RADAR_d2d8bdda_Rx: ComBitPosition=31, ComBitSize=5, ComSignalInitValue=0, ComSignalType=UINT8, ComSystemTemplateSystemSignalRef=TSYN_RESERVED, variation-point=post-build-variant-condition{matching-criterion=RDR_POS, value={1..3}}
        TSYN_SEQUENCE_COUNTER_Mx_oSYS_TIME_SYNC_oPCAN_RADAR_b1c17f84_Rx: ComBitPosition=19, ComBitSize=4, ComSignalInitValue=0, ComSignalType=UINT8, ComSystemTemplateSystemSignalRef=TSYN_SEQUENCE_COUNTER, variation-point=post-build-variant-condition{matching-criterion=RDR_POS, value={1..3}}
        TSYN_SGW_Mx28_oSYS_TIME_SYNC_oPCAN_RADAR_64e22cd6_Rx: ComBitPosition=26, ComBitSize=1, ComSignalInitValue=0, ComSignalType=BOOLEAN, ComSystemTemplateSystemSignalRef=TSYN_SGW, variation-point=post-build-variant-condition{matching-criterion=RDR_POS, value={1..3}}
        TSYN_SYNCTIME_NANOSEC_Mx28_oSYS_TIME_SYNC_oPCAN_RADAR_4ec44b38_Rx: ComBitPosition=39, ComBitSize=32, ComSignalInitValue=0, ComSignalType=UINT32, ComSystemTemplateSystemSignalRef=TSYN_SYNCTIME_NANOSEC, variation-point=post-build-variant-condition{matching-criterion=RDR_POS, value={1..3}}
        TSYN_SYNCTIME_SEC_Mx20_oSYS_TIME_SYNC_oPCAN_RADAR_eefbe385_Rx: ComBitPosition=39, ComBitSize=32, ComSignalInitValue=0, ComSignalType=UINT32, ComSystemTemplateSystemSignalRef=TSYN_SYNCTIME_SEC, variation-point=post-build-variant-condition{matching-criterion=RDR_POS, value={1..3}}
        TSYN_TIMEDOMAIN_Mx_oSYS_TIME_SYNC_oPCAN_RADAR_924f2426_Rx: ComBitPosition=23, ComBitSize=4, ComSignalInitValue=0, ComSignalType=UINT8, ComSystemTemplateSystemSignalRef=TSYN_TIMEDOMAIN, variation-point=post-build-variant-condition{matching-criterion=RDR_POS, value={1..3}}
        TSYN_USERBYTE_Mx20_oSYS_TIME_SYNC_oPCAN_RADAR_0d5c8681_Rx: ComBitPosition=31, ComBitSize=8, ComSignalInitValue=0, ComSignalType=UINT8, ComSystemTemplateSystemSignalRef=TSYN_USERBYTE, variation-point=post-build-variant-condition{matching-criterion=RDR_POS, value={1..3}}
      3 x ComIPdu, all with ComIPduDirection=RECEIVE, ComIPduType=NORMAL, ComIPduChannelRef=ComMConfigSet/CN_PCAN_RADAR_458ff0f1, ComIPduGroupRef=RDR06_oPCAN_RADAR_Rx_1d1eef94, variation-point=post-build-variant-condition{matching-criterion=RDR_POS, value=5}:
        SYS_TIME_SYNC_Mx20_oPCAN_RADAR_7e798636_Rx: ComIPduSignalRef=ComConfig/TSYN_PDU_Mx20_oSYS_TIME_SYNC_oPCAN_RADAR_e2fd289b_Rx, ComIPduSignalRef=ComConfig/TSYN_SYNCTIME_SEC_Mx20_oSYS_TIME_SYNC_oPCAN_RADAR_eefbe385_Rx, ComIPduSignalRef=ComConfig/TSYN_USERBYTE_Mx20_oSYS_TIME_SYNC_oPCAN_RADAR_0d5c8681_Rx, ComPduIdRef=EcucPduCollection/SYS_TIME_SYNC_Mx20_oPCAN_RADAR_7e798636_Rx
        SYS_TIME_SYNC_Mx28_oPCAN_RADAR_247a555b_Rx: ComIPduSignalRef=ComConfig/TSYN_OVS_Mx28_oSYS_TIME_SYNC_oPCAN_RADAR_b3399163_Rx, ComIPduSignalRef=ComConfig/TSYN_PDU_Mx28_oSYS_TIME_SYNC_oPCAN_RADAR_ef52c073_Rx, ComIPduSignalRef=ComConfig/TSYN_RESERVED_Mx28_oSYS_TIME_SYNC_oPCAN_RADAR_d2d8bdda_Rx, ComIPduSignalRef=ComConfig/TSYN_SGW_Mx28_oSYS_TIME_SYNC_oPCAN_RADAR_64e22cd6_Rx, ComIPduSignalRef=ComConfig/TSYN_SYNCTIME_NANOSEC_Mx28_oSYS_TIME_SYNC_oPCAN_RADAR_4ec44b38_Rx, ComPduIdRef=EcucPduCollection/SYS_TIME_SYNC_Mx28_oPCAN_RADAR_247a555b_Rx
        SYS_TIME_SYNC_Mx_oPCAN_RADAR_91ffd000_Rx: ComIPduSignalRef=ComConfig/TSYNC_CRC_Mx_oSYS_TIME_SYNC_oPCAN_RADAR_860ba5d2_Rx, ComIPduSignalRef=ComConfig/TSYN_SEQUENCE_COUNTER_Mx_oSYS_TIME_SYNC_oPCAN_RADAR_b1c17f84_Rx, ComIPduSignalRef=ComConfig/TSYN_TIMEDOMAIN_Mx_oSYS_TIME_SYNC_oPCAN_RADAR_924f2426_Rx, ComPduIdRef=EcucPduCollection/SYS_TIME_SYNC_Mx_oPCAN_RADAR_91ffd000_Rx
      4 x ComIPduGroup, all with variation-point=post-build-variant-condition{matching-criterion=RDR_POS, value=5}:
        RDR06_oPCAN_RADAR_Rx_1d1eef94
        RDR06_oPCAN_RADAR_Tx_4b444812
        RDR06_oVCAN_RADAR_Rx_BC_3f5926a7
        RDR06_oVCAN_RADAR_Tx_0xD0_4a866f84
      11 x ComSignal, all with ComSignalEndianness=BIG_ENDIAN, ComTimeout=0, variation-point=post-build-variant-condition{matching-criterion=RDR_POS, value=5}:
        TSYNC_CRC_Mx_oSYS_TIME_SYNC_oPCAN_RADAR_860ba5d2_Rx: ComBitPosition=15, ComBitSize=8, ComSignalInitValue=0, ComSignalType=UINT8, ComSystemTemplateSystemSignalRef=TSYNC_CRC
        TSYN_OVS_Mx28_oSYS_TIME_SYNC_oPCAN_RADAR_b3399163_Rx: ComBitPosition=25, ComBitSize=2, ComSignalInitValue=0, ComSignalType=UINT8, ComSystemTemplateSystemSignalRef=TSYN_OVS
        TSYN_PDU_Mx20_oSYS_TIME_SYNC_oPCAN_RADAR_e2fd289b_Rx: ComBitPosition=7, ComBitSize=8, ComSignalInitValue=32, ComSignalType=UINT8, ComSystemTemplateSystemSignalRef=TSYN_PDU
        TSYN_PDU_Mx28_oSYS_TIME_SYNC_oPCAN_RADAR_ef52c073_Rx: ComBitPosition=7, ComBitSize=8, ComSignalInitValue=40, ComSignalType=UINT8, ComSystemTemplateSystemSignalRef=TSYN_PDU
        TSYN_RESERVED_Mx28_oSYS_TIME_SYNC_oPCAN_RADAR_d2d8bdda_Rx: ComBitPosition=31, ComBitSize=5, ComSignalInitValue=0, ComSignalType=UINT8, ComSystemTemplateSystemSignalRef=TSYN_RESERVED
        TSYN_SEQUENCE_COUNTER_Mx_oSYS_TIME_SYNC_oPCAN_RADAR_b1c17f84_Rx: ComBitPosition=19, ComBitSize=4, ComSignalInitValue=0, ComSignalType=UINT8, ComSystemTemplateSystemSignalRef=TSYN_SEQUENCE_COUNTER
        TSYN_SGW_Mx28_oSYS_TIME_SYNC_oPCAN_RADAR_64e22cd6_Rx: ComBitPosition=26, ComBitSize=1, ComSignalInitValue=0, ComSignalType=BOOLEAN, ComSystemTemplateSystemSignalRef=TSYN_SGW
        TSYN_SYNCTIME_NANOSEC_Mx28_oSYS_TIME_SYNC_oPCAN_RADAR_4ec44b38_Rx: ComBitPosition=39, ComBitSize=32, ComSignalInitValue=0, ComSignalType=UINT32, ComSystemTemplateSystemSignalRef=TSYN_SYNCTIME_NANOSEC
        TSYN_SYNCTIME_SEC_Mx20_oSYS_TIME_SYNC_oPCAN_RADAR_eefbe385_Rx: ComBitPosition=39, ComBitSize=32, ComSignalInitValue=0, ComSignalType=UINT32, ComSystemTemplateSystemSignalRef=TSYN_SYNCTIME_SEC
        TSYN_TIMEDOMAIN_Mx_oSYS_TIME_SYNC_oPCAN_RADAR_924f2426_Rx: ComBitPosition=23, ComBitSize=4, ComSignalInitValue=0, ComSignalType=UINT8, ComSystemTemplateSystemSignalRef=TSYN_TIMEDOMAIN
        TSYN_USERBYTE_Mx20_oSYS_TIME_SYNC_oPCAN_RADAR_0d5c8681_Rx: ComBitPosition=31, ComBitSize=8, ComSignalInitValue=0, ComSignalType=UINT8, ComSystemTemplateSystemSignalRef=TSYN_USERBYTE
      3 x ComIPdu, all with ComIPduDirection=RECEIVE, ComIPduType=NORMAL, ComIPduChannelRef=ComMConfigSet/CN_PCAN_RADAR_458ff0f1, ComIPduGroupRef=RDR07_oPCAN_RADAR_Rx_b3767e05, variation-point=post-build-variant-condition{matching-criterion=RDR_POS, value=6}:
        SYS_TIME_SYNC_Mx20_oPCAN_RADAR_7e798636_Rx: ComIPduSignalRef=ComConfig/TSYN_PDU_Mx20_oSYS_TIME_SYNC_oPCAN_RADAR_e2fd289b_Rx, ComIPduSignalRef=ComConfig/TSYN_SYNCTIME_SEC_Mx20_oSYS_TIME_SYNC_oPCAN_RADAR_eefbe385_Rx, ComIPduSignalRef=ComConfig/TSYN_USERBYTE_Mx20_oSYS_TIME_SYNC_oPCAN_RADAR_0d5c8681_Rx, ComPduIdRef=EcucPduCollection/SYS_TIME_SYNC_Mx20_oPCAN_RADAR_7e798636_Rx
        SYS_TIME_SYNC_Mx28_oPCAN_RADAR_247a555b_Rx: ComIPduSignalRef=ComConfig/TSYN_OVS_Mx28_oSYS_TIME_SYNC_oPCAN_RADAR_b3399163_Rx, ComIPduSignalRef=ComConfig/TSYN_PDU_Mx28_oSYS_TIME_SYNC_oPCAN_RADAR_ef52c073_Rx, ComIPduSignalRef=ComConfig/TSYN_RESERVED_Mx28_oSYS_TIME_SYNC_oPCAN_RADAR_d2d8bdda_Rx, ComIPduSignalRef=ComConfig/TSYN_SGW_Mx28_oSYS_TIME_SYNC_oPCAN_RADAR_64e22cd6_Rx, ComIPduSignalRef=ComConfig/TSYN_SYNCTIME_NANOSEC_Mx28_oSYS_TIME_SYNC_oPCAN_RADAR_4ec44b38_Rx, ComPduIdRef=EcucPduCollection/SYS_TIME_SYNC_Mx28_oPCAN_RADAR_247a555b_Rx
        SYS_TIME_SYNC_Mx_oPCAN_RADAR_91ffd000_Rx: ComIPduSignalRef=ComConfig/TSYNC_CRC_Mx_oSYS_TIME_SYNC_oPCAN_RADAR_860ba5d2_Rx, ComIPduSignalRef=ComConfig/TSYN_SEQUENCE_COUNTER_Mx_oSYS_TIME_SYNC_oPCAN_RADAR_b1c17f84_Rx, ComIPduSignalRef=ComConfig/TSYN_TIMEDOMAIN_Mx_oSYS_TIME_SYNC_oPCAN_RADAR_924f2426_Rx, ComPduIdRef=EcucPduCollection/SYS_TIME_SYNC_Mx_oPCAN_RADAR_91ffd000_Rx
      4 x ComIPduGroup, all with variation-point=post-build-variant-condition{matching-criterion=RDR_POS, value=6}:
        RDR07_oPCAN_RADAR_Rx_b3767e05
        RDR07_oPCAN_RADAR_Tx_e52cd983
        RDR07_oVCAN_RADAR_Rx_BC_e8bba6ff
        RDR07_oVCAN_RADAR_Tx_0xD0_d55cec1a
      11 x ComSignal, all with ComSignalEndianness=BIG_ENDIAN, ComTimeout=0, variation-point=post-build-variant-condition{matching-criterion=RDR_POS, value=6}:
        TSYNC_CRC_Mx_oSYS_TIME_SYNC_oPCAN_RADAR_860ba5d2_Rx: ComBitPosition=15, ComBitSize=8, ComSignalInitValue=0, ComSignalType=UINT8, ComSystemTemplateSystemSignalRef=TSYNC_CRC
        TSYN_OVS_Mx28_oSYS_TIME_SYNC_oPCAN_RADAR_b3399163_Rx: ComBitPosition=25, ComBitSize=2, ComSignalInitValue=0, ComSignalType=UINT8, ComSystemTemplateSystemSignalRef=TSYN_OVS
        TSYN_PDU_Mx20_oSYS_TIME_SYNC_oPCAN_RADAR_e2fd289b_Rx: ComBitPosition=7, ComBitSize=8, ComSignalInitValue=32, ComSignalType=UINT8, ComSystemTemplateSystemSignalRef=TSYN_PDU
        TSYN_PDU_Mx28_oSYS_TIME_SYNC_oPCAN_RADAR_ef52c073_Rx: ComBitPosition=7, ComBitSize=8, ComSignalInitValue=40, ComSignalType=UINT8, ComSystemTemplateSystemSignalRef=TSYN_PDU
        TSYN_RESERVED_Mx28_oSYS_TIME_SYNC_oPCAN_RADAR_d2d8bdda_Rx: ComBitPosition=31, ComBitSize=5, ComSignalInitValue=0, ComSignalType=UINT8, ComSystemTemplateSystemSignalRef=TSYN_RESERVED
        TSYN_SEQUENCE_COUNTER_Mx_oSYS_TIME_SYNC_oPCAN_RADAR_b1c17f84_Rx: ComBitPosition=19, ComBitSize=4, ComSignalInitValue=0, ComSignalType=UINT8, ComSystemTemplateSystemSignalRef=TSYN_SEQUENCE_COUNTER
        TSYN_SGW_Mx28_oSYS_TIME_SYNC_oPCAN_RADAR_64e22cd6_Rx: ComBitPosition=26, ComBitSize=1, ComSignalInitValue=0, ComSignalType=BOOLEAN, ComSystemTemplateSystemSignalRef=TSYN_SGW
        TSYN_SYNCTIME_NANOSEC_Mx28_oSYS_TIME_SYNC_oPCAN_RADAR_4ec44b38_Rx: ComBitPosition=39, ComBitSize=32, ComSignalInitValue=0, ComSignalType=UINT32, ComSystemTemplateSystemSignalRef=TSYN_SYNCTIME_NANOSEC
        TSYN_SYNCTIME_SEC_Mx20_oSYS_TIME_SYNC_oPCAN_RADAR_eefbe385_Rx: ComBitPosition=39, ComBitSize=32, ComSignalInitValue=0, ComSignalType=UINT32, ComSystemTemplateSystemSignalRef=TSYN_SYNCTIME_SEC
        TSYN_TIMEDOMAIN_Mx_oSYS_TIME_SYNC_oPCAN_RADAR_924f2426_Rx: ComBitPosition=23, ComBitSize=4, ComSignalInitValue=0, ComSignalType=UINT8, ComSystemTemplateSystemSignalRef=TSYN_TIMEDOMAIN
        TSYN_USERBYTE_Mx20_oSYS_TIME_SYNC_oPCAN_RADAR_0d5c8681_Rx: ComBitPosition=31, ComBitSize=8, ComSignalInitValue=0, ComSignalType=UINT8, ComSystemTemplateSystemSignalRef=TSYN_USERBYTE
      3 x ComIPdu, all with ComIPduDirection=RECEIVE, ComIPduType=NORMAL, ComIPduChannelRef=ComMConfigSet/CN_PCAN_RADAR_458ff0f1, ComIPduGroupRef=RDR08_oPCAN_RADAR_Rx_3d9c193f, variation-point=post-build-variant-condition{matching-criterion=RDR_POS, value=7}:
        SYS_TIME_SYNC_Mx20_oPCAN_RADAR_7e798636_Rx: ComIPduSignalRef=ComConfig/TSYN_PDU_Mx20_oSYS_TIME_SYNC_oPCAN_RADAR_e2fd289b_Rx, ComIPduSignalRef=ComConfig/TSYN_SYNCTIME_SEC_Mx20_oSYS_TIME_SYNC_oPCAN_RADAR_eefbe385_Rx, ComIPduSignalRef=ComConfig/TSYN_USERBYTE_Mx20_oSYS_TIME_SYNC_oPCAN_RADAR_0d5c8681_Rx, ComPduIdRef=EcucPduCollection/SYS_TIME_SYNC_Mx20_oPCAN_RADAR_7e798636_Rx
        SYS_TIME_SYNC_Mx28_oPCAN_RADAR_247a555b_Rx: ComIPduSignalRef=ComConfig/TSYN_OVS_Mx28_oSYS_TIME_SYNC_oPCAN_RADAR_b3399163_Rx, ComIPduSignalRef=ComConfig/TSYN_PDU_Mx28_oSYS_TIME_SYNC_oPCAN_RADAR_ef52c073_Rx, ComIPduSignalRef=ComConfig/TSYN_RESERVED_Mx28_oSYS_TIME_SYNC_oPCAN_RADAR_d2d8bdda_Rx, ComIPduSignalRef=ComConfig/TSYN_SGW_Mx28_oSYS_TIME_SYNC_oPCAN_RADAR_64e22cd6_Rx, ComIPduSignalRef=ComConfig/TSYN_SYNCTIME_NANOSEC_Mx28_oSYS_TIME_SYNC_oPCAN_RADAR_4ec44b38_Rx, ComPduIdRef=EcucPduCollection/SYS_TIME_SYNC_Mx28_oPCAN_RADAR_247a555b_Rx
        SYS_TIME_SYNC_Mx_oPCAN_RADAR_91ffd000_Rx: ComIPduSignalRef=ComConfig/TSYNC_CRC_Mx_oSYS_TIME_SYNC_oPCAN_RADAR_860ba5d2_Rx, ComIPduSignalRef=ComConfig/TSYN_SEQUENCE_COUNTER_Mx_oSYS_TIME_SYNC_oPCAN_RADAR_b1c17f84_Rx, ComIPduSignalRef=ComConfig/TSYN_TIMEDOMAIN_Mx_oSYS_TIME_SYNC_oPCAN_RADAR_924f2426_Rx, ComPduIdRef=EcucPduCollection/SYS_TIME_SYNC_Mx_oPCAN_RADAR_91ffd000_Rx
      4 x ComIPduGroup, all with variation-point=post-build-variant-condition{matching-criterion=RDR_POS, value=7}:
        RDR08_oPCAN_RADAR_Rx_3d9c193f
        RDR08_oPCAN_RADAR_Tx_6bc6beb9
        RDR08_oVCAN_RADAR_Rx_BC_ab243031
        RDR08_oVCAN_RADAR_Tx_0xD0_99496334
      11 x ComSignal, all with ComSignalEndianness=BIG_ENDIAN, ComTimeout=0, variation-point=post-build-variant-condition{matching-criterion=RDR_POS, value=7}:
        TSYNC_CRC_Mx_oSYS_TIME_SYNC_oPCAN_RADAR_860ba5d2_Rx: ComBitPosition=15, ComBitSize=8, ComSignalInitValue=0, ComSignalType=UINT8, ComSystemTemplateSystemSignalRef=TSYNC_CRC
        TSYN_OVS_Mx28_oSYS_TIME_SYNC_oPCAN_RADAR_b3399163_Rx: ComBitPosition=25, ComBitSize=2, ComSignalInitValue=0, ComSignalType=UINT8, ComSystemTemplateSystemSignalRef=TSYN_OVS
        TSYN_PDU_Mx20_oSYS_TIME_SYNC_oPCAN_RADAR_e2fd289b_Rx: ComBitPosition=7, ComBitSize=8, ComSignalInitValue=32, ComSignalType=UINT8, ComSystemTemplateSystemSignalRef=TSYN_PDU
        TSYN_PDU_Mx28_oSYS_TIME_SYNC_oPCAN_RADAR_ef52c073_Rx: ComBitPosition=7, ComBitSize=8, ComSignalInitValue=40, ComSignalType=UINT8, ComSystemTemplateSystemSignalRef=TSYN_PDU
        TSYN_RESERVED_Mx28_oSYS_TIME_SYNC_oPCAN_RADAR_d2d8bdda_Rx: ComBitPosition=31, ComBitSize=5, ComSignalInitValue=0, ComSignalType=UINT8, ComSystemTemplateSystemSignalRef=TSYN_RESERVED
        TSYN_SEQUENCE_COUNTER_Mx_oSYS_TIME_SYNC_oPCAN_RADAR_b1c17f84_Rx: ComBitPosition=19, ComBitSize=4, ComSignalInitValue=0, ComSignalType=UINT8, ComSystemTemplateSystemSignalRef=TSYN_SEQUENCE_COUNTER
        TSYN_SGW_Mx28_oSYS_TIME_SYNC_oPCAN_RADAR_64e22cd6_Rx: ComBitPosition=26, ComBitSize=1, ComSignalInitValue=0, ComSignalType=BOOLEAN, ComSystemTemplateSystemSignalRef=TSYN_SGW
        TSYN_SYNCTIME_NANOSEC_Mx28_oSYS_TIME_SYNC_oPCAN_RADAR_4ec44b38_Rx: ComBitPosition=39, ComBitSize=32, ComSignalInitValue=0, ComSignalType=UINT32, ComSystemTemplateSystemSignalRef=TSYN_SYNCTIME_NANOSEC
        TSYN_SYNCTIME_SEC_Mx20_oSYS_TIME_SYNC_oPCAN_RADAR_eefbe385_Rx: ComBitPosition=39, ComBitSize=32, ComSignalInitValue=0, ComSignalType=UINT32, ComSystemTemplateSystemSignalRef=TSYN_SYNCTIME_SEC
        TSYN_TIMEDOMAIN_Mx_oSYS_TIME_SYNC_oPCAN_RADAR_924f2426_Rx: ComBitPosition=23, ComBitSize=4, ComSignalInitValue=0, ComSignalType=UINT8, ComSystemTemplateSystemSignalRef=TSYN_TIMEDOMAIN
        TSYN_USERBYTE_Mx20_oSYS_TIME_SYNC_oPCAN_RADAR_0d5c8681_Rx: ComBitPosition=31, ComBitSize=8, ComSignalInitValue=0, ComSignalType=UINT8, ComSystemTemplateSystemSignalRef=TSYN_USERBYTE
    ComGeneral
  module config ComM
    ComMConfigSet: ComMPncEnabled=false
      3 x ComMChannel:
        CN_PCAN_RADAR_458ff0f1: ComMBusType=COMM_BUS_TYPE_CAN, ComMChannelId=0
          ComMNetworkManagement
          CN_PCAN_RADAR_5dcc26a8 (ComMUserPerChannel): ComMUserChannel=CN_PCAN_RADAR_d6cf874b
        CN_VCAN_RADAR_489180b6: ComMBusType=COMM_BUS_TYPE_CAN, ComMChannelId=1
          ComMNetworkManagement: ComMNmVariant=FULL
          CN_VCAN_RADAR_ccadf631 (ComMUserPerChannel): ComMUserChannel=CN_VCAN_RADAR_4b138c58
        cnctr_RDR_RdrNet_5172a59b: ComMBusType=COMM_BUS_TYPE_ETH, ComMChannelId=2, ComMPncGatewayType=COMM_GATEWAY_TYPE_NONE
          ComMNetworkManagement
          cnctr_RDR_RdrNet_c5113eef (ComMUserPerChannel): ComMUserChannel=cnctr_RDR_RdrNet_9faa6a47
      3 x ComMUser:
        CN_PCAN_RADAR_d6cf874b
        CN_VCAN_RADAR_4b138c58
        cnctr_RDR_RdrNet_9faa6a47
    ComMGeneral: ComMPncIdCounting=COMM_PNC_ID_COUNT_FROM_NM_MESSAGE, ComMPncSupport=false
