[part 20 of 24: package /InitialEcuC]
AUTOSAR XML (schema 00053)
package /InitialEcuC  (continued)
  module config Com  (continued)
    ComConfig  (continued)
      242 x ComSignalGroup, all with ComTransferProperty=PENDING:  (continued)
        SG_TrackerObject040_oRDR_TRACKER_OBJ_040_oPCAN_RADAR_cd9c2a97_Tx: ComSystemTemplateSignalGroupRef=SG_TrackerObject040
          49 x ComGroupSignal, all with ComSignalEndianness=BIG_ENDIAN, ComSignalInitValue=0, ComTransferProperty=PENDING:
            OBJ_ACCELERATION_LAT_040_oRDR_TRACKER_OBJ_040_oPCAN_RADAR_c3b871e0_Tx: ComBitPosition=177, ComBitSize=10, ComSignalType=UINT16, ComSystemTemplateSystemSignalRef=OBJ_ACCELERATION_LAT_040
            OBJ_ACCELERATION_LAT_ERR_040_oRDR_TRACKER_OBJ_040_oPCAN_RADAR_164c4b5e_Tx: ComBitPosition=223, ComBitSize=8, ComSignalType=UINT8, ComSystemTemplateSystemSignalRef=OBJ_ACCELERATION_LAT_ERR_040
            OBJ_ACCELERATION_LONG_040_oRDR_TRACKER_OBJ_040_oPCAN_RADAR_b1482800_Tx: ComBitPosition=193, ComBitSize=10, ComSignalType=UINT16, ComSystemTemplateSystemSignalRef=OBJ_ACCELERATION_LONG_040
            OBJ_ACCELERATION_LONG_ERR_040_oRDR_TRACKER_OBJ_040_oPCAN_RADAR_09e9eef4_Tx: ComBitPosition=215, ComBitSize=8, ComSignalType=UINT8, ComSystemTemplateSystemSignalRef=OBJ_ACCELERATION_LONG_ERR_040
            OBJ_ACCEL_ERR_CRR_COEF_040_oRDR_TRACKER_OBJ_040_oPCAN_RADAR_a94acf92_Tx: ComBitPosition=431, ComBitSize=8, ComSignalType=UINT8, ComSystemTemplateSystemSignalRef=OBJ_ACCEL_ERR_CRR_COEF_040
            OBJ_ALIVE_TIME_040_oRDR_TRACKER_OBJ_040_oPCAN_RADAR_d12963bc_Tx: ComBitPosition=255, ComBitSize=16, ComSignalType=UINT16, ComSystemTemplateSystemSignalRef=OBJ_ALIVE_TIME_040
            OBJ_CLS_TYPE1_040_oRDR_TRACKER_OBJ_040_oPCAN_RADAR_46f2829a_Tx: ComBitPosition=271, ComBitSize=4, ComSignalType=UINT8, ComSystemTemplateSystemSignalRef=OBJ_CLS_TYPE1_040
            OBJ_CLS_TYPE1_PROB_040_oRDR_TRACKER_OBJ_040_oPCAN_RADAR_eeaa5569_Tx: ComBitPosition=303, ComBitSize=8, ComSignalType=UINT8, ComSystemTemplateSystemSignalRef=OBJ_CLS_TYPE1_PROB_040
            OBJ_CLS_TYPE2_040_oRDR_TRACKER_OBJ_040_oPCAN_RADAR_0b1a82fd_Tx: ComBitPosition=267, ComBitSize=4, ComSignalType=UINT8, ComSystemTemplateSystemSignalRef=OBJ_CLS_TYPE2_040
            OBJ_CLS_TYPE2_PROB_040_oRDR_TRACKER_OBJ_040_oPCAN_RADAR_279e4e64_Tx: ComBitPosition=311, ComBitSize=8, ComSignalType=UINT8, ComSystemTemplateSystemSignalRef=OBJ_CLS_TYPE2_PROB_040
            OBJ_CLS_TYPE3_040_oRDR_TRACKER_OBJ_040_oPCAN_RADAR_86927f1f_Tx: ComBitPosition=279, ComBitSize=4, ComSignalType=UINT8, ComSystemTemplateSystemSignalRef=OBJ_CLS_TYPE3_040
            OBJ_CLS_TYPE3_PROB_040_oRDR_TRACKER_OBJ_040_oPCAN_RADAR_608db89f_Tx: ComBitPosition=319, ComBitSize=8, ComSignalType=UINT8, ComSystemTemplateSystemSignalRef=OBJ_CLS_TYPE3_PROB_040
            OBJ_CLS_TYPE4_040_oRDR_TRACKER_OBJ_040_oPCAN_RADAR_90ca8233_Tx: ComBitPosition=275, ComBitSize=4, ComSignalType=UINT8, ComSystemTemplateSystemSignalRef=OBJ_CLS_TYPE4_040
            OBJ_CLS_TYPE4_PROB_040_oRDR_TRACKER_OBJ_040_oPCAN_RADAR_6e877e3f_Tx: ComBitPosition=327, ComBitSize=8, ComSignalType=UINT8, ComSystemTemplateSystemSignalRef=OBJ_CLS_TYPE4_PROB_040
            OBJ_CLS_TYPE5_040_oRDR_TRACKER_OBJ_040_oPCAN_RADAR_1d427fd1_Tx: ComBitPosition=287, ComBitSize=4, ComSignalType=UINT8, ComSystemTemplateSystemSignalRef=OBJ_CLS_TYPE5_040
            OBJ_CLS_TYPE5_PROB_040_oRDR_TRACKER_OBJ_040_oPCAN_RADAR_299488c4_Tx: ComBitPosition=335, ComBitSize=8, ComSignalType=UINT8, ComSystemTemplateSystemSignalRef=OBJ_CLS_TYPE5_PROB_040
            OBJ_CLS_TYPE6_040_oRDR_TRACKER_OBJ_040_oPCAN_RADAR_50aa7fb6_Tx: ComBitPosition=282, ComBitSize=4, ComSignalType=UINT8, ComSystemTemplateSystemSignalRef=OBJ_CLS_TYPE6_040
            OBJ_CLS_TYPE6_PROB_040_oRDR_TRACKER_OBJ_040_oPCAN_RADAR_e0a093c9_Tx: ComBitPosition=343, ComBitSize=8, ComSignalType=UINT8, ComSystemTemplateSystemSignalRef=OBJ_CLS_TYPE6_PROB_040
            OBJ_DIMENSION_LENGTH_040_oRDR_TRACKER_OBJ_040_oPCAN_RADAR_046cd1de_Tx: ComBitPosition=37, ComBitSize=12, ComSignalType=UINT16, ComSystemTemplateSystemSignalRef=OBJ_DIMENSION_LENGTH_040
            OBJ_DIMENSION_LENGTH_ERR_040_oRDR_TRACKER_OBJ_040_oPCAN_RADAR_3f94cea4_Tx: ComBitPosition=41, ComBitSize=10, ComSignalType=UINT16, ComSystemTemplateSystemSignalRef=OBJ_DIMENSION_LENGTH_ERR_040
            OBJ_DIMENSION_WIDTH_040_oRDR_TRACKER_OBJ_040_oPCAN_RADAR_27a22673_Tx: ComBitPosition=17, ComBitSize=10, ComSignalType=UINT16, ComSystemTemplateSystemSignalRef=OBJ_DIMENSION_WIDTH_040
            OBJ_DIMENSION_WIDTH_ERR_040_oRDR_TRACKER_OBJ_040_oPCAN_RADAR_c700e19b_Tx: ComBitPosition=23, ComBitSize=6, ComSignalType=UINT8, ComSystemTemplateSystemSignalRef=OBJ_DIMENSION_WIDTH_ERR_040
            OBJ_EXISTENCE_PROB_040_oRDR_TRACKER_OBJ_040_oPCAN_RADAR_2c1ea24e_Tx: ComBitPosition=229, ComBitSize=14, ComSignalType=UINT16, ComSystemTemplateSystemSignalRef=OBJ_EXISTENCE_PROB_040
            OBJ_GROUP_ID_040_oRDR_TRACKER_OBJ_040_oPCAN_RADAR_a56cb6e3_Tx: ComBitPosition=405, ComBitSize=6, ComSignalType=UINT8, ComSystemTemplateSystemSignalRef=OBJ_GROUP_ID_040
            OBJ_ID_040_oRDR_TRACKER_OBJ_040_oPCAN_RADAR_56429de4_Tx: ComBitPosition=7, ComBitSize=8, ComSignalType=UINT8, ComSystemTemplateSystemSignalRef=OBJ_ID_040
            OBJ_MEASUREMENT_STATUS_040_oRDR_TRACKER_OBJ_040_oPCAN_RADAR_2990ef59_Tx: ComBitPosition=14, ComBitSize=3, ComSignalType=UINT8, ComSystemTemplateSystemSignalRef=OBJ_MEASUREMENT_STATUS_040
            OBJ_MH_CRC16_040_oRDR_TRACKER_OBJ_040_oPCAN_RADAR_55f05865_Tx: ComBitPosition=495, ComBitSize=16, ComSignalType=UINT16, ComSystemTemplateSystemSignalRef=OBJ_MH_CRC16_040
            OBJ_MH_CYCLE_COUNTER_040_oRDR_TRACKER_OBJ_040_oPCAN_RADAR_24140284_Tx: ComBitPosition=487, ComBitSize=8, ComSignalType=UINT8, ComSystemTemplateSystemSignalRef=OBJ_MH_CYCLE_COUNTER_040
            OBJ_MOVEMENT_STATUS_040_oRDR_TRACKER_OBJ_040_oPCAN_RADAR_063e7a15_Tx: ComBitPosition=196, ComBitSize=3, ComSignalType=UINT8, ComSystemTemplateSystemSignalRef=OBJ_MOVEMENT_STATUS_040
            OBJ_POS_ERR_CRR_COEF_040_oRDR_TRACKER_OBJ_040_oPCAN_RADAR_9641ba2f_Tx: ComBitPosition=415, ComBitSize=8, ComSignalType=UINT8, ComSystemTemplateSystemSignalRef=OBJ_POS_ERR_CRR_COEF_040
            OBJ_POS_LAT_040_oRDR_TRACKER_OBJ_040_oPCAN_RADAR_74ee4763_Tx: ComBitPosition=79, ComBitSize=16, ComSignalType=UINT16, ComSystemTemplateSystemSignalRef=OBJ_POS_LAT_040
            OBJ_POS_LAT_ERR_040_oRDR_TRACKER_OBJ_040_oPCAN_RADAR_70a21754_Tx: ComBitPosition=103, ComBitSize=8, ComSignalType=UINT8, ComSystemTemplateSystemSignalRef=OBJ_POS_LAT_ERR_040
            OBJ_POS_LONG_040_oRDR_TRACKER_OBJ_040_oPCAN_RADAR_c54eacac_Tx: ComBitPosition=63, ComBitSize=16, ComSignalType=UINT16, ComSystemTemplateSystemSignalRef=OBJ_POS_LONG_040
            OBJ_POS_LONG_ERR_040_oRDR_TRACKER_OBJ_040_oPCAN_RADAR_e95ae9b6_Tx: ComBitPosition=95, ComBitSize=8, ComSignalType=UINT8, ComSystemTemplateSystemSignalRef=OBJ_POS_LONG_ERR_040
            OBJ_RCS_040_oRDR_TRACKER_OBJ_040_oPCAN_RADAR_56211164_Tx: ComBitPosition=351, ComBitSize=7, ComSignalType=UINT8, ComSystemTemplateSystemSignalRef=OBJ_RCS_040
            OBJ_REF_PT_LAT_OFFSET_040_oRDR_TRACKER_OBJ_040_oPCAN_RADAR_a31c7a11_Tx: ComBitPosition=370, ComBitSize=14, ComSignalType=UINT16, ComSystemTemplateSystemSignalRef=OBJ_REF_PT_LAT_OFFSET_040
            OBJ_REF_PT_LONG_OFFSET_040_oRDR_TRACKER_OBJ_040_oPCAN_RADAR_ec4e8a12_Tx: ComBitPosition=357, ComBitSize=14, ComSignalType=UINT16, ComSystemTemplateSystemSignalRef=OBJ_REF_PT_LONG_OFFSET_040
            OBJ_TIMESTAMP_OFFSET_040_oRDR_TRACKER_OBJ_040_oPCAN_RADAR_568d1132_Tx: ComBitPosition=247, ComBitSize=8, ComSignalType=UINT8, ComSystemTemplateSystemSignalRef=OBJ_TIMESTAMP_OFFSET_040
            OBJ_TRACK_MOTION_MODEL_040_oRDR_TRACKER_OBJ_040_oPCAN_RADAR_9a8e10ef_Tx: ComBitPosition=9, ComBitSize=2, ComSignalType=UINT8, ComSystemTemplateSystemSignalRef=OBJ_TRACK_MOTION_MODEL_040
            OBJ_VEH_TRACK_FLAG_040_oRDR_TRACKER_OBJ_040_oPCAN_RADAR_18a4e6b2_Tx: ComBitPosition=10, ComBitSize=1, ComSignalType=BOOLEAN, ComSystemTemplateSystemSignalRef=OBJ_VEH_TRACK_FLAG_040
            OBJ_VELOCITY_ERR_CRR_COEF_040_oRDR_TRACKER_OBJ_040_oPCAN_RADAR_3f3b87ce_Tx: ComBitPosition=423, ComBitSize=8, ComSignalType=UINT8, ComSystemTemplateSystemSignalRef=OBJ_VELOCITY_ERR_CRR_COEF_040
            OBJ_VELOCITY_LAT_040_oRDR_TRACKER_OBJ_040_oPCAN_RADAR_308d0244_Tx: ComBitPosition=126, ComBitSize=15, ComSignalType=UINT16, ComSystemTemplateSystemSignalRef=OBJ_VELOCITY_LAT_040
            OBJ_VELOCITY_LAT_ERR_040_oRDR_TRACKER_OBJ_040_oPCAN_RADAR_04777215_Tx: ComBitPosition=151, ComBitSize=8, ComSignalType=UINT8, ComSystemTemplateSystemSignalRef=OBJ_VELOCITY_LAT_ERR_040
            OBJ_VELOCITY_LONG_040_oRDR_TRACKER_OBJ_040_oPCAN_RADAR_60007a82_Tx: ComBitPosition=110, ComBitSize=15, ComSignalType=UINT16, ComSystemTemplateSystemSignalRef=OBJ_VELOCITY_LONG_040
            OBJ_VELOCITY_LONG_ERR_040_oRDR_TRACKER_OBJ_040_oPCAN_RADAR_e8f54dd5_Tx: ComBitPosition=143, ComBitSize=8, ComSignalType=UINT8, ComSystemTemplateSystemSignalRef=OBJ_VELOCITY_LONG_ERR_040
            OBJ_YAW_ANGLE_040_oRDR_TRACKER_OBJ_040_oPCAN_RADAR_dc314604_Tx: ComBitPosition=155, ComBitSize=12, ComSignalType=UINT16, ComSystemTemplateSystemSignalRef=OBJ_YAW_ANGLE_040
            OBJ_YAW_ANGLE_ERR_040_oRDR_TRACKER_OBJ_040_oPCAN_RADAR_093c40d3_Tx: ComBitPosition=175, ComBitSize=7, ComSignalType=UINT8, ComSystemTemplateSystemSignalRef=OBJ_YAW_ANGLE_ERR_040
            OBJ_YAW_RATE_040_oRDR_TRACKER_OBJ_040_oPCAN_RADAR_f9be6343_Tx: ComBitPosition=399, ComBitSize=10, ComSignalType=UINT16, ComSystemTemplateSystemSignalRef=OBJ_YAW_RATE_040
            OBJ_YAW_RATE_ERR_040_oRDR_TRACKER_OBJ_040_oPCAN_RADAR_c666f49f_Tx: ComBitPosition=388, ComBitSize=5, ComSignalType=UINT8, ComSystemTemplateSystemSignalRef=OBJ_YAW_RATE_ERR_040
        SG_TrackerObject041_oRDR_TRACKER_OBJ_041_oPCAN_RADAR_3488a224_Tx: ComSystemTemplateSignalGroupRef=SG_TrackerObject041
          49 x ComGroupSignal, all with ComSignalEndianness=BIG_ENDIAN, ComSignalInitValue=0, ComTransferProperty=PENDING:
            OBJ_ACCELERATION_LAT_041_oRDR_TRACKER_OBJ_041_oPCAN_RADAR_3aacf953_Tx: ComBitPosition=177, ComBitSize=10, ComSignalType=UINT16, ComSystemTemplateSystemSignalRef=OBJ_ACCELERATION_LAT_041
            OBJ_ACCELERATION_LAT_ERR_041_oRDR_TRACKER_OBJ_041_oPCAN_RADAR_ef58c3ed_Tx: ComBitPosition=223, ComBitSize=8, ComSignalType=UINT8, ComSystemTemplateSystemSignalRef=OBJ_ACCELERATION_LAT_ERR_041
            OBJ_ACCELERATION_LONG_041_oRDR_TRACKER_OBJ_041_oPCAN_RADAR_485ca0b3_Tx: ComBitPosition=193, ComBitSize=10, ComSignalType=UINT16, ComSystemTemplateSystemSignalRef=OBJ_ACCELERATION_LONG_041
            OBJ_ACCELERATION_LONG_ERR_041_oRDR_TRACKER_OBJ_041_oPCAN_RADAR_f0fd6647_Tx: ComBitPosition=215, ComBitSize=8, ComSignalType=UINT8, ComSystemTemplateSystemSignalRef=OBJ_ACCELERATION_LONG_ERR_041
            OBJ_ACCEL_ERR_CRR_COEF_041_oRDR_TRACKER_OBJ_041_oPCAN_RADAR_505e4721_Tx: ComBitPosition=431, ComBitSize=8, ComSignalType=UINT8, ComSystemTemplateSystemSignalRef=OBJ_ACCEL_ERR_CRR_COEF_041
            OBJ_ALIVE_TIME_041_oRDR_TRACKER_OBJ_041_oPCAN_RADAR_283deb0f_Tx: ComBitPosition=255, ComBitSize=16, ComSignalType=UINT16, ComSystemTemplateSystemSignalRef=OBJ_ALIVE_TIME_041
            OBJ_CLS_TYPE1_041_oRDR_TRACKER_OBJ_041_oPCAN_RADAR_bfe60a29_Tx: ComBitPosition=271, ComBitSize=4, ComSignalType=UINT8, ComSystemTemplateSystemSignalRef=OBJ_CLS_TYPE1_041
            OBJ_CLS_TYPE1_PROB_041_oRDR_TRACKER_OBJ_041_oPCAN_RADAR_17beddda_Tx: ComBitPosition=303, ComBitSize=8, ComSignalType=UINT8, ComSystemTemplateSystemSignalRef=OBJ_CLS_TYPE1_PROB_041
            OBJ_CLS_TYPE2_041_oRDR_TRACKER_OBJ_041_oPCAN_RADAR_f20e0a4e_Tx: ComBitPosition=267, ComBitSize=4, ComSignalType=UINT8, ComSystemTemplateSystemSignalRef=OBJ_CLS_TYPE2_041
            OBJ_CLS_TYPE2_PROB_041_oRDR_TRACKER_OBJ_041_oPCAN_RADAR_de8ac6d7_Tx: ComBitPosition=311, ComBitSize=8, ComSignalType=UINT8, ComSystemTemplateSystemSignalRef=OBJ_CLS_TYPE2_PROB_041
            OBJ_CLS_TYPE3_041_oRDR_TRACKER_OBJ_041_oPCAN_RADAR_7f86f7ac_Tx: ComBitPosition=279, ComBitSize=4, ComSignalType=UINT8, ComSystemTemplateSystemSignalRef=OBJ_CLS_TYPE3_041
            OBJ_CLS_TYPE3_PROB_041_oRDR_TRACKER_OBJ_041_oPCAN_RADAR_9999302c_Tx: ComBitPosition=319, ComBitSize=8, ComSignalType=UINT8, ComSystemTemplateSystemSignalRef=OBJ_CLS_TYPE3_PROB_041
            OBJ_CLS_TYPE4_041_oRDR_TRACKER_OBJ_041_oPCAN_RADAR_69de0a80_Tx: ComBitPosition=275, ComBitSize=4, ComSignalType=UINT8, ComSystemTemplateSystemSignalRef=OBJ_CLS_TYPE4_041
            OBJ_CLS_TYPE4_PROB_041_oRDR_TRACKER_OBJ_041_oPCAN_RADAR_9793f68c_Tx: ComBitPosition=327, ComBitSize=8, ComSignalType=UINT8, ComSystemTemplateSystemSignalRef=OBJ_CLS_TYPE4_PROB_041
            OBJ_CLS_TYPE5_041_oRDR_TRACKER_OBJ_041_oPCAN_RADAR_e456f762_Tx: ComBitPosition=287, ComBitSize=4, ComSignalType=UINT8, ComSystemTemplateSystemSignalRef=OBJ_CLS_TYPE5_041
            OBJ_CLS_TYPE5_PROB_041_oRDR_TRACKER_OBJ_041_oPCAN_RADAR_d0800077_Tx: ComBitPosition=335, ComBitSize=8, ComSignalType=UINT8, ComSystemTemplateSystemSignalRef=OBJ_CLS_TYPE5_PROB_041
            OBJ_CLS_TYPE6_041_oRDR_TRACKER_OBJ_041_oPCAN_RADAR_a9bef705_Tx: ComBitPosition=282, ComBitSize=4, ComSignalType=UINT8, ComSystemTemplateSystemSignalRef=OBJ_CLS_TYPE6_041
            OBJ_CLS_TYPE6_PROB_041_oRDR_TRACKER_OBJ_041_oPCAN_RADAR_19b41b7a_Tx: ComBitPosition=343, ComBitSize=8, ComSignalType=UINT8, ComSystemTemplateSystemSignalRef=OBJ_CLS_TYPE6_PROB_041
            OBJ_DIMENSION_LENGTH_041_oRDR_TRACKER_OBJ_041_oPCAN_RADAR_fd78596d_Tx: ComBitPosition=37, ComBitSize=12, ComSignalType=UINT16, ComSystemTemplateSystemSignalRef=OBJ_DIMENSION_LENGTH_041
            OBJ_DIMENSION_LENGTH_ERR_041_oRDR_TRACKER_OBJ_041_oPCAN_RADAR_c6804617_Tx: ComBitPosition=41, ComBitSize=10, ComSignalType=UINT16, ComSystemTemplateSystemSignalRef=OBJ_DIMENSION_LENGTH_ERR_041
            OBJ_DIMENSION_WIDTH_041_oRDR_TRACKER_OBJ_041_oPCAN_RADAR_deb6aec0_Tx: ComBitPosition=17, ComBitSize=10, ComSignalType=UINT16, ComSystemTemplateSystemSignalRef=OBJ_DIMENSION_WIDTH_041
            OBJ_DIMENSION_WIDTH_ERR_041_oRDR_TRACKER_OBJ_041_oPCAN_RADAR_3e146928_Tx: ComBitPosition=23, ComBitSize=6, ComSignalType=UINT8, ComSystemTemplateSystemSignalRef=OBJ_DIMENSION_WIDTH_ERR_041
            OBJ_EXISTENCE_PROB_041_oRDR_TRACKER_OBJ_041_oPCAN_RADAR_d50a2afd_Tx: ComBitPosition=229, ComBitSize=14, ComSignalType=UINT16, ComSystemTemplateSystemSignalRef=OBJ_EXISTENCE_PROB_041
            OBJ_GROUP_ID_041_oRDR_TRACKER_OBJ_041_oPCAN_RADAR_5c783e50_Tx: ComBitPosition=405, ComBitSize=6, ComSignalType=UINT8, ComSystemTemplateSystemSignalRef=OBJ_GROUP_ID_041
            OBJ_ID_041_oRDR_TRACKER_OBJ_041_oPCAN_RADAR_af561557_Tx: ComBitPosition=7, ComBitSize=8, ComSignalType=UINT8, ComSystemTemplateSystemSignalRef=OBJ_ID_041
            OBJ_MEASUREMENT_STATUS_041_oRDR_TRACKER_OBJ_041_oPCAN_RADAR_d08467ea_Tx: ComBitPosition=14, ComBitSize=3, ComSignalType=UINT8, ComSystemTemplateSystemSignalRef=OBJ_MEASUREMENT_STATUS_041
            OBJ_MH_CRC16_041_oRDR_TRACKER_OBJ_041_oPCAN_RADAR_ace4d0d6_Tx: ComBitPosition=495, ComBitSize=16, ComSignalType=UINT16, ComSystemTemplateSystemSignalRef=OBJ_MH_CRC16_041
            OBJ_MH_CYCLE_COUNTER_041_oRDR_TRACKER_OBJ_041_oPCAN_RADAR_dd008a37_Tx: ComBitPosition=487, ComBitSize=8, ComSignalType=UINT8, ComSystemTemplateSystemSignalRef=OBJ_MH_CYCLE_COUNTER_041
            OBJ_MOVEMENT_STATUS_041_oRDR_TRACKER_OBJ_041_oPCAN_RADAR_ff2af2a6_Tx: ComBitPosition=196, ComBitSize=3, ComSignalType=UINT8, ComSystemTemplateSystemSignalRef=OBJ_MOVEMENT_STATUS_041
            OBJ_POS_ERR_CRR_COEF_041_oRDR_TRACKER_OBJ_041_oPCAN_RADAR_6f55329c_Tx: ComBitPosition=415, ComBitSize=8, ComSignalType=UINT8, ComSystemTemplateSystemSignalRef=OBJ_POS_ERR_CRR_COEF_041
            OBJ_POS_LAT_041_oRDR_TRACKER_OBJ_041_oPCAN_RADAR_8dfacfd0_Tx: ComBitPosition=79, ComBitSize=16, ComSignalType=UINT16, ComSystemTemplateSystemSignalRef=OBJ_POS_LAT_041
            OBJ_POS_LAT_ERR_041_oRDR_TRACKER_OBJ_041_oPCAN_RADAR_89b69fe7_Tx: ComBitPosition=103, ComBitSize=8, ComSignalType=UINT8, ComSystemTemplateSystemSignalRef=OBJ_POS_LAT_ERR_041
            OBJ_POS_LONG_041_oRDR_TRACKER_OBJ_041_oPCAN_RADAR_3c5a241f_Tx: ComBitPosition=63, ComBitSize=16, ComSignalType=UINT16, ComSystemTemplateSystemSignalRef=OBJ_POS_LONG_041
            OBJ_POS_LONG_ERR_041_oRDR_TRACKER_OBJ_041_oPCAN_RADAR_104e6105_Tx: ComBitPosition=95, ComBitSize=8, ComSignalType=UINT8, ComSystemTemplateSystemSignalRef=OBJ_POS_LONG_ERR_041
            OBJ_RCS_041_oRDR_TRACKER_OBJ_041_oPCAN_RADAR_af3599d7_Tx: ComBitPosition=351, ComBitSize=7, ComSignalType=UINT8, ComSystemTemplateSystemSignalRef=OBJ_RCS_041
            OBJ_REF_PT_LAT_OFFSET_041_oRDR_TRACKER_OBJ_041_oPCAN_RADAR_5a08f2a2_Tx: ComBitPosition=370, ComBitSize=14, ComSignalType=UINT16, ComSystemTemplateSystemSignalRef=OBJ_REF_PT_LAT_OFFSET_041
            OBJ_REF_PT_LONG_OFFSET_041_oRDR_TRACKER_OBJ_041_oPCAN_RADAR_155a02a1_Tx: ComBitPosition=357, ComBitSize=14, ComSignalType=UINT16, ComSystemTemplateSystemSignalRef=OBJ_REF_PT_LONG_OFFSET_041
            OBJ_TIMESTAMP_OFFSET_041_oRDR_TRACKER_OBJ_041_oPCAN_RADAR_af999981_Tx: ComBitPosition=247, ComBitSize=8, ComSignalType=UINT8, ComSystemTemplateSystemSignalRef=OBJ_TIMESTAMP_OFFSET_041
            OBJ_TRACK_MOTION_MODEL_041_oRDR_TRACKER_OBJ_041_oPCAN_RADAR_639a985c_Tx: ComBitPosition=9, ComBitSize=2, ComSignalType=UINT8, ComSystemTemplateSystemSignalRef=OBJ_TRACK_MOTION_MODEL_041
            OBJ_VEH_TRACK_FLAG_041_oRDR_TRACKER_OBJ_041_oPCAN_RADAR_e1b06e01_Tx: ComBitPosition=10, ComBitSize=1, ComSignalType=BOOLEAN, ComSystemTemplateSystemSignalRef=OBJ_VEH_TRACK_FLAG_041
            OBJ_VELOCITY_ERR_CRR_COEF_041_oRDR_TRACKER_OBJ_041_oPCAN_RADAR_c62f0f7d_Tx: ComBitPosition=423, ComBitSize=8, ComSignalType=UINT8, ComSystemTemplateSystemSignalRef=OBJ_VELOCITY_ERR_CRR_COEF_041
            OBJ_VELOCITY_LAT_041_oRDR_TRACKER_OBJ_041_oPCAN_RADAR_c9998af7_Tx: ComBitPosition=126, ComBitSize=15, ComSignalType=UINT16, ComSystemTemplateSystemSignalRef=OBJ_VELOCITY_LAT_041
            OBJ_VELOCITY_LAT_ERR_041_oRDR_TRACKER_OBJ_041_oPCAN_RADAR_fd63faa6_Tx: ComBitPosition=151, ComBitSize=8, ComSignalType=UINT8, ComSystemTemplateSystemSignalRef=OBJ_VELOCITY_LAT_ERR_041
            OBJ_VELOCITY_LONG_041_oRDR_TRACKER_OBJ_041_oPCAN_RADAR_9914f231_Tx: ComBitPosition=110, ComBitSize=15, ComSignalType=UINT16, ComSystemTemplateSystemSignalRef=OBJ_VELOCITY_LONG_041
            OBJ_VELOCITY_LONG_ERR_041_oRDR_TRACKER_OBJ_041_oPCAN_RADAR_11e1c566_Tx: ComBitPosition=143, ComBitSize=8, ComSignalType=UINT8, ComSystemTemplateSystemSignalRef=OBJ_VELOCITY_LONG_ERR_041
            OBJ_YAW_ANGLE_041_oRDR_TRACKER_OBJ_041_oPCAN_RADAR_2525ceb7_Tx: ComBitPosition=155, ComBitSize=12, ComSignalType=UINT16, ComSystemTemplateSystemSignalRef=OBJ_YAW_ANGLE_041
            OBJ_YAW_ANGLE_ERR_041_oRDR_TRACKER_OBJ_041_oPCAN_RADAR_f028c860_Tx: ComBitPosition=175, ComBitSize=7, ComSignalType=UINT8, ComSystemTemplateSystemSignalRef=OBJ_YAW_ANGLE_ERR_041
            OBJ_YAW_RATE_041_oRDR_TRACKER_OBJ_041_oPCAN_RADAR_00aaebf0_Tx: ComBitPosition=399, ComBitSize=10, ComSignalType=UINT16, ComSystemTemplateSystemSignalRef=OBJ_YAW_RATE_041
            OBJ_YAW_RATE_ERR_041_oRDR_TRACKER_OBJ_041_oPCAN_RADAR_3f727c2c_Tx: ComBitPosition=388, ComBitSize=5, ComSignalType=UINT8, ComSystemTemplateSystemSignalRef=OBJ_YAW_RATE_ERR_041
        SG_TrackerObject042_oRDR_TRACKER_OBJ_042_oPCAN_RADAR_e4c43db0_Tx: ComSystemTemplateSignalGroupRef=SG_TrackerObject042
          49 x ComGroupSignal, all with ComSignalEndianness=BIG_ENDIAN, ComSignalInitValue=0, ComTransferProperty=PENDING:
            OBJ_ACCELERATION_LAT_042_oRDR_TRACKER_OBJ_042_oPCAN_RADAR_eae066c7_Tx: ComBitPosition=177, ComBitSize=10, ComSignalType=UINT16, ComSystemTemplateSystemSignalRef=OBJ_ACCELERATION_LAT_042
            OBJ_ACCELERATION_LAT_ERR_042_oRDR_TRACKER_OBJ_042_oPCAN_RADAR_3f145c79_Tx: ComBitPosition=223, ComBitSize=8, ComSignalType=UINT8, ComSystemTemplateSystemSignalRef=OBJ_ACCELERATION_LAT_ERR_042
            OBJ_ACCELERATION_LONG_042_oRDR_TRACKER_OBJ_042_oPCAN_RADAR_98103f27_Tx: ComBitPosition=193, ComBitSize=10, ComSignalType=UINT16, ComSystemTemplateSystemSignalRef=OBJ_ACCELERATION_LONG_042
            OBJ_ACCELERATION_LONG_ERR_042_oRDR_TRACKER_OBJ_042_oPCAN_RADAR_20b1f9d3_Tx: ComBitPosition=215, ComBitSize=8, ComSignalType=UINT8, ComSystemTemplateSystemSignalRef=OBJ_ACCELERATION_LONG_ERR_042
            OBJ_ACCEL_ERR_CRR_COEF_042_oRDR_TRACKER_OBJ_042_oPCAN_RADAR_8012d8b5_Tx: ComBitPosition=431, ComBitSize=8, ComSignalType=UINT8, ComSystemTemplateSystemSignalRef=OBJ_ACCEL_ERR_CRR_COEF_042
            OBJ_ALIVE_TIME_042_oRDR_TRACKER_OBJ_042_oPCAN_RADAR_f871749b_Tx: ComBitPosition=255, ComBitSize=16, ComSignalType=UINT16, ComSystemTemplateSystemSignalRef=OBJ_ALIVE_TIME_042
            OBJ_CLS_TYPE1_042_oRDR_TRACKER_OBJ_042_oPCAN_RADAR_6faa95bd_Tx: ComBitPosition=271, ComBitSize=4, ComSignalType=UINT8, ComSystemTemplateSystemSignalRef=OBJ_CLS_TYPE1_042
            OBJ_CLS_TYPE1_PROB_042_oRDR_TRACKER_OBJ_042_oPCAN_RADAR_c7f2424e_Tx: ComBitPosition=303, ComBitSize=8, ComSignalType=UINT8, ComSystemTemplateSystemSignalRef=OBJ_CLS_TYPE1_PROB_042
            OBJ_CLS_TYPE2_042_oRDR_TRACKER_OBJ_042_oPCAN_RADAR_224295da_Tx: ComBitPosition=267, ComBitSize=4, ComSignalType=UINT8, ComSystemTemplateSystemSignalRef=OBJ_CLS_TYPE2_042
            OBJ_CLS_TYPE2_PROB_042_oRDR_TRACKER_OBJ_042_oPCAN_RADAR_0ec65943_Tx: ComBitPosition=311, ComBitSize=8, ComSignalType=UINT8, ComSystemTemplateSystemSignalRef=OBJ_CLS_TYPE2_PROB_042
            OBJ_CLS_TYPE3_042_oRDR_TRACKER_OBJ_042_oPCAN_RADAR_afca6838_Tx: ComBitPosition=279, ComBitSize=4, ComSignalType=UINT8, ComSystemTemplateSystemSignalRef=OBJ_CLS_TYPE3_042
            OBJ_CLS_TYPE3_PROB_042_oRDR_TRACKER_OBJ_042_oPCAN_RADAR_49d5afb8_Tx: ComBitPosition=319, ComBitSize=8, ComSignalType=UINT8, ComSystemTemplateSystemSignalRef=OBJ_CLS_TYPE3_PROB_042
            OBJ_CLS_TYPE4_042_oRDR_TRACKER_OBJ_042_oPCAN_RADAR_b9929514_Tx: ComBitPosition=275, ComBitSize=4, ComSignalType=UINT8, ComSystemTemplateSystemSignalRef=OBJ_CLS_TYPE4_042
            OBJ_CLS_TYPE4_PROB_042_oRDR_TRACKER_OBJ_042_oPCAN_RADAR_47df6918_Tx: ComBitPosition=327, ComBitSize=8, ComSignalType=UINT8, ComSystemTemplateSystemSignalRef=OBJ_CLS_TYPE4_PROB_042
            OBJ_CLS_TYPE5_042_oRDR_TRACKER_OBJ_042_oPCAN_RADAR_341a68f6_Tx: ComBitPosition=287, ComBitSize=4, ComSignalType=UINT8, ComSystemTemplateSystemSignalRef=OBJ_CLS_TYPE5_042
            OBJ_CLS_TYPE5_PROB_042_oRDR_TRACKER_OBJ_042_oPCAN_RADAR_00cc9fe3_Tx: ComBitPosition=335, ComBitSize=8, ComSignalType=UINT8, ComSystemTemplateSystemSignalRef=OBJ_CLS_TYPE5_PROB_042
            OBJ_CLS_TYPE6_042_oRDR_TRACKER_OBJ_042_oPCAN_RADAR_79f26891_Tx: ComBitPosition=282, ComBitSize=4, ComSignalType=UINT8, ComSystemTemplateSystemSignalRef=OBJ_CLS_TYPE6_042
            OBJ_CLS_TYPE6_PROB_042_oRDR_TRACKER_OBJ_042_oPCAN_RADAR_c9f884ee_Tx: ComBitPosition=343, ComBitSize=8, ComSignalType=UINT8, ComSystemTemplateSystemSignalRef=OBJ_CLS_TYPE6_PROB_042
            OBJ_DIMENSION_LENGTH_042_oRDR_TRACKER_OBJ_042_oPCAN_RADAR_2d34c6f9_Tx: ComBitPosition=37, ComBitSize=12, ComSignalType=UINT16, ComSystemTemplateSystemSignalRef=OBJ_DIMENSION_LENGTH_042
            OBJ_DIMENSION_LENGTH_ERR_042_oRDR_TRACKER_OBJ_042_oPCAN_RADAR_16ccd983_Tx: ComBitPosition=41, ComBitSize=10, ComSignalType=UINT16, ComSystemTemplateSystemSignalRef=OBJ_DIMENSION_LENGTH_ERR_042
            OBJ_DIMENSION_WIDTH_042_oRDR_TRACKER_OBJ_042_oPCAN_RADAR_0efa3154_Tx: ComBitPosition=17, ComBitSize=10, ComSignalType=UINT16, ComSystemTemplateSystemSignalRef=OBJ_DIMENSION_WIDTH_042
            OBJ_DIMENSION_WIDTH_ERR_042_oRDR_TRACKER_OBJ_042_oPCAN_RADAR_ee58f6bc_Tx: ComBitPosition=23, ComBitSize=6, ComSignalType=UINT8, ComSystemTemplateSystemSignalRef=OBJ_DIMENSION_WIDTH_ERR_042
            OBJ_EXISTENCE_PROB_042_oRDR_TRACKER_OBJ_042_oPCAN_RADAR_0546b569_Tx: ComBitPosition=229, ComBitSize=14, ComSignalType=UINT16, ComSystemTemplateSystemSignalRef=OBJ_EXISTENCE_PROB_042
            OBJ_GROUP_ID_042_oRDR_TRACKER_OBJ_042_oPCAN_RADAR_8c34a1c4_Tx: ComBitPosition=405, ComBitSize=6, ComSignalType=UINT8, ComSystemTemplateSystemSignalRef=OBJ_GROUP_ID_042
            OBJ_ID_042_oRDR_TRACKER_OBJ_042_oPCAN_RADAR_7f1a8ac3_Tx: ComBitPosition=7, ComBitSize=8, ComSignalType=UINT8, ComSystemTemplateSystemSignalRef=OBJ_ID_042
            OBJ_MEASUREMENT_STATUS_042_oRDR_TRACKER_OBJ_042_oPCAN_RADAR_00c8f87e_Tx: ComBitPosition=14, ComBitSize=3, ComSignalType=UINT8, ComSystemTemplateSystemSignalRef=OBJ_MEASUREMENT_STATUS_042
            OBJ_MH_CRC16_042_oRDR_TRACKER_OBJ_042_oPCAN_RADAR_7ca84f42_Tx: ComBitPosition=495, ComBitSize=16, ComSignalType=UINT16, ComSystemTemplateSystemSignalRef=OBJ_MH_CRC16_042
            OBJ_MH_CYCLE_COUNTER_042_oRDR_TRACKER_OBJ_042_oPCAN_RADAR_0d4c15a3_Tx: ComBitPosition=487, ComBitSize=8, ComSignalType=UINT8, ComSystemTemplateSystemSignalRef=OBJ_MH_CYCLE_COUNTER_042
            OBJ_MOVEMENT_STATUS_042_oRDR_TRACKER_OBJ_042_oPCAN_RADAR_2f666d32_Tx: ComBitPosition=196, ComBitSize=3, ComSignalType=UINT8, ComSystemTemplateSystemSignalRef=OBJ_MOVEMENT_STATUS_042
            OBJ_POS_ERR_CRR_COEF_042_oRDR_TRACKER_OBJ_042_oPCAN_RADAR_bf19ad08_Tx: ComBitPosition=415, ComBitSize=8, ComSignalType=UINT8, ComSystemTemplateSystemSignalRef=OBJ_POS_ERR_CRR_COEF_042
            OBJ_POS_LAT_042_oRDR_TRACKER_OBJ_042_oPCAN_RADAR_5db65044_Tx: ComBitPosition=79, ComBitSize=16, ComSignalType=UINT16, ComSystemTemplateSystemSignalRef=OBJ_POS_LAT_042
            OBJ_POS_LAT_ERR_042_oRDR_TRACKER_OBJ_042_oPCAN_RADAR_59fa0073_Tx: ComBitPosition=103, ComBitSize=8, ComSignalType=UINT8, ComSystemTemplateSystemSignalRef=OBJ_POS_LAT_ERR_042
            OBJ_POS_LONG_042_oRDR_TRACKER_OBJ_042_oPCAN_RADAR_ec16bb8b_Tx: ComBitPosition=63, ComBitSize=16, ComSignalType=UINT16, ComSystemTemplateSystemSignalRef=OBJ_POS_LONG_042
            OBJ_POS_LONG_ERR_042_oRDR_TRACKER_OBJ_042_oPCAN_RADAR_c002fe91_Tx: ComBitPosition=95, ComBitSize=8, ComSignalType=UINT8, ComSystemTemplateSystemSignalRef=OBJ_POS_LONG_ERR_042
            OBJ_RCS_042_oRDR_TRACKER_OBJ_042_oPCAN_RADAR_7f790643_Tx: ComBitPosition=351, ComBitSize=7, ComSignalType=UINT8, ComSystemTemplateSystemSignalRef=OBJ_RCS_042
            OBJ_REF_PT_LAT_OFFSET_042_oRDR_TRACKER_OBJ_042_oPCAN_RADAR_8a446d36_Tx: ComBitPosition=370, ComBitSize=14, ComSignalType=UINT16, ComSystemTemplateSystemSignalRef=OBJ_REF_PT_LAT_OFFSET_042
            OBJ_REF_PT_LONG_OFFSET_042_oRDR_TRACKER_OBJ_042_oPCAN_RADAR_c5169d35_Tx: ComBitPosition=357, ComBitSize=14, ComSignalType=UINT16, ComSystemTemplateSystemSignalRef=OBJ_REF_PT_LONG_OFFSET_042
            OBJ_TIMESTAMP_OFFSET_042_oRDR_TRACKER_OBJ_042_oPCAN_RADAR_7fd50615_Tx: ComBitPosition=247, ComBitSize=8, ComSignalType=UINT8, ComSystemTemplateSystemSignalRef=OBJ_TIMESTAMP_OFFSET_042
            OBJ_TRACK_MOTION_MODEL_042_oRDR_TRACKER_OBJ_042_oPCAN_RADAR_b3d607c8_Tx: ComBitPosition=9, ComBitSize=2, ComSignalType=UINT8, ComSystemTemplateSystemSignalRef=OBJ_TRACK_MOTION_MODEL_042
            OBJ_VEH_TRACK_FLAG_042_oRDR_TRACKER_OBJ_042_oPCAN_RADAR_31fcf195_Tx: ComBitPosition=10, ComBitSize=1, ComSignalType=BOOLEAN, ComSystemTemplateSystemSignalRef=OBJ_VEH_TRACK_FLAG_042
            OBJ_VELOCITY_ERR_CRR_COEF_042_oRDR_TRACKER_OBJ_042_oPCAN_RADAR_166390e9_Tx: ComBitPosition=423, ComBitSize=8, ComSignalType=UINT8, ComSystemTemplateSystemSignalRef=OBJ_VELOCITY_ERR_CRR_COEF_042
            OBJ_VELOCITY_LAT_042_oRDR_TRACKER_OBJ_042_oPCAN_RADAR_19d51563_Tx: ComBitPosition=126, ComBitSize=15, ComSignalType=UINT16, ComSystemTemplateSystemSignalRef=OBJ_VELOCITY_LAT_042
            OBJ_VELOCITY_LAT_ERR_042_oRDR_TRACKER_OBJ_042_oPCAN_RADAR_2d2f6532_Tx: ComBitPosition=151, ComBitSize=8, ComSignalType=UINT8, ComSystemTemplateSystemSignalRef=OBJ_VELOCITY_LAT_ERR_042
            OBJ_VELOCITY_LONG_042_oRDR_TRACKER_OBJ_042_oPCAN_RADAR_49586da5_Tx: ComBitPosition=110, ComBitSize=15, ComSignalType=UINT16, ComSystemTemplateSystemSignalRef=OBJ_VELOCITY_LONG_042
            OBJ_VELOCITY_LONG_ERR_042_oRDR_TRACKER_OBJ_042_oPCAN_RADAR_c1ad5af2_Tx: ComBitPosition=143, ComBitSize=8, ComSignalType=UINT8, ComSystemTemplateSystemSignalRef=OBJ_VELOCITY_LONG_ERR_042
            OBJ_YAW_ANGLE_042_oRDR_TRACKER_OBJ_042_oPCAN_RADAR_f5695123_Tx: ComBitPosition=155, ComBitSize=12, ComSignalType=UINT16, ComSystemTemplateSystemSignalRef=OBJ_YAW_ANGLE_042
            OBJ_YAW_ANGLE_ERR_042_oRDR_TRACKER_OBJ_042_oPCAN_RADAR_206457f4_Tx: ComBitPosition=175, ComBitSize=7, ComSignalType=UINT8, ComSystemTemplateSystemSignalRef=OBJ_YAW_ANGLE_ERR_042
            OBJ_YAW_RATE_042_oRDR_TRACKER_OBJ_042_oPCAN_RADAR_d0e67464_Tx: ComBitPosition=399, ComBitSize=10, ComSignalType=UINT16, ComSystemTemplateSystemSignalRef=OBJ_YAW_RATE_042
            OBJ_YAW_RATE_ERR_042_oRDR_TRACKER_OBJ_042_oPCAN_RADAR_ef3ee3b8_Tx: ComBitPosition=388, ComBitSize=5, ComSignalType=UINT8, ComSystemTemplateSystemSignalRef=OBJ_YAW_RATE_ERR_042
        SG_TrackerObject043_oRDR_TRACKER_OBJ_043_oPCAN_RADAR_1dd0b503_Tx: ComSystemTemplateSignalGroupRef=SG_TrackerObject043
          49 x ComGroupSignal, all with ComSignalEndianness=BIG_ENDIAN, ComSignalInitValue=0, ComTransferProperty=PENDING:
            OBJ_ACCELERATION_LAT_043_oRDR_TRACKER_OBJ_043_oPCAN_RADAR_13f4ee74_Tx: ComBitPosition=177, ComBitSize=10, ComSignalType=UINT16, ComSystemTemplateSystemSignalRef=OBJ_ACCELERATION_LAT_043
            OBJ_ACCELERATION_LAT_ERR_043_oRDR_TRACKER_OBJ_043_oPCAN_RADAR_c600d4ca_Tx: ComBitPosition=223, ComBitSize=8, ComSignalType=UINT8, ComSystemTemplateSystemSignalRef=OBJ_ACCELERATION_LAT_ERR_043
            OBJ_ACCELERATION_LONG_043_oRDR_TRACKER_OBJ_043_oPCAN_RADAR_6104b794_Tx: ComBitPosition=193, ComBitSize=10, ComSignalType=UINT16, ComSystemTemplateSystemSignalRef=OBJ_ACCELERATION_LONG_043
            OBJ_ACCELERATION_LONG_ERR_043_oRDR_TRACKER_OBJ_043_oPCAN_RADAR_d9a57160_Tx: ComBitPosition=215, ComBitSize=8, ComSignalType=UINT8, ComSystemTemplateSystemSignalRef=OBJ_ACCELERATION_LONG_ERR_043
            OBJ_ACCEL_ERR_CRR_COEF_043_oRDR_TRACKER_OBJ_043_oPCAN_RADAR_79065006_Tx: ComBitPosition=431, ComBitSize=8, ComSignalType=UINT8, ComSystemTemplateSystemSignalRef=OBJ_ACCEL_ERR_CRR_COEF_043
            OBJ_ALIVE_TIME_043_oRDR_TRACKER_OBJ_043_oPCAN_RADAR_0165fc28_Tx: ComBitPosition=255, ComBitSize=16, ComSignalType=UINT16, ComSystemTemplateSystemSignalRef=OBJ_ALIVE_TIME_043
            OBJ_CLS_TYPE1_043_oRDR_TRACKER_OBJ_043_oPCAN_RADAR_96be1d0e_Tx: ComBitPosition=271, ComBitSize=4, ComSignalType=UINT8, ComSystemTemplateSystemSignalRef=OBJ_CLS_TYPE1_043
            OBJ_CLS_TYPE1_PROB_043_oRDR_TRACKER_OBJ_043_oPCAN_RADAR_3ee6cafd_Tx: ComBitPosition=303, ComBitSize=8, ComSignalType=UINT8, ComSystemTemplateSystemSignalRef=OBJ_CLS_TYPE1_PROB_043
            OBJ_CLS_TYPE2_043_oRDR_TRACKER_OBJ_043_oPCAN_RADAR_db561d69_Tx: ComBitPosition=267, ComBitSize=4, ComSignalType=UINT8, ComSystemTemplateSystemSignalRef=OBJ_CLS_TYPE2_043
            OBJ_CLS_TYPE2_PROB_043_oRDR_TRACKER_OBJ_043_oPCAN_RADAR_f7d2d1f0_Tx: ComBitPosition=311, ComBitSize=8, ComSignalType=UINT8, ComSystemTemplateSystemSignalRef=OBJ_CLS_TYPE2_PROB_043
            OBJ_CLS_TYPE3_043_oRDR_TRACKER_OBJ_043_oPCAN_RADAR_56dee08b_Tx: ComBitPosition=279, ComBitSize=4, ComSignalType=UINT8, ComSystemTemplateSystemSignalRef=OBJ_CLS_TYPE3_043
            OBJ_CLS_TYPE3_PROB_043_oRDR_TRACKER_OBJ_043_oPCAN_RADAR_b0c1270b_Tx: ComBitPosition=319, ComBitSize=8, ComSignalType=UINT8, ComSystemTemplateSystemSignalRef=OBJ_CLS_TYPE3_PROB_043
            OBJ_CLS_TYPE4_043_oRDR_TRACKER_OBJ_043_oPCAN_RADAR_40861da7_Tx: ComBitPosition=275, ComBitSize=4, ComSignalType=UINT8, ComSystemTemplateSystemSignalRef=OBJ_CLS_TYPE4_043
            OBJ_CLS_TYPE4_PROB_043_oRDR_TRACKER_OBJ_043_oPCAN_RADAR_becbe1ab_Tx: ComBitPosition=327, ComBitSize=8, ComSignalType=UINT8, ComSystemTemplateSystemSignalRef=OBJ_CLS_TYPE4_PROB_043
            OBJ_CLS_TYPE5_043_oRDR_TRACKER_OBJ_043_oPCAN_RADAR_cd0ee045_Tx: ComBitPosition=287, ComBitSize=4, ComSignalType=UINT8, ComSystemTemplateSystemSignalRef=OBJ_CLS_TYPE5_043
            OBJ_CLS_TYPE5_PROB_043_oRDR_TRACKER_OBJ_043_oPCAN_RADAR_f9d81750_Tx: ComBitPosition=335, ComBitSize=8, ComSignalType=UINT8, ComSystemTemplateSystemSignalRef=OBJ_CLS_TYPE5_PROB_043
            OBJ_CLS_TYPE6_043_oRDR_TRACKER_OBJ_043_oPCAN_RADAR_80e6e022_Tx: ComBitPosition=282, ComBitSize=4, ComSignalType=UINT8, ComSystemTemplateSystemSignalRef=OBJ_CLS_TYPE6_043
            OBJ_CLS_TYPE6_PROB_043_oRDR_TRACKER_OBJ_043_oPCAN_RADAR_30ec0c5d_Tx: ComBitPosition=343, ComBitSize=8, ComSignalType=UINT8, ComSystemTemplateSystemSignalRef=OBJ_CLS_TYPE6_PROB_043
            OBJ_DIMENSION_LENGTH_043_oRDR_TRACKER_OBJ_043_oPCAN_RADAR_d4204e4a_Tx: ComBitPosition=37, ComBitSize=12, ComSignalType=UINT16, ComSystemTemplateSystemSignalRef=OBJ_DIMENSION_LENGTH_043
            OBJ_DIMENSION_LENGTH_ERR_043_oRDR_TRACKER_OBJ_043_oPCAN_RADAR_efd85130_Tx: ComBitPosition=41, ComBitSize=10, ComSignalType=UINT16, ComSystemTemplateSystemSignalRef=OBJ_DIMENSION_LENGTH_ERR_043
            OBJ_DIMENSION_WIDTH_043_oRDR_TRACKER_OBJ_043_oPCAN_RADAR_f7eeb9e7_Tx: ComBitPosition=17, ComBitSize=10, ComSignalType=UINT16, ComSystemTemplateSystemSignalRef=OBJ_DIMENSION_WIDTH_043
            OBJ_DIMENSION_WIDTH_ERR_043_oRDR_TRACKER_OBJ_043_oPCAN_RADAR_174c7e0f_Tx: ComBitPosition=23, ComBitSize=6, ComSignalType=UINT8, ComSystemTemplateSystemSignalRef=OBJ_DIMENSION_WIDTH_ERR_043
            OBJ_EXISTENCE_PROB_043_oRDR_TRACKER_OBJ_043_oPCAN_RADAR_fc523dda_Tx: ComBitPosition=229, ComBitSize=14, ComSignalType=UINT16, ComSystemTemplateSystemSignalRef=OBJ_EXISTENCE_PROB_043
            OBJ_GROUP_ID_043_oRDR_TRACKER_OBJ_043_oPCAN_RADAR_75202977_Tx: ComBitPosition=405, ComBitSize=6, ComSignalType=UINT8, ComSystemTemplateSystemSignalRef=OBJ_GROUP_ID_043
            OBJ_ID_043_oRDR_TRACKER_OBJ_043_oPCAN_RADAR_860e0270_Tx: ComBitPosition=7, ComBitSize=8, ComSignalType=UINT8, ComSystemTemplateSystemSignalRef=OBJ_ID_043
            OBJ_MEASUREMENT_STATUS_043_oRDR_TRACKER_OBJ_043_oPCAN_RADAR_f9dc70cd_Tx: ComBitPosition=14, ComBitSize=3, ComSignalType=UINT8, ComSystemTemplateSystemSignalRef=OBJ_MEASUREMENT_STATUS_043
            OBJ_MH_CRC16_043_oRDR_TRACKER_OBJ_043_oPCAN_RADAR_85bcc7f1_Tx: ComBitPosition=495, ComBitSize=16, ComSignalType=UINT16, ComSystemTemplateSystemSignalRef=OBJ_MH_CRC16_043
            OBJ_MH_CYCLE_COUNTER_043_oRDR_TRACKER_OBJ_043_oPCAN_RADAR_f4589d10_Tx: ComBitPosition=487, ComBitSize=8, ComSignalType=UINT8, ComSystemTemplateSystemSignalRef=OBJ_MH_CYCLE_COUNTER_043
            OBJ_MOVEMENT_STATUS_043_oRDR_TRACKER_OBJ_043_oPCAN_RADAR_d672e581_Tx: ComBitPosition=196, ComBitSize=3, ComSignalType=UINT8, ComSystemTemplateSystemSignalRef=OBJ_MOVEMENT_STATUS_043
            OBJ_POS_ERR_CRR_COEF_043_oRDR_TRACKER_OBJ_043_oPCAN_RADAR_460d25bb_Tx: ComBitPosition=415, ComBitSize=8, ComSignalType=UINT8, ComSystemTemplateSystemSignalRef=OBJ_POS_ERR_CRR_COEF_043
            OBJ_POS_LAT_043_oRDR_TRACKER_OBJ_043_oPCAN_RADAR_a4a2d8f7_Tx: ComBitPosition=79, ComBitSize=16, ComSignalType=UINT16, ComSystemTemplateSystemSignalRef=OBJ_POS_LAT_043
            OBJ_POS_LAT_ERR_043_oRDR_TRACKER_OBJ_043_oPCAN_RADAR_a0ee88c0_Tx: ComBitPosition=103, ComBitSize=8, ComSignalType=UINT8, ComSystemTemplateSystemSignalRef=OBJ_POS_LAT_ERR_043
            OBJ_POS_LONG_043_oRDR_TRACKER_OBJ_043_oPCAN_RADAR_15023338_Tx: ComBitPosition=63, ComBitSize=16, ComSignalType=UINT16, ComSystemTemplateSystemSignalRef=OBJ_POS_LONG_043
            OBJ_POS_LONG_ERR_043_oRDR_TRACKER_OBJ_043_oPCAN_RADAR_39167622_Tx: ComBitPosition=95, ComBitSize=8, ComSignalType=UINT8, ComSystemTemplateSystemSignalRef=OBJ_POS_LONG_ERR_043
            OBJ_RCS_043_oRDR_TRACKER_OBJ_043_oPCAN_RADAR_866d8ef0_Tx: ComBitPosition=351, ComBitSize=7, ComSignalType=UINT8, ComSystemTemplateSystemSignalRef=OBJ_RCS_043
            OBJ_REF_PT_LAT_OFFSET_043_oRDR_TRACKER_OBJ_043_oPCAN_RADAR_7350e585_Tx: ComBitPosition=370, ComBitSize=14, ComSignalType=UINT16, ComSystemTemplateSystemSignalRef=OBJ_REF_PT_LAT_OFFSET_043
            OBJ_REF_PT_LONG_OFFSET_043_oRDR_TRACKER_OBJ_043_oPCAN_RADAR_3c021586_Tx: ComBitPosition=357, ComBitSize=14, ComSignalType=UINT16, ComSystemTemplateSystemSignalRef=OBJ_REF_PT_LONG_OFFSET_043
            OBJ_TIMESTAMP_OFFSET_043_oRDR_TRACKER_OBJ_043_oPCAN_RADAR_86c18ea6_Tx: ComBitPosition=247, ComBitSize=8, ComSignalType=UINT8, ComSystemTemplateSystemSignalRef=OBJ_TIMESTAMP_OFFSET_043
            OBJ_TRACK_MOTION_MODEL_043_oRDR_TRACKER_OBJ_043_oPCAN_RADAR_4ac28f7b_Tx: ComBitPosition=9, ComBitSize=2, ComSignalType=UINT8, ComSystemTemplateSystemSignalRef=OBJ_TRACK_MOTION_MODEL_043
            OBJ_VEH_TRACK_FLAG_043_oRDR_TRACKER_OBJ_043_oPCAN_RADAR_c8e87926_Tx: ComBitPosition=10, ComBitSize=1, ComSignalType=BOOLEAN, ComSystemTemplateSystemSignalRef=OBJ_VEH_TRACK_FLAG_043
            OBJ_VELOCITY_ERR_CRR_COEF_043_oRDR_TRACKER_OBJ_043_oPCAN_RADAR_ef77185a_Tx: ComBitPosition=423, ComBitSize=8, ComSignalType=UINT8, ComSystemTemplateSystemSignalRef=OBJ_VELOCITY_ERR_CRR_COEF_043
            OBJ_VELOCITY_LAT_043_oRDR_TRACKER_OBJ_043_oPCAN_RADAR_e0c19dd0_Tx: ComBitPosition=126, ComBitSize=15, ComSignalType=UINT16, ComSystemTemplateSystemSignalRef=OBJ_VELOCITY_LAT_043
            OBJ_VELOCITY_LAT_ERR_043_oRDR_TRACKER_OBJ_043_oPCAN_RADAR_d43bed81_Tx: ComBitPosition=151, ComBitSize=8, ComSignalType=UINT8, ComSystemTemplateSystemSignalRef=OBJ_VELOCITY_LAT_ERR_043
            OBJ_VELOCITY_LONG_043_oRDR_TRACKER_OBJ_043_oPCAN_RADAR_b04ce516_Tx: ComBitPosition=110, ComBitSize=15, ComSignalType=UINT16, ComSystemTemplateSystemSignalRef=OBJ_VELOCITY_LONG_043
            OBJ_VELOCITY_LONG_ERR_043_oRDR_TRACKER_OBJ_043_oPCAN_RADAR_38b9d241_Tx: ComBitPosition=143, ComBitSize=8, ComSignalType=UINT8, ComSystemTemplateSystemSignalRef=OBJ_VELOCITY_LONG_ERR_043
            OBJ_YAW_ANGLE_043_oRDR_TRACKER_OBJ_043_oPCAN_RADAR_0c7dd990_Tx: ComBitPosition=155, ComBitSize=12, ComSignalType=UINT16, ComSystemTemplateSystemSignalRef=OBJ_YAW_ANGLE_043
            OBJ_YAW_ANGLE_ERR_043_oRDR_TRACKER_OBJ_043_oPCAN_RADAR_d970df47_Tx: ComBitPosition=175, ComBitSize=7, ComSignalType=UINT8, ComSystemTemplateSystemSignalRef=OBJ_YAW_ANGLE_ERR_043
            OBJ_YAW_RATE_043_oRDR_TRACKER_OBJ_043_oPCAN_RADAR_29f2fcd7_Tx: ComBitPosition=399, ComBitSize=10, ComSignalType=UINT16, ComSystemTemplateSystemSignalRef=OBJ_YAW_RATE_043
            OBJ_YAW_RATE_ERR_043_oRDR_TRACKER_OBJ_043_oPCAN_RADAR_162a6b0b_Tx: ComBitPosition=388, ComBitSize=5, ComSignalType=UINT8, ComSystemTemplateSystemSignalRef=OBJ_YAW_RATE_ERR_043
        SG_TrackerObject044_oRDR_TRACKER_OBJ_044_oPCAN_RADAR_9f2c04d9_Tx: ComSystemTemplateSignalGroupRef=SG_TrackerObject044
          49 x ComGroupSignal, all with ComSignalEndianness=BIG_ENDIAN, ComSignalInitValue=0, ComTransferProperty=PENDING:
            OBJ_ACCELERATION_LAT_044_oRDR_TRACKER_OBJ_044_oPCAN_RADAR_91085fae_Tx: ComBitPosition=177, ComBitSize=10, ComSignalType=UINT16, ComSystemTemplateSystemSignalRef=OBJ_ACCELERATION_LAT_044
            OBJ_ACCELERATION_LAT_ERR_044_oRDR_TRACKER_OBJ_044_oPCAN_RADAR_44fc6510_Tx: ComBitPosition=223, ComBitSize=8, ComSignalType=UINT8, ComSystemTemplateSystemSignalRef=OBJ_ACCELERATION_LAT_ERR_044
            OBJ_ACCELERATION_LONG_044_oRDR_TRACKER_OBJ_044_oPCAN_RADAR_e3f8064e_Tx: ComBitPosition=193, ComBitSize=10, ComSignalType=UINT16, ComSystemTemplateSystemSignalRef=OBJ_ACCELERATION_LONG_044
            OBJ_ACCELERATION_LONG_ERR_044_oRDR_TRACKER_OBJ_044_oPCAN_RADAR_5b59c0ba_Tx: ComBitPosition=215, ComBitSize=8, ComSignalType=UINT8, ComSystemTemplateSystemSignalRef=OBJ_ACCELERATION_LONG_ERR_044
            OBJ_ACCEL_ERR_CRR_COEF_044_oRDR_TRACKER_OBJ_044_oPCAN_RADAR_fbfae1dc_Tx: ComBitPosition=431, ComBitSize=8, ComSignalType=UINT8, ComSystemTemplateSystemSignalRef=OBJ_ACCEL_ERR_CRR_COEF_044
            OBJ_ALIVE_TIME_044_oRDR_TRACKER_OBJ_044_oPCAN_RADAR_83994df2_Tx: ComBitPosition=255, ComBitSize=16, ComSignalType=UINT16, ComSystemTemplateSystemSignalRef=OBJ_ALIVE_TIME_044
            OBJ_CLS_TYPE1_044_oRDR_TRACKER_OBJ_044_oPCAN_RADAR_1442acd4_Tx: ComBitPosition=271, ComBitSize=4, ComSignalType=UINT8, ComSystemTemplateSystemSignalRef=OBJ_CLS_TYPE1_044
            OBJ_CLS_TYPE1_PROB_044_oRDR_TRACKER_OBJ_044_oPCAN_RADAR_bc1a7b27_Tx: ComBitPosition=303, ComBitSize=8, ComSignalType=UINT8, ComSystemTemplateSystemSignalRef=OBJ_CLS_TYPE1_PROB_044
            OBJ_CLS_TYPE2_044_oRDR_TRACKER_OBJ_044_oPCAN_RADAR_59aaacb3_Tx: ComBitPosition=267, ComBitSize=4, ComSignalType=UINT8, ComSystemTemplateSystemSignalRef=OBJ_CLS_TYPE2_044
            OBJ_CLS_TYPE2_PROB_044_oRDR_TRACKER_OBJ_044_oPCAN_RADAR_752e602a_Tx: ComBitPosition=311, ComBitSize=8, ComSignalType=UINT8, ComSystemTemplateSystemSignalRef=OBJ_CLS_TYPE2_PROB_044
            OBJ_CLS_TYPE3_044_oRDR_TRACKER_OBJ_044_oPCAN_RADAR_d4225151_Tx: ComBitPosition=279, ComBitSize=4, ComSignalType=UINT8, ComSystemTemplateSystemSignalRef=OBJ_CLS_TYPE3_044
            OBJ_CLS_TYPE3_PROB_044_oRDR_TRACKER_OBJ_044_oPCAN_RADAR_323d96d1_Tx: ComBitPosition=319, ComBitSize=8, ComSignalType=UINT8, ComSystemTemplateSystemSignalRef=OBJ_CLS_TYPE3_PROB_044
            OBJ_CLS_TYPE4_044_oRDR_TRACKER_OBJ_044_oPCAN_RADAR_c27aac7d_Tx: ComBitPosition=275, ComBitSize=4, ComSignalType=UINT8, ComSystemTemplateSystemSignalRef=OBJ_CLS_TYPE4_044
            OBJ_CLS_TYPE4_PROB_044_oRDR_TRACKER_OBJ_044_oPCAN_RADAR_3c375071_Tx: ComBitPosition=327, ComBitSize=8, ComSignalType=UINT8, ComSystemTemplateSystemSignalRef=OBJ_CLS_TYPE4_PROB_044
            OBJ_CLS_TYPE5_044_oRDR_TRACKER_OBJ_044_oPCAN_RADAR_4ff2519f_Tx: ComBitPosition=287, ComBitSize=4, ComSignalType=UINT8, ComSystemTemplateSystemSignalRef=OBJ_CLS_TYPE5_044
            OBJ_CLS_TYPE5_PROB_044_oRDR_TRACKER_OBJ_044_oPCAN_RADAR_7b24a68a_Tx: ComBitPosition=335, ComBitSize=8, ComSignalType=UINT8, ComSystemTemplateSystemSignalRef=OBJ_CLS_TYPE5_PROB_044
            OBJ_CLS_TYPE6_044_oRDR_TRACKER_OBJ_044_oPCAN_RADAR_021a51f8_Tx: ComBitPosition=282, ComBitSize=4, ComSignalType=UINT8, ComSystemTemplateSystemSignalRef=OBJ_CLS_TYPE6_044
            OBJ_CLS_TYPE6_PROB_044_oRDR_TRACKER_OBJ_044_oPCAN_RADAR_b210bd87_Tx: ComBitPosition=343, ComBitSize=8, ComSignalType=UINT8, ComSystemTemplateSystemSignalRef=OBJ_CLS_TYPE6_PROB_044
            OBJ_DIMENSION_LENGTH_044_oRDR_TRACKER_OBJ_044_oPCAN_RADAR_56dcff90_Tx: ComBitPosition=37, ComBitSize=12, ComSignalType=UINT16, ComSystemTemplateSystemSignalRef=OBJ_DIMENSION_LENGTH_044
            OBJ_DIMENSION_LENGTH_ERR_044_oRDR_TRACKER_OBJ_044_oPCAN_RADAR_6d24e0ea_Tx: ComBitPosition=41, ComBitSize=10, ComSignalType=UINT16, ComSystemTemplateSystemSignalRef=OBJ_DIMENSION_LENGTH_ERR_044
            OBJ_DIMENSION_WIDTH_044_oRDR_TRACKER_OBJ_044_oPCAN_RADAR_7512083d_Tx: ComBitPosition=17, ComBitSize=10, ComSignalType=UINT16, ComSystemTemplateSystemSignalRef=OBJ_DIMENSION_WIDTH_044
            OBJ_DIMENSION_WIDTH_ERR_044_oRDR_TRACKER_OBJ_044_oPCAN_RADAR_95b0cfd5_Tx: ComBitPosition=23, ComBitSize=6, ComSignalType=UINT8, ComSystemTemplateSystemSignalRef=OBJ_DIMENSION_WIDTH_ERR_044
            OBJ_EXISTENCE_PROB_044_oRDR_TRACKER_OBJ_044_oPCAN_RADAR_7eae8c00_Tx: ComBitPosition=229, ComBitSize=14, ComSignalType=UINT16, ComSystemTemplateSystemSignalRef=OBJ_EXISTENCE_PROB_044
            OBJ_GROUP_ID_044_oRDR_TRACKER_OBJ_044_oPCAN_RADAR_f7dc98ad_Tx: ComBitPosition=405, ComBitSize=6, ComSignalType=UINT8, ComSystemTemplateSystemSignalRef=OBJ_GROUP_ID_044
            OBJ_ID_044_oRDR_TRACKER_OBJ_044_oPCAN_RADAR_04f2b3aa_Tx: ComBitPosition=7, ComBitSize=8, ComSignalType=UINT8, ComSystemTemplateSystemSignalRef=OBJ_ID_044
            OBJ_MEASUREMENT_STATUS_044_oRDR_TRACKER_OBJ_044_oPCAN_RADAR_7b20c117_Tx: ComBitPosition=14, ComBitSize=3, ComSignalType=UINT8, ComSystemTemplateSystemSignalRef=OBJ_MEASUREMENT_STATUS_044
            OBJ_MH_CRC16_044_oRDR_TRACKER_OBJ_044_oPCAN_RADAR_0740762b_Tx: ComBitPosition=495, ComBitSize=16, ComSignalType=UINT16, ComSystemTemplateSystemSignalRef=OBJ_MH_CRC16_044
            OBJ_MH_CYCLE_COUNTER_044_oRDR_TRACKER_OBJ_044_oPCAN_RADAR_76a42cca_Tx: ComBitPosition=487, ComBitSize=8, ComSignalType=UINT8, ComSystemTemplateSystemSignalRef=OBJ_MH_CYCLE_COUNTER_044
            OBJ_MOVEMENT_STATUS_044_oRDR_TRACKER_OBJ_044_oPCAN_RADAR_548e545b_Tx: ComBitPosition=196, ComBitSize=3, ComSignalType=UINT8, ComSystemTemplateSystemSignalRef=OBJ_MOVEMENT_STATUS_044
            OBJ_POS_ERR_CRR_COEF_044_oRDR_TRACKER_OBJ_044_oPCAN_RADAR_c4f19461_Tx: ComBitPosition=415, ComBitSize=8, ComSignalType=UINT8, ComSystemTemplateSystemSignalRef=OBJ_POS_ERR_CRR_COEF_044
            OBJ_POS_LAT_044_oRDR_TRACKER_OBJ_044_oPCAN_RADAR_265e692d_Tx: ComBitPosition=79, ComBitSize=16, ComSignalType=UINT16, ComSystemTemplateSystemSignalRef=OBJ_POS_LAT_044
            OBJ_POS_LAT_ERR_044_oRDR_TRACKER_OBJ_044_oPCAN_RADAR_2212391a_Tx: ComBitPosition=103, ComBitSize=8, ComSignalType=UINT8, ComSystemTemplateSystemSignalRef=OBJ_POS_LAT_ERR_044
            OBJ_POS_LONG_044_oRDR_TRACKER_OBJ_044_oPCAN_RADAR_97fe82e2_Tx: ComBitPosition=63, ComBitSize=16, ComSignalType=UINT16, ComSystemTemplateSystemSignalRef=OBJ_POS_LONG_044
            OBJ_POS_LONG_ERR_044_oRDR_TRACKER_OBJ_044_oPCAN_RADAR_bbeac7f8_Tx: ComBitPosition=95, ComBitSize=8, ComSignalType=UINT8, ComSystemTemplateSystemSignalRef=OBJ_POS_LONG_ERR_044
            OBJ_RCS_044_oRDR_TRACKER_OBJ_044_oPCAN_RADAR_04913f2a_Tx: ComBitPosition=351, ComBitSize=7, ComSignalType=UINT8, ComSystemTemplateSystemSignalRef=OBJ_RCS_044
            OBJ_REF_PT_LAT_OFFSET_044_oRDR_TRACKER_OBJ_044_oPCAN_RADAR_f1ac545f_Tx: ComBitPosition=370, ComBitSize=14, ComSignalType=UINT16, ComSystemTemplateSystemSignalRef=OBJ_REF_PT_LAT_OFFSET_044
            OBJ_REF_PT_LONG_OFFSET_044_oRDR_TRACKER_OBJ_044_oPCAN_RADAR_befea45c_Tx: ComBitPosition=357, ComBitSize=14, ComSignalType=UINT16, ComSystemTemplateSystemSignalRef=OBJ_REF_PT_LONG_OFFSET_044
            OBJ_TIMESTAMP_OFFSET_044_oRDR_TRACKER_OBJ_044_oPCAN_RADAR_043d3f7c_Tx: ComBitPosition=247, ComBitSize=8, ComSignalType=UINT8, ComSystemTemplateSystemSignalRef=OBJ_TIMESTAMP_OFFSET_044
            OBJ_TRACK_MOTION_MODEL_044_oRDR_TRACKER_OBJ_044_oPCAN_RADAR_c83e3ea1_Tx: ComBitPosition=9, ComBitSize=2, ComSignalType=UINT8, ComSystemTemplateSystemSignalRef=OBJ_TRACK_MOTION_MODEL_044
            OBJ_VEH_TRACK_FLAG_044_oRDR_TRACKER_OBJ_044_oPCAN_RADAR_4a14c8fc_Tx: ComBitPosition=10, ComBitSize=1, ComSignalType=BOOLEAN, ComSystemTemplateSystemSignalRef=OBJ_VEH_TRACK_FLAG_044
            OBJ_VELOCITY_ERR_CRR_COEF_044_oRDR_TRACKER_OBJ_044_oPCAN_RADAR_6d8ba980_Tx: ComBitPosition=423, ComBitSize=8, ComSignalType=UINT8, ComSystemTemplateSystemSignalRef=OBJ_VELOCITY_ERR_CRR_COEF_044
            OBJ_VELOCITY_LAT_044_oRDR_TRACKER_OBJ_044_oPCAN_RADAR_623d2c0a_Tx: ComBitPosition=126, ComBitSize=15, ComSignalType=UINT16, ComSystemTemplateSystemSignalRef=OBJ_VELOCITY_LAT_044
            OBJ_VELOCITY_LAT_ERR_044_oRDR_TRACKER_OBJ_044_oPCAN_RADAR_56c75c5b_Tx: ComBitPosition=151, ComBitSize=8, ComSignalType=UINT8, ComSystemTemplateSystemSignalRef=OBJ_VELOCITY_LAT_ERR_044
            OBJ_VELOCITY_LONG_044_oRDR_TRACKER_OBJ_044_oPCAN_RADAR_32b054cc_Tx: ComBitPosition=110, ComBitSize=15, ComSignalType=UINT16, ComSystemTemplateSystemSignalRef=OBJ_VELOCITY_LONG_044
            OBJ_VELOCITY_LONG_ERR_044_oRDR_TRACKER_OBJ_044_oPCAN_RADAR_ba45639b_Tx: ComBitPosition=143, ComBitSize=8, ComSignalType=UINT8, ComSystemTemplateSystemSignalRef=OBJ_VELOCITY_LONG_ERR_044
            OBJ_YAW_ANGLE_044_oRDR_TRACKER_OBJ_044_oPCAN_RADAR_8e81684a_Tx: ComBitPosition=155, ComBitSize=12, ComSignalType=UINT16, ComSystemTemplateSystemSignalRef=OBJ_YAW_ANGLE_044
            OBJ_YAW_ANGLE_ERR_044_oRDR_TRACKER_OBJ_044_oPCAN_RADAR_5b8c6e9d_Tx: ComBitPosition=175, ComBitSize=7, ComSignalType=UINT8, ComSystemTemplateSystemSignalRef=OBJ_YAW_ANGLE_ERR_044
            OBJ_YAW_RATE_044_oRDR_TRACKER_OBJ_044_oPCAN_RADAR_ab0e4d0d_Tx: ComBitPosition=399, ComBitSize=10, ComSignalType=UINT16, ComSystemTemplateSystemSignalRef=OBJ_YAW_RATE_044
            OBJ_YAW_RATE_ERR_044_oRDR_TRACKER_OBJ_044_oPCAN_RADAR_94d6dad1_Tx: ComBitPosition=388, ComBitSize=5, ComSignalType=UINT8, ComSystemTemplateSystemSignalRef=OBJ_YAW_RATE_ERR_044
        SG_TrackerObject045_oRDR_TRACKER_OBJ_045_oPCAN_RADAR_66388c6a_Tx: ComSystemTemplateSignalGroupRef=SG_TrackerObject045
          49 x ComGroupSignal, all with ComSignalEndianness=BIG_ENDIAN, ComSignalInitValue=0, ComTransferProperty=PENDING:
            OBJ_ACCELERATION_LAT_045_oRDR_TRACKER_OBJ_045_oPCAN_RADAR_681cd71d_Tx: ComBitPosition=177, ComBitSize=10, ComSignalType=UINT16, ComSystemTemplateSystemSignalRef=OBJ_ACCELERATION_LAT_045
            OBJ_ACCELERATION_LAT_ERR_045_oRDR_TRACKER_OBJ_045_oPCAN_RADAR_bde8eda3_Tx: ComBitPosition=223, ComBitSize=8, ComSignalType=UINT8, ComSystemTemplateSystemSignalRef=OBJ_ACCELERATION_LAT_ERR_045
            OBJ_ACCELERATION_LONG_045_oRDR_TRACKER_OBJ_045_oPCAN_RADAR_1aec8efd_Tx: ComBitPosition=193, ComBitSize=10, ComSignalType=UINT16, ComSystemTemplateSystemSignalRef=OBJ_ACCELERATION_LONG_045
            OBJ_ACCELERATION_LONG_ERR_045_oRDR_TRACKER_OBJ_045_oPCAN_RADAR_a24d4809_Tx: ComBitPosition=215, ComBitSize=8, ComSignalType=UINT8, ComSystemTemplateSystemSignalRef=OBJ_ACCELERATION_LONG_ERR_045
            OBJ_ACCEL_ERR_CRR_COEF_045_oRDR_TRACKER_OBJ_045_oPCAN_RADAR_02ee696f_Tx: ComBitPosition=431, ComBitSize=8, ComSignalType=UINT8, ComSystemTemplateSystemSignalRef=OBJ_ACCEL_ERR_CRR_COEF_045
            OBJ_ALIVE_TIME_045_oRDR_TRACKER_OBJ_045_oPCAN_RADAR_7a8dc541_Tx: ComBitPosition=255, ComBitSize=16, ComSignalType=UINT16, ComSystemTemplateSystemSignalRef=OBJ_ALIVE_TIME_045
            OBJ_CLS_TYPE1_045_oRDR_TRACKER_OBJ_045_oPCAN_RADAR_ed562467_Tx: ComBitPosition=271, ComBitSize=4, ComSignalType=UINT8, ComSystemTemplateSystemSignalRef=OBJ_CLS_TYPE1_045
            OBJ_CLS_TYPE1_PROB_045_oRDR_TRACKER_OBJ_045_oPCAN_RADAR_450ef394_Tx: ComBitPosition=303, ComBitSize=8, ComSignalType=UINT8, ComSystemTemplateSystemSignalRef=OBJ_CLS_TYPE1_PROB_045
            OBJ_CLS_TYPE2_045_oRDR_TRACKER_OBJ_045_oPCAN_RADAR_a0be2400_Tx: ComBitPosition=267, ComBitSize=4, ComSignalType=UINT8, ComSystemTemplateSystemSignalRef=OBJ_CLS_TYPE2_045
            OBJ_CLS_TYPE2_PROB_045_oRDR_TRACKER_OBJ_045_oPCAN_RADAR_8c3ae899_Tx: ComBitPosition=311, ComBitSize=8, ComSignalType=UINT8, ComSystemTemplateSystemSignalRef=OBJ_CLS_TYPE2_PROB_045
            OBJ_CLS_TYPE3_045_oRDR_TRACKER_OBJ_045_oPCAN_RADAR_2d36d9e2_Tx: ComBitPosition=279, ComBitSize=4, ComSignalType=UINT8, ComSystemTemplateSystemSignalRef=OBJ_CLS_TYPE3_045
            OBJ_CLS_TYPE3_PROB_045_oRDR_TRACKER_OBJ_045_oPCAN_RADAR_cb291e62_Tx: ComBitPosition=319, ComBitSize=8, ComSignalType=UINT8, ComSystemTemplateSystemSignalRef=OBJ_CLS_TYPE3_PROB_045
            OBJ_CLS_TYPE4_045_oRDR_TRACKER_OBJ_045_oPCAN_RADAR_3b6e24ce_Tx: ComBitPosition=275, ComBitSize=4, ComSignalType=UINT8, ComSystemTemplateSystemSignalRef=OBJ_CLS_TYPE4_045
            OBJ_CLS_TYPE4_PROB_045_oRDR_TRACKER_OBJ_045_oPCAN_RADAR_c523d8c2_Tx: ComBitPosition=327, ComBitSize=8, ComSignalType=UINT8, ComSystemTemplateSystemSignalRef=OBJ_CLS_TYPE4_PROB_045
            OBJ_CLS_TYPE5_045_oRDR_TRACKER_OBJ_045_oPCAN_RADAR_b6e6d92c_Tx: ComBitPosition=287, ComBitSize=4, ComSignalType=UINT8, ComSystemTemplateSystemSignalRef=OBJ_CLS_TYPE5_045
            OBJ_CLS_TYPE5_PROB_045_oRDR_TRACKER_OBJ_045_oPCAN_RADAR_82302e39_Tx: ComBitPosition=335, ComBitSize=8, ComSignalType=UINT8, ComSystemTemplateSystemSignalRef=OBJ_CLS_TYPE5_PROB_045
            OBJ_CLS_TYPE6_045_oRDR_TRACKER_OBJ_045_oPCAN_RADAR_fb0ed94b_Tx: ComBitPosition=282, ComBitSize=4, ComSignalType=UINT8, ComSystemTemplateSystemSignalRef=OBJ_CLS_TYPE6_045
            OBJ_CLS_TYPE6_PROB_045_oRDR_TRACKER_OBJ_045_oPCAN_RADAR_4b043534_Tx: ComBitPosition=343, ComBitSize=8, ComSignalType=UINT8, ComSystemTemplateSystemSignalRef=OBJ_CLS_TYPE6_PROB_045
            OBJ_DIMENSION_LENGTH_045_oRDR_TRACKER_OBJ_045_oPCAN_RADAR_afc87723_Tx: ComBitPosition=37, ComBitSize=12, ComSignalType=UINT16, ComSystemTemplateSystemSignalRef=OBJ_DIMENSION_LENGTH_045
            OBJ_DIMENSION_LENGTH_ERR_045_oRDR_TRACKER_OBJ_045_oPCAN_RADAR_94306859_Tx: ComBitPosition=41, ComBitSize=10, ComSignalType=UINT16, ComSystemTemplateSystemSignalRef=OBJ_DIMENSION_LENGTH_ERR_045
            OBJ_DIMENSION_WIDTH_045_oRDR_TRACKER_OBJ_045_oPCAN_RADAR_8c06808e_Tx: ComBitPosition=17, ComBitSize=10, ComSignalType=UINT16, ComSystemTemplateSystemSignalRef=OBJ_DIMENSION_WIDTH_045
            OBJ_DIMENSION_WIDTH_ERR_045_oRDR_TRACKER_OBJ_045_oPCAN_RADAR_6ca44766_Tx: ComBitPosition=23, ComBitSize=6, ComSignalType=UINT8, ComSystemTemplateSystemSignalRef=OBJ_DIMENSION_WIDTH_ERR_045
            OBJ_EXISTENCE_PROB_045_oRDR_TRACKER_OBJ_045_oPCAN_RADAR_87ba04b3_Tx: ComBitPosition=229, ComBitSize=14, ComSignalType=UINT16, ComSystemTemplateSystemSignalRef=OBJ_EXISTENCE_PROB_045
            OBJ_GROUP_ID_045_oRDR_TRACKER_OBJ_045_oPCAN_RADAR_0ec8101e_Tx: ComBitPosition=405, ComBitSize=6, ComSignalType=UINT8, ComSystemTemplateSystemSignalRef=OBJ_GROUP_ID_045
            OBJ_ID_045_oRDR_TRACKER_OBJ_045_oPCAN_RADAR_fde63b19_Tx: ComBitPosition=7, ComBitSize=8, ComSignalType=UINT8, ComSystemTemplateSystemSignalRef=OBJ_ID_045
            OBJ_MEASUREMENT_STATUS_045_oRDR_TRACKER_OBJ_045_oPCAN_RADAR_823449a4_Tx: ComBitPosition=14, ComBitSize=3, ComSignalType=UINT8, ComSystemTemplateSystemSignalRef=OBJ_MEASUREMENT_STATUS_045
            OBJ_MH_CRC16_045_oRDR_TRACKER_OBJ_045_oPCAN_RADAR_fe54fe98_Tx: ComBitPosition=495, ComBitSize=16, ComSignalType=UINT16, ComSystemTemplateSystemSignalRef=OBJ_MH_CRC16_045
            OBJ_MH_CYCLE_COUNTER_045_oRDR_TRACKER_OBJ_045_oPCAN_RADAR_8fb0a479_Tx: ComBitPosition=487, ComBitSize=8, ComSignalType=UINT8, ComSystemTemplateSystemSignalRef=OBJ_MH_CYCLE_COUNTER_045
            OBJ_MOVEMENT_STATUS_045_oRDR_TRACKER_OBJ_045_oPCAN_RADAR_ad9adce8_Tx: ComBitPosition=196, ComBitSize=3, ComSignalType=UINT8, ComSystemTemplateSystemSignalRef=OBJ_MOVEMENT_STATUS_045
            OBJ_POS_ERR_CRR_COEF_045_oRDR_TRACKER_OBJ_045_oPCAN_RADAR_3de51cd2_Tx: ComBitPosition=415, ComBitSize=8, ComSignalType=UINT8, ComSystemTemplateSystemSignalRef=OBJ_POS_ERR_CRR_COEF_045
            OBJ_POS_LAT_045_oRDR_TRACKER_OBJ_045_oPCAN_RADAR_df4ae19e_Tx: ComBitPosition=79, ComBitSize=16, ComSignalType=UINT16, ComSystemTemplateSystemSignalRef=OBJ_POS_LAT_045
            OBJ_POS_LAT_ERR_045_oRDR_TRACKER_OBJ_045_oPCAN_RADAR_db06b1a9_Tx: ComBitPosition=103, ComBitSize=8, ComSignalType=UINT8, ComSystemTemplateSystemSignalRef=OBJ_POS_LAT_ERR_045
            OBJ_POS_LONG_045_oRDR_TRACKER_OBJ_045_oPCAN_RADAR_6eea0a51_Tx: ComBitPosition=63, ComBitSize=16, ComSignalType=UINT16, ComSystemTemplateSystemSignalRef=OBJ_POS_LONG_045
            OBJ_POS_LONG_ERR_045_oRDR_TRACKER_OBJ_045_oPCAN_RADAR_42fe4f4b_Tx: ComBitPosition=95, ComBitSize=8, ComSignalType=UINT8, ComSystemTemplateSystemSignalRef=OBJ_POS_LONG_ERR_045
            OBJ_RCS_045_oRDR_TRACKER_OBJ_045_oPCAN_RADAR_fd85b799_Tx: ComBitPosition=351, ComBitSize=7, ComSignalType=UINT8, ComSystemTemplateSystemSignalRef=OBJ_RCS_045
            OBJ_REF_PT_LAT_OFFSET_045_oRDR_TRACKER_OBJ_045_oPCAN_RADAR_08b8dcec_Tx: ComBitPosition=370, ComBitSize=14, ComSignalType=UINT16, ComSystemTemplateSystemSignalRef=OBJ_REF_PT_LAT_OFFSET_045
            OBJ_REF_PT_LONG_OFFSET_045_oRDR_TRACKER_OBJ_045_oPCAN_RADAR_47ea2cef_Tx: ComBitPosition=357, ComBitSize=14, ComSignalType=UINT16, ComSystemTemplateSystemSignalRef=OBJ_REF_PT_LONG_OFFSET_045
            OBJ_TIMESTAMP_OFFSET_045_oRDR_TRACKER_OBJ_045_oPCAN_RADAR_fd29b7cf_Tx: ComBitPosition=247, ComBitSize=8, ComSignalType=UINT8, ComSystemTemplateSystemSignalRef=OBJ_TIMESTAMP_OFFSET_045
            OBJ_TRACK_MOTION_MODEL_045_oRDR_TRACKER_OBJ_045_oPCAN_RADAR_312ab612_Tx: ComBitPosition=9, ComBitSize=2, ComSignalType=UINT8, ComSystemTemplateSystemSignalRef=OBJ_TRACK_MOTION_MODEL_045
            OBJ_VEH_TRACK_FLAG_045_oRDR_TRACKER_OBJ_045_oPCAN_RADAR_b300404f_Tx: ComBitPosition=10, ComBitSize=1, ComSignalType=BOOLEAN, ComSystemTemplateSystemSignalRef=OBJ_VEH_TRACK_FLAG_045
            OBJ_VELOCITY_ERR_CRR_COEF_045_oRDR_TRACKER_OBJ_045_oPCAN_RADAR_949f2133_Tx: ComBitPosition=423, ComBitSize=8, ComSignalType=UINT8, ComSystemTemplateSystemSignalRef=OBJ_VELOCITY_ERR_CRR_COEF_045
            OBJ_VELOCITY_LAT_045_oRDR_TRACKER_OBJ_045_oPCAN_RADAR_9b29a4b9_Tx: ComBitPosition=126, ComBitSize=15, ComSignalType=UINT16, ComSystemTemplateSystemSignalRef=OBJ_VELOCITY_LAT_045
            OBJ_VELOCITY_LAT_ERR_045_oRDR_TRACKER_OBJ_045_oPCAN_RADAR_afd3d4e8_Tx: ComBitPosition=151, ComBitSize=8, ComSignalType=UINT8, ComSystemTemplateSystemSignalRef=OBJ_VELOCITY_LAT_ERR_045
            OBJ_VELOCITY_LONG_045_oRDR_TRACKER_OBJ_045_oPCAN_RADAR_cba4dc7f_Tx: ComBitPosition=110, ComBitSize=15, ComSignalType=UINT16, ComSystemTemplateSystemSignalRef=OBJ_VELOCITY_LONG_045
            OBJ_VELOCITY_LONG_ERR_045_oRDR_TRACKER_OBJ_045_oPCAN_RADAR_4351eb28_Tx: ComBitPosition=143, ComBitSize=8, ComSignalType=UINT8, ComSystemTemplateSystemSignalRef=OBJ_VELOCITY_LONG_ERR_045
            OBJ_YAW_ANGLE_045_oRDR_TRACKER_OBJ_045_oPCAN_RADAR_7795e0f9_Tx: ComBitPosition=155, ComBitSize=12, ComSignalType=UINT16, ComSystemTemplateSystemSignalRef=OBJ_YAW_ANGLE_045
            OBJ_YAW_ANGLE_ERR_045_oRDR_TRACKER_OBJ_045_oPCAN_RADAR_a298e62e_Tx: ComBitPosition=175, ComBitSize=7, ComSignalType=UINT8, ComSystemTemplateSystemSignalRef=OBJ_YAW_ANGLE_ERR_045
            OBJ_YAW_RATE_045_oRDR_TRACKER_OBJ_045_oPCAN_RADAR_521ac5be_Tx: ComBitPosition=399, ComBitSize=10, ComSignalType=UINT16, ComSystemTemplateSystemSignalRef=OBJ_YAW_RATE_045
            OBJ_YAW_RATE_ERR_045_oRDR_TRACKER_OBJ_045_oPCAN_RADAR_6dc25262_Tx: ComBitPosition=388, ComBitSize=5, ComSignalType=UINT8, ComSystemTemplateSystemSignalRef=OBJ_YAW_RATE_ERR_045
        SG_TrackerObject046_oRDR_TRACKER_OBJ_046_oPCAN_RADAR_b67413fe_Tx: ComSystemTemplateSignalGroupRef=SG_TrackerObject046
          49 x ComGroupSignal, all with ComSignalEndianness=BIG_ENDIAN, ComSignalInitValue=0, ComTransferProperty=PENDING:
            OBJ_ACCELERATION_LAT_046_oRDR_TRACKER_OBJ_046_oPCAN_RADAR_b8504889_Tx: ComBitPosition=177, ComBitSize=10, ComSignalType=UINT16, ComSystemTemplateSystemSignalRef=OBJ_ACCELERATION_LAT_046
            OBJ_ACCELERATION_LAT_ERR_046_oRDR_TRACKER_OBJ_046_oPCAN_RADAR_6da47237_Tx: ComBitPosition=223, ComBitSize=8, ComSignalType=UINT8, ComSystemTemplateSystemSignalRef=OBJ_ACCELERATION_LAT_ERR_046
            OBJ_ACCELERATION_LONG_046_oRDR_TRACKER_OBJ_046_oPCAN_RADAR_caa01169_Tx: ComBitPosition=193, ComBitSize=10, ComSignalType=UINT16, ComSystemTemplateSystemSignalRef=OBJ_ACCELERATION_LONG_046
            OBJ_ACCELERATION_LONG_ERR_046_oRDR_TRACKER_OBJ_046_oPCAN_RADAR_7201d79d_Tx: ComBitPosition=215, ComBitSize=8, ComSignalType=UINT8, ComSystemTemplateSystemSignalRef=OBJ_ACCELERATION_LONG_ERR_046
            OBJ_ACCEL_ERR_CRR_COEF_046_oRDR_TRACKER_OBJ_046_oPCAN_RADAR_d2a2f6fb_Tx: ComBitPosition=431, ComBitSize=8, ComSignalType=UINT8, ComSystemTemplateSystemSignalRef=OBJ_ACCEL_ERR_CRR_COEF_046
            OBJ_ALIVE_TIME_046_oRDR_TRACKER_OBJ_046_oPCAN_RADAR_aac15ad5_Tx: ComBitPosition=255, ComBitSize=16, ComSignalType=UINT16, ComSystemTemplateSystemSignalRef=OBJ_ALIVE_TIME_046
            OBJ_CLS_TYPE1_046_oRDR_TRACKER_OBJ_046_oPCAN_RADAR_3d1abbf3_Tx: ComBitPosition=271, ComBitSize=4, ComSignalType=UINT8, ComSystemTemplateSystemSignalRef=OBJ_CLS_TYPE1_046
            OBJ_CLS_TYPE1_PROB_046_oRDR_TRACKER_OBJ_046_oPCAN_RADAR_95426c00_Tx: ComBitPosition=303, ComBitSize=8, ComSignalType=UINT8, ComSystemTemplateSystemSignalRef=OBJ_CLS_TYPE1_PROB_046
            OBJ_CLS_TYPE2_046_oRDR_TRACKER_OBJ_046_oPCAN_RADAR_70f2bb94_Tx: ComBitPosition=267, ComBitSize=4, ComSignalType=UINT8, ComSystemTemplateSystemSignalRef=OBJ_CLS_TYPE2_046
            OBJ_CLS_TYPE2_PROB_046_oRDR_TRACKER_OBJ_046_oPCAN_RADAR_5c76770d_Tx: ComBitPosition=311, ComBitSize=8, ComSignalType=UINT8, ComSystemTemplateSystemSignalRef=OBJ_CLS_TYPE2_PROB_046
            OBJ_CLS_TYPE3_046_oRDR_TRACKER_OBJ_046_oPCAN_RADAR_fd7a4676_Tx: ComBitPosition=279, ComBitSize=4, ComSignalType=UINT8, ComSystemTemplateSystemSignalRef=OBJ_CLS_TYPE3_046
            OBJ_CLS_TYPE3_PROB_046_oRDR_TRACKER_OBJ_046_oPCAN_RADAR_1b6581f6_Tx: ComBitPosition=319, ComBitSize=8, ComSignalType=UINT8, ComSystemTemplateSystemSignalRef=OBJ_CLS_TYPE3_PROB_046
            OBJ_CLS_TYPE4_046_oRDR_TRACKER_OBJ_046_oPCAN_RADAR_eb22bb5a_Tx: ComBitPosition=275, ComBitSize=4, ComSignalType=UINT8, ComSystemTemplateSystemSignalRef=OBJ_CLS_TYPE4_046
            OBJ_CLS_TYPE4_PROB_046_oRDR_TRACKER_OBJ_046_oPCAN_RADAR_156f4756_Tx: ComBitPosition=327, ComBitSize=8, ComSignalType=UINT8, ComSystemTemplateSystemSignalRef=OBJ_CLS_TYPE4_PROB_046
            OBJ_CLS_TYPE5_046_oRDR_TRACKER_OBJ_046_oPCAN_RADAR_66aa46b8_Tx: ComBitPosition=287, ComBitSize=4, ComSignalType=UINT8, ComSystemTemplateSystemSignalRef=OBJ_CLS_TYPE5_046
            OBJ_CLS_TYPE5_PROB_046_oRDR_TRACKER_OBJ_046_oPCAN_RADAR_527cb1ad_Tx: ComBitPosition=335, ComBitSize=8, ComSignalType=UINT8, ComSystemTemplateSystemSignalRef=OBJ_CLS_TYPE5_PROB_046
            OBJ_CLS_TYPE6_046_oRDR_TRACKER_OBJ_046_oPCAN_RADAR_2b4246df_Tx: ComBitPosition=282, ComBitSize=4, ComSignalType=UINT8, ComSystemTemplateSystemSignalRef=OBJ_CLS_TYPE6_046
            OBJ_CLS_TYPE6_PROB_046_oRDR_TRACKER_OBJ_046_oPCAN_RADAR_9b48aaa0_Tx: ComBitPosition=343, ComBitSize=8, ComSignalType=UINT8, ComSystemTemplateSystemSignalRef=OBJ_CLS_TYPE6_PROB_046
            OBJ_DIMENSION_LENGTH_046_oRDR_TRACKER_OBJ_046_oPCAN_RADAR_7f84e8b7_Tx: ComBitPosition=37, ComBitSize=12, ComSignalType=UINT16, ComSystemTemplateSystemSignalRef=OBJ_DIMENSION_LENGTH_046
            OBJ_DIMENSION_LENGTH_ERR_046_oRDR_TRACKER_OBJ_046_oPCAN_RADAR_447cf7cd_Tx: ComBitPosition=41, ComBitSize=10, ComSignalType=UINT16, ComSystemTemplateSystemSignalRef=OBJ_DIMENSION_LENGTH_ERR_046
            OBJ_DIMENSION_WIDTH_046_oRDR_TRACKER_OBJ_046_oPCAN_RADAR_5c4a1f1a_Tx: ComBitPosition=17, ComBitSize=10, ComSignalType=UINT16, ComSystemTemplateSystemSignalRef=OBJ_DIMENSION_WIDTH_046
            OBJ_DIMENSION_WIDTH_ERR_046_oRDR_TRACKER_OBJ_046_oPCAN_RADAR_bce8d8f2_Tx: ComBitPosition=23, ComBitSize=6, ComSignalType=UINT8, ComSystemTemplateSystemSignalRef=OBJ_DIMENSION_WIDTH_ERR_046
            OBJ_EXISTENCE_PROB_046_oRDR_TRACKER_OBJ_046_oPCAN_RADAR_57f69b27_Tx: ComBitPosition=229, ComBitSize=14, ComSignalType=UINT16, ComSystemTemplateSystemSignalRef=OBJ_EXISTENCE_PROB_046
            OBJ_GROUP_ID_046_oRDR_TRACKER_OBJ_046_oPCAN_RADAR_de848f8a_Tx: ComBitPosition=405, ComBitSize=6, ComSignalType=UINT8, ComSystemTemplateSystemSignalRef=OBJ_GROUP_ID_046
            OBJ_ID_046_oRDR_TRACKER_OBJ_046_oPCAN_RADAR_2daaa48d_Tx: ComBitPosition=7, ComBitSize=8, ComSignalType=UINT8, ComSystemTemplateSystemSignalRef=OBJ_ID_046
            OBJ_MEASUREMENT_STATUS_046_oRDR_TRACKER_OBJ_046_oPCAN_RADAR_5278d630_Tx: ComBitPosition=14, ComBitSize=3, ComSignalType=UINT8, ComSystemTemplateSystemSignalRef=OBJ_MEASUREMENT_STATUS_046
            OBJ_MH_CRC16_046_oRDR_TRACKER_OBJ_046_oPCAN_RADAR_2e18610c_Tx: ComBitPosition=495, ComBitSize=16, ComSignalType=UINT16, ComSystemTemplateSystemSignalRef=OBJ_MH_CRC16_046
            OBJ_MH_CYCLE_COUNTER_046_oRDR_TRACKER_OBJ_046_oPCAN_RADAR_5ffc3bed_Tx: ComBitPosition=487, ComBitSize=8, ComSignalType=UINT8, ComSystemTemplateSystemSignalRef=OBJ_MH_CYCLE_COUNTER_046
            OBJ_MOVEMENT_STATUS_046_oRDR_TRACKER_OBJ_046_oPCAN_RADAR_7dd6437c_Tx: ComBitPosition=196, ComBitSize=3, ComSignalType=UINT8, ComSystemTemplateSystemSignalRef=OBJ_MOVEMENT_STATUS_046
            OBJ_POS_ERR_CRR_COEF_046_oRDR_TRACKER_OBJ_046_oPCAN_RADAR_eda98346_Tx: ComBitPosition=415, ComBitSize=8, ComSignalType=UINT8, ComSystemTemplateSystemSignalRef=OBJ_POS_ERR_CRR_COEF_046
            OBJ_POS_LAT_046_oRDR_TRACKER_OBJ_046_oPCAN_RADAR_0f067e0a_Tx: ComBitPosition=79, ComBitSize=16, ComSignalType=UINT16, ComSystemTemplateSystemSignalRef=OBJ_POS_LAT_046
            OBJ_POS_LAT_ERR_046_oRDR_TRACKER_OBJ_046_oPCAN_RADAR_0b4a2e3d_Tx: ComBitPosition=103, ComBitSize=8, ComSignalType=UINT8, ComSystemTemplateSystemSignalRef=OBJ_POS_LAT_ERR_046
            OBJ_POS_LONG_046_oRDR_TRACKER_OBJ_046_oPCAN_RADAR_bea695c5_Tx: ComBitPosition=63, ComBitSize=16, ComSignalType=UINT16, ComSystemTemplateSystemSignalRef=OBJ_POS_LONG_046
            OBJ_POS_LONG_ERR_046_oRDR_TRACKER_OBJ_046_oPCAN_RADAR_92b2d0df_Tx: ComBitPosition=95, ComBitSize=8, ComSignalType=UINT8, ComSystemTemplateSystemSignalRef=OBJ_POS_LONG_ERR_046
            OBJ_RCS_046_oRDR_TRACKER_OBJ_046_oPCAN_RADAR_2dc9280d_Tx: ComBitPosition=351, ComBitSize=7, ComSignalType=UINT8, ComSystemTemplateSystemSignalRef=OBJ_RCS_046
            OBJ_REF_PT_LAT_OFFSET_046_oRDR_TRACKER_OBJ_046_oPCAN_RADAR_d8f44378_Tx: ComBitPosition=370, ComBitSize=14, ComSignalType=UINT16, ComSystemTemplateSystemSignalRef=OBJ_REF_PT_LAT_OFFSET_046
            OBJ_REF_PT_LONG_OFFSET_046_oRDR_TRACKER_OBJ_046_oPCAN_RADAR_97a6b37b_Tx: ComBitPosition=357, ComBitSize=14, ComSignalType=UINT16, ComSystemTemplateSystemSignalRef=OBJ_REF_PT_LONG_OFFSET_046
            OBJ_TIMESTAMP_OFFSET_046_oRDR_TRACKER_OBJ_046_oPCAN_RADAR_2d65285b_Tx: ComBitPosition=247, ComBitSize=8, ComSignalType=UINT8, ComSystemTemplateSystemSignalRef=OBJ_TIMESTAMP_OFFSET_046
            OBJ_TRACK_MOTION_MODEL_046_oRDR_TRACKER_OBJ_046_oPCAN_RADAR_e1662986_Tx: ComBitPosition=9, ComBitSize=2, ComSignalType=UINT8, ComSystemTemplateSystemSignalRef=OBJ_TRACK_MOTION_MODEL_046
            OBJ_VEH_TRACK_FLAG_046_oRDR_TRACKER_OBJ_046_oPCAN_RADAR_634cdfdb_Tx: ComBitPosition=10, ComBitSize=1, ComSignalType=BOOLEAN, ComSystemTemplateSystemSignalRef=OBJ_VEH_TRACK_FLAG_046
            OBJ_VELOCITY_ERR_CRR_COEF_046_oRDR_TRACKER_OBJ_046_oPCAN_RADAR_44d3bea7_Tx: ComBitPosition=423, ComBitSize=8, ComSignalType=UINT8, ComSystemTemplateSystemSignalRef=OBJ_VELOCITY_ERR_CRR_COEF_046
            OBJ_VELOCITY_LAT_046_oRDR_TRACKER_OBJ_046_oPCAN_RADAR_4b653b2d_Tx: ComBitPosition=126, ComBitSize=15, ComSignalType=UINT16, ComSystemTemplateSystemSignalRef=OBJ_VELOCITY_LAT_046
            OBJ_VELOCITY_LAT_ERR_046_oRDR_TRACKER_OBJ_046_oPCAN_RADAR_7f9f4b7c_Tx: ComBitPosition=151, ComBitSize=8, ComSignalType=UINT8, ComSystemTemplateSystemSignalRef=OBJ_VELOCITY_LAT_ERR_046
            OBJ_VELOCITY_LONG_046_oRDR_TRACKER_OBJ_046_oPCAN_RADAR_1be843eb_Tx: ComBitPosition=110, ComBitSize=15, ComSignalType=UINT16, ComSystemTemplateSystemSignalRef=OBJ_VELOCITY_LONG_046
            OBJ_VELOCITY_LONG_ERR_046_oRDR_TRACKER_OBJ_046_oPCAN_RADAR_931d74bc_Tx: ComBitPosition=143, ComBitSize=8, ComSignalType=UINT8, ComSystemTemplateSystemSignalRef=OBJ_VELOCITY_LONG_ERR_046
            OBJ_YAW_ANGLE_046_oRDR_TRACKER_OBJ_046_oPCAN_RADAR_a7d97f6d_Tx: ComBitPosition=155, ComBitSize=12, ComSignalType=UINT16, ComSystemTemplateSystemSignalRef=OBJ_YAW_ANGLE_046
            OBJ_YAW_ANGLE_ERR_046_oRDR_TRACKER_OBJ_046_oPCAN_RADAR_72d479ba_Tx: ComBitPosition=175, ComBitSize=7, ComSignalType=UINT8, ComSystemTemplateSystemSignalRef=OBJ_YAW_ANGLE_ERR_046
            OBJ_YAW_RATE_046_oRDR_TRACKER_OBJ_046_oPCAN_RADAR_82565a2a_Tx: ComBitPosition=399, ComBitSize=10, ComSignalType=UINT16, ComSystemTemplateSystemSignalRef=OBJ_YAW_RATE_046
            OBJ_YAW_RATE_ERR_046_oRDR_TRACKER_OBJ_046_oPCAN_RADAR_bd8ecdf6_Tx: ComBitPosition=388, ComBitSize=5, ComSignalType=UINT8, ComSystemTemplateSystemSignalRef=OBJ_YAW_RATE_ERR_046
        SG_TrackerObject047_oRDR_TRACKER_OBJ_047_oPCAN_RADAR_4f609b4d_Tx: ComSystemTemplateSignalGroupRef=SG_TrackerObject047
          49 x ComGroupSignal, all with ComSignalEndianness=BIG_ENDIAN, ComSignalInitValue=0, ComTransferProperty=PENDING:
            OBJ_ACCELERATION_LAT_047_oRDR_TRACKER_OBJ_047_oPCAN_RADAR_4144c03a_Tx: ComBitPosition=177, ComBitSize=10, ComSignalType=UINT16, ComSystemTemplateSystemSignalRef=OBJ_ACCELERATION_LAT_047
            OBJ_ACCELERATION_LAT_ERR_047_oRDR_TRACKER_OBJ_047_oPCAN_RADAR_94b0fa84_Tx: ComBitPosition=223, ComBitSize=8, ComSignalType=UINT8, ComSystemTemplateSystemSignalRef=OBJ_ACCELERATION_LAT_ERR_047
            OBJ_ACCELERATION_LONG_047_oRDR_TRACKER_OBJ_047_oPCAN_RADAR_33b499da_Tx: ComBitPosition=193, ComBitSize=10, ComSignalType=UINT16, ComSystemTemplateSystemSignalRef=OBJ_ACCELERATION_LONG_047
            OBJ_ACCELERATION_LONG_ERR_047_oRDR_TRACKER_OBJ_047_oPCAN_RADAR_8b155f2e_Tx: ComBitPosition=215, ComBitSize=8, ComSignalType=UINT8, ComSystemTemplateSystemSignalRef=OBJ_ACCELERATION_LONG_ERR_047
            OBJ_ACCEL_ERR_CRR_COEF_047_oRDR_TRACKER_OBJ_047_oPCAN_RADAR_2bb67e48_Tx: ComBitPosition=431, ComBitSize=8, ComSignalType=UINT8, ComSystemTemplateSystemSignalRef=OBJ_ACCEL_ERR_CRR_COEF_047
            OBJ_ALIVE_TIME_047_oRDR_TRACKER_OBJ_047_oPCAN_RADAR_53d5d266_Tx: ComBitPosition=255, ComBitSize=16, ComSignalType=UINT16, ComSystemTemplateSystemSignalRef=OBJ_ALIVE_TIME_047
            OBJ_CLS_TYPE1_047_oRDR_TRACKER_OBJ_047_oPCAN_RADAR_c40e3340_Tx: ComBitPosition=271, ComBitSize=4, ComSignalType=UINT8, ComSystemTemplateSystemSignalRef=OBJ_CLS_TYPE1_047
            OBJ_CLS_TYPE1_PROB_047_oRDR_TRACKER_OBJ_047_oPCAN_RADAR_6c56e4b3_Tx: ComBitPosition=303, ComBitSize=8, ComSignalType=UINT8, ComSystemTemplateSystemSignalRef=OBJ_CLS_TYPE1_PROB_047
            OBJ_CLS_TYPE2_047_oRDR_TRACKER_OBJ_047_oPCAN_RADAR_89e63327_Tx: ComBitPosition=267, ComBitSize=4, ComSignalType=UINT8, ComSystemTemplateSystemSignalRef=OBJ_CLS_TYPE2_047
            OBJ_CLS_TYPE2_PROB_047_oRDR_TRACKER_OBJ_047_oPCAN_RADAR_a562ffbe_Tx: ComBitPosition=311, ComBitSize=8, ComSignalType=UINT8, ComSystemTemplateSystemSignalRef=OBJ_CLS_TYPE2_PROB_047
            OBJ_CLS_TYPE3_047_oRDR_TRACKER_OBJ_047_oPCAN_RADAR_046ecec5_Tx: ComBitPosition=279, ComBitSize=4, ComSignalType=UINT8, ComSystemTemplateSystemSignalRef=OBJ_CLS_TYPE3_047
            OBJ_CLS_TYPE3_PROB_047_oRDR_TRACKER_OBJ_047_oPCAN_RADAR_e2710945_Tx: ComBitPosition=319, ComBitSize=8, ComSignalType=UINT8, ComSystemTemplateSystemSignalRef=OBJ_CLS_TYPE3_PROB_047
            OBJ_CLS_TYPE4_047_oRDR_TRACKER_OBJ_047_oPCAN_RADAR_123633e9_Tx: ComBitPosition=275, ComBitSize=4, ComSignalType=UINT8, ComSystemTemplateSystemSignalRef=OBJ_CLS_TYPE4_047
            OBJ_CLS_TYPE4_PROB_047_oRDR_TRACKER_OBJ_047_oPCAN_RADAR_ec7bcfe5_Tx: ComBitPosition=327, ComBitSize=8, ComSignalType=UINT8, ComSystemTemplateSystemSignalRef=OBJ_CLS_TYPE4_PROB_047
            OBJ_CLS_TYPE5_047_oRDR_TRACKER_OBJ_047_oPCAN_RADAR_9fbece0b_Tx: ComBitPosition=287, ComBitSize=4, ComSignalType=UINT8, ComSystemTemplateSystemSignalRef=OBJ_CLS_TYPE5_047
            OBJ_CLS_TYPE5_PROB_047_oRDR_TRACKER_OBJ_047_oPCAN_RADAR_ab68391e_Tx: ComBitPosition=335, ComBitSize=8, ComSignalType=UINT8, ComSystemTemplateSystemSignalRef=OBJ_CLS_TYPE5_PROB_047
            OBJ_CLS_TYPE6_047_oRDR_TRACKER_OBJ_047_oPCAN_RADAR_d256ce6c_Tx: ComBitPosition=282, ComBitSize=4, ComSignalType=UINT8, ComSystemTemplateSystemSignalRef=OBJ_CLS_TYPE6_047
            OBJ_CLS_TYPE6_PROB_047_oRDR_TRACKER_OBJ_047_oPCAN_RADAR_625c2213_Tx: ComBitPosition=343, ComBitSize=8, ComSignalType=UINT8, ComSystemTemplateSystemSignalRef=OBJ_CLS_TYPE6_PROB_047
            OBJ_DIMENSION_LENGTH_047_oRDR_TRACKER_OBJ_047_oPCAN_RADAR_86906004_Tx: ComBitPosition=37, ComBitSize=12, ComSignalType=UINT16, ComSystemTemplateSystemSignalRef=OBJ_DIMENSION_LENGTH_047
            OBJ_DIMENSION_LENGTH_ERR_047_oRDR_TRACKER_OBJ_047_oPCAN_RADAR_bd687f7e_Tx: ComBitPosition=41, ComBitSize=10, ComSignalType=UINT16, ComSystemTemplateSystemSignalRef=OBJ_DIMENSION_LENGTH_ERR_047
            OBJ_DIMENSION_WIDTH_047_oRDR_TRACKER_OBJ_047_oPCAN_RADAR_a55e97a9_Tx: ComBitPosition=17, ComBitSize=10, ComSignalType=UINT16, ComSystemTemplateSystemSignalRef=OBJ_DIMENSION_WIDTH_047
            OBJ_DIMENSION_WIDTH_ERR_047_oRDR_TRACKER_OBJ_047_oPCAN_RADAR_45fc5041_Tx: ComBitPosition=23, ComBitSize=6, ComSignalType=UINT8, ComSystemTemplateSystemSignalRef=OBJ_DIMENSION_WIDTH_ERR_047
            OBJ_EXISTENCE_PROB_047_oRDR_TRACKER_OBJ_047_oPCAN_RADAR_aee21394_Tx: ComBitPosition=229, ComBitSize=14, ComSignalType=UINT16, ComSystemTemplateSystemSignalRef=OBJ_EXISTENCE_PROB_047
            OBJ_GROUP_ID_047_oRDR_TRACKER_OBJ_047_oPCAN_RADAR_27900739_Tx: ComBitPosition=405, ComBitSize=6, ComSignalType=UINT8, ComSystemTemplateSystemSignalRef=OBJ_GROUP_ID_047
            OBJ_ID_047_oRDR_TRACKER_OBJ_047_oPCAN_RADAR_d4be2c3e_Tx: ComBitPosition=7, ComBitSize=8, ComSignalType=UINT8, ComSystemTemplateSystemSignalRef=OBJ_ID_047
            OBJ_MEASUREMENT_STATUS_047_oRDR_TRACKER_OBJ_047_oPCAN_RADAR_ab6c5e83_Tx: ComBitPosition=14, ComBitSize=3, ComSignalType=UINT8, ComSystemTemplateSystemSignalRef=OBJ_MEASUREMENT_STATUS_047
            OBJ_MH_CRC16_047_oRDR_TRACKER_OBJ_047_oPCAN_RADAR_d70ce9bf_Tx: ComBitPosition=495, ComBitSize=16, ComSignalType=UINT16, ComSystemTemplateSystemSignalRef=OBJ_MH_CRC16_047
            OBJ_MH_CYCLE_COUNTER_047_oRDR_TRACKER_OBJ_047_oPCAN_RADAR_a6e8b35e_Tx: ComBitPosition=487, ComBitSize=8, ComSignalType=UINT8, ComSystemTemplateSystemSignalRef=OBJ_MH_CYCLE_COUNTER_047
            OBJ_MOVEMENT_STATUS_047_oRDR_TRACKER_OBJ_047_oPCAN_RADAR_84c2cbcf_Tx: ComBitPosition=196, ComBitSize=3, ComSignalType=UINT8, ComSystemTemplateSystemSignalRef=OBJ_MOVEMENT_STATUS_047
            OBJ_POS_ERR_CRR_COEF_047_oRDR_TRACKER_OBJ_047_oPCAN_RADAR_14bd0bf5_Tx: ComBitPosition=415, ComBitSize=8, ComSignalType=UINT8, ComSystemTemplateSystemSignalRef=OBJ_POS_ERR_CRR_COEF_047
            OBJ_POS_LAT_047_oRDR_TRACKER_OBJ_047_oPCAN_RADAR_f612f6b9_Tx: ComBitPosition=79, ComBitSize=16, ComSignalType=UINT16, ComSystemTemplateSystemSignalRef=OBJ_POS_LAT_047
            OBJ_POS_LAT_ERR_047_oRDR_TRACKER_OBJ_047_oPCAN_RADAR_f25ea68e_Tx: ComBitPosition=103, ComBitSize=8, ComSignalType=UINT8, ComSystemTemplateSystemSignalRef=OBJ_POS_LAT_ERR_047
            OBJ_POS_LONG_047_oRDR_TRACKER_OBJ_047_oPCAN_RADAR_47b21d76_Tx: ComBitPosition=63, ComBitSize=16, ComSignalType=UINT16, ComSystemTemplateSystemSignalRef=OBJ_POS_LONG_047
            OBJ_POS_LONG_ERR_047_oRDR_TRACKER_OBJ_047_oPCAN_RADAR_6ba6586c_Tx: ComBitPosition=95, ComBitSize=8, ComSignalType=UINT8, ComSystemTemplateSystemSignalRef=OBJ_POS_LONG_ERR_047
            OBJ_RCS_047_oRDR_TRACKER_OBJ_047_oPCAN_RADAR_d4dda0be_Tx: ComBitPosition=351, ComBitSize=7, ComSignalType=UINT8, ComSystemTemplateSystemSignalRef=OBJ_RCS_047
            OBJ_REF_PT_LAT_OFFSET_047_oRDR_TRACKER_OBJ_047_oPCAN_RADAR_21e0cbcb_Tx: ComBitPosition=370, ComBitSize=14, ComSignalType=UINT16, ComSystemTemplateSystemSignalRef=OBJ_REF_PT_LAT_OFFSET_047
            OBJ_REF_PT_LONG_OFFSET_047_oRDR_TRACKER_OBJ_047_oPCAN_RADAR_6eb23bc8_Tx: ComBitPosition=357, ComBitSize=14, ComSignalType=UINT16, ComSystemTemplateSystemSignalRef=OBJ_REF_PT_LONG_OFFSET_047
            OBJ_TIMESTAMP_OFFSET_047_oRDR_TRACKER_OBJ_047_oPCAN_RADAR_d471a0e8_Tx: ComBitPosition=247, ComBitSize=8, ComSignalType=UINT8, ComSystemTemplateSystemSignalRef=OBJ_TIMESTAMP_OFFSET_047
            OBJ_TRACK_MOTION_MODEL_047_oRDR_TRACKER_OBJ_047_oPCAN_RADAR_1872a135_Tx: ComBitPosition=9, ComBitSize=2, ComSignalType=UINT8, ComSystemTemplateSystemSignalRef=OBJ_TRACK_MOTION_MODEL_047
            OBJ_VEH_TRACK_FLAG_047_oRDR_TRACKER_OBJ_047_oPCAN_RADAR_9a585768_Tx: ComBitPosition=10, ComBitSize=1, ComSignalType=BOOLEAN, ComSystemTemplateSystemSignalRef=OBJ_VEH_TRACK_FLAG_047
            OBJ_VELOCITY_ERR_CRR_COEF_047_oRDR_TRACKER_OBJ_047_oPCAN_RADAR_bdc73614_Tx: ComBitPosition=423, ComBitSize=8, ComSignalType=UINT8, ComSystemTemplateSystemSignalRef=OBJ_VELOCITY_ERR_CRR_COEF_047
            OBJ_VELOCITY_LAT_047_oRDR_TRACKER_OBJ_047_oPCAN_RADAR_b271b39e_Tx: ComBitPosition=126, ComBitSize=15, ComSignalType=UINT16, ComSystemTemplateSystemSignalRef=OBJ_VELOCITY_LAT_047
            OBJ_VELOCITY_LAT_ERR_047_oRDR_TRACKER_OBJ_047_oPCAN_RADAR_868bc3cf_Tx: ComBitPosition=151, ComBitSize=8, ComSignalType=UINT8, ComSystemTemplateSystemSignalRef=OBJ_VELOCITY_LAT_ERR_047
            OBJ_VELOCITY_LONG_047_oRDR_TRACKER_OBJ_047_oPCAN_RADAR_e2fccb58_Tx: ComBitPosition=110, ComBitSize=15, ComSignalType=UINT16, ComSystemTemplateSystemSignalRef=OBJ_VELOCITY_LONG_047
            OBJ_VELOCITY_LONG_ERR_047_oRDR_TRACKER_OBJ_047_oPCAN_RADAR_6a09fc0f_Tx: ComBitPosition=143, ComBitSize=8, ComSignalType=UINT8, ComSystemTemplateSystemSignalRef=OBJ_VELOCITY_LONG_ERR_047
            OBJ_YAW_ANGLE_047_oRDR_TRACKER_OBJ_047_oPCAN_RADAR_5ecdf7de_Tx: ComBitPosition=155, ComBitSize=12, ComSignalType=UINT16, ComSystemTemplateSystemSignalRef=OBJ_YAW_ANGLE_047
            OBJ_YAW_ANGLE_ERR_047_oRDR_TRACKER_OBJ_047_oPCAN_RADAR_8bc0f109_Tx: ComBitPosition=175, ComBitSize=7, ComSignalType=UINT8, ComSystemTemplateSystemSignalRef=OBJ_YAW_ANGLE_ERR_047
            OBJ_YAW_RATE_047_oRDR_TRACKER_OBJ_047_oPCAN_RADAR_7b42d299_Tx: ComBitPosition=399, ComBitSize=10, ComSignalType=UINT16, ComSystemTemplateSystemSignalRef=OBJ_YAW_RATE_047
            OBJ_YAW_RATE_ERR_047_oRDR_TRACKER_OBJ_047_oPCAN_RADAR_449a4545_Tx: ComBitPosition=388, ComBitSize=5, ComSignalType=UINT8, ComSystemTemplateSystemSignalRef=OBJ_YAW_RATE_ERR_047
        SG_TrackerObject048_oRDR_TRACKER_OBJ_048_oPCAN_RADAR_68fc760b_Tx: ComSystemTemplateSignalGroupRef=SG_TrackerObject048
          49 x ComGroupSignal, all with ComSignalEndianness=BIG_ENDIAN, ComSignalInitValue=0, ComTransferProperty=PENDING:
            OBJ_ACCELERATION_LAT_048_oRDR_TRACKER_OBJ_048_oPCAN_RADAR_66d82d7c_Tx: ComBitPosition=177, ComBitSize=10, ComSignalType=UINT16, ComSystemTemplateSystemSignalRef=OBJ_ACCELERATION_LAT_048
            OBJ_ACCELERATION_LAT_ERR_048_oRDR_TRACKER_OBJ_048_oPCAN_RADAR_b32c17c2_Tx: ComBitPosition=223, ComBitSize=8, ComSignalType=UINT8, ComSystemTemplateSystemSignalRef=OBJ_ACCELERATION_LAT_ERR_048
            OBJ_ACCELERATION_LONG_048_oRDR_TRACKER_OBJ_048_oPCAN_RADAR_1428749c_Tx: ComBitPosition=193, ComBitSize=10, ComSignalType=UINT16, ComSystemTemplateSystemSignalRef=OBJ_ACCELERATION_LONG_048
            OBJ_ACCELERATION_LONG_ERR_048_oRDR_TRACKER_OBJ_048_oPCAN_RADAR_ac89b268_Tx: ComBitPosition=215, ComBitSize=8, ComSignalType=UINT8, ComSystemTemplateSystemSignalRef=OBJ_ACCELERATION_LONG_ERR_048
            OBJ_ACCEL_ERR_CRR_COEF_048_oRDR_TRACKER_OBJ_048_oPCAN_RADAR_0c2a930e_Tx: ComBitPosition=431, ComBitSize=8, ComSignalType=UINT8, ComSystemTemplateSystemSignalRef=OBJ_ACCEL_ERR_CRR_COEF_048
            OBJ_ALIVE_TIME_048_oRDR_TRACKER_OBJ_048_oPCAN_RADAR_74493f20_Tx: ComBitPosition=255, ComBitSize=16, ComSignalType=UINT16, ComSystemTemplateSystemSignalRef=OBJ_ALIVE_TIME_048
            OBJ_CLS_TYPE1_048_oRDR_TRACKER_OBJ_048_oPCAN_RADAR_e392de06_Tx: ComBitPosition=271, ComBitSize=4, ComSignalType=UINT8, ComSystemTemplateSystemSignalRef=OBJ_CLS_TYPE1_048
            OBJ_CLS_TYPE1_PROB_048_oRDR_TRACKER_OBJ_048_oPCAN_RADAR_4bca09f5_Tx: ComBitPosition=303, ComBitSize=8, ComSignalType=UINT8, ComSystemTemplateSystemSignalRef=OBJ_CLS_TYPE1_PROB_048
            OBJ_CLS_TYPE2_048_oRDR_TRACKER_OBJ_048_oPCAN_RADAR_ae7ade61_Tx: ComBitPosition=267, ComBitSize=4, ComSignalType=UINT8, ComSystemTemplateSystemSignalRef=OBJ_CLS_TYPE2_048
            OBJ_CLS_TYPE2_PROB_048_oRDR_TRACKER_OBJ_048_oPCAN_RADAR_82fe12f8_Tx: ComBitPosition=311, ComBitSize=8, ComSignalType=UINT8, ComSystemTemplateSystemSignalRef=OBJ_CLS_TYPE2_PROB_048
            OBJ_CLS_TYPE3_048_oRDR_TRACKER_OBJ_048_oPCAN_RADAR_23f22383_Tx: ComBitPosition=279, ComBitSize=4, ComSignalType=UINT8, ComSystemTemplateSystemSignalRef=OBJ_CLS_TYPE3_048
            OBJ_CLS_TYPE3_PROB_048_oRDR_TRACKER_OBJ_048_oPCAN_RADAR_c5ede403_Tx: ComBitPosition=319, ComBitSize=8, ComSignalType=UINT8, ComSystemTemplateSystemSignalRef=OBJ_CLS_TYPE3_PROB_048
            OBJ_CLS_TYPE4_048_oRDR_TRACKER_OBJ_048_oPCAN_RADAR_35aadeaf_Tx: ComBitPosition=275, ComBitSize=4, ComSignalType=UINT8, ComSystemTemplateSystemSignalRef=OBJ_CLS_TYPE4_048
            OBJ_CLS_TYPE4_PROB_048_oRDR_TRACKER_OBJ_048_oPCAN_RADAR_cbe722a3_Tx: ComBitPosition=327, ComBitSize=8, ComSignalType=UINT8, ComSystemTemplateSystemSignalRef=OBJ_CLS_TYPE4_PROB_048
            OBJ_CLS_TYPE5_048_oRDR_TRACKER_OBJ_048_oPCAN_RADAR_b822234d_Tx: ComBitPosition=287, ComBitSize=4, ComSignalType=UINT8, ComSystemTemplateSystemSignalRef=OBJ_CLS_TYPE5_048
            OBJ_CLS_TYPE5_PROB_048_oRDR_TRACKER_OBJ_048_oPCAN_RADAR_8cf4d458_Tx: ComBitPosition=335, ComBitSize=8, ComSignalType=UINT8, ComSystemTemplateSystemSignalRef=OBJ_CLS_TYPE5_PROB_048
            OBJ_CLS_TYPE6_048_oRDR_TRACKER_OBJ_048_oPCAN_RADAR_f5ca232a_Tx: ComBitPosition=282, ComBitSize=4, ComSignalType=UINT8, ComSystemTemplateSystemSignalRef=OBJ_CLS_TYPE6_048
            OBJ_CLS_TYPE6_PROB_048_oRDR_TRACKER_OBJ_048_oPCAN_RADAR_45c0cf55_Tx: ComBitPosition=343, ComBitSize=8, ComSignalType=UINT8, ComSystemTemplateSystemSignalRef=OBJ_CLS_TYPE6_PROB_048
            OBJ_DIMENSION_LENGTH_048_oRDR_TRACKER_OBJ_048_oPCAN_RADAR_a10c8d42_Tx: ComBitPosition=37, ComBitSize=12, ComSignalType=UINT16, ComSystemTemplateSystemSignalRef=OBJ_DIMENSION_LENGTH_048
            OBJ_DIMENSION_LENGTH_ERR_048_oRDR_TRACKER_OBJ_048_oPCAN_RADAR_9af49238_Tx: ComBitPosition=41, ComBitSize=10, ComSignalType=UINT16, ComSystemTemplateSystemSignalRef=OBJ_DIMENSION_LENGTH_ERR_048
            OBJ_DIMENSION_WIDTH_048_oRDR_TRACKER_OBJ_048_oPCAN_RADAR_82c27aef_Tx: ComBitPosition=17, ComBitSize=10, ComSignalType=UINT16, ComSystemTemplateSystemSignalRef=OBJ_DIMENSION_WIDTH_048
            OBJ_DIMENSION_WIDTH_ERR_048_oRDR_TRACKER_OBJ_048_oPCAN_RADAR_6260bd07_Tx: ComBitPosition=23, ComBitSize=6, ComSignalType=UINT8, ComSystemTemplateSystemSignalRef=OBJ_DIMENSION_WIDTH_ERR_048
            OBJ_EXISTENCE_PROB_048_oRDR_TRACKER_OBJ_048_oPCAN_RADAR_897efed2_Tx: ComBitPosition=229, ComBitSize=14, ComSignalType=UINT16, ComSystemTemplateSystemSignalRef=OBJ_EXISTENCE_PROB_048
            OBJ_GROUP_ID_048_oRDR_TRACKER_OBJ_048_oPCAN_RADAR_000cea7f_Tx: ComBitPosition=405, ComBitSize=6, ComSignalType=UINT8, ComSystemTemplateSystemSignalRef=OBJ_GROUP_ID_048
            OBJ_ID_048_oRDR_TRACKER_OBJ_048_oPCAN_RADAR_f322c178_Tx: ComBitPosition=7, ComBitSize=8, ComSignalType=UINT8, ComSystemTemplateSystemSignalRef=OBJ_ID_048
            OBJ_MEASUREMENT_STATUS_048_oRDR_TRACKER_OBJ_048_oPCAN_RADAR_8cf0b3c5_Tx: ComBitPosition=14, ComBitSize=3, ComSignalType=UINT8, ComSystemTemplateSystemSignalRef=OBJ_MEASUREMENT_STATUS_048
            OBJ_MH_CRC16_048_oRDR_TRACKER_OBJ_048_oPCAN_RADAR_f09004f9_Tx: ComBitPosition=495, ComBitSize=16, ComSignalType=UINT16, ComSystemTemplateSystemSignalRef=OBJ_MH_CRC16_048
            OBJ_MH_CYCLE_COUNTER_048_oRDR_TRACKER_OBJ_048_oPCAN_RADAR_81745e18_Tx: ComBitPosition=487, ComBitSize=8, ComSignalType=UINT8, ComSystemTemplateSystemSignalRef=OBJ_MH_CYCLE_COUNTER_048
            OBJ_MOVEMENT_STATUS_048_oRDR_TRACKER_OBJ_048_oPCAN_RADAR_a35e2689_Tx: ComBitPosition=196, ComBitSize=3, ComSignalType=UINT8, ComSystemTemplateSystemSignalRef=OBJ_MOVEMENT_STATUS_048
            OBJ_POS_ERR_CRR_COEF_048_oRDR_TRACKER_OBJ_048_oPCAN_RADAR_3321e6b3_Tx: ComBitPosition=415, ComBitSize=8, ComSignalType=UINT8, ComSystemTemplateSystemSignalRef=OBJ_POS_ERR_CRR_COEF_048
            OBJ_POS_LAT_048_oRDR_TRACKER_OBJ_048_oPCAN_RADAR_d18e1bff_Tx: ComBitPosition=79, ComBitSize=16, ComSignalType=UINT16, ComSystemTemplateSystemSignalRef=OBJ_POS_LAT_048
            OBJ_POS_LAT_ERR_048_oRDR_TRACKER_OBJ_048_oPCAN_RADAR_d5c24bc8_Tx: ComBitPosition=103, ComBitSize=8, ComSignalType=UINT8, ComSystemTemplateSystemSignalRef=OBJ_POS_LAT_ERR_048
            OBJ_POS_LONG_048_oRDR_TRACKER_OBJ_048_oPCAN_RADAR_602ef030_Tx: ComBitPosition=63, ComBitSize=16, ComSignalType=UINT16, ComSystemTemplateSystemSignalRef=OBJ_POS_LONG_048
            OBJ_POS_LONG_ERR_048_oRDR_TRACKER_OBJ_048_oPCAN_RADAR_4c3ab52a_Tx: ComBitPosition=95, ComBitSize=8, ComSignalType=UINT8, ComSystemTemplateSystemSignalRef=OBJ_POS_LONG_ERR_048
            OBJ_RCS_048_oRDR_TRACKER_OBJ_048_oPCAN_RADAR_f3414df8_Tx: ComBitPosition=351, ComBitSize=7, ComSignalType=UINT8, ComSystemTemplateSystemSignalRef=OBJ_RCS_048
            OBJ_REF_PT_LAT_OFFSET_048_oRDR_TRACKER_OBJ_048_oPCAN_RADAR_067c268d_Tx: ComBitPosition=370, ComBitSize=14, ComSignalType=UINT16, ComSystemTemplateSystemSignalRef=OBJ_REF_PT_LAT_OFFSET_048
            OBJ_REF_PT_LONG_OFFSET_048_oRDR_TRACKER_OBJ_048_oPCAN_RADAR_492ed68e_Tx: ComBitPosition=357, ComBitSize=14, ComSignalType=UINT16, ComSystemTemplateSystemSignalRef=OBJ_REF_PT_LONG_OFFSET_048
            OBJ_TIMESTAMP_OFFSET_048_oRDR_TRACKER_OBJ_048_oPCAN_RADAR_f3ed4dae_Tx: ComBitPosition=247, ComBitSize=8, ComSignalType=UINT8, ComSystemTemplateSystemSignalRef=OBJ_TIMESTAMP_OFFSET_048
            OBJ_TRACK_MOTION_MODEL_048_oRDR_TRACKER_OBJ_048_oPCAN_RADAR_3fee4c73_Tx: ComBitPosition=9, ComBitSize=2, ComSignalType=UINT8, ComSystemTemplateSystemSignalRef=OBJ_TRACK_MOTION_MODEL_048
            OBJ_VEH_TRACK_FLAG_048_oRDR_TRACKER_OBJ_048_oPCAN_RADAR_bdc4ba2e_Tx: ComBitPosition=10, ComBitSize=1, ComSignalType=BOOLEAN, ComSystemTemplateSystemSignalRef=OBJ_VEH_TRACK_FLAG_048
            OBJ_VELOCITY_ERR_CRR_COEF_048_oRDR_TRACKER_OBJ_048_oPCAN_RADAR_9a5bdb52_Tx: ComBitPosition=423, ComBitSize=8, ComSignalType=UINT8, ComSystemTemplateSystemSignalRef=OBJ_VELOCITY_ERR_CRR_COEF_048
            OBJ_VELOCITY_LAT_048_oRDR_TRACKER_OBJ_048_oPCAN_RADAR_95ed5ed8_Tx: ComBitPosition=126, ComBitSize=15, ComSignalType=UINT16, ComSystemTemplateSystemSignalRef=OBJ_VELOCITY_LAT_048
            OBJ_VELOCITY_LAT_ERR_048_oRDR_TRACKER_OBJ_048_oPCAN_RADAR_a1172e89_Tx: ComBitPosition=151, ComBitSize=8, ComSignalType=UINT8, ComSystemTemplateSystemSignalRef=OBJ_VELOCITY_LAT_ERR_048
            OBJ_VELOCITY_LONG_048_oRDR_TRACKER_OBJ_048_oPCAN_RADAR_c560261e_Tx: ComBitPosition=110, ComBitSize=15, ComSignalType=UINT16, ComSystemTemplateSystemSignalRef=OBJ_VELOCITY_LONG_048
            OBJ_VELOCITY_LONG_ERR_048_oRDR_TRACKER_OBJ_048_oPCAN_RADAR_4d951149_Tx: ComBitPosition=143, ComBitSize=8, ComSignalType=UINT8, ComSystemTemplateSystemSignalRef=OBJ_VELOCITY_LONG_ERR_048
            OBJ_YAW_ANGLE_048_oRDR_TRACKER_OBJ_048_oPCAN_RADAR_79511a98_Tx: ComBitPosition=155, ComBitSize=12, ComSignalType=UINT16, ComSystemTemplateSystemSignalRef=OBJ_YAW_ANGLE_048
            OBJ_YAW_ANGLE_ERR_048_oRDR_TRACKER_OBJ_048_oPCAN_RADAR_ac5c1c4f_Tx: ComBitPosition=175, ComBitSize=7, ComSignalType=UINT8, ComSystemTemplateSystemSignalRef=OBJ_YAW_ANGLE_ERR_048
            OBJ_YAW_RATE_048_oRDR_TRACKER_OBJ_048_oPCAN_RADAR_5cde3fdf_Tx: ComBitPosition=399, ComBitSize=10, ComSignalType=UINT16, ComSystemTemplateSystemSignalRef=OBJ_YAW_RATE_048
            OBJ_YAW_RATE_ERR_048_oRDR_TRACKER_OBJ_048_oPCAN_RADAR_6306a803_Tx: ComBitPosition=388, ComBitSize=5, ComSignalType=UINT8, ComSystemTemplateSystemSignalRef=OBJ_YAW_RATE_ERR_048
        SG_TrackerObject049_oRDR_TRACKER_OBJ_049_oPCAN_RADAR_91e8feb8_Tx: ComSystemTemplateSignalGroupRef=SG_TrackerObject049
          49 x ComGroupSignal, all with ComSignalEndianness=BIG_ENDIAN, ComSignalInitValue=0, ComTransferProperty=PENDING:
            OBJ_ACCELERATION_LAT_049_oRDR_TRACKER_OBJ_049_oPCAN_RADAR_9fcca5cf_Tx: ComBitPosition=177, ComBitSize=10, ComSignalType=UINT16, ComSystemTemplateSystemSignalRef=OBJ_ACCELERATION_LAT_049
            OBJ_ACCELERATION_LAT_ERR_049_oRDR_TRACKER_OBJ_049_oPCAN_RADAR_4a389f71_Tx: ComBitPosition=223, ComBitSize=8, ComSignalType=UINT8, ComSystemTemplateSystemSignalRef=OBJ_ACCELERATION_LAT_ERR_049
            OBJ_ACCELERATION_LONG_049_oRDR_TRACKER_OBJ_049_oPCAN_RADAR_ed3cfc2f_Tx: ComBitPosition=193, ComBitSize=10, ComSignalType=UINT16, ComSystemTemplateSystemSignalRef=OBJ_ACCELERATION_LONG_049
            OBJ_ACCELERATION_LONG_ERR_049_oRDR_TRACKER_OBJ_049_oPCAN_RADAR_559d3adb_Tx: ComBitPosition=215, ComBitSize=8, ComSignalType=UINT8, ComSystemTemplateSystemSignalRef=OBJ_ACCELERATION_LONG_ERR_049
            OBJ_ACCEL_ERR_CRR_COEF_049_oRDR_TRACKER_OBJ_049_oPCAN_RADAR_f53e1bbd_Tx: ComBitPosition=431, ComBitSize=8, ComSignalType=UINT8, ComSystemTemplateSystemSignalRef=OBJ_ACCEL_ERR_CRR_COEF_049
            OBJ_ALIVE_TIME_049_oRDR_TRACKER_OBJ_049_oPCAN_RADAR_8d5db793_Tx: ComBitPosition=255, ComBitSize=16, ComSignalType=UINT16, ComSystemTemplateSystemSignalRef=OBJ_ALIVE_TIME_049
            OBJ_CLS_TYPE1_049_oRDR_TRACKER_OBJ_049_oPCAN_RADAR_1a8656b5_Tx: ComBitPosition=271, ComBitSize=4, ComSignalType=UINT8, ComSystemTemplateSystemSignalRef=OBJ_CLS_TYPE1_049
            OBJ_CLS_TYPE1_PROB_049_oRDR_TRACKER_OBJ_049_oPCAN_RADAR_b2de8146_Tx: ComBitPosition=303, ComBitSize=8, ComSignalType=UINT8, ComSystemTemplateSystemSignalRef=OBJ_CLS_TYPE1_PROB_049
            OBJ_CLS_TYPE2_049_oRDR_TRACKER_OBJ_049_oPCAN_RADAR_576e56d2_Tx: ComBitPosition=267, ComBitSize=4, ComSignalType=UINT8, ComSystemTemplateSystemSignalRef=OBJ_CLS_TYPE2_049
            OBJ_CLS_TYPE2_PROB_049_oRDR_TRACKER_OBJ_049_oPCAN_RADAR_7bea9a4b_Tx: ComBitPosition=311, ComBitSize=8, ComSignalType=UINT8, ComSystemTemplateSystemSignalRef=OBJ_CLS_TYPE2_PROB_049
            OBJ_CLS_TYPE3_049_oRDR_TRACKER_OBJ_049_oPCAN_RADAR_dae6ab30_Tx: ComBitPosition=279, ComBitSize=4, ComSignalType=UINT8, ComSystemTemplateSystemSignalRef=OBJ_CLS_TYPE3_049
            OBJ_CLS_TYPE3_PROB_049_oRDR_TRACKER_OBJ_049_oPCAN_RADAR_3cf96cb0_Tx: ComBitPosition=319, ComBitSize=8, ComSignalType=UINT8, ComSystemTemplateSystemSignalRef=OBJ_CLS_TYPE3_PROB_049
            OBJ_CLS_TYPE4_049_oRDR_TRACKER_OBJ_049_oPCAN_RADAR_ccbe561c_Tx: ComBitPosition=275, ComBitSize=4, ComSignalType=UINT8, ComSystemTemplateSystemSignalRef=OBJ_CLS_TYPE4_049
            OBJ_CLS_TYPE4_PROB_049_oRDR_TRACKER_OBJ_049_oPCAN_RADAR_32f3aa10_Tx: ComBitPosition=327, ComBitSize=8, ComSignalType=UINT8, ComSystemTemplateSystemSignalRef=OBJ_CLS_TYPE4_PROB_049
            OBJ_CLS_TYPE5_049_oRDR_TRACKER_OBJ_049_oPCAN_RADAR_4136abfe_Tx: ComBitPosition=287, ComBitSize=4, ComSignalType=UINT8, ComSystemTemplateSystemSignalRef=OBJ_CLS_TYPE5_049
            OBJ_CLS_TYPE5_PROB_049_oRDR_TRACKER_OBJ_049_oPCAN_RADAR_75e05ceb_Tx: ComBitPosition=335, ComBitSize=8, ComSignalType=UINT8, ComSystemTemplateSystemSignalRef=OBJ_CLS_TYPE5_PROB_049
            OBJ_CLS_TYPE6_049_oRDR_TRACKER_OBJ_049_oPCAN_RADAR_0cdeab99_Tx: ComBitPosition=282, ComBitSize=4, ComSignalType=UINT8, ComSystemTemplateSystemSignalRef=OBJ_CLS_TYPE6_049
            OBJ_CLS_TYPE6_PROB_049_oRDR_TRACKER_OBJ_049_oPCAN_RADAR_bcd447e6_Tx: ComBitPosition=343, ComBitSize=8, ComSignalType=UINT8, ComSystemTemplateSystemSignalRef=OBJ_CLS_TYPE6_PROB_049
            OBJ_DIMENSION_LENGTH_049_oRDR_TRACKER_OBJ_049_oPCAN_RADAR_581805f1_Tx: ComBitPosition=37, ComBitSize=12, ComSignalType=UINT16, ComSystemTemplateSystemSignalRef=OBJ_DIMENSION_LENGTH_049
            OBJ_DIMENSION_LENGTH_ERR_049_oRDR_TRACKER_OBJ_049_oPCAN_RADAR_63e01a8b_Tx: ComBitPosition=41, ComBitSize=10, ComSignalType=UINT16, ComSystemTemplateSystemSignalRef=OBJ_DIMENSION_LENGTH_ERR_049
            OBJ_DIMENSION_WIDTH_049_oRDR_TRACKER_OBJ_049_oPCAN_RADAR_7bd6f25c_Tx: ComBitPosition=17, ComBitSize=10, ComSignalType=UINT16, ComSystemTemplateSystemSignalRef=OBJ_DIMENSION_WIDTH_049
            OBJ_DIMENSION_WIDTH_ERR_049_oRDR_TRACKER_OBJ_049_oPCAN_RADAR_9b7435b4_Tx: ComBitPosition=23, ComBitSize=6, ComSignalType=UINT8, ComSystemTemplateSystemSignalRef=OBJ_DIMENSION_WIDTH_ERR_049
            OBJ_EXISTENCE_PROB_049_oRDR_TRACKER_OBJ_049_oPCAN_RADAR_706a7661_Tx: ComBitPosition=229, ComBitSize=14, ComSignalType=UINT16, ComSystemTemplateSystemSignalRef=OBJ_EXISTENCE_PROB_049
            OBJ_GROUP_ID_049_oRDR_TRACKER_OBJ_049_oPCAN_RADAR_f91862cc_Tx: ComBitPosition=405, ComBitSize=6, ComSignalType=UINT8, ComSystemTemplateSystemSignalRef=OBJ_GROUP_ID_049
            OBJ_ID_049_oRDR_TRACKER_OBJ_049_oPCAN_RADAR_0a3649cb_Tx: ComBitPosition=7, ComBitSize=8, ComSignalType=UINT8, ComSystemTemplateSystemSignalRef=OBJ_ID_049
            OBJ_MEASUREMENT_STATUS_049_oRDR_TRACKER_OBJ_049_oPCAN_RADAR_75e43b76_Tx: ComBitPosition=14, ComBitSize=3, ComSignalType=UINT8, ComSystemTemplateSystemSignalRef=OBJ_MEASUREMENT_STATUS_049
            OBJ_MH_CRC16_049_oRDR_TRACKER_OBJ_049_oPCAN_RADAR_09848c4a_Tx: ComBitPosition=495, ComBitSize=16, ComSignalType=UINT16, ComSystemTemplateSystemSignalRef=OBJ_MH_CRC16_049
            OBJ_MH_CYCLE_COUNTER_049_oRDR_TRACKER_OBJ_049_oPCAN_RADAR_7860d6ab_Tx: ComBitPosition=487, ComBitSize=8, ComSignalType=UINT8, ComSystemTemplateSystemSignalRef=OBJ_MH_CYCLE_COUNTER_049
            OBJ_MOVEMENT_STATUS_049_oRDR_TRACKER_OBJ_049_oPCAN_RADAR_5a4aae3a_Tx: ComBitPosition=196, ComBitSize=3, ComSignalType=UINT8, ComSystemTemplateSystemSignalRef=OBJ_MOVEMENT_STATUS_049
            OBJ_POS_ERR_CRR_COEF_049_oRDR_TRACKER_OBJ_049_oPCAN_RADAR_ca356e00_Tx: ComBitPosition=415, ComBitSize=8, ComSignalType=UINT8, ComSystemTemplateSystemSignalRef=OBJ_POS_ERR_CRR_COEF_049
            OBJ_POS_LAT_049_oRDR_TRACKER_OBJ_049_oPCAN_RADAR_289a934c_Tx: ComBitPosition=79, ComBitSize=16, ComSignalType=UINT16, ComSystemTemplateSystemSignalRef=OBJ_POS_LAT_049
            OBJ_POS_LAT_ERR_049_oRDR_TRACKER_OBJ_049_oPCAN_RADAR_2cd6c37b_Tx: ComBitPosition=103, ComBitSize=8, ComSignalType=UINT8, ComSystemTemplateSystemSignalRef=OBJ_POS_LAT_ERR_049
            OBJ_POS_LONG_049_oRDR_TRACKER_OBJ_049_oPCAN_RADAR_993a7883_Tx: ComBitPosition=63, ComBitSize=16, ComSignalType=UINT16, ComSystemTemplateSystemSignalRef=OBJ_POS_LONG_049
            OBJ_POS_LONG_ERR_049_oRDR_TRACKER_OBJ_049_oPCAN_RADAR_b52e3d99_Tx: ComBitPosition=95, ComBitSize=8, ComSignalType=UINT8, ComSystemTemplateSystemSignalRef=OBJ_POS_LONG_ERR_049
            OBJ_RCS_049_oRDR_TRACKER_OBJ_049_oPCAN_RADAR_0a55c54b_Tx: ComBitPosition=351, ComBitSize=7, ComSignalType=UINT8, ComSystemTemplateSystemSignalRef=OBJ_RCS_049
            OBJ_REF_PT_LAT_OFFSET_049_oRDR_TRACKER_OBJ_049_oPCAN_RADAR_ff68ae3e_Tx: ComBitPosition=370, ComBitSize=14, ComSignalType=UINT16, ComSystemTemplateSystemSignalRef=OBJ_REF_PT_LAT_OFFSET_049
            OBJ_REF_PT_LONG_OFFSET_049_oRDR_TRACKER_OBJ_049_oPCAN_RADAR_b03a5e3d_Tx: ComBitPosition=357, ComBitSize=14, ComSignalType=UINT16, ComSystemTemplateSystemSignalRef=OBJ_REF_PT_LONG_OFFSET_049
            OBJ_TIMESTAMP_OFFSET_049_oRDR_TRACKER_OBJ_049_oPCAN_RADAR_0af9c51d_Tx: ComBitPosition=247, ComBitSize=8, ComSignalType=UINT8, ComSystemTemplateSystemSignalRef=OBJ_TIMESTAMP_OFFSET_049
            OBJ_TRACK_MOTION_MODEL_049_oRDR_TRACKER_OBJ_049_oPCAN_RADAR_c6fac4c0_Tx: ComBitPosition=9, ComBitSize=2, ComSignalType=UINT8, ComSystemTemplateSystemSignalRef=OBJ_TRACK_MOTION_MODEL_049
            OBJ_VEH_TRACK_FLAG_049_oRDR_TRACKER_OBJ_049_oPCAN_RADAR_44d0329d_Tx: ComBitPosition=10, ComBitSize=1, ComSignalType=BOOLEAN, ComSystemTemplateSystemSignalRef=OBJ_VEH_TRACK_FLAG_049
            OBJ_VELOCITY_ERR_CRR_COEF_049_oRDR_TRACKER_OBJ_049_oPCAN_RADAR_634f53e1_Tx: ComBitPosition=423, ComBitSize=8, ComSignalType=UINT8, ComSystemTemplateSystemSignalRef=OBJ_VELOCITY_ERR_CRR_COEF_049
            OBJ_VELOCITY_LAT_049_oRDR_TRACKER_OBJ_049_oPCAN_RADAR_6cf9d66b_Tx: ComBitPosition=126, ComBitSize=15, ComSignalType=UINT16, ComSystemTemplateSystemSignalRef=OBJ_VELOCITY_LAT_049
            OBJ_VELOCITY_LAT_ERR_049_oRDR_TRACKER_OBJ_049_oPCAN_RADAR_5803a63a_Tx: ComBitPosition=151, ComBitSize=8, ComSignalType=UINT8, ComSystemTemplateSystemSignalRef=OBJ_VELOCITY_LAT_ERR_049
            OBJ_VELOCITY_LONG_049_oRDR_TRACKER_OBJ_049_oPCAN_RADAR_3c74aead_Tx: ComBitPosition=110, ComBitSize=15, ComSignalType=UINT16, ComSystemTemplateSystemSignalRef=OBJ_VELOCITY_LONG_049
            OBJ_VELOCITY_LONG_ERR_049_oRDR_TRACKER_OBJ_049_oPCAN_RADAR_b48199fa_Tx: ComBitPosition=143, ComBitSize=8, ComSignalType=UINT8, ComSystemTemplateSystemSignalRef=OBJ_VELOCITY_LONG_ERR_049
            OBJ_YAW_ANGLE_049_oRDR_TRACKER_OBJ_049_oPCAN_RADAR_8045922b_Tx: ComBitPosition=155, ComBitSize=12, ComSignalType=UINT16, ComSystemTemplateSystemSignalRef=OBJ_YAW_ANGLE_049
            OBJ_YAW_ANGLE_ERR_049_oRDR_TRACKER_OBJ_049_oPCAN_RADAR_554894fc_Tx: ComBitPosition=175, ComBitSize=7, ComSignalType=UINT8, ComSystemTemplateSystemSignalRef=OBJ_YAW_ANGLE_ERR_049
            OBJ_YAW_RATE_049_oRDR_TRACKER_OBJ_049_oPCAN_RADAR_a5cab76c_Tx: ComBitPosition=399, ComBitSize=10, ComSignalType=UINT16, ComSystemTemplateSystemSignalRef=OBJ_YAW_RATE_049
            OBJ_YAW_RATE_ERR_049_oRDR_TRACKER_OBJ_049_oPCAN_RADAR_9a1220b0_Tx: ComBitPosition=388, ComBitSize=5, ComSignalType=UINT8, ComSystemTemplateSystemSignalRef=OBJ_YAW_RATE_ERR_049
        SG_TrackerObject050_oRDR_TRACKER_OBJ_050_oPCAN_RADAR_9f0ddc29_Tx: ComSystemTemplateSignalGroupRef=SG_TrackerObject050
          49 x ComGroupSignal, all with ComSignalEndianness=BIG_ENDIAN, ComSignalInitValue=0, ComTransferProperty=PENDING:
            OBJ_ACCELERATION_LAT_050_oRDR_TRACKER_OBJ_050_oPCAN_RADAR_9129875e_Tx: ComBitPosition=177, ComBitSize=10, ComSignalType=UINT16, ComSystemTemplateSystemSignalRef=OBJ_ACCELERATION_LAT_050
            OBJ_ACCELERATION_LAT_ERR_050_oRDR_TRACKER_OBJ_050_oPCAN_RADAR_44ddbde0_Tx: ComBitPosition=223, ComBitSize=8, ComSignalType=UINT8, ComSystemTemplateSystemSignalRef=OBJ_ACCELERATION_LAT_ERR_050
            OBJ_ACCELERATION_LONG_050_oRDR_TRACKER_OBJ_050_oPCAN_RADAR_e3d9debe_Tx: ComBitPosition=193, ComBitSize=10, ComSignalType=UINT16, ComSystemTemplateSystemSignalRef=OBJ_ACCELERATION_LONG_050
            OBJ_ACCELERATION_LONG_ERR_050_oRDR_TRACKER_OBJ_050_oPCAN_RADAR_5b78184a_Tx: ComBitPosition=215, ComBitSize=8, ComSignalType=UINT8, ComSystemTemplateSystemSignalRef=OBJ_ACCELERATION_LONG_ERR_050
            OBJ_ACCEL_ERR_CRR_COEF_050_oRDR_TRACKER_OBJ_050_oPCAN_RADAR_fbdb392c_Tx: ComBitPosition=431, ComBitSize=8, ComSignalType=UINT8, ComSystemTemplateSystemSignalRef=OBJ_ACCEL_ERR_CRR_COEF_050
            OBJ_ALIVE_TIME_050_oRDR_TRACKER_OBJ_050_oPCAN_RADAR_83b89502_Tx: ComBitPosition=255, ComBitSize=16, ComSignalType=UINT16, ComSystemTemplateSystemSignalRef=OBJ_ALIVE_TIME_050
            OBJ_CLS_TYPE1_050_oRDR_TRACKER_OBJ_050_oPCAN_RADAR_14637424_Tx: ComBitPosition=271, ComBitSize=4, ComSignalType=UINT8, ComSystemTemplateSystemSignalRef=OBJ_CLS_TYPE1_050
            OBJ_CLS_TYPE1_PROB_050_oRDR_TRACKER_OBJ_050_oPCAN_RADAR_bc3ba3d7_Tx: ComBitPosition=303, ComBitSize=8, ComSignalType=UINT8, ComSystemTemplateSystemSignalRef=OBJ_CLS_TYPE1_PROB_050
            OBJ_CLS_TYPE2_050_oRDR_TRACKER_OBJ_050_oPCAN_RADAR_598b7443_Tx: ComBitPosition=267, ComBitSize=4, ComSignalType=UINT8, ComSystemTemplateSystemSignalRef=OBJ_CLS_TYPE2_050
            OBJ_CLS_TYPE2_PROB_050_oRDR_TRACKER_OBJ_050_oPCAN_RADAR_750fb8da_Tx: ComBitPosition=311, ComBitSize=8, ComSignalType=UINT8, ComSystemTemplateSystemSignalRef=OBJ_CLS_TYPE2_PROB_050
            OBJ_CLS_TYPE3_050_oRDR_TRACKER_OBJ_050_oPCAN_RADAR_d40389a1_Tx: ComBitPosition=279, ComBitSize=4, ComSignalType=UINT8, ComSystemTemplateSystemSignalRef=OBJ_CLS_TYPE3_050
            OBJ_CLS_TYPE3_PROB_050_oRDR_TRACKER_OBJ_050_oPCAN_RADAR_321c4e21_Tx: ComBitPosition=319, ComBitSize=8, ComSignalType=UINT8, ComSystemTemplateSystemSignalRef=OBJ_CLS_TYPE3_PROB_050
            OBJ_CLS_TYPE4_050_oRDR_TRACKER_OBJ_050_oPCAN_RADAR_c25b748d_Tx: ComBitPosition=275, ComBitSize=4, ComSignalType=UINT8, ComSystemTemplateSystemSignalRef=OBJ_CLS_TYPE4_050
            OBJ_CLS_TYPE4_PROB_050_oRDR_TRACKER_OBJ_050_oPCAN_RADAR_3c168881_Tx: ComBitPosition=327, ComBitSize=8, ComSignalType=UINT8, ComSystemTemplateSystemSignalRef=OBJ_CLS_TYPE4_PROB_050
            OBJ_CLS_TYPE5_050_oRDR_TRACKER_OBJ_050_oPCAN_RADAR_4fd3896f_Tx: ComBitPosition=287, ComBitSize=4, ComSignalType=UINT8, ComSystemTemplateSystemSignalRef=OBJ_CLS_TYPE5_050
            OBJ_CLS_TYPE5_PROB_050_oRDR_TRACKER_OBJ_050_oPCAN_RADAR_7b057e7a_Tx: ComBitPosition=335, ComBitSize=8, ComSignalType=UINT8, ComSystemTemplateSystemSignalRef=OBJ_CLS_TYPE5_PROB_050
            OBJ_CLS_TYPE6_050_oRDR_TRACKER_OBJ_050_oPCAN_RADAR_023b8908_Tx: ComBitPosition=282, ComBitSize=4, ComSignalType=UINT8, ComSystemTemplateSystemSignalRef=OBJ_CLS_TYPE6_050
            OBJ_CLS_TYPE6_PROB_050_oRDR_TRACKER_OBJ_050_oPCAN_RADAR_b2316577_Tx: ComBitPosition=343, ComBitSize=8, ComSignalType=UINT8, ComSystemTemplateSystemSignalRef=OBJ_CLS_TYPE6_PROB_050
            OBJ_DIMENSION_LENGTH_050_oRDR_TRACKER_OBJ_050_oPCAN_RADAR_56fd2760_Tx: ComBitPosition=37, ComBitSize=12, ComSignalType=UINT16, ComSystemTemplateSystemSignalRef=OBJ_DIMENSION_LENGTH_050
            OBJ_DIMENSION_LENGTH_ERR_050_oRDR_TRACKER_OBJ_050_oPCAN_RADAR_6d05381a_Tx: ComBitPosition=41, ComBitSize=10, ComSignalType=UINT16, ComSystemTemplateSystemSignalRef=OBJ_DIMENSION_LENGTH_ERR_050
            OBJ_DIMENSION_WIDTH_050_oRDR_TRACKER_OBJ_050_oPCAN_RADAR_7533d0cd_Tx: ComBitPosition=17, ComBitSize=10, ComSignalType=UINT16, ComSystemTemplateSystemSignalRef=OBJ_DIMENSION_WIDTH_050
            OBJ_DIMENSION_WIDTH_ERR_050_oRDR_TRACKER_OBJ_050_oPCAN_RADAR_95911725_Tx: ComBitPosition=23, ComBitSize=6, ComSignalType=UINT8, ComSystemTemplateSystemSignalRef=OBJ_DIMENSION_WIDTH_ERR_050
            OBJ_EXISTENCE_PROB_050_oRDR_TRACKER_OBJ_050_oPCAN_RADAR_7e8f54f0_Tx: ComBitPosition=229, ComBitSize=14, ComSignalType=UINT16, ComSystemTemplateSystemSignalRef=OBJ_EXISTENCE_PROB_050
            OBJ_GROUP_ID_050_oRDR_TRACKER_OBJ_050_oPCAN_RADAR_f7fd405d_Tx: ComBitPosition=405, ComBitSize=6, ComSignalType=UINT8, ComSystemTemplateSystemSignalRef=OBJ_GROUP_ID_050
            OBJ_ID_050_oRDR_TRACKER_OBJ_050_oPCAN_RADAR_04d36b5a_Tx: ComBitPosition=7, ComBitSize=8, ComSignalType=UINT8, ComSystemTemplateSystemSignalRef=OBJ_ID_050
            OBJ_MEASUREMENT_STATUS_050_oRDR_TRACKER_OBJ_050_oPCAN_RADAR_7b0119e7_Tx: ComBitPosition=14, ComBitSize=3, ComSignalType=UINT8, ComSystemTemplateSystemSignalRef=OBJ_MEASUREMENT_STATUS_050
            OBJ_MH_CRC16_050_oRDR_TRACKER_OBJ_050_oPCAN_RADAR_0761aedb_Tx: ComBitPosition=495, ComBitSize=16, ComSignalType=UINT16, ComSystemTemplateSystemSignalRef=OBJ_MH_CRC16_050
            OBJ_MH_CYCLE_COUNTER_050_oRDR_TRACKER_OBJ_050_oPCAN_RADAR_7685f43a_Tx: ComBitPosition=487, ComBitSize=8, ComSignalType=UINT8, ComSystemTemplateSystemSignalRef=OBJ_MH_CYCLE_COUNTER_050
            OBJ_MOVEMENT_STATUS_050_oRDR_TRACKER_OBJ_050_oPCAN_RADAR_54af8cab_Tx: ComBitPosition=196, ComBitSize=3, ComSignalType=UINT8, ComSystemTemplateSystemSignalRef=OBJ_MOVEMENT_STATUS_050
            OBJ_POS_ERR_CRR_COEF_050_oRDR_TRACKER_OBJ_050_oPCAN_RADAR_c4d04c91_Tx: ComBitPosition=415, ComBitSize=8, ComSignalType=UINT8, ComSystemTemplateSystemSignalRef=OBJ_POS_ERR_CRR_COEF_050
            OBJ_POS_LAT_050_oRDR_TRACKER_OBJ_050_oPCAN_RADAR_267fb1dd_Tx: ComBitPosition=79, ComBitSize=16, ComSignalType=UINT16, ComSystemTemplateSystemSignalRef=OBJ_POS_LAT_050
            OBJ_POS_LAT_ERR_050_oRDR_TRACKER_OBJ_050_oPCAN_RADAR_2233e1ea_Tx: ComBitPosition=103, ComBitSize=8, ComSignalType=UINT8, ComSystemTemplateSystemSignalRef=OBJ_POS_LAT_ERR_050
            OBJ_POS_LONG_050_oRDR_TRACKER_OBJ_050_oPCAN_RADAR_97df5a12_Tx: ComBitPosition=63, ComBitSize=16, ComSignalType=UINT16, ComSystemTemplateSystemSignalRef=OBJ_POS_LONG_050
            OBJ_POS_LONG_ERR_050_oRDR_TRACKER_OBJ_050_oPCAN_RADAR_bbcb1f08_Tx: ComBitPosition=95, ComBitSize=8, ComSignalType=UINT8, ComSystemTemplateSystemSignalRef=OBJ_POS_LONG_ERR_050
            OBJ_RCS_050_oRDR_TRACKER_OBJ_050_oPCAN_RADAR_04b0e7da_Tx: ComBitPosition=351, ComBitSize=7, ComSignalType=UINT8, ComSystemTemplateSystemSignalRef=OBJ_RCS_050
            OBJ_REF_PT_LAT_OFFSET_050_oRDR_TRACKER_OBJ_050_oPCAN_RADAR_f18d8caf_Tx: ComBitPosition=370, ComBitSize=14, ComSignalType=UINT16, ComSystemTemplateSystemSignalRef=OBJ_REF_PT_LAT_OFFSET_050
            OBJ_REF_PT_LONG_OFFSET_050_oRDR_TRACKER_OBJ_050_oPCAN_RADAR_bedf7cac_Tx: ComBitPosition=357, ComBitSize=14, ComSignalType=UINT16, ComSystemTemplateSystemSignalRef=OBJ_REF_PT_LONG_OFFSET_050
            OBJ_TIMESTAMP_OFFSET_050_oRDR_TRACKER_OBJ_050_oPCAN_RADAR_041ce78c_Tx: ComBitPosition=247, ComBitSize=8, ComSignalType=UINT8, ComSystemTemplateSystemSignalRef=OBJ_TIMESTAMP_OFFSET_050
            OBJ_TRACK_MOTION_MODEL_050_oRDR_TRACKER_OBJ_050_oPCAN_RADAR_c81fe651_Tx: ComBitPosition=9, ComBitSize=2, ComSignalType=UINT8, ComSystemTemplateSystemSignalRef=OBJ_TRACK_MOTION_MODEL_050
            OBJ_VEH_TRACK_FLAG_050_oRDR_TRACKER_OBJ_050_oPCAN_RADAR_4a35100c_Tx: ComBitPosition=10, ComBitSize=1, ComSignalType=BOOLEAN, ComSystemTemplateSystemSignalRef=OBJ_VEH_TRACK_FLAG_050
            OBJ_VELOCITY_ERR_CRR_COEF_050_oRDR_TRACKER_OBJ_050_oPCAN_RADAR_6daa7170_Tx: ComBitPosition=423, ComBitSize=8, ComSignalType=UINT8, ComSystemTemplateSystemSignalRef=OBJ_VELOCITY_ERR_CRR_COEF_050
            OBJ_VELOCITY_LAT_050_oRDR_TRACKER_OBJ_050_oPCAN_RADAR_621cf4fa_Tx: ComBitPosition=126, ComBitSize=15, ComSignalType=UINT16, ComSystemTemplateSystemSignalRef=OBJ_VELOCITY_LAT_050
            OBJ_VELOCITY_LAT_ERR_050_oRDR_TRACKER_OBJ_050_oPCAN_RADAR_56e684ab_Tx: ComBitPosition=151, ComBitSize=8, ComSignalType=UINT8, ComSystemTemplateSystemSignalRef=OBJ_VELOCITY_LAT_ERR_050
            OBJ_VELOCITY_LONG_050_oRDR_TRACKER_OBJ_050_oPCAN_RADAR_32918c3c_Tx: ComBitPosition=110, ComBitSize=15, ComSignalType=UINT16, ComSystemTemplateSystemSignalRef=OBJ_VELOCITY_LONG_050
            OBJ_VELOCITY_LONG_ERR_050_oRDR_TRACKER_OBJ_050_oPCAN_RADAR_ba64bb6b_Tx: ComBitPosition=143, ComBitSize=8, ComSignalType=UINT8, ComSystemTemplateSystemSignalRef=OBJ_VELOCITY_LONG_ERR_050
            OBJ_YAW_ANGLE_050_oRDR_TRACKER_OBJ_050_oPCAN_RADAR_8ea0b0ba_Tx: ComBitPosition=155, ComBitSize=12, ComSignalType=UINT16, ComSystemTemplateSystemSignalRef=OBJ_YAW_ANGLE_050
            OBJ_YAW_ANGLE_ERR_050_oRDR_TRACKER_OBJ_050_oPCAN_RADAR_5badb66d_Tx: ComBitPosition=175, ComBitSize=7, ComSignalType=UINT8, ComSystemTemplateSystemSignalRef=OBJ_YAW_ANGLE_ERR_050
            OBJ_YAW_RATE_050_oRDR_TRACKER_OBJ_050_oPCAN_RADAR_ab2f95fd_Tx: ComBitPosition=399, ComBitSize=10, ComSignalType=UINT16, ComSystemTemplateSystemSignalRef=OBJ_YAW_RATE_050
            OBJ_YAW_RATE_ERR_050_oRDR_TRACKER_OBJ_050_oPCAN_RADAR_94f70221_Tx: ComBitPosition=388, ComBitSize=5, ComSignalType=UINT8, ComSystemTemplateSystemSignalRef=OBJ_YAW_RATE_ERR_050
        SG_TrackerObject051_oRDR_TRACKER_OBJ_051_oPCAN_RADAR_6619549a_Tx: ComSystemTemplateSignalGroupRef=SG_TrackerObject051
          49 x ComGroupSignal, all with ComSignalEndianness=BIG_ENDIAN, ComSignalInitValue=0, ComTransferProperty=PENDING:
            OBJ_ACCELERATION_LAT_051_oRDR_TRACKER_OBJ_051_oPCAN_RADAR_683d0fed_Tx: ComBitPosition=177, ComBitSize=10, ComSignalType=UINT16, ComSystemTemplateSystemSignalRef=OBJ_ACCELERATION_LAT_051
            OBJ_ACCELERATION_LAT_ERR_051_oRDR_TRACKER_OBJ_051_oPCAN_RADAR_bdc93553_Tx: ComBitPosition=223, ComBitSize=8, ComSignalType=UINT8, ComSystemTemplateSystemSignalRef=OBJ_ACCELERATION_LAT_ERR_051
            OBJ_ACCELERATION_LONG_051_oRDR_TRACKER_OBJ_051_oPCAN_RADAR_1acd560d_Tx: ComBitPosition=193, ComBitSize=10, ComSignalType=UINT16, ComSystemTemplateSystemSignalRef=OBJ_ACCELERATION_LONG_051
            OBJ_ACCELERATION_LONG_ERR_051_oRDR_TRACKER_OBJ_051_oPCAN_RADAR_a26c90f9_Tx: ComBitPosition=215, ComBitSize=8, ComSignalType=UINT8, ComSystemTemplateSystemSignalRef=OBJ_ACCELERATION_LONG_ERR_051
            OBJ_ACCEL_ERR_CRR_COEF_051_oRDR_TRACKER_OBJ_051_oPCAN_RADAR_02cfb19f_Tx: ComBitPosition=431, ComBitSize=8, ComSignalType=UINT8, ComSystemTemplateSystemSignalRef=OBJ_ACCEL_ERR_CRR_COEF_051
            OBJ_ALIVE_TIME_051_oRDR_TRACKER_OBJ_051_oPCAN_RADAR_7aac1db1_Tx: ComBitPosition=255, ComBitSize=16, ComSignalType=UINT16, ComSystemTemplateSystemSignalRef=OBJ_ALIVE_TIME_051
            OBJ_CLS_TYPE1_051_oRDR_TRACKER_OBJ_051_oPCAN_RADAR_ed77fc97_Tx: ComBitPosition=271, ComBitSize=4, ComSignalType=UINT8, ComSystemTemplateSystemSignalRef=OBJ_CLS_TYPE1_051
            OBJ_CLS_TYPE1_PROB_051_oRDR_TRACKER_OBJ_051_oPCAN_RADAR_452f2b64_Tx: ComBitPosition=303, ComBitSize=8, ComSignalType=UINT8, ComSystemTemplateSystemSignalRef=OBJ_CLS_TYPE1_PROB_051
            OBJ_CLS_TYPE2_051_oRDR_TRACKER_OBJ_051_oPCAN_RADAR_a09ffcf0_Tx: ComBitPosition=267, ComBitSize=4, ComSignalType=UINT8, ComSystemTemplateSystemSignalRef=OBJ_CLS_TYPE2_051
            OBJ_CLS_TYPE2_PROB_051_oRDR_TRACKER_OBJ_051_oPCAN_RADAR_8c1b3069_Tx: ComBitPosition=311, ComBitSize=8, ComSignalType=UINT8, ComSystemTemplateSystemSignalRef=OBJ_CLS_TYPE2_PROB_051
            OBJ_CLS_TYPE3_051_oRDR_TRACKER_OBJ_051_oPCAN_RADAR_2d170112_Tx: ComBitPosition=279, ComBitSize=4, ComSignalType=UINT8, ComSystemTemplateSystemSignalRef=OBJ_CLS_TYPE3_051
            OBJ_CLS_TYPE3_PROB_051_oRDR_TRACKER_OBJ_051_oPCAN_RADAR_cb08c692_Tx: ComBitPosition=319, ComBitSize=8, ComSignalType=UINT8, ComSystemTemplateSystemSignalRef=OBJ_CLS_TYPE3_PROB_051
            OBJ_CLS_TYPE4_051_oRDR_TRACKER_OBJ_051_oPCAN_RADAR_3b4ffc3e_Tx: ComBitPosition=275, ComBitSize=4, ComSignalType=UINT8, ComSystemTemplateSystemSignalRef=OBJ_CLS_TYPE4_051
            OBJ_CLS_TYPE4_PROB_051_oRDR_TRACKER_OBJ_051_oPCAN_RADAR_c5020032_Tx: ComBitPosition=327, ComBitSize=8, ComSignalType=UINT8, ComSystemTemplateSystemSignalRef=OBJ_CLS_TYPE4_PROB_051
            OBJ_CLS_TYPE5_051_oRDR_TRACKER_OBJ_051_oPCAN_RADAR_b6c701dc_Tx: ComBitPosition=287, ComBitSize=4, ComSignalType=UINT8, ComSystemTemplateSystemSignalRef=OBJ_CLS_TYPE5_051
            OBJ_CLS_TYPE5_PROB_051_oRDR_TRACKER_OBJ_051_oPCAN_RADAR_8211f6c9_Tx: ComBitPosition=335, ComBitSize=8, ComSignalType=UINT8, ComSystemTemplateSystemSignalRef=OBJ_CLS_TYPE5_PROB_051
            OBJ_CLS_TYPE6_051_oRDR_TRACKER_OBJ_051_oPCAN_RADAR_fb2f01bb_Tx: ComBitPosition=282, ComBitSize=4, ComSignalType=UINT8, ComSystemTemplateSystemSignalRef=OBJ_CLS_TYPE6_051
            OBJ_CLS_TYPE6_PROB_051_oRDR_TRACKER_OBJ_051_oPCAN_RADAR_4b25edc4_Tx: ComBitPosition=343, ComBitSize=8, ComSignalType=UINT8, ComSystemTemplateSystemSignalRef=OBJ_CLS_TYPE6_PROB_051
            OBJ_DIMENSION_LENGTH_051_oRDR_TRACKER_OBJ_051_oPCAN_RADAR_afe9afd3_Tx: ComBitPosition=37, ComBitSize=12, ComSignalType=UINT16, ComSystemTemplateSystemSignalRef=OBJ_DIMENSION_LENGTH_051
            OBJ_DIMENSION_LENGTH_ERR_051_oRDR_TRACKER_OBJ_051_oPCAN_RADAR_9411b0a9_Tx: ComBitPosition=41, ComBitSize=10, ComSignalType=UINT16, ComSystemTemplateSystemSignalRef=OBJ_DIMENSION_LENGTH_ERR_051
            OBJ_DIMENSION_WIDTH_051_oRDR_TRACKER_OBJ_051_oPCAN_RADAR_8c27587e_Tx: ComBitPosition=17, ComBitSize=10, ComSignalType=UINT16, ComSystemTemplateSystemSignalRef=OBJ_DIMENSION_WIDTH_051
            OBJ_DIMENSION_WIDTH_ERR_051_oRDR_TRACKER_OBJ_051_oPCAN_RADAR_6c859f96_Tx: ComBitPosition=23, ComBitSize=6, ComSignalType=UINT8, ComSystemTemplateSystemSignalRef=OBJ_DIMENSION_WIDTH_ERR_051
            OBJ_EXISTENCE_PROB_051_oRDR_TRACKER_OBJ_051_oPCAN_RADAR_879bdc43_Tx: ComBitPosition=229, ComBitSize=14, ComSignalType=UINT16, ComSystemTemplateSystemSignalRef=OBJ_EXISTENCE_PROB_051
            OBJ_GROUP_ID_051_oRDR_TRACKER_OBJ_051_oPCAN_RADAR_0ee9c8ee_Tx: ComBitPosition=405, ComBitSize=6, ComSignalType=UINT8, ComSystemTemplateSystemSignalRef=OBJ_GROUP_ID_051
            OBJ_ID_051_oRDR_TRACKER_OBJ_051_oPCAN_RADAR_fdc7e3e9_Tx: ComBitPosition=7, ComBitSize=8, ComSignalType=UINT8, ComSystemTemplateSystemSignalRef=OBJ_ID_051
            OBJ_MEASUREMENT_STATUS_051_oRDR_TRACKER_OBJ_051_oPCAN_RADAR_82159154_Tx: ComBitPosition=14, ComBitSize=3, ComSignalType=UINT8, ComSystemTemplateSystemSignalRef=OBJ_MEASUREMENT_STATUS_051
            OBJ_MH_CRC16_051_oRDR_TRACKER_OBJ_051_oPCAN_RADAR_fe752668_Tx: ComBitPosition=495, ComBitSize=16, ComSignalType=UINT16, ComSystemTemplateSystemSignalRef=OBJ_MH_CRC16_051
            OBJ_MH_CYCLE_COUNTER_051_oRDR_TRACKER_OBJ_051_oPCAN_RADAR_8f917c89_Tx: ComBitPosition=487, ComBitSize=8, ComSignalType=UINT8, ComSystemTemplateSystemSignalRef=OBJ_MH_CYCLE_COUNTER_051
            OBJ_MOVEMENT_STATUS_051_oRDR_TRACKER_OBJ_051_oPCAN_RADAR_adbb0418_Tx: ComBitPosition=196, ComBitSize=3, ComSignalType=UINT8, ComSystemTemplateSystemSignalRef=OBJ_MOVEMENT_STATUS_051
            OBJ_POS_ERR_CRR_COEF_051_oRDR_TRACKER_OBJ_051_oPCAN_RADAR_3dc4c422_Tx: ComBitPosition=415, ComBitSize=8, ComSignalType=UINT8, ComSystemTemplateSystemSignalRef=OBJ_POS_ERR_CRR_COEF_051
            OBJ_POS_LAT_051_oRDR_TRACKER_OBJ_051_oPCAN_RADAR_df6b396e_Tx: ComBitPosition=79, ComBitSize=16, ComSignalType=UINT16, ComSystemTemplateSystemSignalRef=OBJ_POS_LAT_051
            OBJ_POS_LAT_ERR_051_oRDR_TRACKER_OBJ_051_oPCAN_RADAR_db276959_Tx: ComBitPosition=103, ComBitSize=8, ComSignalType=UINT8, ComSystemTemplateSystemSignalRef=OBJ_POS_LAT_ERR_051
            OBJ_POS_LONG_051_oRDR_TRACKER_OBJ_051_oPCAN_RADAR_6ecbd2a1_Tx: ComBitPosition=63, ComBitSize=16, ComSignalType=UINT16, ComSystemTemplateSystemSignalRef=OBJ_POS_LONG_051
            OBJ_POS_LONG_ERR_051_oRDR_TRACKER_OBJ_051_oPCAN_RADAR_42df97bb_Tx: ComBitPosition=95, ComBitSize=8, ComSignalType=UINT8, ComSystemTemplateSystemSignalRef=OBJ_POS_LONG_ERR_051
            OBJ_RCS_051_oRDR_TRACKER_OBJ_051_oPCAN_RADAR_fda46f69_Tx: ComBitPosition=351, ComBitSize=7, ComSignalType=UINT8, ComSystemTemplateSystemSignalRef=OBJ_RCS_051
            OBJ_REF_PT_LAT_OFFSET_051_oRDR_TRACKER_OBJ_051_oPCAN_RADAR_0899041c_Tx: ComBitPosition=370, ComBitSize=14, ComSignalType=UINT16, ComSystemTemplateSystemSignalRef=OBJ_REF_PT_LAT_OFFSET_051
            OBJ_REF_PT_LONG_OFFSET_051_oRDR_TRACKER_OBJ_051_oPCAN_RADAR_47cbf41f_Tx: ComBitPosition=357, ComBitSize=14, ComSignalType=UINT16, ComSystemTemplateSystemSignalRef=OBJ_REF_PT_LONG_OFFSET_051
            OBJ_TIMESTAMP_OFFSET_051_oRDR_TRACKER_OBJ_051_oPCAN_RADAR_fd086f3f_Tx: ComBitPosition=247, ComBitSize=8, ComSignalType=UINT8, ComSystemTemplateSystemSignalRef=OBJ_TIMESTAMP_OFFSET_051
            OBJ_TRACK_MOTION_MODEL_051_oRDR_TRACKER_OBJ_051_oPCAN_RADAR_310b6ee2_Tx: ComBitPosition=9, ComBitSize=2, ComSignalType=UINT8, ComSystemTemplateSystemSignalRef=OBJ_TRACK_MOTION_MODEL_051
            OBJ_VEH_TRACK_FLAG_051_oRDR_TRACKER_OBJ_051_oPCAN_RADAR_b32198bf_Tx: ComBitPosition=10, ComBitSize=1, ComSignalType=BOOLEAN, ComSystemTemplateSystemSignalRef=OBJ_VEH_TRACK_FLAG_051
            OBJ_VELOCITY_ERR_CRR_COEF_051_oRDR_TRACKER_OBJ_051_oPCAN_RADAR_94bef9c3_Tx: ComBitPosition=423, ComBitSize=8, ComSignalType=UINT8, ComSystemTemplateSystemSignalRef=OBJ_VELOCITY_ERR_CRR_COEF_051
            OBJ_VELOCITY_LAT_051_oRDR_TRACKER_OBJ_051_oPCAN_RADAR_9b087c49_Tx: ComBitPosition=126, ComBitSize=15, ComSignalType=UINT16, ComSystemTemplateSystemSignalRef=OBJ_VELOCITY_LAT_051
            OBJ_VELOCITY_LAT_ERR_051_oRDR_TRACKER_OBJ_051_oPCAN_RADAR_aff20c18_Tx: ComBitPosition=151, ComBitSize=8, ComSignalType=UINT8, ComSystemTemplateSystemSignalRef=OBJ_VELOCITY_LAT_ERR_051
            OBJ_VELOCITY_LONG_051_oRDR_TRACKER_OBJ_051_oPCAN_RADAR_cb85048f_Tx: ComBitPosition=110, ComBitSize=15, ComSignalType=UINT16, ComSystemTemplateSystemSignalRef=OBJ_VELOCITY_LONG_051
            OBJ_VELOCITY_LONG_ERR_051_oRDR_TRACKER_OBJ_051_oPCAN_RADAR_437033d8_Tx: ComBitPosition=143, ComBitSize=8, ComSignalType=UINT8, ComSystemTemplateSystemSignalRef=OBJ_VELOCITY_LONG_ERR_051
            OBJ_YAW_ANGLE_051_oRDR_TRACKER_OBJ_051_oPCAN_RADAR_77b43809_Tx: ComBitPosition=155, ComBitSize=12, ComSignalType=UINT16, ComSystemTemplateSystemSignalRef=OBJ_YAW_ANGLE_051
            OBJ_YAW_ANGLE_ERR_051_oRDR_TRACKER_OBJ_051_oPCAN_RADAR_a2b93ede_Tx: ComBitPosition=175, ComBitSize=7, ComSignalType=UINT8, ComSystemTemplateSystemSignalRef=OBJ_YAW_ANGLE_ERR_051
            OBJ_YAW_RATE_051_oRDR_TRACKER_OBJ_051_oPCAN_RADAR_523b1d4e_Tx: ComBitPosition=399, ComBitSize=10, ComSignalType=UINT16, ComSystemTemplateSystemSignalRef=OBJ_YAW_RATE_051
            OBJ_YAW_RATE_ERR_051_oRDR_TRACKER_OBJ_051_oPCAN_RADAR_6de38a92_Tx: ComBitPosition=388, ComBitSize=5, ComSignalType=UINT8, ComSystemTemplateSystemSignalRef=OBJ_YAW_RATE_ERR_051
        SG_TrackerObject052_oRDR_TRACKER_OBJ_052_oPCAN_RADAR_b655cb0e_Tx: ComSystemTemplateSignalGroupRef=SG_TrackerObject052
          49 x ComGroupSignal, all with ComSignalEndianness=BIG_ENDIAN, ComSignalInitValue=0, ComTransferProperty=PENDING:
            OBJ_ACCELERATION_LAT_052_oRDR_TRACKER_OBJ_052_oPCAN_RADAR_b8719079_Tx: ComBitPosition=177, ComBitSize=10, ComSignalType=UINT16, ComSystemTemplateSystemSignalRef=OBJ_ACCELERATION_LAT_052
            OBJ_ACCELERATION_LAT_ERR_052_oRDR_TRACKER_OBJ_052_oPCAN_RADAR_6d85aac7_Tx: ComBitPosition=223, ComBitSize=8, ComSignalType=UINT8, ComSystemTemplateSystemSignalRef=OBJ_ACCELERATION_LAT_ERR_052
            OBJ_ACCELERATION_LONG_052_oRDR_TRACKER_OBJ_052_oPCAN_RADAR_ca81c999_Tx: ComBitPosition=193, ComBitSize=10, ComSignalType=UINT16, ComSystemTemplateSystemSignalRef=OBJ_ACCELERATION_LONG_052
            OBJ_ACCELERATION_LONG_ERR_052_oRDR_TRACKER_OBJ_052_oPCAN_RADAR_72200f6d_Tx: ComBitPosition=215, ComBitSize=8, ComSignalType=UINT8, ComSystemTemplateSystemSignalRef=OBJ_ACCELERATION_LONG_ERR_052
            OBJ_ACCEL_ERR_CRR_COEF_052_oRDR_TRACKER_OBJ_052_oPCAN_RADAR_d2832e0b_Tx: ComBitPosition=431, ComBitSize=8, ComSignalType=UINT8, ComSystemTemplateSystemSignalRef=OBJ_ACCEL_ERR_CRR_COEF_052
            OBJ_ALIVE_TIME_052_oRDR_TRACKER_OBJ_052_oPCAN_RADAR_aae08225_Tx: ComBitPosition=255, ComBitSize=16, ComSignalType=UINT16, ComSystemTemplateSystemSignalRef=OBJ_ALIVE_TIME_052
            OBJ_CLS_TYPE1_052_oRDR_TRACKER_OBJ_052_oPCAN_RADAR_3d3b6303_Tx: ComBitPosition=271, ComBitSize=4, ComSignalType=UINT8, ComSystemTemplateSystemSignalRef=OBJ_CLS_TYPE1_052
            OBJ_CLS_TYPE1_PROB_052_oRDR_TRACKER_OBJ_052_oPCAN_RADAR_9563b4f0_Tx: ComBitPosition=303, ComBitSize=8, ComSignalType=UINT8, ComSystemTemplateSystemSignalRef=OBJ_CLS_TYPE1_PROB_052
            OBJ_CLS_TYPE2_052_oRDR_TRACKER_OBJ_052_oPCAN_RADAR_70d36364_Tx: ComBitPosition=267, ComBitSize=4, ComSignalType=UINT8, ComSystemTemplateSystemSignalRef=OBJ_CLS_TYPE2_052
            OBJ_CLS_TYPE2_PROB_052_oRDR_TRACKER_OBJ_052_oPCAN_RADAR_5c57affd_Tx: ComBitPosition=311, ComBitSize=8, ComSignalType=UINT8, ComSystemTemplateSystemSignalRef=OBJ_CLS_TYPE2_PROB_052
            OBJ_CLS_TYPE3_052_oRDR_TRACKER_OBJ_052_oPCAN_RADAR_fd5b9e86_Tx: ComBitPosition=279, ComBitSize=4, ComSignalType=UINT8, ComSystemTemplateSystemSignalRef=OBJ_CLS_TYPE3_052
            OBJ_CLS_TYPE3_PROB_052_oRDR_TRACKER_OBJ_052_oPCAN_RADAR_1b445906_Tx: ComBitPosition=319, ComBitSize=8, ComSignalType=UINT8, ComSystemTemplateSystemSignalRef=OBJ_CLS_TYPE3_PROB_052
            OBJ_CLS_TYPE4_052_oRDR_TRACKER_OBJ_052_oPCAN_RADAR_eb0363aa_Tx: ComBitPosition=275, ComBitSize=4, ComSignalType=UINT8, ComSystemTemplateSystemSignalRef=OBJ_CLS_TYPE4_052
            OBJ_CLS_TYPE4_PROB_052_oRDR_TRACKER_OBJ_052_oPCAN_RADAR_154e9fa6_Tx: ComBitPosition=327, ComBitSize=8, ComSignalType=UINT8, ComSystemTemplateSystemSignalRef=OBJ_CLS_TYPE4_PROB_052
            OBJ_CLS_TYPE5_052_oRDR_TRACKER_OBJ_052_oPCAN_RADAR_668b9e48_Tx: ComBitPosition=287, ComBitSize=4, ComSignalType=UINT8, ComSystemTemplateSystemSignalRef=OBJ_CLS_TYPE5_052
            OBJ_CLS_TYPE5_PROB_052_oRDR_TRACKER_OBJ_052_oPCAN_RADAR_525d695d_Tx: ComBitPosition=335, ComBitSize=8, ComSignalType=UINT8, ComSystemTemplateSystemSignalRef=OBJ_CLS_TYPE5_PROB_052
            OBJ_CLS_TYPE6_052_oRDR_TRACKER_OBJ_052_oPCAN_RADAR_2b639e2f_Tx: ComBitPosition=282, ComBitSize=4, ComSignalType=UINT8, ComSystemTemplateSystemSignalRef=OBJ_CLS_TYPE6_052
            OBJ_CLS_TYPE6_PROB_052_oRDR_TRACKER_OBJ_052_oPCAN_RADAR_9b697250_Tx: ComBitPosition=343, ComBitSize=8, ComSignalType=UINT8, ComSystemTemplateSystemSignalRef=OBJ_CLS_TYPE6_PROB_052
            OBJ_DIMENSION_LENGTH_052_oRDR_TRACKER_OBJ_052_oPCAN_RADAR_7fa53047_Tx: ComBitPosition=37, ComBitSize=12, ComSignalType=UINT16, ComSystemTemplateSystemSignalRef=OBJ_DIMENSION_LENGTH_052
            OBJ_DIMENSION_LENGTH_ERR_052_oRDR_TRACKER_OBJ_052_oPCAN_RADAR_445d2f3d_Tx: ComBitPosition=41, ComBitSize=10, ComSignalType=UINT16, ComSystemTemplateSystemSignalRef=OBJ_DIMENSION_LENGTH_ERR_052
            OBJ_DIMENSION_WIDTH_052_oRDR_TRACKER_OBJ_052_oPCAN_RADAR_5c6bc7ea_Tx: ComBitPosition=17, ComBitSize=10, ComSignalType=UINT16, ComSystemTemplateSystemSignalRef=OBJ_DIMENSION_WIDTH_052
            OBJ_DIMENSION_WIDTH_ERR_052_oRDR_TRACKER_OBJ_052_oPCAN_RADAR_bcc90002_Tx: ComBitPosition=23, ComBitSize=6, ComSignalType=UINT8, ComSystemTemplateSystemSignalRef=OBJ_DIMENSION_WIDTH_ERR_052
            OBJ_EXISTENCE_PROB_052_oRDR_TRACKER_OBJ_052_oPCAN_RADAR_57d743d7_Tx: ComBitPosition=229, ComBitSize=14, ComSignalType=UINT16, ComSystemTemplateSystemSignalRef=OBJ_EXISTENCE_PROB_052
            OBJ_GROUP_ID_052_oRDR_TRACKER_OBJ_052_oPCAN_RADAR_dea5577a_Tx: ComBitPosition=405, ComBitSize=6, ComSignalType=UINT8, ComSystemTemplateSystemSignalRef=OBJ_GROUP_ID_052
            OBJ_ID_052_oRDR_TRACKER_OBJ_052_oPCAN_RADAR_2d8b7c7d_Tx: ComBitPosition=7, ComBitSize=8, ComSignalType=UINT8, ComSystemTemplateSystemSignalRef=OBJ_ID_052
            OBJ_MEASUREMENT_STATUS_052_oRDR_TRACKER_OBJ_052_oPCAN_RADAR_52590ec0_Tx: ComBitPosition=14, ComBitSize=3, ComSignalType=UINT8, ComSystemTemplateSystemSignalRef=OBJ_MEASUREMENT_STATUS_052
            OBJ_MH_CRC16_052_oRDR_TRACKER_OBJ_052_oPCAN_RADAR_2e39b9fc_Tx: ComBitPosition=495, ComBitSize=16, ComSignalType=UINT16, ComSystemTemplateSystemSignalRef=OBJ_MH_CRC16_052
            OBJ_MH_CYCLE_COUNTER_052_oRDR_TRACKER_OBJ_052_oPCAN_RADAR_5fdde31d_Tx: ComBitPosition=487, ComBitSize=8, ComSignalType=UINT8, ComSystemTemplateSystemSignalRef=OBJ_MH_CYCLE_COUNTER_052
            OBJ_MOVEMENT_STATUS_052_oRDR_TRACKER_OBJ_052_oPCAN_RADAR_7df79b8c_Tx: ComBitPosition=196, ComBitSize=3, ComSignalType=UINT8, ComSystemTemplateSystemSignalRef=OBJ_MOVEMENT_STATUS_052
            OBJ_POS_ERR_CRR_COEF_052_oRDR_TRACKER_OBJ_052_oPCAN_RADAR_ed885bb6_Tx: ComBitPosition=415, ComBitSize=8, ComSignalType=UINT8, ComSystemTemplateSystemSignalRef=OBJ_POS_ERR_CRR_COEF_052
            OBJ_POS_LAT_052_oRDR_TRACKER_OBJ_052_oPCAN_RADAR_0f27a6fa_Tx: ComBitPosition=79, ComBitSize=16, ComSignalType=UINT16, ComSystemTemplateSystemSignalRef=OBJ_POS_LAT_052
            OBJ_POS_LAT_ERR_052_oRDR_TRACKER_OBJ_052_oPCAN_RADAR_0b6bf6cd_Tx: ComBitPosition=103, ComBitSize=8, ComSignalType=UINT8, ComSystemTemplateSystemSignalRef=OBJ_POS_LAT_ERR_052
            OBJ_POS_LONG_052_oRDR_TRACKER_OBJ_052_oPCAN_RADAR_be874d35_Tx: ComBitPosition=63, ComBitSize=16, ComSignalType=UINT16, ComSystemTemplateSystemSignalRef=OBJ_POS_LONG_052
            OBJ_POS_LONG_ERR_052_oRDR_TRACKER_OBJ_052_oPCAN_RADAR_9293082f_Tx: ComBitPosition=95, ComBitSize=8, ComSignalType=UINT8, ComSystemTemplateSystemSignalRef=OBJ_POS_LONG_ERR_052
            OBJ_RCS_052_oRDR_TRACKER_OBJ_052_oPCAN_RADAR_2de8f0fd_Tx: ComBitPosition=351, ComBitSize=7, ComSignalType=UINT8, ComSystemTemplateSystemSignalRef=OBJ_RCS_052
            OBJ_REF_PT_LAT_OFFSET_052_oRDR_TRACKER_OBJ_052_oPCAN_RADAR_d8d59b88_Tx: ComBitPosition=370, ComBitSize=14, ComSignalType=UINT16, ComSystemTemplateSystemSignalRef=OBJ_REF_PT_LAT_OFFSET_052
            OBJ_REF_PT_LONG_OFFSET_052_oRDR_TRACKER_OBJ_052_oPCAN_RADAR_97876b8b_Tx: ComBitPosition=357, ComBitSize=14, ComSignalType=UINT16, ComSystemTemplateSystemSignalRef=OBJ_REF_PT_LONG_OFFSET_052
            OBJ_TIMESTAMP_OFFSET_052_oRDR_TRACKER_OBJ_052_oPCAN_RADAR_2d44f0ab_Tx: ComBitPosition=247, ComBitSize=8, ComSignalType=UINT8, ComSystemTemplateSystemSignalRef=OBJ_TIMESTAMP_OFFSET_052
            OBJ_TRACK_MOTION_MODEL_052_oRDR_TRACKER_OBJ_052_oPCAN_RADAR_e147f176_Tx: ComBitPosition=9, ComBitSize=2, ComSignalType=UINT8, ComSystemTemplateSystemSignalRef=OBJ_TRACK_MOTION_MODEL_052
            OBJ_VEH_TRACK_FLAG_052_oRDR_TRACKER_OBJ_052_oPCAN_RADAR_636d072b_Tx: ComBitPosition=10, ComBitSize=1, ComSignalType=BOOLEAN, ComSystemTemplateSystemSignalRef=OBJ_VEH_TRACK_FLAG_052
            OBJ_VELOCITY_ERR_CRR_COEF_052_oRDR_TRACKER_OBJ_052_oPCAN_RADAR_44f26657_Tx: ComBitPosition=423, ComBitSize=8, ComSignalType=UINT8, ComSystemTemplateSystemSignalRef=OBJ_VELOCITY_ERR_CRR_COEF_052
            OBJ_VELOCITY_LAT_052_oRDR_TRACKER_OBJ_052_oPCAN_RADAR_4b44e3dd_Tx: ComBitPosition=126, ComBitSize=15, ComSignalType=UINT16, ComSystemTemplateSystemSignalRef=OBJ_VELOCITY_LAT_052
            OBJ_VELOCITY_LAT_ERR_052_oRDR_TRACKER_OBJ_052_oPCAN_RADAR_7fbe938c_Tx: ComBitPosition=151, ComBitSize=8, ComSignalType=UINT8, ComSystemTemplateSystemSignalRef=OBJ_VELOCITY_LAT_ERR_052
            OBJ_VELOCITY_LONG_052_oRDR_TRACKER_OBJ_052_oPCAN_RADAR_1bc99b1b_Tx: ComBitPosition=110, ComBitSize=15, ComSignalType=UINT16, ComSystemTemplateSystemSignalRef=OBJ_VELOCITY_LONG_052
            OBJ_VELOCITY_LONG_ERR_052_oRDR_TRACKER_OBJ_052_oPCAN_RADAR_933cac4c_Tx: ComBitPosition=143, ComBitSize=8, ComSignalType=UINT8, ComSystemTemplateSystemSignalRef=OBJ_VELOCITY_LONG_ERR_052
            OBJ_YAW_ANGLE_052_oRDR_TRACKER_OBJ_052_oPCAN_RADAR_a7f8a79d_Tx: ComBitPosition=155, ComBitSize=12, ComSignalType=UINT16, ComSystemTemplateSystemSignalRef=OBJ_YAW_ANGLE_052
            OBJ_YAW_ANGLE_ERR_052_oRDR_TRACKER_OBJ_052_oPCAN_RADAR_72f5a14a_Tx: ComBitPosition=175, ComBitSize=7, ComSignalType=UINT8, ComSystemTemplateSystemSignalRef=OBJ_YAW_ANGLE_ERR_052
            OBJ_YAW_RATE_052_oRDR_TRACKER_OBJ_052_oPCAN_RADAR_827782da_Tx: ComBitPosition=399, ComBitSize=10, ComSignalType=UINT16, ComSystemTemplateSystemSignalRef=OBJ_YAW_RATE_052
            OBJ_YAW_RATE_ERR_052_oRDR_TRACKER_OBJ_052_oPCAN_RADAR_bdaf1506_Tx: ComBitPosition=388, ComBitSize=5, ComSignalType=UINT8, ComSystemTemplateSystemSignalRef=OBJ_YAW_RATE_ERR_052
        SG_TrackerObject053_oRDR_TRACKER_OBJ_053_oPCAN_RADAR_4f4143bd_Tx: ComSystemTemplateSignalGroupRef=SG_TrackerObject053
          49 x ComGroupSignal, all with ComSignalEndianness=BIG_ENDIAN, ComSignalInitValue=0, ComTransferProperty=PENDING:
            OBJ_ACCELERATION_LAT_053_oRDR_TRACKER_OBJ_053_oPCAN_RADAR_416518ca_Tx: ComBitPosition=177, ComBitSize=10, ComSignalType=UINT16, ComSystemTemplateSystemSignalRef=OBJ_ACCELERATION_LAT_053
            OBJ_ACCELERATION_LAT_ERR_053_oRDR_TRACKER_OBJ_053_oPCAN_RADAR_94912274_Tx: ComBitPosition=223, ComBitSize=8, ComSignalType=UINT8, ComSystemTemplateSystemSignalRef=OBJ_ACCELERATION_LAT_ERR_053
            OBJ_ACCELERATION_LONG_053_oRDR_TRACKER_OBJ_053_oPCAN_RADAR_3395412a_Tx: ComBitPosition=193, ComBitSize=10, ComSignalType=UINT16, ComSystemTemplateSystemSignalRef=OBJ_ACCELERATION_LONG_053
            OBJ_ACCELERATION_LONG_ERR_053_oRDR_TRACKER_OBJ_053_oPCAN_RADAR_8b3487de_Tx: ComBitPosition=215, ComBitSize=8, ComSignalType=UINT8, ComSystemTemplateSystemSignalRef=OBJ_ACCELERATION_LONG_ERR_053
            OBJ_ACCEL_ERR_CRR_COEF_053_oRDR_TRACKER_OBJ_053_oPCAN_RADAR_2b97a6b8_Tx: ComBitPosition=431, ComBitSize=8, ComSignalType=UINT8, ComSystemTemplateSystemSignalRef=OBJ_ACCEL_ERR_CRR_COEF_053
            OBJ_ALIVE_TIME_053_oRDR_TRACKER_OBJ_053_oPCAN_RADAR_53f40a96_Tx: ComBitPosition=255, ComBitSize=16, ComSignalType=UINT16, ComSystemTemplateSystemSignalRef=OBJ_ALIVE_TIME_053
            OBJ_CLS_TYPE1_053_oRDR_TRACKER_OBJ_053_oPCAN_RADAR_c42febb0_Tx: ComBitPosition=271, ComBitSize=4, ComSignalType=UINT8, ComSystemTemplateSystemSignalRef=OBJ_CLS_TYPE1_053
            OBJ_CLS_TYPE1_PROB_053_oRDR_TRACKER_OBJ_053_oPCAN_RADAR_6c773c43_Tx: ComBitPosition=303, ComBitSize=8, ComSignalType=UINT8, ComSystemTemplateSystemSignalRef=OBJ_CLS_TYPE1_PROB_053
            OBJ_CLS_TYPE2_053_oRDR_TRACKER_OBJ_053_oPCAN_RADAR_89c7ebd7_Tx: ComBitPosition=267, ComBitSize=4, ComSignalType=UINT8, ComSystemTemplateSystemSignalRef=OBJ_CLS_TYPE2_053
            OBJ_CLS_TYPE2_PROB_053_oRDR_TRACKER_OBJ_053_oPCAN_RADAR_a543274e_Tx: ComBitPosition=311, ComBitSize=8, ComSignalType=UINT8, ComSystemTemplateSystemSignalRef=OBJ_CLS_TYPE2_PROB_053
            OBJ_CLS_TYPE3_053_oRDR_TRACKER_OBJ_053_oPCAN_RADAR_044f1635_Tx: ComBitPosition=279, ComBitSize=4, ComSignalType=UINT8, ComSystemTemplateSystemSignalRef=OBJ_CLS_TYPE3_053
            OBJ_CLS_TYPE3_PROB_053_oRDR_TRACKER_OBJ_053_oPCAN_RADAR_e250d1b5_Tx: ComBitPosition=319, ComBitSize=8, ComSignalType=UINT8, ComSystemTemplateSystemSignalRef=OBJ_CLS_TYPE3_PROB_053
            OBJ_CLS_TYPE4_053_oRDR_TRACKER_OBJ_053_oPCAN_RADAR_1217eb19_Tx: ComBitPosition=275, ComBitSize=4, ComSignalType=UINT8, ComSystemTemplateSystemSignalRef=OBJ_CLS_TYPE4_053
            OBJ_CLS_TYPE4_PROB_053_oRDR_TRACKER_OBJ_053_oPCAN_RADAR_ec5a1715_Tx: ComBitPosition=327, ComBitSize=8, ComSignalType=UINT8, ComSystemTemplateSystemSignalRef=OBJ_CLS_TYPE4_PROB_053
            OBJ_CLS_TYPE5_053_oRDR_TRACKER_OBJ_053_oPCAN_RADAR_9f9f16fb_Tx: ComBitPosition=287, ComBitSize=4, ComSignalType=UINT8, ComSystemTemplateSystemSignalRef=OBJ_CLS_TYPE5_053
            OBJ_CLS_TYPE5_PROB_053_oRDR_TRACKER_OBJ_053_oPCAN_RADAR_ab49e1ee_Tx: ComBitPosition=335, ComBitSize=8, ComSignalType=UINT8, ComSystemTemplateSystemSignalRef=OBJ_CLS_TYPE5_PROB_053
            OBJ_CLS_TYPE6_053_oRDR_TRACKER_OBJ_053_oPCAN_RADAR_d277169c_Tx: ComBitPosition=282, ComBitSize=4, ComSignalType=UINT8, ComSystemTemplateSystemSignalRef=OBJ_CLS_TYPE6_053
            OBJ_CLS_TYPE6_PROB_053_oRDR_TRACKER_OBJ_053_oPCAN_RADAR_627dfae3_Tx: ComBitPosition=343, ComBitSize=8, ComSignalType=UINT8, ComSystemTemplateSystemSignalRef=OBJ_CLS_TYPE6_PROB_053
            OBJ_DIMENSION_LENGTH_053_oRDR_TRACKER_OBJ_053_oPCAN_RADAR_86b1b8f4_Tx: ComBitPosition=37, ComBitSize=12, ComSignalType=UINT16, ComSystemTemplateSystemSignalRef=OBJ_DIMENSION_LENGTH_053
            OBJ_DIMENSION_LENGTH_ERR_053_oRDR_TRACKER_OBJ_053_oPCAN_RADAR_bd49a78e_Tx: ComBitPosition=41, ComBitSize=10, ComSignalType=UINT16, ComSystemTemplateSystemSignalRef=OBJ_DIMENSION_LENGTH_ERR_053
            OBJ_DIMENSION_WIDTH_053_oRDR_TRACKER_OBJ_053_oPCAN_RADAR_a57f4f59_Tx: ComBitPosition=17, ComBitSize=10, ComSignalType=UINT16, ComSystemTemplateSystemSignalRef=OBJ_DIMENSION_WIDTH_053
            OBJ_DIMENSION_WIDTH_ERR_053_oRDR_TRACKER_OBJ_053_oPCAN_RADAR_45dd88b1_Tx: ComBitPosition=23, ComBitSize=6, ComSignalType=UINT8, ComSystemTemplateSystemSignalRef=OBJ_DIMENSION_WIDTH_ERR_053
            OBJ_EXISTENCE_PROB_053_oRDR_TRACKER_OBJ_053_oPCAN_RADAR_aec3cb64_Tx: ComBitPosition=229, ComBitSize=14, ComSignalType=UINT16, ComSystemTemplateSystemSignalRef=OBJ_EXISTENCE_PROB_053
            OBJ_GROUP_ID_053_oRDR_TRACKER_OBJ_053_oPCAN_RADAR_27b1dfc9_Tx: ComBitPosition=405, ComBitSize=6, ComSignalType=UINT8, ComSystemTemplateSystemSignalRef=OBJ_GROUP_ID_053
            OBJ_ID_053_oRDR_TRACKER_OBJ_053_oPCAN_RADAR_d49ff4ce_Tx: ComBitPosition=7, ComBitSize=8, ComSignalType=UINT8, ComSystemTemplateSystemSignalRef=OBJ_ID_053
            OBJ_MEASUREMENT_STATUS_053_oRDR_TRACKER_OBJ_053_oPCAN_RADAR_ab4d8673_Tx: ComBitPosition=14, ComBitSize=3, ComSignalType=UINT8, ComSystemTemplateSystemSignalRef=OBJ_MEASUREMENT_STATUS_053
            OBJ_MH_CRC16_053_oRDR_TRACKER_OBJ_053_oPCAN_RADAR_d72d314f_Tx: ComBitPosition=495, ComBitSize=16, ComSignalType=UINT16, ComSystemTemplateSystemSignalRef=OBJ_MH_CRC16_053
            OBJ_MH_CYCLE_COUNTER_053_oRDR_TRACKER_OBJ_053_oPCAN_RADAR_a6c96bae_Tx: ComBitPosition=487, ComBitSize=8, ComSignalType=UINT8, ComSystemTemplateSystemSignalRef=OBJ_MH_CYCLE_COUNTER_053
            OBJ_MOVEMENT_STATUS_053_oRDR_TRACKER_OBJ_053_oPCAN_RADAR_84e3133f_Tx: ComBitPosition=196, ComBitSize=3, ComSignalType=UINT8, ComSystemTemplateSystemSignalRef=OBJ_MOVEMENT_STATUS_053
            OBJ_POS_ERR_CRR_COEF_053_oRDR_TRACKER_OBJ_053_oPCAN_RADAR_149cd305_Tx: ComBitPosition=415, ComBitSize=8, ComSignalType=UINT8, ComSystemTemplateSystemSignalRef=OBJ_POS_ERR_CRR_COEF_053
            OBJ_POS_LAT_053_oRDR_TRACKER_OBJ_053_oPCAN_RADAR_f6332e49_Tx: ComBitPosition=79, ComBitSize=16, ComSignalType=UINT16, ComSystemTemplateSystemSignalRef=OBJ_POS_LAT_053
            OBJ_POS_LAT_ERR_053_oRDR_TRACKER_OBJ_053_oPCAN_RADAR_f27f7e7e_Tx: ComBitPosition=103, ComBitSize=8, ComSignalType=UINT8, ComSystemTemplateSystemSignalRef=OBJ_POS_LAT_ERR_053
            OBJ_POS_LONG_053_oRDR_TRACKER_OBJ_053_oPCAN_RADAR_4793c586_Tx: ComBitPosition=63, ComBitSize=16, ComSignalType=UINT16, ComSystemTemplateSystemSignalRef=OBJ_POS_LONG_053
            OBJ_POS_LONG_ERR_053_oRDR_TRACKER_OBJ_053_oPCAN_RADAR_6b87809c_Tx: ComBitPosition=95, ComBitSize=8, ComSignalType=UINT8, ComSystemTemplateSystemSignalRef=OBJ_POS_LONG_ERR_053
            OBJ_RCS_053_oRDR_TRACKER_OBJ_053_oPCAN_RADAR_d4fc784e_Tx: ComBitPosition=351, ComBitSize=7, ComSignalType=UINT8, ComSystemTemplateSystemSignalRef=OBJ_RCS_053
            OBJ_REF_PT_LAT_OFFSET_053_oRDR_TRACKER_OBJ_053_oPCAN_RADAR_21c1133b_Tx: ComBitPosition=370, ComBitSize=14, ComSignalType=UINT16, ComSystemTemplateSystemSignalRef=OBJ_REF_PT_LAT_OFFSET_053
            OBJ_REF_PT_LONG_OFFSET_053_oRDR_TRACKER_OBJ_053_oPCAN_RADAR_6e93e338_Tx: ComBitPosition=357, ComBitSize=14, ComSignalType=UINT16, ComSystemTemplateSystemSignalRef=OBJ_REF_PT_LONG_OFFSET_053
            OBJ_TIMESTAMP_OFFSET_053_oRDR_TRACKER_OBJ_053_oPCAN_RADAR_d4507818_Tx: ComBitPosition=247, ComBitSize=8, ComSignalType=UINT8, ComSystemTemplateSystemSignalRef=OBJ_TIMESTAMP_OFFSET_053
            OBJ_TRACK_MOTION_MODEL_053_oRDR_TRACKER_OBJ_053_oPCAN_RADAR_185379c5_Tx: ComBitPosition=9, ComBitSize=2, ComSignalType=UINT8, ComSystemTemplateSystemSignalRef=OBJ_TRACK_MOTION_MODEL_053
            OBJ_VEH_TRACK_FLAG_053_oRDR_TRACKER_OBJ_053_oPCAN_RADAR_9a798f98_Tx: ComBitPosition=10, ComBitSize=1, ComSignalType=BOOLEAN, ComSystemTemplateSystemSignalRef=OBJ_VEH_TRACK_FLAG_053
            OBJ_VELOCITY_ERR_CRR_COEF_053_oRDR_TRACKER_OBJ_053_oPCAN_RADAR_bde6eee4_Tx: ComBitPosition=423, ComBitSize=8, ComSignalType=UINT8, ComSystemTemplateSystemSignalRef=OBJ_VELOCITY_ERR_CRR_COEF_053
            OBJ_VELOCITY_LAT_053_oRDR_TRACKER_OBJ_053_oPCAN_RADAR_b2506b6e_Tx: ComBitPosition=126, ComBitSize=15, ComSignalType=UINT16, ComSystemTemplateSystemSignalRef=OBJ_VELOCITY_LAT_053
            OBJ_VELOCITY_LAT_ERR_053_oRDR_TRACKER_OBJ_053_oPCAN_RADAR_86aa1b3f_Tx: ComBitPosition=151, ComBitSize=8, ComSignalType=UINT8, ComSystemTemplateSystemSignalRef=OBJ_VELOCITY_LAT_ERR_053
            OBJ_VELOCITY_LONG_053_oRDR_TRACKER_OBJ_053_oPCAN_RADAR_e2dd13a8_Tx: ComBitPosition=110, ComBitSize=15, ComSignalType=UINT16, ComSystemTemplateSystemSignalRef=OBJ_VELOCITY_LONG_053
            OBJ_VELOCITY_LONG_ERR_053_oRDR_TRACKER_OBJ_053_oPCAN_RADAR_6a2824ff_Tx: ComBitPosition=143, ComBitSize=8, ComSignalType=UINT8, ComSystemTemplateSystemSignalRef=OBJ_VELOCITY_LONG_ERR_053
            OBJ_YAW_ANGLE_053_oRDR_TRACKER_OBJ_053_oPCAN_RADAR_5eec2f2e_Tx: ComBitPosition=155, ComBitSize=12, ComSignalType=UINT16, ComSystemTemplateSystemSignalRef=OBJ_YAW_ANGLE_053
            OBJ_YAW_ANGLE_ERR_053_oRDR_TRACKER_OBJ_053_oPCAN_RADAR_8be129f9_Tx: ComBitPosition=175, ComBitSize=7, ComSignalType=UINT8, ComSystemTemplateSystemSignalRef=OBJ_YAW_ANGLE_ERR_053
            OBJ_YAW_RATE_053_oRDR_TRACKER_OBJ_053_oPCAN_RADAR_7b630a69_Tx: ComBitPosition=399, ComBitSize=10, ComSignalType=UINT16, ComSystemTemplateSystemSignalRef=OBJ_YAW_RATE_053
            OBJ_YAW_RATE_ERR_053_oRDR_TRACKER_OBJ_053_oPCAN_RADAR_44bb9db5_Tx: ComBitPosition=388, ComBitSize=5, ComSignalType=UINT8, ComSystemTemplateSystemSignalRef=OBJ_YAW_RATE_ERR_053
        SG_TrackerObject054_oRDR_TRACKER_OBJ_054_oPCAN_RADAR_cdbdf267_Tx: ComSystemTemplateSignalGroupRef=SG_TrackerObject054
          49 x ComGroupSignal, all with ComSignalEndianness=BIG_ENDIAN, ComSignalInitValue=0, ComTransferProperty=PENDING:
            OBJ_ACCELERATION_LAT_054_oRDR_TRACKER_OBJ_054_oPCAN_RADAR_c399a910_Tx: ComBitPosition=177, ComBitSize=10, ComSignalType=UINT16, ComSystemTemplateSystemSignalRef=OBJ_ACCELERATION_LAT_054
            OBJ_ACCELERATION_LAT_ERR_054_oRDR_TRACKER_OBJ_054_oPCAN_RADAR_166d93ae_Tx: ComBitPosition=223, ComBitSize=8, ComSignalType=UINT8, ComSystemTemplateSystemSignalRef=OBJ_ACCELERATION_LAT_ERR_054
            OBJ_ACCELERATION_LONG_054_oRDR_TRACKER_OBJ_054_oPCAN_RADAR_b169f0f0_Tx: ComBitPosition=193, ComBitSize=10, ComSignalType=UINT16, ComSystemTemplateSystemSignalRef=OBJ_ACCELERATION_LONG_054
            OBJ_ACCELERATION_LONG_ERR_054_oRDR_TRACKER_OBJ_054_oPCAN_RADAR_09c83604_Tx: ComBitPosition=215, ComBitSize=8, ComSignalType=UINT8, ComSystemTemplateSystemSignalRef=OBJ_ACCELERATION_LONG_ERR_054
            OBJ_ACCEL_ERR_CRR_COEF_054_oRDR_TRACKER_OBJ_054_oPCAN_RADAR_a96b1762_Tx: ComBitPosition=431, ComBitSize=8, ComSignalType=UINT8, ComSystemTemplateSystemSignalRef=OBJ_ACCEL_ERR_CRR_COEF_054
            OBJ_ALIVE_TIME_054_oRDR_TRACKER_OBJ_054_oPCAN_RADAR_d108bb4c_Tx: ComBitPosition=255, ComBitSize=16, ComSignalType=UINT16, ComSystemTemplateSystemSignalRef=OBJ_ALIVE_TIME_054
            OBJ_CLS_TYPE1_054_oRDR_TRACKER_OBJ_054_oPCAN_RADAR_46d35a6a_Tx: ComBitPosition=271, ComBitSize=4, ComSignalType=UINT8, ComSystemTemplateSystemSignalRef=OBJ_CLS_TYPE1_054
            OBJ_CLS_TYPE1_PROB_054_oRDR_TRACKER_OBJ_054_oPCAN_RADAR_ee8b8d99_Tx: ComBitPosition=303, ComBitSize=8, ComSignalType=UINT8, ComSystemTemplateSystemSignalRef=OBJ_CLS_TYPE1_PROB_054
            OBJ_CLS_TYPE2_054_oRDR_TRACKER_OBJ_054_oPCAN_RADAR_0b3b5a0d_Tx: ComBitPosition=267, ComBitSize=4, ComSignalType=UINT8, ComSystemTemplateSystemSignalRef=OBJ_CLS_TYPE2_054
            OBJ_CLS_TYPE2_PROB_054_oRDR_TRACKER_OBJ_054_oPCAN_RADAR_27bf9694_Tx: ComBitPosition=311, ComBitSize=8, ComSignalType=UINT8, ComSystemTemplateSystemSignalRef=OBJ_CLS_TYPE2_PROB_054
            OBJ_CLS_TYPE3_054_oRDR_TRACKER_OBJ_054_oPCAN_RADAR_86b3a7ef_Tx: ComBitPosition=279, ComBitSize=4, ComSignalType=UINT8, ComSystemTemplateSystemSignalRef=OBJ_CLS_TYPE3_054
            OBJ_CLS_TYPE3_PROB_054_oRDR_TRACKER_OBJ_054_oPCAN_RADAR_60ac606f_Tx: ComBitPosition=319, ComBitSize=8, ComSignalType=UINT8, ComSystemTemplateSystemSignalRef=OBJ_CLS_TYPE3_PROB_054
            OBJ_CLS_TYPE4_054_oRDR_TRACKER_OBJ_054_oPCAN_RADAR_90eb5ac3_Tx: ComBitPosition=275, ComBitSize=4, ComSignalType=UINT8, ComSystemTemplateSystemSignalRef=OBJ_CLS_TYPE4_054
            OBJ_CLS_TYPE4_PROB_054_oRDR_TRACKER_OBJ_054_oPCAN_RADAR_6ea6a6cf_Tx: ComBitPosition=327, ComBitSize=8, ComSignalType=UINT8, ComSystemTemplateSystemSignalRef=OBJ_CLS_TYPE4_PROB_054
            OBJ_CLS_TYPE5_054_oRDR_TRACKER_OBJ_054_oPCAN_RADAR_1d63a721_Tx: ComBitPosition=287, ComBitSize=4, ComSignalType=UINT8, ComSystemTemplateSystemSignalRef=OBJ_CLS_TYPE5_054
            OBJ_CLS_TYPE5_PROB_054_oRDR_TRACKER_OBJ_054_oPCAN_RADAR_29b55034_Tx: ComBitPosition=335, ComBitSize=8, ComSignalType=UINT8, ComSystemTemplateSystemSignalRef=OBJ_CLS_TYPE5_PROB_054
            OBJ_CLS_TYPE6_054_oRDR_TRACKER_OBJ_054_oPCAN_RADAR_508ba746_Tx: ComBitPosition=282, ComBitSize=4, ComSignalType=UINT8, ComSystemTemplateSystemSignalRef=OBJ_CLS_TYPE6_054
            OBJ_CLS_TYPE6_PROB_054_oRDR_TRACKER_OBJ_054_oPCAN_RADAR_e0814b39_Tx: ComBitPosition=343, ComBitSize=8, ComSignalType=UINT8, ComSystemTemplateSystemSignalRef=OBJ_CLS_TYPE6_PROB_054
            OBJ_DIMENSION_LENGTH_054_oRDR_TRACKER_OBJ_054_oPCAN_RADAR_044d092e_Tx: ComBitPosition=37, ComBitSize=12, ComSignalType=UINT16, ComSystemTemplateSystemSignalRef=OBJ_DIMENSION_LENGTH_054
            OBJ_DIMENSION_LENGTH_ERR_054_oRDR_TRACKER_OBJ_054_oPCAN_RADAR_3fb51654_Tx: ComBitPosition=41, ComBitSize=10, ComSignalType=UINT16, ComSystemTemplateSystemSignalRef=OBJ_DIMENSION_LENGTH_ERR_054
            OBJ_DIMENSION_WIDTH_054_oRDR_TRACKER_OBJ_054_oPCAN_RADAR_2783fe83_Tx: ComBitPosition=17, ComBitSize=10, ComSignalType=UINT16, ComSystemTemplateSystemSignalRef=OBJ_DIMENSION_WIDTH_054
            OBJ_DIMENSION_WIDTH_ERR_054_oRDR_TRACKER_OBJ_054_oPCAN_RADAR_c721396b_Tx: ComBitPosition=23, ComBitSize=6, ComSignalType=UINT8, ComSystemTemplateSystemSignalRef=OBJ_DIMENSION_WIDTH_ERR_054
            OBJ_EXISTENCE_PROB_054_oRDR_TRACKER_OBJ_054_oPCAN_RADAR_2c3f7abe_Tx: ComBitPosition=229, ComBitSize=14, ComSignalType=UINT16, ComSystemTemplateSystemSignalRef=OBJ_EXISTENCE_PROB_054
            OBJ_GROUP_ID_054_oRDR_TRACKER_OBJ_054_oPCAN_RADAR_a54d6e13_Tx: ComBitPosition=405, ComBitSize=6, ComSignalType=UINT8, ComSystemTemplateSystemSignalRef=OBJ_GROUP_ID_054
            OBJ_ID_054_oRDR_TRACKER_OBJ_054_oPCAN_RADAR_56634514_Tx: ComBitPosition=7, ComBitSize=8, ComSignalType=UINT8, ComSystemTemplateSystemSignalRef=OBJ_ID_054
            OBJ_MEASUREMENT_STATUS_054_oRDR_TRACKER_OBJ_054_oPCAN_RADAR_29b137a9_Tx: ComBitPosition=14, ComBitSize=3, ComSignalType=UINT8, ComSystemTemplateSystemSignalRef=OBJ_MEASUREMENT_STATUS_054
            OBJ_MH_CRC16_054_oRDR_TRACKER_OBJ_054_oPCAN_RADAR_55d18095_Tx: ComBitPosition=495, ComBitSize=16, ComSignalType=UINT16, ComSystemTemplateSystemSignalRef=OBJ_MH_CRC16_054
            OBJ_MH_CYCLE_COUNTER_054_oRDR_TRACKER_OBJ_054_oPCAN_RADAR_2435da74_Tx: ComBitPosition=487, ComBitSize=8, ComSignalType=UINT8, ComSystemTemplateSystemSignalRef=OBJ_MH_CYCLE_COUNTER_054
            OBJ_MOVEMENT_STATUS_054_oRDR_TRACKER_OBJ_054_oPCAN_RADAR_061fa2e5_Tx: ComBitPosition=196, ComBitSize=3, ComSignalType=UINT8, ComSystemTemplateSystemSignalRef=OBJ_MOVEMENT_STATUS_054
            OBJ_POS_ERR_CRR_COEF_054_oRDR_TRACKER_OBJ_054_oPCAN_RADAR_966062df_Tx: ComBitPosition=415, ComBitSize=8, ComSignalType=UINT8, ComSystemTemplateSystemSignalRef=OBJ_POS_ERR_CRR_COEF_054
            OBJ_POS_LAT_054_oRDR_TRACKER_OBJ_054_oPCAN_RADAR_74cf9f93_Tx: ComBitPosition=79, ComBitSize=16, ComSignalType=UINT16, ComSystemTemplateSystemSignalRef=OBJ_POS_LAT_054
            OBJ_POS_LAT_ERR_054_oRDR_TRACKER_OBJ_054_oPCAN_RADAR_7083cfa4_Tx: ComBitPosition=103, ComBitSize=8, ComSignalType=UINT8, ComSystemTemplateSystemSignalRef=OBJ_POS_LAT_ERR_054
            OBJ_POS_LONG_054_oRDR_TRACKER_OBJ_054_oPCAN_RADAR_c56f745c_Tx: ComBitPosition=63, ComBitSize=16, ComSignalType=UINT16, ComSystemTemplateSystemSignalRef=OBJ_POS_LONG_054
            OBJ_POS_LONG_ERR_054_oRDR_TRACKER_OBJ_054_oPCAN_RADAR_e97b3146_Tx: ComBitPosition=95, ComBitSize=8, ComSignalType=UINT8, ComSystemTemplateSystemSignalRef=OBJ_POS_LONG_ERR_054
            OBJ_RCS_054_oRDR_TRACKER_OBJ_054_oPCAN_RADAR_5600c994_Tx: ComBitPosition=351, ComBitSize=7, ComSignalType=UINT8, ComSystemTemplateSystemSignalRef=OBJ_RCS_054
            OBJ_REF_PT_LAT_OFFSET_054_oRDR_TRACKER_OBJ_054_oPCAN_RADAR_a33da2e1_Tx: ComBitPosition=370, ComBitSize=14, ComSignalType=UINT16, ComSystemTemplateSystemSignalRef=OBJ_REF_PT_LAT_OFFSET_054
            OBJ_REF_PT_LONG_OFFSET_054_oRDR_TRACKER_OBJ_054_oPCAN_RADAR_ec6f52e2_Tx: ComBitPosition=357, ComBitSize=14, ComSignalType=UINT16, ComSystemTemplateSystemSignalRef=OBJ_REF_PT_LONG_OFFSET_054
            OBJ_TIMESTAMP_OFFSET_054_oRDR_TRACKER_OBJ_054_oPCAN_RADAR_56acc9c2_Tx: ComBitPosition=247, ComBitSize=8, ComSignalType=UINT8, ComSystemTemplateSystemSignalRef=OBJ_TIMESTAMP_OFFSET_054
            OBJ_TRACK_MOTION_MODEL_054_oRDR_TRACKER_OBJ_054_oPCAN_RADAR_9aafc81f_Tx: ComBitPosition=9, ComBitSize=2, ComSignalType=UINT8, ComSystemTemplateSystemSignalRef=OBJ_TRACK_MOTION_MODEL_054
            OBJ_VEH_TRACK_FLAG_054_oRDR_TRACKER_OBJ_054_oPCAN_RADAR_18853e42_Tx: ComBitPosition=10, ComBitSize=1, ComSignalType=BOOLEAN, ComSystemTemplateSystemSignalRef=OBJ_VEH_TRACK_FLAG_054
            OBJ_VELOCITY_ERR_CRR_COEF_054_oRDR_TRACKER_OBJ_054_oPCAN_RADAR_3f1a5f3e_Tx: ComBitPosition=423, ComBitSize=8, ComSignalType=UINT8, ComSystemTemplateSystemSignalRef=OBJ_VELOCITY_ERR_CRR_COEF_054
            OBJ_VELOCITY_LAT_054_oRDR_TRACKER_OBJ_054_oPCAN_RADAR_30acdab4_Tx: ComBitPosition=126, ComBitSize=15, ComSignalType=UINT16, ComSystemTemplateSystemSignalRef=OBJ_VELOCITY_LAT_054
            OBJ_VELOCITY_LAT_ERR_054_oRDR_TRACKER_OBJ_054_oPCAN_RADAR_0456aae5_Tx: ComBitPosition=151, ComBitSize=8, ComSignalType=UINT8, ComSystemTemplateSystemSignalRef=OBJ_VELOCITY_LAT_ERR_054
            OBJ_VELOCITY_LONG_054_oRDR_TRACKER_OBJ_054_oPCAN_RADAR_6021a272_Tx: ComBitPosition=110, ComBitSize=15, ComSignalType=UINT16, ComSystemTemplateSystemSignalRef=OBJ_VELOCITY_LONG_054
            OBJ_VELOCITY_LONG_ERR_054_oRDR_TRACKER_OBJ_054_oPCAN_RADAR_e8d49525_Tx: ComBitPosition=143, ComBitSize=8, ComSignalType=UINT8, ComSystemTemplateSystemSignalRef=OBJ_VELOCITY_LONG_ERR_054
            OBJ_YAW_ANGLE_054_oRDR_TRACKER_OBJ_054_oPCAN_RADAR_dc109ef4_Tx: ComBitPosition=155, ComBitSize=12, ComSignalType=UINT16, ComSystemTemplateSystemSignalRef=OBJ_YAW_ANGLE_054
            OBJ_YAW_ANGLE_ERR_054_oRDR_TRACKER_OBJ_054_oPCAN_RADAR_091d9823_Tx: ComBitPosition=175, ComBitSize=7, ComSignalType=UINT8, ComSystemTemplateSystemSignalRef=OBJ_YAW_ANGLE_ERR_054
            OBJ_YAW_RATE_054_oRDR_TRACKER_OBJ_054_oPCAN_RADAR_f99fbbb3_Tx: ComBitPosition=399, ComBitSize=10, ComSignalType=UINT16, ComSystemTemplateSystemSignalRef=OBJ_YAW_RATE_054
            OBJ_YAW_RATE_ERR_054_oRDR_TRACKER_OBJ_054_oPCAN_RADAR_c6472c6f_Tx: ComBitPosition=388, ComBitSize=5, ComSignalType=UINT8, ComSystemTemplateSystemSignalRef=OBJ_YAW_RATE_ERR_054
        SG_TrackerObject055_oRDR_TRACKER_OBJ_055_oPCAN_RADAR_34a97ad4_Tx: ComSystemTemplateSignalGroupRef=SG_TrackerObject055
          49 x ComGroupSignal, all with ComSignalEndianness=BIG_ENDIAN, ComSignalInitValue=0, ComTransferProperty=PENDING:
            OBJ_ACCELERATION_LAT_055_oRDR_TRACKER_OBJ_055_oPCAN_RADAR_3a8d21a3_Tx: ComBitPosition=177, ComBitSize=10, ComSignalType=UINT16, ComSystemTemplateSystemSignalRef=OBJ_ACCELERATION_LAT_055
            OBJ_ACCELERATION_LAT_ERR_055_oRDR_TRACKER_OBJ_055_oPCAN_RADAR_ef791b1d_Tx: ComBitPosition=223, ComBitSize=8, ComSignalType=UINT8, ComSystemTemplateSystemSignalRef=OBJ_ACCELERATION_LAT_ERR_055
            OBJ_ACCELERATION_LONG_055_oRDR_TRACKER_OBJ_055_oPCAN_RADAR_487d7843_Tx: ComBitPosition=193, ComBitSize=10, ComSignalType=UINT16, ComSystemTemplateSystemSignalRef=OBJ_ACCELERATION_LONG_055
            OBJ_ACCELERATION_LONG_ERR_055_oRDR_TRACKER_OBJ_055_oPCAN_RADAR_f0dcbeb7_Tx: ComBitPosition=215, ComBitSize=8, ComSignalType=UINT8, ComSystemTemplateSystemSignalRef=OBJ_ACCELERATION_LONG_ERR_055
            OBJ_ACCEL_ERR_CRR_COEF_055_oRDR_TRACKER_OBJ_055_oPCAN_RADAR_507f9fd1_Tx: ComBitPosition=431, ComBitSize=8, ComSignalType=UINT8, ComSystemTemplateSystemSignalRef=OBJ_ACCEL_ERR_CRR_COEF_055
            OBJ_ALIVE_TIME_055_oRDR_TRACKER_OBJ_055_oPCAN_RADAR_281c33ff_Tx: ComBitPosition=255, ComBitSize=16, ComSignalType=UINT16, ComSystemTemplateSystemSignalRef=OBJ_ALIVE_TIME_055
            OBJ_CLS_TYPE1_055_oRDR_TRACKER_OBJ_055_oPCAN_RADAR_bfc7d2d9_Tx: ComBitPosition=271, ComBitSize=4, ComSignalType=UINT8, ComSystemTemplateSystemSignalRef=OBJ_CLS_TYPE1_055
            OBJ_CLS_TYPE1_PROB_055_oRDR_TRACKER_OBJ_055_oPCAN_RADAR_179f052a_Tx: ComBitPosition=303, ComBitSize=8, ComSignalType=UINT8, ComSystemTemplateSystemSignalRef=OBJ_CLS_TYPE1_PROB_055
            OBJ_CLS_TYPE2_055_oRDR_TRACKER_OBJ_055_oPCAN_RADAR_f22fd2be_Tx: ComBitPosition=267, ComBitSize=4, ComSignalType=UINT8, ComSystemTemplateSystemSignalRef=OBJ_CLS_TYPE2_055
            OBJ_CLS_TYPE2_PROB_055_oRDR_TRACKER_OBJ_055_oPCAN_RADAR_deab1e27_Tx: ComBitPosition=311, ComBitSize=8, ComSignalType=UINT8, ComSystemTemplateSystemSignalRef=OBJ_CLS_TYPE2_PROB_055
            OBJ_CLS_TYPE3_055_oRDR_TRACKER_OBJ_055_oPCAN_RADAR_7fa72f5c_Tx: ComBitPosition=279, ComBitSize=4, ComSignalType=UINT8, ComSystemTemplateSystemSignalRef=OBJ_CLS_TYPE3_055
            OBJ_CLS_TYPE3_PROB_055_oRDR_TRACKER_OBJ_055_oPCAN_RADAR_99b8e8dc_Tx: ComBitPosition=319, ComBitSize=8, ComSignalType=UINT8, ComSystemTemplateSystemSignalRef=OBJ_CLS_TYPE3_PROB_055
            OBJ_CLS_TYPE4_055_oRDR_TRACKER_OBJ_055_oPCAN_RADAR_69ffd270_Tx: ComBitPosition=275, ComBitSize=4, ComSignalType=UINT8, ComSystemTemplateSystemSignalRef=OBJ_CLS_TYPE4_055
            OBJ_CLS_TYPE4_PROB_055_oRDR_TRACKER_OBJ_055_oPCAN_RADAR_97b22e7c_Tx: ComBitPosition=327, ComBitSize=8, ComSignalType=UINT8, ComSystemTemplateSystemSignalRef=OBJ_CLS_TYPE4_PROB_055
            OBJ_CLS_TYPE5_055_oRDR_TRACKER_OBJ_055_oPCAN_RADAR_e4772f92_Tx: ComBitPosition=287, ComBitSize=4, ComSignalType=UINT8, ComSystemTemplateSystemSignalRef=OBJ_CLS_TYPE5_055
            OBJ_CLS_TYPE5_PROB_055_oRDR_TRACKER_OBJ_055_oPCAN_RADAR_d0a1d887_Tx: ComBitPosition=335, ComBitSize=8, ComSignalType=UINT8, ComSystemTemplateSystemSignalRef=OBJ_CLS_TYPE5_PROB_055
            OBJ_CLS_TYPE6_055_oRDR_TRACKER_OBJ_055_oPCAN_RADAR_a99f2ff5_Tx: ComBitPosition=282, ComBitSize=4, ComSignalType=UINT8, ComSystemTemplateSystemSignalRef=OBJ_CLS_TYPE6_055
            OBJ_CLS_TYPE6_PROB_055_oRDR_TRACKER_OBJ_055_oPCAN_RADAR_1995c38a_Tx: ComBitPosition=343, ComBitSize=8, ComSignalType=UINT8, ComSystemTemplateSystemSignalRef=OBJ_CLS_TYPE6_PROB_055
            OBJ_DIMENSION_LENGTH_055_oRDR_TRACKER_OBJ_055_oPCAN_RADAR_fd59819d_Tx: ComBitPosition=37, ComBitSize=12, ComSignalType=UINT16, ComSystemTemplateSystemSignalRef=OBJ_DIMENSION_LENGTH_055
            OBJ_DIMENSION_LENGTH_ERR_055_oRDR_TRACKER_OBJ_055_oPCAN_RADAR_c6a19ee7_Tx: ComBitPosition=41, ComBitSize=10, ComSignalType=UINT16, ComSystemTemplateSystemSignalRef=OBJ_DIMENSION_LENGTH_ERR_055
            OBJ_DIMENSION_WIDTH_055_oRDR_TRACKER_OBJ_055_oPCAN_RADAR_de977630_Tx: ComBitPosition=17, ComBitSize=10, ComSignalType=UINT16, ComSystemTemplateSystemSignalRef=OBJ_DIMENSION_WIDTH_055
            OBJ_DIMENSION_WIDTH_ERR_055_oRDR_TRACKER_OBJ_055_oPCAN_RADAR_3e35b1d8_Tx: ComBitPosition=23, ComBitSize=6, ComSignalType=UINT8, ComSystemTemplateSystemSignalRef=OBJ_DIMENSION_WIDTH_ERR_055
            OBJ_EXISTENCE_PROB_055_oRDR_TRACKER_OBJ_055_oPCAN_RADAR_d52bf20d_Tx: ComBitPosition=229, ComBitSize=14, ComSignalType=UINT16, ComSystemTemplateSystemSignalRef=OBJ_EXISTENCE_PROB_055
            OBJ_GROUP_ID_055_oRDR_TRACKER_OBJ_055_oPCAN_RADAR_5c59e6a0_Tx: ComBitPosition=405, ComBitSize=6, ComSignalType=UINT8, ComSystemTemplateSystemSignalRef=OBJ_GROUP_ID_055
            OBJ_ID_055_oRDR_TRACKER_OBJ_055_oPCAN_RADAR_af77cda7_Tx: ComBitPosition=7, ComBitSize=8, ComSignalType=UINT8, ComSystemTemplateSystemSignalRef=OBJ_ID_055
            OBJ_MEASUREMENT_STATUS_055_oRDR_TRACKER_OBJ_055_oPCAN_RADAR_d0a5bf1a_Tx: ComBitPosition=14, ComBitSize=3, ComSignalType=UINT8, ComSystemTemplateSystemSignalRef=OBJ_MEASUREMENT_STATUS_055
            OBJ_MH_CRC16_055_oRDR_TRACKER_OBJ_055_oPCAN_RADAR_acc50826_Tx: ComBitPosition=495, ComBitSize=16, ComSignalType=UINT16, ComSystemTemplateSystemSignalRef=OBJ_MH_CRC16_055
            OBJ_MH_CYCLE_COUNTER_055_oRDR_TRACKER_OBJ_055_oPCAN_RADAR_dd2152c7_Tx: ComBitPosition=487, ComBitSize=8, ComSignalType=UINT8, ComSystemTemplateSystemSignalRef=OBJ_MH_CYCLE_COUNTER_055
            OBJ_MOVEMENT_STATUS_055_oRDR_TRACKER_OBJ_055_oPCAN_RADAR_ff0b2a56_Tx: ComBitPosition=196, ComBitSize=3, ComSignalType=UINT8, ComSystemTemplateSystemSignalRef=OBJ_MOVEMENT_STATUS_055
            OBJ_POS_ERR_CRR_COEF_055_oRDR_TRACKER_OBJ_055_oPCAN_RADAR_6f74ea6c_Tx: ComBitPosition=415, ComBitSize=8, ComSignalType=UINT8, ComSystemTemplateSystemSignalRef=OBJ_POS_ERR_CRR_COEF_055
            OBJ_POS_LAT_055_oRDR_TRACKER_OBJ_055_oPCAN_RADAR_8ddb1720_Tx: ComBitPosition=79, ComBitSize=16, ComSignalType=UINT16, ComSystemTemplateSystemSignalRef=OBJ_POS_LAT_055
            OBJ_POS_LAT_ERR_055_oRDR_TRACKER_OBJ_055_oPCAN_RADAR_89974717_Tx: ComBitPosition=103, ComBitSize=8, ComSignalType=UINT8, ComSystemTemplateSystemSignalRef=OBJ_POS_LAT_ERR_055
            OBJ_POS_LONG_055_oRDR_TRACKER_OBJ_055_oPCAN_RADAR_3c7bfcef_Tx: ComBitPosition=63, ComBitSize=16, ComSignalType=UINT16, ComSystemTemplateSystemSignalRef=OBJ_POS_LONG_055
            OBJ_POS_LONG_ERR_055_oRDR_TRACKER_OBJ_055_oPCAN_RADAR_106fb9f5_Tx: ComBitPosition=95, ComBitSize=8, ComSignalType=UINT8, ComSystemTemplateSystemSignalRef=OBJ_POS_LONG_ERR_055
            OBJ_RCS_055_oRDR_TRACKER_OBJ_055_oPCAN_RADAR_af144127_Tx: ComBitPosition=351, ComBitSize=7, ComSignalType=UINT8, ComSystemTemplateSystemSignalRef=OBJ_RCS_055
            OBJ_REF_PT_LAT_OFFSET_055_oRDR_TRACKER_OBJ_055_oPCAN_RADAR_5a292a52_Tx: ComBitPosition=370, ComBitSize=14, ComSignalType=UINT16, ComSystemTemplateSystemSignalRef=OBJ_REF_PT_LAT_OFFSET_055
            OBJ_REF_PT_LONG_OFFSET_055_oRDR_TRACKER_OBJ_055_oPCAN_RADAR_157bda51_Tx: ComBitPosition=357, ComBitSize=14, ComSignalType=UINT16, ComSystemTemplateSystemSignalRef=OBJ_REF_PT_LONG_OFFSET_055
            OBJ_TIMESTAMP_OFFSET_055_oRDR_TRACKER_OBJ_055_oPCAN_RADAR_afb84171_Tx: ComBitPosition=247, ComBitSize=8, ComSignalType=UINT8, ComSystemTemplateSystemSignalRef=OBJ_TIMESTAMP_OFFSET_055
            OBJ_TRACK_MOTION_MODEL_055_oRDR_TRACKER_OBJ_055_oPCAN_RADAR_63bb40ac_Tx: ComBitPosition=9, ComBitSize=2, ComSignalType=UINT8, ComSystemTemplateSystemSignalRef=OBJ_TRACK_MOTION_MODEL_055
            OBJ_VEH_TRACK_FLAG_055_oRDR_TRACKER_OBJ_055_oPCAN_RADAR_e191b6f1_Tx: ComBitPosition=10, ComBitSize=1, ComSignalType=BOOLEAN, ComSystemTemplateSystemSignalRef=OBJ_VEH_TRACK_FLAG_055
            OBJ_VELOCITY_ERR_CRR_COEF_055_oRDR_TRACKER_OBJ_055_oPCAN_RADAR_c60ed78d_Tx: ComBitPosition=423, ComBitSize=8, ComSignalType=UINT8, ComSystemTemplateSystemSignalRef=OBJ_VELOCITY_ERR_CRR_COEF_055
            OBJ_VELOCITY_LAT_055_oRDR_TRACKER_OBJ_055_oPCAN_RADAR_c9b85207_Tx: ComBitPosition=126, ComBitSize=15, ComSignalType=UINT16, ComSystemTemplateSystemSignalRef=OBJ_VELOCITY_LAT_055
            OBJ_VELOCITY_LAT_ERR_055_oRDR_TRACKER_OBJ_055_oPCAN_RADAR_fd422256_Tx: ComBitPosition=151, ComBitSize=8, ComSignalType=UINT8, ComSystemTemplateSystemSignalRef=OBJ_VELOCITY_LAT_ERR_055
            OBJ_VELOCITY_LONG_055_oRDR_TRACKER_OBJ_055_oPCAN_RADAR_99352ac1_Tx: ComBitPosition=110, ComBitSize=15, ComSignalType=UINT16, ComSystemTemplateSystemSignalRef=OBJ_VELOCITY_LONG_055
            OBJ_VELOCITY_LONG_ERR_055_oRDR_TRACKER_OBJ_055_oPCAN_RADAR_11c01d96_Tx: ComBitPosition=143, ComBitSize=8, ComSignalType=UINT8, ComSystemTemplateSystemSignalRef=OBJ_VELOCITY_LONG_ERR_055
            OBJ_YAW_ANGLE_055_oRDR_TRACKER_OBJ_055_oPCAN_RADAR_25041647_Tx: ComBitPosition=155, ComBitSize=12, ComSignalType=UINT16, ComSystemTemplateSystemSignalRef=OBJ_YAW_ANGLE_055
            OBJ_YAW_ANGLE_ERR_055_oRDR_TRACKER_OBJ_055_oPCAN_RADAR_f0091090_Tx: ComBitPosition=175, ComBitSize=7, ComSignalType=UINT8, ComSystemTemplateSystemSignalRef=OBJ_YAW_ANGLE_ERR_055
            OBJ_YAW_RATE_055_oRDR_TRACKER_OBJ_055_oPCAN_RADAR_008b3300_Tx: ComBitPosition=399, ComBitSize=10, ComSignalType=UINT16, ComSystemTemplateSystemSignalRef=OBJ_YAW_RATE_055
            OBJ_YAW_RATE_ERR_055_oRDR_TRACKER_OBJ_055_oPCAN_RADAR_3f53a4dc_Tx: ComBitPosition=388, ComBitSize=5, ComSignalType=UINT8, ComSystemTemplateSystemSignalRef=OBJ_YAW_RATE_ERR_055
        SG_TrackerObject056_oRDR_TRACKER_OBJ_056_oPCAN_RADAR_e4e5e540_Tx: ComSystemTemplateSignalGroupRef=SG_TrackerObject056
          49 x ComGroupSignal, all with ComSignalEndianness=BIG_ENDIAN, ComSignalInitValue=0, ComTransferProperty=PENDING:
            OBJ_ACCELERATION_LAT_056_oRDR_TRACKER_OBJ_056_oPCAN_RADAR_eac1be37_Tx: ComBitPosition=177, ComBitSize=10, ComSignalType=UINT16, ComSystemTemplateSystemSignalRef=OBJ_ACCELERATION_LAT_056
            OBJ_ACCELERATION_LAT_ERR_056_oRDR_TRACKER_OBJ_056_oPCAN_RADAR_3f358489_Tx: ComBitPosition=223, ComBitSize=8, ComSignalType=UINT8, ComSystemTemplateSystemSignalRef=OBJ_ACCELERATION_LAT_ERR_056
            OBJ_ACCELERATION_LONG_056_oRDR_TRACKER_OBJ_056_oPCAN_RADAR_9831e7d7_Tx: ComBitPosition=193, ComBitSize=10, ComSignalType=UINT16, ComSystemTemplateSystemSignalRef=OBJ_ACCELERATION_LONG_056
            OBJ_ACCELERATION_LONG_ERR_056_oRDR_TRACKER_OBJ_056_oPCAN_RADAR_20902123_Tx: ComBitPosition=215, ComBitSize=8, ComSignalType=UINT8, ComSystemTemplateSystemSignalRef=OBJ_ACCELERATION_LONG_ERR_056
            OBJ_ACCEL_ERR_CRR_COEF_056_oRDR_TRACKER_OBJ_056_oPCAN_RADAR_80330045_Tx: ComBitPosition=431, ComBitSize=8, ComSignalType=UINT8, ComSystemTemplateSystemSignalRef=OBJ_ACCEL_ERR_CRR_COEF_056
            OBJ_ALIVE_TIME_056_oRDR_TRACKER_OBJ_056_oPCAN_RADAR_f850ac6b_Tx: ComBitPosition=255, ComBitSize=16, ComSignalType=UINT16, ComSystemTemplateSystemSignalRef=OBJ_ALIVE_TIME_056
            OBJ_CLS_TYPE1_056_oRDR_TRACKER_OBJ_056_oPCAN_RADAR_6f8b4d4d_Tx: ComBitPosition=271, ComBitSize=4, ComSignalType=UINT8, ComSystemTemplateSystemSignalRef=OBJ_CLS_TYPE1_056
            OBJ_CLS_TYPE1_PROB_056_oRDR_TRACKER_OBJ_056_oPCAN_RADAR_c7d39abe_Tx: ComBitPosition=303, ComBitSize=8, ComSignalType=UINT8, ComSystemTemplateSystemSignalRef=OBJ_CLS_TYPE1_PROB_056
            OBJ_CLS_TYPE2_056_oRDR_TRACKER_OBJ_056_oPCAN_RADAR_22634d2a_Tx: ComBitPosition=267, ComBitSize=4, ComSignalType=UINT8, ComSystemTemplateSystemSignalRef=OBJ_CLS_TYPE2_056
            OBJ_CLS_TYPE2_PROB_056_oRDR_TRACKER_OBJ_056_oPCAN_RADAR_0ee781b3_Tx: ComBitPosition=311, ComBitSize=8, ComSignalType=UINT8, ComSystemTemplateSystemSignalRef=OBJ_CLS_TYPE2_PROB_056
            OBJ_CLS_TYPE3_056_oRDR_TRACKER_OBJ_056_oPCAN_RADAR_afebb0c8_Tx: ComBitPosition=279, ComBitSize=4, ComSignalType=UINT8, ComSystemTemplateSystemSignalRef=OBJ_CLS_TYPE3_056
            OBJ_CLS_TYPE3_PROB_056_oRDR_TRACKER_OBJ_056_oPCAN_RADAR_49f47748_Tx: ComBitPosition=319, ComBitSize=8, ComSignalType=UINT8, ComSystemTemplateSystemSignalRef=OBJ_CLS_TYPE3_PROB_056
            OBJ_CLS_TYPE4_056_oRDR_TRACKER_OBJ_056_oPCAN_RADAR_b9b34de4_Tx: ComBitPosition=275, ComBitSize=4, ComSignalType=UINT8, ComSystemTemplateSystemSignalRef=OBJ_CLS_TYPE4_056
            OBJ_CLS_TYPE4_PROB_056_oRDR_TRACKER_OBJ_056_oPCAN_RADAR_47feb1e8_Tx: ComBitPosition=327, ComBitSize=8, ComSignalType=UINT8, ComSystemTemplateSystemSignalRef=OBJ_CLS_TYPE4_PROB_056
            OBJ_CLS_TYPE5_056_oRDR_TRACKER_OBJ_056_oPCAN_RADAR_343bb006_Tx: ComBitPosition=287, ComBitSize=4, ComSignalType=UINT8, ComSystemTemplateSystemSignalRef=OBJ_CLS_TYPE5_056
            OBJ_CLS_TYPE5_PROB_056_oRDR_TRACKER_OBJ_056_oPCAN_RADAR_00ed4713_Tx: ComBitPosition=335, ComBitSize=8, ComSignalType=UINT8, ComSystemTemplateSystemSignalRef=OBJ_CLS_TYPE5_PROB_056
            OBJ_CLS_TYPE6_056_oRDR_TRACKER_OBJ_056_oPCAN_RADAR_79d3b061_Tx: ComBitPosition=282, ComBitSize=4, ComSignalType=UINT8, ComSystemTemplateSystemSignalRef=OBJ_CLS_TYPE6_056
            OBJ_CLS_TYPE6_PROB_056_oRDR_TRACKER_OBJ_056_oPCAN_RADAR_c9d95c1e_Tx: ComBitPosition=343, ComBitSize=8, ComSignalType=UINT8, ComSystemTemplateSystemSignalRef=OBJ_CLS_TYPE6_PROB_056
            OBJ_DIMENSION_LENGTH_056_oRDR_TRACKER_OBJ_056_oPCAN_RADAR_2d151e09_Tx: ComBitPosition=37, ComBitSize=12, ComSignalType=UINT16, ComSystemTemplateSystemSignalRef=OBJ_DIMENSION_LENGTH_056
            OBJ_DIMENSION_LENGTH_ERR_056_oRDR_TRACKER_OBJ_056_oPCAN_RADAR_16ed0173_Tx: ComBitPosition=41, ComBitSize=10, ComSignalType=UINT16, ComSystemTemplateSystemSignalRef=OBJ_DIMENSION_LENGTH_ERR_056
            OBJ_DIMENSION_WIDTH_056_oRDR_TRACKER_OBJ_056_oPCAN_RADAR_0edbe9a4_Tx: ComBitPosition=17, ComBitSize=10, ComSignalType=UINT16, ComSystemTemplateSystemSignalRef=OBJ_DIMENSION_WIDTH_056
            OBJ_DIMENSION_WIDTH_ERR_056_oRDR_TRACKER_OBJ_056_oPCAN_RADAR_ee792e4c_Tx: ComBitPosition=23, ComBitSize=6, ComSignalType=UINT8, ComSystemTemplateSystemSignalRef=OBJ_DIMENSION_WIDTH_ERR_056
            OBJ_EXISTENCE_PROB_056_oRDR_TRACKER_OBJ_056_oPCAN_RADAR_05676d99_Tx: ComBitPosition=229, ComBitSize=14, ComSignalType=UINT16, ComSystemTemplateSystemSignalRef=OBJ_EXISTENCE_PROB_056
            OBJ_GROUP_ID_056_oRDR_TRACKER_OBJ_056_oPCAN_RADAR_8c157934_Tx: ComBitPosition=405, ComBitSize=6, ComSignalType=UINT8, ComSystemTemplateSystemSignalRef=OBJ_GROUP_ID_056
            OBJ_ID_056_oRDR_TRACKER_OBJ_056_oPCAN_RADAR_7f3b5233_Tx: ComBitPosition=7, ComBitSize=8, ComSignalType=UINT8, ComSystemTemplateSystemSignalRef=OBJ_ID_056
            OBJ_MEASUREMENT_STATUS_056_oRDR_TRACKER_OBJ_056_oPCAN_RADAR_00e9208e_Tx: ComBitPosition=14, ComBitSize=3, ComSignalType=UINT8, ComSystemTemplateSystemSignalRef=OBJ_MEASUREMENT_STATUS_056
            OBJ_MH_CRC16_056_oRDR_TRACKER_OBJ_056_oPCAN_RADAR_7c8997b2_Tx: ComBitPosition=495, ComBitSize=16, ComSignalType=UINT16, ComSystemTemplateSystemSignalRef=OBJ_MH_CRC16_056
            OBJ_MH_CYCLE_COUNTER_056_oRDR_TRACKER_OBJ_056_oPCAN_RADAR_0d6dcd53_Tx: ComBitPosition=487, ComBitSize=8, ComSignalType=UINT8, ComSystemTemplateSystemSignalRef=OBJ_MH_CYCLE_COUNTER_056
            OBJ_MOVEMENT_STATUS_056_oRDR_TRACKER_OBJ_056_oPCAN_RADAR_2f47b5c2_Tx: ComBitPosition=196, ComBitSize=3, ComSignalType=UINT8, ComSystemTemplateSystemSignalRef=OBJ_MOVEMENT_STATUS_056
            OBJ_POS_ERR_CRR_COEF_056_oRDR_TRACKER_OBJ_056_oPCAN_RADAR_bf3875f8_Tx: ComBitPosition=415, ComBitSize=8, ComSignalType=UINT8, ComSystemTemplateSystemSignalRef=OBJ_POS_ERR_CRR_COEF_056
            OBJ_POS_LAT_056_oRDR_TRACKER_OBJ_056_oPCAN_RADAR_5d9788b4_Tx: ComBitPosition=79, ComBitSize=16, ComSignalType=UINT16, ComSystemTemplateSystemSignalRef=OBJ_POS_LAT_056
            OBJ_POS_LAT_ERR_056_oRDR_TRACKER_OBJ_056_oPCAN_RADAR_59dbd883_Tx: ComBitPosition=103, ComBitSize=8, ComSignalType=UINT8, ComSystemTemplateSystemSignalRef=OBJ_POS_LAT_ERR_056
            OBJ_POS_LONG_056_oRDR_TRACKER_OBJ_056_oPCAN_RADAR_ec37637b_Tx: ComBitPosition=63, ComBitSize=16, ComSignalType=UINT16, ComSystemTemplateSystemSignalRef=OBJ_POS_LONG_056
            OBJ_POS_LONG_ERR_056_oRDR_TRACKER_OBJ_056_oPCAN_RADAR_c0232661_Tx: ComBitPosition=95, ComBitSize=8, ComSignalType=UINT8, ComSystemTemplateSystemSignalRef=OBJ_POS_LONG_ERR_056
            OBJ_RCS_056_oRDR_TRACKER_OBJ_056_oPCAN_RADAR_7f58deb3_Tx: ComBitPosition=351, ComBitSize=7, ComSignalType=UINT8, ComSystemTemplateSystemSignalRef=OBJ_RCS_056
            OBJ_REF_PT_LAT_OFFSET_056_oRDR_TRACKER_OBJ_056_oPCAN_RADAR_8a65b5c6_Tx: ComBitPosition=370, ComBitSize=14, ComSignalType=UINT16, ComSystemTemplateSystemSignalRef=OBJ_REF_PT_LAT_OFFSET_056
            OBJ_REF_PT_LONG_OFFSET_056_oRDR_TRACKER_OBJ_056_oPCAN_RADAR_c53745c5_Tx: ComBitPosition=357, ComBitSize=14, ComSignalType=UINT16, ComSystemTemplateSystemSignalRef=OBJ_REF_PT_LONG_OFFSET_056
            OBJ_TIMESTAMP_OFFSET_056_oRDR_TRACKER_OBJ_056_oPCAN_RADAR_7ff4dee5_Tx: ComBitPosition=247, ComBitSize=8, ComSignalType=UINT8, ComSystemTemplateSystemSignalRef=OBJ_TIMESTAMP_OFFSET_056
            OBJ_TRACK_MOTION_MODEL_056_oRDR_TRACKER_OBJ_056_oPCAN_RADAR_b3f7df38_Tx: ComBitPosition=9, ComBitSize=2, ComSignalType=UINT8, ComSystemTemplateSystemSignalRef=OBJ_TRACK_MOTION_MODEL_056
            OBJ_VEH_TRACK_FLAG_056_oRDR_TRACKER_OBJ_056_oPCAN_RADAR_31dd2965_Tx: ComBitPosition=10, ComBitSize=1, ComSignalType=BOOLEAN, ComSystemTemplateSystemSignalRef=OBJ_VEH_TRACK_FLAG_056
            OBJ_VELOCITY_ERR_CRR_COEF_056_oRDR_TRACKER_OBJ_056_oPCAN_RADAR_16424819_Tx: ComBitPosition=423, ComBitSize=8, ComSignalType=UINT8, ComSystemTemplateSystemSignalRef=OBJ_VELOCITY_ERR_CRR_COEF_056
            OBJ_VELOCITY_LAT_056_oRDR_TRACKER_OBJ_056_oPCAN_RADAR_19f4cd93_Tx: ComBitPosition=126, ComBitSize=15, ComSignalType=UINT16, ComSystemTemplateSystemSignalRef=OBJ_VELOCITY_LAT_056
            OBJ_VELOCITY_LAT_ERR_056_oRDR_TRACKER_OBJ_056_oPCAN_RADAR_2d0ebdc2_Tx: ComBitPosition=151, ComBitSize=8, ComSignalType=UINT8, ComSystemTemplateSystemSignalRef=OBJ_VELOCITY_LAT_ERR_056
            OBJ_VELOCITY_LONG_056_oRDR_TRACKER_OBJ_056_oPCAN_RADAR_4979b555_Tx: ComBitPosition=110, ComBitSize=15, ComSignalType=UINT16, ComSystemTemplateSystemSignalRef=OBJ_VELOCITY_LONG_056
            OBJ_VELOCITY_LONG_ERR_056_oRDR_TRACKER_OBJ_056_oPCAN_RADAR_c18c8202_Tx: ComBitPosition=143, ComBitSize=8, ComSignalType=UINT8, ComSystemTemplateSystemSignalRef=OBJ_VELOCITY_LONG_ERR_056
            OBJ_YAW_ANGLE_056_oRDR_TRACKER_OBJ_056_oPCAN_RADAR_f54889d3_Tx: ComBitPosition=155, ComBitSize=12, ComSignalType=UINT16, ComSystemTemplateSystemSignalRef=OBJ_YAW_ANGLE_056
            OBJ_YAW_ANGLE_ERR_056_oRDR_TRACKER_OBJ_056_oPCAN_RADAR_20458f04_Tx: ComBitPosition=175, ComBitSize=7, ComSignalType=UINT8, ComSystemTemplateSystemSignalRef=OBJ_YAW_ANGLE_ERR_056
            OBJ_YAW_RATE_056_oRDR_TRACKER_OBJ_056_oPCAN_RADAR_d0c7ac94_Tx: ComBitPosition=399, ComBitSize=10, ComSignalType=UINT16, ComSystemTemplateSystemSignalRef=OBJ_YAW_RATE_056
            OBJ_YAW_RATE_ERR_056_oRDR_TRACKER_OBJ_056_oPCAN_RADAR_ef1f3b48_Tx: ComBitPosition=388, ComBitSize=5, ComSignalType=UINT8, ComSystemTemplateSystemSignalRef=OBJ_YAW_RATE_ERR_056
        SG_TrackerObject057_oRDR_TRACKER_OBJ_057_oPCAN_RADAR_1df16df3_Tx: ComSystemTemplateSignalGroupRef=SG_TrackerObject057
          49 x ComGroupSignal, all with ComSignalEndianness=BIG_ENDIAN, ComSignalInitValue=0, ComTransferProperty=PENDING:
            OBJ_ACCELERATION_LAT_057_oRDR_TRACKER_OBJ_057_oPCAN_RADAR_13d53684_Tx: ComBitPosition=177, ComBitSize=10, ComSignalType=UINT16, ComSystemTemplateSystemSignalRef=OBJ_ACCELERATION_LAT_057
            OBJ_ACCELERATION_LAT_ERR_057_oRDR_TRACKER_OBJ_057_oPCAN_RADAR_c6210c3a_Tx: ComBitPosition=223, ComBitSize=8, ComSignalType=UINT8, ComSystemTemplateSystemSignalRef=OBJ_ACCELERATION_LAT_ERR_057
            OBJ_ACCELERATION_LONG_057_oRDR_TRACKER_OBJ_057_oPCAN_RADAR_61256f64_Tx: ComBitPosition=193, ComBitSize=10, ComSignalType=UINT16, ComSystemTemplateSystemSignalRef=OBJ_ACCELERATION_LONG_057
            OBJ_ACCELERATION_LONG_ERR_057_oRDR_TRACKER_OBJ_057_oPCAN_RADAR_d984a990_Tx: ComBitPosition=215, ComBitSize=8, ComSignalType=UINT8, ComSystemTemplateSystemSignalRef=OBJ_ACCELERATION_LONG_ERR_057
            OBJ_ACCEL_ERR_CRR_COEF_057_oRDR_TRACKER_OBJ_057_oPCAN_RADAR_792788f6_Tx: ComBitPosition=431, ComBitSize=8, ComSignalType=UINT8, ComSystemTemplateSystemSignalRef=OBJ_ACCEL_ERR_CRR_COEF_057
            OBJ_ALIVE_TIME_057_oRDR_TRACKER_OBJ_057_oPCAN_RADAR_014424d8_Tx: ComBitPosition=255, ComBitSize=16, ComSignalType=UINT16, ComSystemTemplateSystemSignalRef=OBJ_ALIVE_TIME_057
            OBJ_CLS_TYPE1_057_oRDR_TRACKER_OBJ_057_oPCAN_RADAR_969fc5fe_Tx: ComBitPosition=271, ComBitSize=4, ComSignalType=UINT8, ComSystemTemplateSystemSignalRef=OBJ_CLS_TYPE1_057
            OBJ_CLS_TYPE1_PROB_057_oRDR_TRACKER_OBJ_057_oPCAN_RADAR_3ec7120d_Tx: ComBitPosition=303, ComBitSize=8, ComSignalType=UINT8, ComSystemTemplateSystemSignalRef=OBJ_CLS_TYPE1_PROB_057
            OBJ_CLS_TYPE2_057_oRDR_TRACKER_OBJ_057_oPCAN_RADAR_db77c599_Tx: ComBitPosition=267, ComBitSize=4, ComSignalType=UINT8, ComSystemTemplateSystemSignalRef=OBJ_CLS_TYPE2_057
            OBJ_CLS_TYPE2_PROB_057_oRDR_TRACKER_OBJ_057_oPCAN_RADAR_f7f30900_Tx: ComBitPosition=311, ComBitSize=8, ComSignalType=UINT8, ComSystemTemplateSystemSignalRef=OBJ_CLS_TYPE2_PROB_057
            OBJ_CLS_TYPE3_057_oRDR_TRACKER_OBJ_057_oPCAN_RADAR_56ff387b_Tx: ComBitPosition=279, ComBitSize=4, ComSignalType=UINT8, ComSystemTemplateSystemSignalRef=OBJ_CLS_TYPE3_057
            OBJ_CLS_TYPE3_PROB_057_oRDR_TRACKER_OBJ_057_oPCAN_RADAR_b0e0fffb_Tx: ComBitPosition=319, ComBitSize=8, ComSignalType=UINT8, ComSystemTemplateSystemSignalRef=OBJ_CLS_TYPE3_PROB_057
            OBJ_CLS_TYPE4_057_oRDR_TRACKER_OBJ_057_oPCAN_RADAR_40a7c557_Tx: ComBitPosition=275, ComBitSize=4, ComSignalType=UINT8, ComSystemTemplateSystemSignalRef=OBJ_CLS_TYPE4_057
            OBJ_CLS_TYPE4_PROB_057_oRDR_TRACKER_OBJ_057_oPCAN_RADAR_beea395b_Tx: ComBitPosition=327, ComBitSize=8, ComSignalType=UINT8, ComSystemTemplateSystemSignalRef=OBJ_CLS_TYPE4_PROB_057
            OBJ_CLS_TYPE5_057_oRDR_TRACKER_OBJ_057_oPCAN_RADAR_cd2f38b5_Tx: ComBitPosition=287, ComBitSize=4, ComSignalType=UINT8, ComSystemTemplateSystemSignalRef=OBJ_CLS_TYPE5_057
            OBJ_CLS_TYPE5_PROB_057_oRDR_TRACKER_OBJ_057_oPCAN_RADAR_f9f9cfa0_Tx: ComBitPosition=335, ComBitSize=8, ComSignalType=UINT8, ComSystemTemplateSystemSignalRef=OBJ_CLS_TYPE5_PROB_057
            OBJ_CLS_TYPE6_057_oRDR_TRACKER_OBJ_057_oPCAN_RADAR_80c738d2_Tx: ComBitPosition=282, ComBitSize=4, ComSignalType=UINT8, ComSystemTemplateSystemSignalRef=OBJ_CLS_TYPE6_057
            OBJ_CLS_TYPE6_PROB_057_oRDR_TRACKER_OBJ_057_oPCAN_RADAR_30cdd4ad_Tx: ComBitPosition=343, ComBitSize=8, ComSignalType=UINT8, ComSystemTemplateSystemSignalRef=OBJ_CLS_TYPE6_PROB_057
            OBJ_DIMENSION_LENGTH_057_oRDR_TRACKER_OBJ_057_oPCAN_RADAR_d40196ba_Tx: ComBitPosition=37, ComBitSize=12, ComSignalType=UINT16, ComSystemTemplateSystemSignalRef=OBJ_DIMENSION_LENGTH_057
            OBJ_DIMENSION_LENGTH_ERR_057_oRDR_TRACKER_OBJ_057_oPCAN_RADAR_eff989c0_Tx: ComBitPosition=41, ComBitSize=10, ComSignalType=UINT16, ComSystemTemplateSystemSignalRef=OBJ_DIMENSION_LENGTH_ERR_057
            OBJ_DIMENSION_WIDTH_057_oRDR_TRACKER_OBJ_057_oPCAN_RADAR_f7cf6117_Tx: ComBitPosition=17, ComBitSize=10, ComSignalType=UINT16, ComSystemTemplateSystemSignalRef=OBJ_DIMENSION_WIDTH_057
            OBJ_DIMENSION_WIDTH_ERR_057_oRDR_TRACKER_OBJ_057_oPCAN_RADAR_176da6ff_Tx: ComBitPosition=23, ComBitSize=6, ComSignalType=UINT8, ComSystemTemplateSystemSignalRef=OBJ_DIMENSION_WIDTH_ERR_057
            OBJ_EXISTENCE_PROB_057_oRDR_TRACKER_OBJ_057_oPCAN_RADAR_fc73e52a_Tx: ComBitPosition=229, ComBitSize=14, ComSignalType=UINT16, ComSystemTemplateSystemSignalRef=OBJ_EXISTENCE_PROB_057
            OBJ_GROUP_ID_057_oRDR_TRACKER_OBJ_057_oPCAN_RADAR_7501f187_Tx: ComBitPosition=405, ComBitSize=6, ComSignalType=UINT8, ComSystemTemplateSystemSignalRef=OBJ_GROUP_ID_057
            OBJ_ID_057_oRDR_TRACKER_OBJ_057_oPCAN_RADAR_862fda80_Tx: ComBitPosition=7, ComBitSize=8, ComSignalType=UINT8, ComSystemTemplateSystemSignalRef=OBJ_ID_057
            OBJ_MEASUREMENT_STATUS_057_oRDR_TRACKER_OBJ_057_oPCAN_RADAR_f9fda83d_Tx: ComBitPosition=14, ComBitSize=3, ComSignalType=UINT8, ComSystemTemplateSystemSignalRef=OBJ_MEASUREMENT_STATUS_057
            OBJ_MH_CRC16_057_oRDR_TRACKER_OBJ_057_oPCAN_RADAR_859d1f01_Tx: ComBitPosition=495, ComBitSize=16, ComSignalType=UINT16, ComSystemTemplateSystemSignalRef=OBJ_MH_CRC16_057
            OBJ_MH_CYCLE_COUNTER_057_oRDR_TRACKER_OBJ_057_oPCAN_RADAR_f47945e0_Tx: ComBitPosition=487, ComBitSize=8, ComSignalType=UINT8, ComSystemTemplateSystemSignalRef=OBJ_MH_CYCLE_COUNTER_057
            OBJ_MOVEMENT_STATUS_057_oRDR_TRACKER_OBJ_057_oPCAN_RADAR_d6533d71_Tx: ComBitPosition=196, ComBitSize=3, ComSignalType=UINT8, ComSystemTemplateSystemSignalRef=OBJ_MOVEMENT_STATUS_057
            OBJ_POS_ERR_CRR_COEF_057_oRDR_TRACKER_OBJ_057_oPCAN_RADAR_462cfd4b_Tx: ComBitPosition=415, ComBitSize=8, ComSignalType=UINT8, ComSystemTemplateSystemSignalRef=OBJ_POS_ERR_CRR_COEF_057
            OBJ_POS_LAT_057_oRDR_TRACKER_OBJ_057_oPCAN_RADAR_a4830007_Tx: ComBitPosition=79, ComBitSize=16, ComSignalType=UINT16, ComSystemTemplateSystemSignalRef=OBJ_POS_LAT_057
            OBJ_POS_LAT_ERR_057_oRDR_TRACKER_OBJ_057_oPCAN_RADAR_a0cf5030_Tx: ComBitPosition=103, ComBitSize=8, ComSignalType=UINT8, ComSystemTemplateSystemSignalRef=OBJ_POS_LAT_ERR_057
            OBJ_POS_LONG_057_oRDR_TRACKER_OBJ_057_oPCAN_RADAR_1523ebc8_Tx: ComBitPosition=63, ComBitSize=16, ComSignalType=UINT16, ComSystemTemplateSystemSignalRef=OBJ_POS_LONG_057
            OBJ_POS_LONG_ERR_057_oRDR_TRACKER_OBJ_057_oPCAN_RADAR_3937aed2_Tx: ComBitPosition=95, ComBitSize=8, ComSignalType=UINT8, ComSystemTemplateSystemSignalRef=OBJ_POS_LONG_ERR_057
            OBJ_RCS_057_oRDR_TRACKER_OBJ_057_oPCAN_RADAR_864c5600_Tx: ComBitPosition=351, ComBitSize=7, ComSignalType=UINT8, ComSystemTemplateSystemSignalRef=OBJ_RCS_057
            OBJ_REF_PT_LAT_OFFSET_057_oRDR_TRACKER_OBJ_057_oPCAN_RADAR_73713d75_Tx: ComBitPosition=370, ComBitSize=14, ComSignalType=UINT16, ComSystemTemplateSystemSignalRef=OBJ_REF_PT_LAT_OFFSET_057
            OBJ_REF_PT_LONG_OFFSET_057_oRDR_TRACKER_OBJ_057_oPCAN_RADAR_3c23cd76_Tx: ComBitPosition=357, ComBitSize=14, ComSignalType=UINT16, ComSystemTemplateSystemSignalRef=OBJ_REF_PT_LONG_OFFSET_057
            OBJ_TIMESTAMP_OFFSET_057_oRDR_TRACKER_OBJ_057_oPCAN_RADAR_86e05656_Tx: ComBitPosition=247, ComBitSize=8, ComSignalType=UINT8, ComSystemTemplateSystemSignalRef=OBJ_TIMESTAMP_OFFSET_057
            OBJ_TRACK_MOTION_MODEL_057_oRDR_TRACKER_OBJ_057_oPCAN_RADAR_4ae3578b_Tx: ComBitPosition=9, ComBitSize=2, ComSignalType=UINT8, ComSystemTemplateSystemSignalRef=OBJ_TRACK_MOTION_MODEL_057
            OBJ_VEH_TRACK_FLAG_057_oRDR_TRACKER_OBJ_057_oPCAN_RADAR_c8c9a1d6_Tx: ComBitPosition=10, ComBitSize=1, ComSignalType=BOOLEAN, ComSystemTemplateSystemSignalRef=OBJ_VEH_TRACK_FLAG_057
            OBJ_VELOCITY_ERR_CRR_COEF_057_oRDR_TRACKER_OBJ_057_oPCAN_RADAR_ef56c0aa_Tx: ComBitPosition=423, ComBitSize=8, ComSignalType=UINT8, ComSystemTemplateSystemSignalRef=OBJ_VELOCITY_ERR_CRR_COEF_057
            OBJ_VELOCITY_LAT_057_oRDR_TRACKER_OBJ_057_oPCAN_RADAR_e0e04520_Tx: ComBitPosition=126, ComBitSize=15, ComSignalType=UINT16, ComSystemTemplateSystemSignalRef=OBJ_VELOCITY_LAT_057
            OBJ_VELOCITY_LAT_ERR_057_oRDR_TRACKER_OBJ_057_oPCAN_RADAR_d41a3571_Tx: ComBitPosition=151, ComBitSize=8, ComSignalType=UINT8, ComSystemTemplateSystemSignalRef=OBJ_VELOCITY_LAT_ERR_057
            OBJ_VELOCITY_LONG_057_oRDR_TRACKER_OBJ_057_oPCAN_RADAR_b06d3de6_Tx: ComBitPosition=110, ComBitSize=15, ComSignalType=UINT16, ComSystemTemplateSystemSignalRef=OBJ_VELOCITY_LONG_057
            OBJ_VELOCITY_LONG_ERR_057_oRDR_TRACKER_OBJ_057_oPCAN_RADAR_38980ab1_Tx: ComBitPosition=143, ComBitSize=8, ComSignalType=UINT8, ComSystemTemplateSystemSignalRef=OBJ_VELOCITY_LONG_ERR_057
            OBJ_YAW_ANGLE_057_oRDR_TRACKER_OBJ_057_oPCAN_RADAR_0c5c0160_Tx: ComBitPosition=155, ComBitSize=12, ComSignalType=UINT16, ComSystemTemplateSystemSignalRef=OBJ_YAW_ANGLE_057
            OBJ_YAW_ANGLE_ERR_057_oRDR_TRACKER_OBJ_057_oPCAN_RADAR_d95107b7_Tx: ComBitPosition=175, ComBitSize=7, ComSignalType=UINT8, ComSystemTemplateSystemSignalRef=OBJ_YAW_ANGLE_ERR_057
            OBJ_YAW_RATE_057_oRDR_TRACKER_OBJ_057_oPCAN_RADAR_29d32427_Tx: ComBitPosition=399, ComBitSize=10, ComSignalType=UINT16, ComSystemTemplateSystemSignalRef=OBJ_YAW_RATE_057
            OBJ_YAW_RATE_ERR_057_oRDR_TRACKER_OBJ_057_oPCAN_RADAR_160bb3fb_Tx: ComBitPosition=388, ComBitSize=5, ComSignalType=UINT8, ComSystemTemplateSystemSignalRef=OBJ_YAW_RATE_ERR_057
        SG_TrackerObject058_oRDR_TRACKER_OBJ_058_oPCAN_RADAR_3a6d80b5_Tx: ComSystemTemplateSignalGroupRef=SG_TrackerObject058
          49 x ComGroupSignal, all with ComSignalEndianness=BIG_ENDIAN, ComSignalInitValue=0, ComTransferProperty=PENDING:
            OBJ_ACCELERATION_LAT_058_oRDR_TRACKER_OBJ_058_oPCAN_RADAR_3449dbc2_Tx: ComBitPosition=177, ComBitSize=10, ComSignalType=UINT16, ComSystemTemplateSystemSignalRef=OBJ_ACCELERATION_LAT_058
            OBJ_ACCELERATION_LAT_ERR_058_oRDR_TRACKER_OBJ_058_oPCAN_RADAR_e1bde17c_Tx: ComBitPosition=223, ComBitSize=8, ComSignalType=UINT8, ComSystemTemplateSystemSignalRef=OBJ_ACCELERATION_LAT_ERR_058
            OBJ_ACCELERATION_LONG_058_oRDR_TRACKER_OBJ_058_oPCAN_RADAR_46b98222_Tx: ComBitPosition=193, ComBitSize=10, ComSignalType=UINT16, ComSystemTemplateSystemSignalRef=OBJ_ACCELERATION_LONG_058
            OBJ_ACCELERATION_LONG_ERR_058_oRDR_TRACKER_OBJ_058_oPCAN_RADAR_fe1844d6_Tx: ComBitPosition=215, ComBitSize=8, ComSignalType=UINT8, ComSystemTemplateSystemSignalRef=OBJ_ACCELERATION_LONG_ERR_058
            OBJ_ACCEL_ERR_CRR_COEF_058_oRDR_TRACKER_OBJ_058_oPCAN_RADAR_5ebb65b0_Tx: ComBitPosition=431, ComBitSize=8, ComSignalType=UINT8, ComSystemTemplateSystemSignalRef=OBJ_ACCEL_ERR_CRR_COEF_058
            OBJ_ALIVE_TIME_058_oRDR_TRACKER_OBJ_058_oPCAN_RADAR_26d8c99e_Tx: ComBitPosition=255, ComBitSize=16, ComSignalType=UINT16, ComSystemTemplateSystemSignalRef=OBJ_ALIVE_TIME_058
            OBJ_CLS_TYPE1_058_oRDR_TRACKER_OBJ_058_oPCAN_RADAR_b10328b8_Tx: ComBitPosition=271, ComBitSize=4, ComSignalType=UINT8, ComSystemTemplateSystemSignalRef=OBJ_CLS_TYPE1_058
            OBJ_CLS_TYPE1_PROB_058_oRDR_TRACKER_OBJ_058_oPCAN_RADAR_195bff4b_Tx: ComBitPosition=303, ComBitSize=8, ComSignalType=UINT8, ComSystemTemplateSystemSignalRef=OBJ_CLS_TYPE1_PROB_058
            OBJ_CLS_TYPE2_058_oRDR_TRACKER_OBJ_058_oPCAN_RADAR_fceb28df_Tx: ComBitPosition=267, ComBitSize=4, ComSignalType=UINT8, ComSystemTemplateSystemSignalRef=OBJ_CLS_TYPE2_058
            OBJ_CLS_TYPE2_PROB_058_oRDR_TRACKER_OBJ_058_oPCAN_RADAR_d06fe446_Tx: ComBitPosition=311, ComBitSize=8, ComSignalType=UINT8, ComSystemTemplateSystemSignalRef=OBJ_CLS_TYPE2_PROB_058
            OBJ_CLS_TYPE3_058_oRDR_TRACKER_OBJ_058_oPCAN_RADAR_7163d53d_Tx: ComBitPosition=279, ComBitSize=4, ComSignalType=UINT8, ComSystemTemplateSystemSignalRef=OBJ_CLS_TYPE3_058
            OBJ_CLS_TYPE3_PROB_058_oRDR_TRACKER_OBJ_058_oPCAN_RADAR_977c12bd_Tx: ComBitPosition=319, ComBitSize=8, ComSignalType=UINT8, ComSystemTemplateSystemSignalRef=OBJ_CLS_TYPE3_PROB_058
            OBJ_CLS_TYPE4_058_oRDR_TRACKER_OBJ_058_oPCAN_RADAR_673b2811_Tx: ComBitPosition=275, ComBitSize=4, ComSignalType=UINT8, ComSystemTemplateSystemSignalRef=OBJ_CLS_TYPE4_058
            OBJ_CLS_TYPE4_PROB_058_oRDR_TRACKER_OBJ_058_oPCAN_RADAR_9976d41d_Tx: ComBitPosition=327, ComBitSize=8, ComSignalType=UINT8, ComSystemTemplateSystemSignalRef=OBJ_CLS_TYPE4_PROB_058
            OBJ_CLS_TYPE5_058_oRDR_TRACKER_OBJ_058_oPCAN_RADAR_eab3d5f3_Tx: ComBitPosition=287, ComBitSize=4, ComSignalType=UINT8, ComSystemTemplateSystemSignalRef=OBJ_CLS_TYPE5_058
            OBJ_CLS_TYPE5_PROB_058_oRDR_TRACKER_OBJ_058_oPCAN_RADAR_de6522e6_Tx: ComBitPosition=335, ComBitSize=8, ComSignalType=UINT8, ComSystemTemplateSystemSignalRef=OBJ_CLS_TYPE5_PROB_058
            OBJ_CLS_TYPE6_058_oRDR_TRACKER_OBJ_058_oPCAN_RADAR_a75bd594_Tx: ComBitPosition=282, ComBitSize=4, ComSignalType=UINT8, ComSystemTemplateSystemSignalRef=OBJ_CLS_TYPE6_058
            OBJ_CLS_TYPE6_PROB_058_oRDR_TRACKER_OBJ_058_oPCAN_RADAR_175139eb_Tx: ComBitPosition=343, ComBitSize=8, ComSignalType=UINT8, ComSystemTemplateSystemSignalRef=OBJ_CLS_TYPE6_PROB_058
            OBJ_DIMENSION_LENGTH_058_oRDR_TRACKER_OBJ_058_oPCAN_RADAR_f39d7bfc_Tx: ComBitPosition=37, ComBitSize=12, ComSignalType=UINT16, ComSystemTemplateSystemSignalRef=OBJ_DIMENSION_LENGTH_058
            OBJ_DIMENSION_LENGTH_ERR_058_oRDR_TRACKER_OBJ_058_oPCAN_RADAR_c8656486_Tx: ComBitPosition=41, ComBitSize=10, ComSignalType=UINT16, ComSystemTemplateSystemSignalRef=OBJ_DIMENSION_LENGTH_ERR_058
            OBJ_DIMENSION_WIDTH_058_oRDR_TRACKER_OBJ_058_oPCAN_RADAR_d0538c51_Tx: ComBitPosition=17, ComBitSize=10, ComSignalType=UINT16, ComSystemTemplateSystemSignalRef=OBJ_DIMENSION_WIDTH_058
            OBJ_DIMENSION_WIDTH_ERR_058_oRDR_TRACKER_OBJ_058_oPCAN_RADAR_30f14bb9_Tx: ComBitPosition=23, ComBitSize=6, ComSignalType=UINT8, ComSystemTemplateSystemSignalRef=OBJ_DIMENSION_WIDTH_ERR_058
            OBJ_EXISTENCE_PROB_058_oRDR_TRACKER_OBJ_058_oPCAN_RADAR_dbef086c_Tx: ComBitPosition=229, ComBitSize=14, ComSignalType=UINT16, ComSystemTemplateSystemSignalRef=OBJ_EXISTENCE_PROB_058
            OBJ_GROUP_ID_058_oRDR_TRACKER_OBJ_058_oPCAN_RADAR_529d1cc1_Tx: ComBitPosition=405, ComBitSize=6, ComSignalType=UINT8, ComSystemTemplateSystemSignalRef=OBJ_GROUP_ID_058
            OBJ_ID_058_oRDR_TRACKER_OBJ_058_oPCAN_RADAR_a1b337c6_Tx: ComBitPosition=7, ComBitSize=8, ComSignalType=UINT8, ComSystemTemplateSystemSignalRef=OBJ_ID_058
            OBJ_MEASUREMENT_STATUS_058_oRDR_TRACKER_OBJ_058_oPCAN_RADAR_de61457b_Tx: ComBitPosition=14, ComBitSize=3, ComSignalType=UINT8, ComSystemTemplateSystemSignalRef=OBJ_MEASUREMENT_STATUS_058
            OBJ_MH_CRC16_058_oRDR_TRACKER_OBJ_058_oPCAN_RADAR_a201f247_Tx: ComBitPosition=495, ComBitSize=16, ComSignalType=UINT16, ComSystemTemplateSystemSignalRef=OBJ_MH_CRC16_058
            OBJ_MH_CYCLE_COUNTER_058_oRDR_TRACKER_OBJ_058_oPCAN_RADAR_d3e5a8a6_Tx: ComBitPosition=487, ComBitSize=8, ComSignalType=UINT8, ComSystemTemplateSystemSignalRef=OBJ_MH_CYCLE_COUNTER_058
            OBJ_MOVEMENT_STATUS_058_oRDR_TRACKER_OBJ_058_oPCAN_RADAR_f1cfd037_Tx: ComBitPosition=196, ComBitSize=3, ComSignalType=UINT8, ComSystemTemplateSystemSignalRef=OBJ_MOVEMENT_STATUS_058
            OBJ_POS_ERR_CRR_COEF_058_oRDR_TRACKER_OBJ_058_oPCAN_RADAR_61b0100d_Tx: ComBitPosition=415, ComBitSize=8, ComSignalType=UINT8, ComSystemTemplateSystemSignalRef=OBJ_POS_ERR_CRR_COEF_058
            OBJ_POS_LAT_058_oRDR_TRACKER_OBJ_058_oPCAN_RADAR_831fed41_Tx: ComBitPosition=79, ComBitSize=16, ComSignalType=UINT16, ComSystemTemplateSystemSignalRef=OBJ_POS_LAT_058
            OBJ_POS_LAT_ERR_058_oRDR_TRACKER_OBJ_058_oPCAN_RADAR_8753bd76_Tx: ComBitPosition=103, ComBitSize=8, ComSignalType=UINT8, ComSystemTemplateSystemSignalRef=OBJ_POS_LAT_ERR_058
            OBJ_POS_LONG_058_oRDR_TRACKER_OBJ_058_oPCAN_RADAR_32bf068e_Tx: ComBitPosition=63, ComBitSize=16, ComSignalType=UINT16, ComSystemTemplateSystemSignalRef=OBJ_POS_LONG_058
            OBJ_POS_LONG_ERR_058_oRDR_TRACKER_OBJ_058_oPCAN_RADAR_1eab4394_Tx: ComBitPosition=95, ComBitSize=8, ComSignalType=UINT8, ComSystemTemplateSystemSignalRef=OBJ_POS_LONG_ERR_058
            OBJ_RCS_058_oRDR_TRACKER_OBJ_058_oPCAN_RADAR_a1d0bb46_Tx: ComBitPosition=351, ComBitSize=7, ComSignalType=UINT8, ComSystemTemplateSystemSignalRef=OBJ_RCS_058
            OBJ_REF_PT_LAT_OFFSET_058_oRDR_TRACKER_OBJ_058_oPCAN_RADAR_54edd033_Tx: ComBitPosition=370, ComBitSize=14, ComSignalType=UINT16, ComSystemTemplateSystemSignalRef=OBJ_REF_PT_LAT_OFFSET_058
            OBJ_REF_PT_LONG_OFFSET_058_oRDR_TRACKER_OBJ_058_oPCAN_RADAR_1bbf2030_Tx: ComBitPosition=357, ComBitSize=14, ComSignalType=UINT16, ComSystemTemplateSystemSignalRef=OBJ_REF_PT_LONG_OFFSET_058
            OBJ_TIMESTAMP_OFFSET_058_oRDR_TRACKER_OBJ_058_oPCAN_RADAR_a17cbb10_Tx: ComBitPosition=247, ComBitSize=8, ComSignalType=UINT8, ComSystemTemplateSystemSignalRef=OBJ_TIMESTAMP_OFFSET_058
            OBJ_TRACK_MOTION_MODEL_058_oRDR_TRACKER_OBJ_058_oPCAN_RADAR_6d7fbacd_Tx: ComBitPosition=9, ComBitSize=2, ComSignalType=UINT8, ComSystemTemplateSystemSignalRef=OBJ_TRACK_MOTION_MODEL_058
            OBJ_VEH_TRACK_FLAG_058_oRDR_TRACKER_OBJ_058_oPCAN_RADAR_ef554c90_Tx: ComBitPosition=10, ComBitSize=1, ComSignalType=BOOLEAN, ComSystemTemplateSystemSignalRef=OBJ_VEH_TRACK_FLAG_058
            OBJ_VELOCITY_ERR_CRR_COEF_058_oRDR_TRACKER_OBJ_058_oPCAN_RADAR_c8ca2dec_Tx: ComBitPosition=423, ComBitSize=8, ComSignalType=UINT8, ComSystemTemplateSystemSignalRef=OBJ_VELOCITY_ERR_CRR_COEF_058
            OBJ_VELOCITY_LAT_058_oRDR_TRACKER_OBJ_058_oPCAN_RADAR_c77ca866_Tx: ComBitPosition=126, ComBitSize=15, ComSignalType=UINT16, ComSystemTemplateSystemSignalRef=OBJ_VELOCITY_LAT_058
            OBJ_VELOCITY_LAT_ERR_058_oRDR_TRACKER_OBJ_058_oPCAN_RADAR_f386d837_Tx: ComBitPosition=151, ComBitSize=8, ComSignalType=UINT8, ComSystemTemplateSystemSignalRef=OBJ_VELOCITY_LAT_ERR_058
            OBJ_VELOCITY_LONG_058_oRDR_TRACKER_OBJ_058_oPCAN_RADAR_97f1d0a0_Tx: ComBitPosition=110, ComBitSize=15, ComSignalType=UINT16, ComSystemTemplateSystemSignalRef=OBJ_VELOCITY_LONG_058
            OBJ_VELOCITY_LONG_ERR_058_oRDR_TRACKER_OBJ_058_oPCAN_RADAR_1f04e7f7_Tx: ComBitPosition=143, ComBitSize=8, ComSignalType=UINT8, ComSystemTemplateSystemSignalRef=OBJ_VELOCITY_LONG_ERR_058
            OBJ_YAW_ANGLE_058_oRDR_TRACKER_OBJ_058_oPCAN_RADAR_2bc0ec26_Tx: ComBitPosition=155, ComBitSize=12, ComSignalType=UINT16, ComSystemTemplateSystemSignalRef=OBJ_YAW_ANGLE_058
            OBJ_YAW_ANGLE_ERR_058_oRDR_TRACKER_OBJ_058_oPCAN_RADAR_fecdeaf1_Tx: ComBitPosition=175, ComBitSize=7, ComSignalType=UINT8, ComSystemTemplateSystemSignalRef=OBJ_YAW_ANGLE_ERR_058
            OBJ_YAW_RATE_058_oRDR_TRACKER_OBJ_058_oPCAN_RADAR_0e4fc961_Tx: ComBitPosition=399, ComBitSize=10, ComSignalType=UINT16, ComSystemTemplateSystemSignalRef=OBJ_YAW_RATE_058
            OBJ_YAW_RATE_ERR_058_oRDR_TRACKER_OBJ_058_oPCAN_RADAR_31975ebd_Tx: ComBitPosition=388, ComBitSize=5, ComSignalType=UINT8, ComSystemTemplateSystemSignalRef=OBJ_YAW_RATE_ERR_058
        SG_TrackerObject059_oRDR_TRACKER_OBJ_059_oPCAN_RADAR_c3790806_Tx: ComSystemTemplateSignalGroupRef=SG_TrackerObject059
          49 x ComGroupSignal, all with ComSignalEndianness=BIG_ENDIAN, ComSignalInitValue=0, ComTransferProperty=PENDING:
            OBJ_ACCELERATION_LAT_059_oRDR_TRACKER_OBJ_059_oPCAN_RADAR_cd5d5371_Tx: ComBitPosition=177, ComBitSize=10, ComSignalType=UINT16, ComSystemTemplateSystemSignalRef=OBJ_ACCELERATION_LAT_059
            OBJ_ACCELERATION_LAT_ERR_059_oRDR_TRACKER_OBJ_059_oPCAN_RADAR_18a969cf_Tx: ComBitPosition=223, ComBitSize=8, ComSignalType=UINT8, ComSystemTemplateSystemSignalRef=OBJ_ACCELERATION_LAT_ERR_059
            OBJ_ACCELERATION_LONG_059_oRDR_TRACKER_OBJ_059_oPCAN_RADAR_bfad0a91_Tx: ComBitPosition=193, ComBitSize=10, ComSignalType=UINT16, ComSystemTemplateSystemSignalRef=OBJ_ACCELERATION_LONG_059
            OBJ_ACCELERATION_LONG_ERR_059_oRDR_TRACKER_OBJ_059_oPCAN_RADAR_070ccc65_Tx: ComBitPosition=215, ComBitSize=8, ComSignalType=UINT8, ComSystemTemplateSystemSignalRef=OBJ_ACCELERATION_LONG_ERR_059
            OBJ_ACCEL_ERR_CRR_COEF_059_oRDR_TRACKER_OBJ_059_oPCAN_RADAR_a7afed03_Tx: ComBitPosition=431, ComBitSize=8, ComSignalType=UINT8, ComSystemTemplateSystemSignalRef=OBJ_ACCEL_ERR_CRR_COEF_059
            OBJ_ALIVE_TIME_059_oRDR_TRACKER_OBJ_059_oPCAN_RADAR_dfcc412d_Tx: ComBitPosition=255, ComBitSize=16, ComSignalType=UINT16, ComSystemTemplateSystemSignalRef=OBJ_ALIVE_TIME_059
            OBJ_CLS_TYPE1_059_oRDR_TRACKER_OBJ_059_oPCAN_RADAR_4817a00b_Tx: ComBitPosition=271, ComBitSize=4, ComSignalType=UINT8, ComSystemTemplateSystemSignalRef=OBJ_CLS_TYPE1_059
            OBJ_CLS_TYPE1_PROB_059_oRDR_TRACKER_OBJ_059_oPCAN_RADAR_e04f77f8_Tx: ComBitPosition=303, ComBitSize=8, ComSignalType=UINT8, ComSystemTemplateSystemSignalRef=OBJ_CLS_TYPE1_PROB_059
            OBJ_CLS_TYPE2_059_oRDR_TRACKER_OBJ_059_oPCAN_RADAR_05ffa06c_Tx: ComBitPosition=267, ComBitSize=4, ComSignalType=UINT8, ComSystemTemplateSystemSignalRef=OBJ_CLS_TYPE2_059
            OBJ_CLS_TYPE2_PROB_059_oRDR_TRACKER_OBJ_059_oPCAN_RADAR_297b6cf5_Tx: ComBitPosition=311, ComBitSize=8, ComSignalType=UINT8, ComSystemTemplateSystemSignalRef=OBJ_CLS_TYPE2_PROB_059
            OBJ_CLS_TYPE3_059_oRDR_TRACKER_OBJ_059_oPCAN_RADAR_88775d8e_Tx: ComBitPosition=279, ComBitSize=4, ComSignalType=UINT8, ComSystemTemplateSystemSignalRef=OBJ_CLS_TYPE3_059
            OBJ_CLS_TYPE3_PROB_059_oRDR_TRACKER_OBJ_059_oPCAN_RADAR_6e689a0e_Tx: ComBitPosition=319, ComBitSize=8, ComSignalType=UINT8, ComSystemTemplateSystemSignalRef=OBJ_CLS_TYPE3_PROB_059
            OBJ_CLS_TYPE4_059_oRDR_TRACKER_OBJ_059_oPCAN_RADAR_9e2fa0a2_Tx: ComBitPosition=275, ComBitSize=4, ComSignalType=UINT8, ComSystemTemplateSystemSignalRef=OBJ_CLS_TYPE4_059
            OBJ_CLS_TYPE4_PROB_059_oRDR_TRACKER_OBJ_059_oPCAN_RADAR_60625cae_Tx: ComBitPosition=327, ComBitSize=8, ComSignalType=UINT8, ComSystemTemplateSystemSignalRef=OBJ_CLS_TYPE4_PROB_059
            OBJ_CLS_TYPE5_059_oRDR_TRACKER_OBJ_059_oPCAN_RADAR_13a75d40_Tx: ComBitPosition=287, ComBitSize=4, ComSignalType=UINT8, ComSystemTemplateSystemSignalRef=OBJ_CLS_TYPE5_059
            OBJ_CLS_TYPE5_PROB_059_oRDR_TRACKER_OBJ_059_oPCAN_RADAR_2771aa55_Tx: ComBitPosition=335, ComBitSize=8, ComSignalType=UINT8, ComSystemTemplateSystemSignalRef=OBJ_CLS_TYPE5_PROB_059
            OBJ_CLS_TYPE6_059_oRDR_TRACKER_OBJ_059_oPCAN_RADAR_5e4f5d27_Tx: ComBitPosition=282, ComBitSize=4, ComSignalType=UINT8, ComSystemTemplateSystemSignalRef=OBJ_CLS_TYPE6_059
            OBJ_CLS_TYPE6_PROB_059_oRDR_TRACKER_OBJ_059_oPCAN_RADAR_ee45b158_Tx: ComBitPosition=343, ComBitSize=8, ComSignalType=UINT8, ComSystemTemplateSystemSignalRef=OBJ_CLS_TYPE6_PROB_059
            OBJ_DIMENSION_LENGTH_059_oRDR_TRACKER_OBJ_059_oPCAN_RADAR_0a89f34f_Tx: ComBitPosition=37, ComBitSize=12, ComSignalType=UINT16, ComSystemTemplateSystemSignalRef=OBJ_DIMENSION_LENGTH_059
            OBJ_DIMENSION_LENGTH_ERR_059_oRDR_TRACKER_OBJ_059_oPCAN_RADAR_3171ec35_Tx: ComBitPosition=41, ComBitSize=10, ComSignalType=UINT16, ComSystemTemplateSystemSignalRef=OBJ_DIMENSION_LENGTH_ERR_059
            OBJ_DIMENSION_WIDTH_059_oRDR_TRACKER_OBJ_059_oPCAN_RADAR_294704e2_Tx: ComBitPosition=17, ComBitSize=10, ComSignalType=UINT16, ComSystemTemplateSystemSignalRef=OBJ_DIMENSION_WIDTH_059
            OBJ_DIMENSION_WIDTH_ERR_059_oRDR_TRACKER_OBJ_059_oPCAN_RADAR_c9e5c30a_Tx: ComBitPosition=23, ComBitSize=6, ComSignalType=UINT8, ComSystemTemplateSystemSignalRef=OBJ_DIMENSION_WIDTH_ERR_059
            OBJ_EXISTENCE_PROB_059_oRDR_TRACKER_OBJ_059_oPCAN_RADAR_22fb80df_Tx: ComBitPosition=229, ComBitSize=14, ComSignalType=UINT16, ComSystemTemplateSystemSignalRef=OBJ_EXISTENCE_PROB_059
            OBJ_GROUP_ID_059_oRDR_TRACKER_OBJ_059_oPCAN_RADAR_ab899472_Tx: ComBitPosition=405, ComBitSize=6, ComSignalType=UINT8, ComSystemTemplateSystemSignalRef=OBJ_GROUP_ID_059
            OBJ_ID_059_oRDR_TRACKER_OBJ_059_oPCAN_RADAR_58a7bf75_Tx: ComBitPosition=7, ComBitSize=8, ComSignalType=UINT8, ComSystemTemplateSystemSignalRef=OBJ_ID_059
            OBJ_MEASUREMENT_STATUS_059_oRDR_TRACKER_OBJ_059_oPCAN_RADAR_2775cdc8_Tx: ComBitPosition=14, ComBitSize=3, ComSignalType=UINT8, ComSystemTemplateSystemSignalRef=OBJ_MEASUREMENT_STATUS_059
            OBJ_MH_CRC16_059_oRDR_TRACKER_OBJ_059_oPCAN_RADAR_5b157af4_Tx: ComBitPosition=495, ComBitSize=16, ComSignalType=UINT16, ComSystemTemplateSystemSignalRef=OBJ_MH_CRC16_059
            OBJ_MH_CYCLE_COUNTER_059_oRDR_TRACKER_OBJ_059_oPCAN_RADAR_2af12015_Tx: ComBitPosition=487, ComBitSize=8, ComSignalType=UINT8, ComSystemTemplateSystemSignalRef=OBJ_MH_CYCLE_COUNTER_059
            OBJ_MOVEMENT_STATUS_059_oRDR_TRACKER_OBJ_059_oPCAN_RADAR_08db5884_Tx: ComBitPosition=196, ComBitSize=3, ComSignalType=UINT8, ComSystemTemplateSystemSignalRef=OBJ_MOVEMENT_STATUS_059
            OBJ_POS_ERR_CRR_COEF_059_oRDR_TRACKER_OBJ_059_oPCAN_RADAR_98a498be_Tx: ComBitPosition=415, ComBitSize=8, ComSignalType=UINT8, ComSystemTemplateSystemSignalRef=OBJ_POS_ERR_CRR_COEF_059
            OBJ_POS_LAT_059_oRDR_TRACKER_OBJ_059_oPCAN_RADAR_7a0b65f2_Tx: ComBitPosition=79, ComBitSize=16, ComSignalType=UINT16, ComSystemTemplateSystemSignalRef=OBJ_POS_LAT_059
            OBJ_POS_LAT_ERR_059_oRDR_TRACKER_OBJ_059_oPCAN_RADAR_7e4735c5_Tx: ComBitPosition=103, ComBitSize=8, ComSignalType=UINT8, ComSystemTemplateSystemSignalRef=OBJ_POS_LAT_ERR_059
            OBJ_POS_LONG_059_oRDR_TRACKER_OBJ_059_oPCAN_RADAR_cbab8e3d_Tx: ComBitPosition=63, ComBitSize=16, ComSignalType=UINT16, ComSystemTemplateSystemSignalRef=OBJ_POS_LONG_059
            OBJ_POS_LONG_ERR_059_oRDR_TRACKER_OBJ_059_oPCAN_RADAR_e7bfcb27_Tx: ComBitPosition=95, ComBitSize=8, ComSignalType=UINT8, ComSystemTemplateSystemSignalRef=OBJ_POS_LONG_ERR_059
            OBJ_RCS_059_oRDR_TRACKER_OBJ_059_oPCAN_RADAR_58c433f5_Tx: ComBitPosition=351, ComBitSize=7, ComSignalType=UINT8, ComSystemTemplateSystemSignalRef=OBJ_RCS_059
            OBJ_REF_PT_LAT_OFFSET_059_oRDR_TRACKER_OBJ_059_oPCAN_RADAR_adf95880_Tx: ComBitPosition=370, ComBitSize=14, ComSignalType=UINT16, ComSystemTemplateSystemSignalRef=OBJ_REF_PT_LAT_OFFSET_059
            OBJ_REF_PT_LONG_OFFSET_059_oRDR_TRACKER_OBJ_059_oPCAN_RADAR_e2aba883_Tx: ComBitPosition=357, ComBitSize=14, ComSignalType=UINT16, ComSystemTemplateSystemSignalRef=OBJ_REF_PT_LONG_OFFSET_059
            OBJ_TIMESTAMP_OFFSET_059_oRDR_TRACKER_OBJ_059_oPCAN_RADAR_586833a3_Tx: ComBitPosition=247, ComBitSize=8, ComSignalType=UINT8, ComSystemTemplateSystemSignalRef=OBJ_TIMESTAMP_OFFSET_059
            OBJ_TRACK_MOTION_MODEL_059_oRDR_TRACKER_OBJ_059_oPCAN_RADAR_946b327e_Tx: ComBitPosition=9, ComBitSize=2, ComSignalType=UINT8, ComSystemTemplateSystemSignalRef=OBJ_TRACK_MOTION_MODEL_059
            OBJ_VEH_TRACK_FLAG_059_oRDR_TRACKER_OBJ_059_oPCAN_RADAR_1641c423_Tx: ComBitPosition=10, ComBitSize=1, ComSignalType=BOOLEAN, ComSystemTemplateSystemSignalRef=OBJ_VEH_TRACK_FLAG_059
            OBJ_VELOCITY_ERR_CRR_COEF_059_oRDR_TRACKER_OBJ_059_oPCAN_RADAR_31dea55f_Tx: ComBitPosition=423, ComBitSize=8, ComSignalType=UINT8, ComSystemTemplateSystemSignalRef=OBJ_VELOCITY_ERR_CRR_COEF_059
            OBJ_VELOCITY_LAT_059_oRDR_TRACKER_OBJ_059_oPCAN_RADAR_3e6820d5_Tx: ComBitPosition=126, ComBitSize=15, ComSignalType=UINT16, ComSystemTemplateSystemSignalRef=OBJ_VELOCITY_LAT_059
            OBJ_VELOCITY_LAT_ERR_059_oRDR_TRACKER_OBJ_059_oPCAN_RADAR_0a925084_Tx: ComBitPosition=151, ComBitSize=8, ComSignalType=UINT8, ComSystemTemplateSystemSignalRef=OBJ_VELOCITY_LAT_ERR_059
            OBJ_VELOCITY_LONG_059_oRDR_TRACKER_OBJ_059_oPCAN_RADAR_6ee55813_Tx: ComBitPosition=110, ComBitSize=15, ComSignalType=UINT16, ComSystemTemplateSystemSignalRef=OBJ_VELOCITY_LONG_059
            OBJ_VELOCITY_LONG_ERR_059_oRDR_TRACKER_OBJ_059_oPCAN_RADAR_e6106f44_Tx: ComBitPosition=143, ComBitSize=8, ComSignalType=UINT8, ComSystemTemplateSystemSignalRef=OBJ_VELOCITY_LONG_ERR_059
            OBJ_YAW_ANGLE_059_oRDR_TRACKER_OBJ_059_oPCAN_RADAR_d2d46495_Tx: ComBitPosition=155, ComBitSize=12, ComSignalType=UINT16, ComSystemTemplateSystemSignalRef=OBJ_YAW_ANGLE_059
            OBJ_YAW_ANGLE_ERR_059_oRDR_TRACKER_OBJ_059_oPCAN_RADAR_07d96242_Tx: ComBitPosition=175, ComBitSize=7, ComSignalType=UINT8, ComSystemTemplateSystemSignalRef=OBJ_YAW_ANGLE_ERR_059
            OBJ_YAW_RATE_059_oRDR_TRACKER_OBJ_059_oPCAN_RADAR_f75b41d2_Tx: ComBitPosition=399, ComBitSize=10, ComSignalType=UINT16, ComSystemTemplateSystemSignalRef=OBJ_YAW_RATE_059
            OBJ_YAW_RATE_ERR_059_oRDR_TRACKER_OBJ_059_oPCAN_RADAR_c883d60e_Tx: ComBitPosition=388, ComBitSize=5, ComSignalType=UINT8, ComSystemTemplateSystemSignalRef=OBJ_YAW_RATE_ERR_059
