[part 18 of 24: package /InitialEcuC]
AUTOSAR XML (schema 00053)
package /InitialEcuC  (continued)
  module config Com  (continued)
    ComConfig  (continued)
      242 x ComSignalGroup, all with ComTransferProperty=PENDING:  (continued)
        SG_SAS_oSAS_oVCAN_RADAR_c902864e_Rx: ComSystemTemplateSignalGroupRef=SG_SAS
          8 x ComGroupSignal, all with ComSignalEndianness=LITTLE_ENDIAN, ComSignalInitValue=0:
            ActiveMode_oSAS_oVCAN_RADAR_d0796acb_Rx: ComBitPosition=48, ComBitSize=2, ComSignalDataInvalidValue=3, ComSignalType=UINT8, ComSystemTemplateSystemSignalRef=ActiveMode
            Calibrated_oSAS_oVCAN_RADAR_ebf0ded0_Rx: ComBitPosition=50, ComBitSize=2, ComSignalDataInvalidValue=3, ComSignalType=UINT8, ComSystemTemplateSystemSignalRef=Calibrated
            MessageChecksum_oSAS_oVCAN_RADAR_61fa3dc9_Rx: ComBitPosition=60, ComBitSize=4, ComSignalType=UINT8, ComSystemTemplateSystemSignalRef=MessageChecksum
            MessageCounter_oSAS_oVCAN_RADAR_bad50fe2_Rx: ComBitPosition=56, ComBitSize=4, ComSignalType=UINT8, ComSystemTemplateSystemSignalRef=MessageCounter
            SteeringWheelAngleRangeCounterType_oSAS_oVCAN_RADAR_7889a4bc_Rx: ComBitPosition=22, ComBitSize=2, ComSignalType=UINT8, ComSystemTemplateSystemSignalRef=SteeringWheelAngleRangeCounterType
            SteeringWheelAngleRangeCounter_oSAS_oVCAN_RADAR_5300a9ef_Rx: ComBitPosition=16, ComBitSize=6, ComSignalType=UINT8, ComSystemTemplateSystemSignalRef=SteeringWheelAngleRangeCounter
            SteeringWheelAngleRange_oSAS_oVCAN_RADAR_2ef6c42e_Rx: ComBitPosition=32, ComBitSize=16, ComSignalType=UINT16, ComSystemTemplateSystemSignalRef=SteeringWheelAngleRange
            SteeringWheelAngle_oSAS_oVCAN_RADAR_17cf9abd_Rx: ComBitPosition=0, ComBitSize=16, ComSignalType=UINT16, ComSystemTemplateSystemSignalRef=SteeringWheelAngle
        SG_TD_oTD_oVCAN_RADAR_c3698ded_Rx: ComSystemTemplateSignalGroupRef=SG_TD
          8 x ComGroupSignal, all with ComBitSize=8, ComSignalEndianness=LITTLE_ENDIAN, ComSignalType=UINT8:
            Day_oTD_oVCAN_RADAR_d9e1ba53_Rx: ComBitPosition=32, ComSignalInitValue=0, ComSystemTemplateSystemSignalRef=Day
            Hours_oTD_oVCAN_RADAR_408d2c34_Rx: ComBitPosition=16, ComSignalInitValue=0, ComSystemTemplateSystemSignalRef=Hours
            LocalHourOffset_oTD_oVCAN_RADAR_82942db5_Rx: ComBitPosition=48, ComSignalInitValue=125, ComSystemTemplateSystemSignalRef=LocalHourOffset
            LocalMinuteOffset_oTD_oVCAN_RADAR_074fc4ab_Rx: ComBitPosition=56, ComSignalInitValue=125, ComSystemTemplateSystemSignalRef=LocalMinuteOffset
            Minutes_oTD_oVCAN_RADAR_2546db9e_Rx: ComBitPosition=8, ComSignalInitValue=0, ComSystemTemplateSystemSignalRef=Minutes
            Month_oTD_oVCAN_RADAR_d8bc3ad5_Rx: ComBitPosition=24, ComSignalInitValue=0, ComSystemTemplateSystemSignalRef=Month
            Seconds_oTD_oVCAN_RADAR_b2a2ca59_Rx: ComBitPosition=0, ComSignalInitValue=0, ComSystemTemplateSystemSignalRef=Seconds
            Year_oTD_oVCAN_RADAR_b229b348_Rx: ComBitPosition=40, ComSignalInitValue=0, ComSystemTemplateSystemSignalRef=Year
        SG_TrackerHeader_oRDR_OBJ_HEADER_002_oPCAN_RADAR_563ddea3_Tx: ComSystemTemplateSignalGroupRef=SG_TrackerHeader
          11 x ComGroupSignal, all with ComSignalEndianness=BIG_ENDIAN, ComSignalInitValue=0, ComTransferProperty=PENDING:
            HED_MH_002_CRC16_oRDR_OBJ_HEADER_002_oPCAN_RADAR_81f46ac0_Tx: ComBitPosition=143, ComBitSize=16, ComSignalType=UINT16, ComSystemTemplateSystemSignalRef=HED_MH_002_CRC16
            HED_MH_002_CYCLE_COUNTER_oRDR_OBJ_HEADER_002_oPCAN_RADAR_03c7ff49_Tx: ComBitPosition=159, ComBitSize=8, ComSignalType=UINT8, ComSystemTemplateSystemSignalRef=HED_MH_002_CYCLE_COUNTER
            HED_TRKR_DATA_QUALIFIER_oRDR_OBJ_HEADER_002_oPCAN_RADAR_2d7db6a6_Tx: ComBitPosition=42, ComBitSize=3, ComSignalType=UINT8, ComSystemTemplateSystemSignalRef=HED_TRKR_DATA_QUALIFIER
            HED_TRKR_IDX_oRDR_OBJ_HEADER_002_oPCAN_RADAR_1c8e25ae_Tx: ComBitPosition=7, ComBitSize=16, ComSignalType=UINT16, ComSystemTemplateSystemSignalRef=HED_TRKR_IDX
            HED_TRKR_NUM_OF_ACTIV_OBJS_oRDR_OBJ_HEADER_002_oPCAN_RADAR_66219812_Tx: ComBitPosition=55, ComBitSize=8, ComSignalType=UINT8, ComSystemTemplateSystemSignalRef=HED_TRKR_NUM_OF_ACTIV_OBJS
            HED_TRKR_OBJLST_TIME_STAMP_NS_oRDR_OBJ_HEADER_002_oPCAN_RADAR_d5ff88d0_Tx: ComBitPosition=111, ComBitSize=32, ComSignalType=UINT32, ComSystemTemplateSystemSignalRef=HED_TRKR_OBJLST_TIME_STAMP_NS
            HED_TRKR_OBJLST_TIME_STAMP_SC_oRDR_OBJ_HEADER_002_oPCAN_RADAR_606a08de_Tx: ComBitPosition=79, ComBitSize=32, ComSignalType=UINT32, ComSystemTemplateSystemSignalRef=HED_TRKR_OBJLST_TIME_STAMP_SC
            HED_TRKR_TIME_INST_oRDR_OBJ_HEADER_002_oPCAN_RADAR_b8b3e235_Tx: ComBitPosition=63, ComBitSize=8, ComSignalType=UINT8, ComSystemTemplateSystemSignalRef=HED_TRKR_TIME_INST
            HED_TRKR_TIME_PEAK_oRDR_OBJ_HEADER_002_oPCAN_RADAR_a4f5b1b3_Tx: ComBitPosition=71, ComBitSize=8, ComSignalType=UINT8, ComSystemTemplateSystemSignalRef=HED_TRKR_TIME_PEAK
            HED_TRKR_VEHICLE_IDX_oRDR_OBJ_HEADER_002_oPCAN_RADAR_90acc389_Tx: ComBitPosition=23, ComBitSize=16, ComSignalType=UINT16, ComSystemTemplateSystemSignalRef=HED_TRKR_VEHICLE_IDX
            HED_TRKR_VEH_COORD_TYPE_oRDR_OBJ_HEADER_002_oPCAN_RADAR_7d99e32a_Tx: ComBitPosition=32, ComBitSize=1, ComSignalType=BOOLEAN, ComSystemTemplateSystemSignalRef=HED_TRKR_VEH_COORD_TYPE
        SG_TrackerObject001_oRDR_TRACKER_OBJ_001_oPCAN_RADAR_a5be7e9d_Tx: ComSystemTemplateSignalGroupRef=SG_TrackerObject001
          49 x ComGroupSignal, all with ComSignalEndianness=BIG_ENDIAN, ComSignalInitValue=0, ComTransferProperty=PENDING:
            OBJ_ACCELERATION_LAT_001_oRDR_TRACKER_OBJ_001_oPCAN_RADAR_ab9a25ea_Tx: ComBitPosition=177, ComBitSize=10, ComSignalType=UINT16, ComSystemTemplateSystemSignalRef=OBJ_ACCELERATION_LAT_001
            OBJ_ACCELERATION_LAT_ERR_001_oRDR_TRACKER_OBJ_001_oPCAN_RADAR_7e6e1f54_Tx: ComBitPosition=223, ComBitSize=8, ComSignalType=UINT8, ComSystemTemplateSystemSignalRef=OBJ_ACCELERATION_LAT_ERR_001
            OBJ_ACCELERATION_LONG_001_oRDR_TRACKER_OBJ_001_oPCAN_RADAR_d96a7c0a_Tx: ComBitPosition=193, ComBitSize=10, ComSignalType=UINT16, ComSystemTemplateSystemSignalRef=OBJ_ACCELERATION_LONG_001
            OBJ_ACCELERATION_LONG_ERR_001_oRDR_TRACKER_OBJ_001_oPCAN_RADAR_61cbbafe_Tx: ComBitPosition=215, ComBitSize=8, ComSignalType=UINT8, ComSystemTemplateSystemSignalRef=OBJ_ACCELERATION_LONG_ERR_001
            OBJ_ACCEL_ERR_CRR_COEF_001_oRDR_TRACKER_OBJ_001_oPCAN_RADAR_c1689b98_Tx: ComBitPosition=431, ComBitSize=8, ComSignalType=UINT8, ComSystemTemplateSystemSignalRef=OBJ_ACCEL_ERR_CRR_COEF_001
            OBJ_ALIVE_TIME_001_oRDR_TRACKER_OBJ_001_oPCAN_RADAR_b90b37b6_Tx: ComBitPosition=255, ComBitSize=16, ComSignalType=UINT16, ComSystemTemplateSystemSignalRef=OBJ_ALIVE_TIME_001
            OBJ_CLS_TYPE1_001_oRDR_TRACKER_OBJ_001_oPCAN_RADAR_2ed0d690_Tx: ComBitPosition=271, ComBitSize=4, ComSignalType=UINT8, ComSystemTemplateSystemSignalRef=OBJ_CLS_TYPE1_001
            OBJ_CLS_TYPE1_PROB_001_oRDR_TRACKER_OBJ_001_oPCAN_RADAR_86880163_Tx: ComBitPosition=303, ComBitSize=8, ComSignalType=UINT8, ComSystemTemplateSystemSignalRef=OBJ_CLS_TYPE1_PROB_001
            OBJ_CLS_TYPE2_001_oRDR_TRACKER_OBJ_001_oPCAN_RADAR_6338d6f7_Tx: ComBitPosition=267, ComBitSize=4, ComSignalType=UINT8, ComSystemTemplateSystemSignalRef=OBJ_CLS_TYPE2_001
            OBJ_CLS_TYPE2_PROB_001_oRDR_TRACKER_OBJ_001_oPCAN_RADAR_4fbc1a6e_Tx: ComBitPosition=311, ComBitSize=8, ComSignalType=UINT8, ComSystemTemplateSystemSignalRef=OBJ_CLS_TYPE2_PROB_001
            OBJ_CLS_TYPE3_001_oRDR_TRACKER_OBJ_001_oPCAN_RADAR_eeb02b15_Tx: ComBitPosition=279, ComBitSize=4, ComSignalType=UINT8, ComSystemTemplateSystemSignalRef=OBJ_CLS_TYPE3_001
            OBJ_CLS_TYPE3_PROB_001_oRDR_TRACKER_OBJ_001_oPCAN_RADAR_08afec95_Tx: ComBitPosition=319, ComBitSize=8, ComSignalType=UINT8, ComSystemTemplateSystemSignalRef=OBJ_CLS_TYPE3_PROB_001
            OBJ_CLS_TYPE4_001_oRDR_TRACKER_OBJ_001_oPCAN_RADAR_f8e8d639_Tx: ComBitPosition=275, ComBitSize=4, ComSignalType=UINT8, ComSystemTemplateSystemSignalRef=OBJ_CLS_TYPE4_001
            OBJ_CLS_TYPE4_PROB_001_oRDR_TRACKER_OBJ_001_oPCAN_RADAR_06a52a35_Tx: ComBitPosition=327, ComBitSize=8, ComSignalType=UINT8, ComSystemTemplateSystemSignalRef=OBJ_CLS_TYPE4_PROB_001
            OBJ_CLS_TYPE5_001_oRDR_TRACKER_OBJ_001_oPCAN_RADAR_75602bdb_Tx: ComBitPosition=287, ComBitSize=4, ComSignalType=UINT8, ComSystemTemplateSystemSignalRef=OBJ_CLS_TYPE5_001
            OBJ_CLS_TYPE5_PROB_001_oRDR_TRACKER_OBJ_001_oPCAN_RADAR_41b6dcce_Tx: ComBitPosition=335, ComBitSize=8, ComSignalType=UINT8, ComSystemTemplateSystemSignalRef=OBJ_CLS_TYPE5_PROB_001
            OBJ_CLS_TYPE6_001_oRDR_TRACKER_OBJ_001_oPCAN_RADAR_38882bbc_Tx: ComBitPosition=282, ComBitSize=4, ComSignalType=UINT8, ComSystemTemplateSystemSignalRef=OBJ_CLS_TYPE6_001
            OBJ_CLS_TYPE6_PROB_001_oRDR_TRACKER_OBJ_001_oPCAN_RADAR_8882c7c3_Tx: ComBitPosition=343, ComBitSize=8, ComSignalType=UINT8, ComSystemTemplateSystemSignalRef=OBJ_CLS_TYPE6_PROB_001
            OBJ_DIMENSION_LENGTH_001_oRDR_TRACKER_OBJ_001_oPCAN_RADAR_6c4e85d4_Tx: ComBitPosition=37, ComBitSize=12, ComSignalType=UINT16, ComSystemTemplateSystemSignalRef=OBJ_DIMENSION_LENGTH_001
            OBJ_DIMENSION_LENGTH_ERR_001_oRDR_TRACKER_OBJ_001_oPCAN_RADAR_57b69aae_Tx: ComBitPosition=41, ComBitSize=10, ComSignalType=UINT16, ComSystemTemplateSystemSignalRef=OBJ_DIMENSION_LENGTH_ERR_001
            OBJ_DIMENSION_WIDTH_001_oRDR_TRACKER_OBJ_001_oPCAN_RADAR_4f807279_Tx: ComBitPosition=17, ComBitSize=10, ComSignalType=UINT16, ComSystemTemplateSystemSignalRef=OBJ_DIMENSION_WIDTH_001
            OBJ_DIMENSION_WIDTH_ERR_001_oRDR_TRACKER_OBJ_001_oPCAN_RADAR_af22b591_Tx: ComBitPosition=23, ComBitSize=6, ComSignalType=UINT8, ComSystemTemplateSystemSignalRef=OBJ_DIMENSION_WIDTH_ERR_001
            OBJ_EXISTENCE_PROB_001_oRDR_TRACKER_OBJ_001_oPCAN_RADAR_443cf644_Tx: ComBitPosition=229, ComBitSize=14, ComSignalType=UINT16, ComSystemTemplateSystemSignalRef=OBJ_EXISTENCE_PROB_001
            OBJ_GROUP_ID_001_oRDR_TRACKER_OBJ_001_oPCAN_RADAR_cd4ee2e9_Tx: ComBitPosition=405, ComBitSize=6, ComSignalType=UINT8, ComSystemTemplateSystemSignalRef=OBJ_GROUP_ID_001
            OBJ_ID_001_oRDR_TRACKER_OBJ_001_oPCAN_RADAR_3e60c9ee_Tx: ComBitPosition=7, ComBitSize=8, ComSignalType=UINT8, ComSystemTemplateSystemSignalRef=OBJ_ID_001
            OBJ_MEASUREMENT_STATUS_001_oRDR_TRACKER_OBJ_001_oPCAN_RADAR_41b2bb53_Tx: ComBitPosition=14, ComBitSize=3, ComSignalType=UINT8, ComSystemTemplateSystemSignalRef=OBJ_MEASUREMENT_STATUS_001
            OBJ_MH_CRC16_001_oRDR_TRACKER_OBJ_001_oPCAN_RADAR_3dd20c6f_Tx: ComBitPosition=495, ComBitSize=16, ComSignalType=UINT16, ComSystemTemplateSystemSignalRef=OBJ_MH_CRC16_001
            OBJ_MH_CYCLE_COUNTER_001_oRDR_TRACKER_OBJ_001_oPCAN_RADAR_4c36568e_Tx: ComBitPosition=487, ComBitSize=8, ComSignalType=UINT8, ComSystemTemplateSystemSignalRef=OBJ_MH_CYCLE_COUNTER_001
            OBJ_MOVEMENT_STATUS_001_oRDR_TRACKER_OBJ_001_oPCAN_RADAR_6e1c2e1f_Tx: ComBitPosition=196, ComBitSize=3, ComSignalType=UINT8, ComSystemTemplateSystemSignalRef=OBJ_MOVEMENT_STATUS_001
            OBJ_POS_ERR_CRR_COEF_001_oRDR_TRACKER_OBJ_001_oPCAN_RADAR_fe63ee25_Tx: ComBitPosition=415, ComBitSize=8, ComSignalType=UINT8, ComSystemTemplateSystemSignalRef=OBJ_POS_ERR_CRR_COEF_001
            OBJ_POS_LAT_001_oRDR_TRACKER_OBJ_001_oPCAN_RADAR_1ccc1369_Tx: ComBitPosition=79, ComBitSize=16, ComSignalType=UINT16, ComSystemTemplateSystemSignalRef=OBJ_POS_LAT_001
            OBJ_POS_LAT_ERR_001_oRDR_TRACKER_OBJ_001_oPCAN_RADAR_1880435e_Tx: ComBitPosition=103, ComBitSize=8, ComSignalType=UINT8, ComSystemTemplateSystemSignalRef=OBJ_POS_LAT_ERR_001
            OBJ_POS_LONG_001_oRDR_TRACKER_OBJ_001_oPCAN_RADAR_ad6cf8a6_Tx: ComBitPosition=63, ComBitSize=16, ComSignalType=UINT16, ComSystemTemplateSystemSignalRef=OBJ_POS_LONG_001
            OBJ_POS_LONG_ERR_001_oRDR_TRACKER_OBJ_001_oPCAN_RADAR_8178bdbc_Tx: ComBitPosition=95, ComBitSize=8, ComSignalType=UINT8, ComSystemTemplateSystemSignalRef=OBJ_POS_LONG_ERR_001
            OBJ_RCS_001_oRDR_TRACKER_OBJ_001_oPCAN_RADAR_3e03456e_Tx: ComBitPosition=351, ComBitSize=7, ComSignalType=UINT8, ComSystemTemplateSystemSignalRef=OBJ_RCS_001
            OBJ_REF_PT_LAT_OFFSET_001_oRDR_TRACKER_OBJ_001_oPCAN_RADAR_cb3e2e1b_Tx: ComBitPosition=370, ComBitSize=14, ComSignalType=UINT16, ComSystemTemplateSystemSignalRef=OBJ_REF_PT_LAT_OFFSET_001
            OBJ_REF_PT_LONG_OFFSET_001_oRDR_TRACKER_OBJ_001_oPCAN_RADAR_846cde18_Tx: ComBitPosition=357, ComBitSize=14, ComSignalType=UINT16, ComSystemTemplateSystemSignalRef=OBJ_REF_PT_LONG_OFFSET_001
            OBJ_TIMESTAMP_OFFSET_001_oRDR_TRACKER_OBJ_001_oPCAN_RADAR_3eaf4538_Tx: ComBitPosition=247, ComBitSize=8, ComSignalType=UINT8, ComSystemTemplateSystemSignalRef=OBJ_TIMESTAMP_OFFSET_001
            OBJ_TRACK_MOTION_MODEL_001_oRDR_TRACKER_OBJ_001_oPCAN_RADAR_f2ac44e5_Tx: ComBitPosition=9, ComBitSize=2, ComSignalType=UINT8, ComSystemTemplateSystemSignalRef=OBJ_TRACK_MOTION_MODEL_001
            OBJ_VEH_TRACK_FLAG_001_oRDR_TRACKER_OBJ_001_oPCAN_RADAR_7086b2b8_Tx: ComBitPosition=10, ComBitSize=1, ComSignalType=BOOLEAN, ComSystemTemplateSystemSignalRef=OBJ_VEH_TRACK_FLAG_001
            OBJ_VELOCITY_ERR_CRR_COEF_001_oRDR_TRACKER_OBJ_001_oPCAN_RADAR_5719d3c4_Tx: ComBitPosition=423, ComBitSize=8, ComSignalType=UINT8, ComSystemTemplateSystemSignalRef=OBJ_VELOCITY_ERR_CRR_COEF_001
            OBJ_VELOCITY_LAT_001_oRDR_TRACKER_OBJ_001_oPCAN_RADAR_58af564e_Tx: ComBitPosition=126, ComBitSize=15, ComSignalType=UINT16, ComSystemTemplateSystemSignalRef=OBJ_VELOCITY_LAT_001
            OBJ_VELOCITY_LAT_ERR_001_oRDR_TRACKER_OBJ_001_oPCAN_RADAR_6c55261f_Tx: ComBitPosition=151, ComBitSize=8, ComSignalType=UINT8, ComSystemTemplateSystemSignalRef=OBJ_VELOCITY_LAT_ERR_001
            OBJ_VELOCITY_LONG_001_oRDR_TRACKER_OBJ_001_oPCAN_RADAR_08222e88_Tx: ComBitPosition=110, ComBitSize=15, ComSignalType=UINT16, ComSystemTemplateSystemSignalRef=OBJ_VELOCITY_LONG_001
            OBJ_VELOCITY_LONG_ERR_001_oRDR_TRACKER_OBJ_001_oPCAN_RADAR_80d719df_Tx: ComBitPosition=143, ComBitSize=8, ComSignalType=UINT8, ComSystemTemplateSystemSignalRef=OBJ_VELOCITY_LONG_ERR_001
            OBJ_YAW_ANGLE_001_oRDR_TRACKER_OBJ_001_oPCAN_RADAR_b413120e_Tx: ComBitPosition=155, ComBitSize=12, ComSignalType=UINT16, ComSystemTemplateSystemSignalRef=OBJ_YAW_ANGLE_001
            OBJ_YAW_ANGLE_ERR_001_oRDR_TRACKER_OBJ_001_oPCAN_RADAR_611e14d9_Tx: ComBitPosition=175, ComBitSize=7, ComSignalType=UINT8, ComSystemTemplateSystemSignalRef=OBJ_YAW_ANGLE_ERR_001
            OBJ_YAW_RATE_001_oRDR_TRACKER_OBJ_001_oPCAN_RADAR_919c3749_Tx: ComBitPosition=399, ComBitSize=10, ComSignalType=UINT16, ComSystemTemplateSystemSignalRef=OBJ_YAW_RATE_001
            OBJ_YAW_RATE_ERR_001_oRDR_TRACKER_OBJ_001_oPCAN_RADAR_ae44a095_Tx: ComBitPosition=388, ComBitSize=5, ComSignalType=UINT8, ComSystemTemplateSystemSignalRef=OBJ_YAW_RATE_ERR_001
        SG_TrackerObject002_oRDR_TRACKER_OBJ_002_oPCAN_RADAR_75f2e109_Tx: ComSystemTemplateSignalGroupRef=SG_TrackerObject002
          49 x ComGroupSignal, all with ComSignalEndianness=BIG_ENDIAN, ComSignalInitValue=0, ComTransferProperty=PENDING:
            OBJ_ACCELERATION_LAT_002_oRDR_TRACKER_OBJ_002_oPCAN_RADAR_7bd6ba7e_Tx: ComBitPosition=177, ComBitSize=10, ComSignalType=UINT16, ComSystemTemplateSystemSignalRef=OBJ_ACCELERATION_LAT_002
            OBJ_ACCELERATION_LAT_ERR_002_oRDR_TRACKER_OBJ_002_oPCAN_RADAR_ae2280c0_Tx: ComBitPosition=223, ComBitSize=8, ComSignalType=UINT8, ComSystemTemplateSystemSignalRef=OBJ_ACCELERATION_LAT_ERR_002
            OBJ_ACCELERATION_LONG_002_oRDR_TRACKER_OBJ_002_oPCAN_RADAR_0926e39e_Tx: ComBitPosition=193, ComBitSize=10, ComSignalType=UINT16, ComSystemTemplateSystemSignalRef=OBJ_ACCELERATION_LONG_002
            OBJ_ACCELERATION_LONG_ERR_002_oRDR_TRACKER_OBJ_002_oPCAN_RADAR_b187256a_Tx: ComBitPosition=215, ComBitSize=8, ComSignalType=UINT8, ComSystemTemplateSystemSignalRef=OBJ_ACCELERATION_LONG_ERR_002
            OBJ_ACCEL_ERR_CRR_COEF_002_oRDR_TRACKER_OBJ_002_oPCAN_RADAR_1124040c_Tx: ComBitPosition=431, ComBitSize=8, ComSignalType=UINT8, ComSystemTemplateSystemSignalRef=OBJ_ACCEL_ERR_CRR_COEF_002
            OBJ_ALIVE_TIME_002_oRDR_TRACKER_OBJ_002_oPCAN_RADAR_6947a822_Tx: ComBitPosition=255, ComBitSize=16, ComSignalType=UINT16, ComSystemTemplateSystemSignalRef=OBJ_ALIVE_TIME_002
            OBJ_CLS_TYPE1_002_oRDR_TRACKER_OBJ_002_oPCAN_RADAR_fe9c4904_Tx: ComBitPosition=271, ComBitSize=4, ComSignalType=UINT8, ComSystemTemplateSystemSignalRef=OBJ_CLS_TYPE1_002
            OBJ_CLS_TYPE1_PROB_002_oRDR_TRACKER_OBJ_002_oPCAN_RADAR_56c49ef7_Tx: ComBitPosition=303, ComBitSize=8, ComSignalType=UINT8, ComSystemTemplateSystemSignalRef=OBJ_CLS_TYPE1_PROB_002
            OBJ_CLS_TYPE2_002_oRDR_TRACKER_OBJ_002_oPCAN_RADAR_b3744963_Tx: ComBitPosition=267, ComBitSize=4, ComSignalType=UINT8, ComSystemTemplateSystemSignalRef=OBJ_CLS_TYPE2_002
            OBJ_CLS_TYPE2_PROB_002_oRDR_TRACKER_OBJ_002_oPCAN_RADAR_9ff085fa_Tx: ComBitPosition=311, ComBitSize=8, ComSignalType=UINT8, ComSystemTemplateSystemSignalRef=OBJ_CLS_TYPE2_PROB_002
            OBJ_CLS_TYPE3_002_oRDR_TRACKER_OBJ_002_oPCAN_RADAR_3efcb481_Tx: ComBitPosition=279, ComBitSize=4, ComSignalType=UINT8, ComSystemTemplateSystemSignalRef=OBJ_CLS_TYPE3_002
            OBJ_CLS_TYPE3_PROB_002_oRDR_TRACKER_OBJ_002_oPCAN_RADAR_d8e37301_Tx: ComBitPosition=319, ComBitSize=8, ComSignalType=UINT8, ComSystemTemplateSystemSignalRef=OBJ_CLS_TYPE3_PROB_002
            OBJ_CLS_TYPE4_002_oRDR_TRACKER_OBJ_002_oPCAN_RADAR_28a449ad_Tx: ComBitPosition=275, ComBitSize=4, ComSignalType=UINT8, ComSystemTemplateSystemSignalRef=OBJ_CLS_TYPE4_002
            OBJ_CLS_TYPE4_PROB_002_oRDR_TRACKER_OBJ_002_oPCAN_RADAR_d6e9b5a1_Tx: ComBitPosition=327, ComBitSize=8, ComSignalType=UINT8, ComSystemTemplateSystemSignalRef=OBJ_CLS_TYPE4_PROB_002
            OBJ_CLS_TYPE5_002_oRDR_TRACKER_OBJ_002_oPCAN_RADAR_a52cb44f_Tx: ComBitPosition=287, ComBitSize=4, ComSignalType=UINT8, ComSystemTemplateSystemSignalRef=OBJ_CLS_TYPE5_002
            OBJ_CLS_TYPE5_PROB_002_oRDR_TRACKER_OBJ_002_oPCAN_RADAR_91fa435a_Tx: ComBitPosition=335, ComBitSize=8, ComSignalType=UINT8, ComSystemTemplateSystemSignalRef=OBJ_CLS_TYPE5_PROB_002
            OBJ_CLS_TYPE6_002_oRDR_TRACKER_OBJ_002_oPCAN_RADAR_e8c4b428_Tx: ComBitPosition=282, ComBitSize=4, ComSignalType=UINT8, ComSystemTemplateSystemSignalRef=OBJ_CLS_TYPE6_002
            OBJ_CLS_TYPE6_PROB_002_oRDR_TRACKER_OBJ_002_oPCAN_RADAR_58ce5857_Tx: ComBitPosition=343, ComBitSize=8, ComSignalType=UINT8, ComSystemTemplateSystemSignalRef=OBJ_CLS_TYPE6_PROB_002
            OBJ_DIMENSION_LENGTH_002_oRDR_TRACKER_OBJ_002_oPCAN_RADAR_bc021a40_Tx: ComBitPosition=37, ComBitSize=12, ComSignalType=UINT16, ComSystemTemplateSystemSignalRef=OBJ_DIMENSION_LENGTH_002
            OBJ_DIMENSION_LENGTH_ERR_002_oRDR_TRACKER_OBJ_002_oPCAN_RADAR_87fa053a_Tx: ComBitPosition=41, ComBitSize=10, ComSignalType=UINT16, ComSystemTemplateSystemSignalRef=OBJ_DIMENSION_LENGTH_ERR_002
            OBJ_DIMENSION_WIDTH_002_oRDR_TRACKER_OBJ_002_oPCAN_RADAR_9fcceded_Tx: ComBitPosition=17, ComBitSize=10, ComSignalType=UINT16, ComSystemTemplateSystemSignalRef=OBJ_DIMENSION_WIDTH_002
            OBJ_DIMENSION_WIDTH_ERR_002_oRDR_TRACKER_OBJ_002_oPCAN_RADAR_7f6e2a05_Tx: ComBitPosition=23, ComBitSize=6, ComSignalType=UINT8, ComSystemTemplateSystemSignalRef=OBJ_DIMENSION_WIDTH_ERR_002
            OBJ_EXISTENCE_PROB_002_oRDR_TRACKER_OBJ_002_oPCAN_RADAR_947069d0_Tx: ComBitPosition=229, ComBitSize=14, ComSignalType=UINT16, ComSystemTemplateSystemSignalRef=OBJ_EXISTENCE_PROB_002
            OBJ_GROUP_ID_002_oRDR_TRACKER_OBJ_002_oPCAN_RADAR_1d027d7d_Tx: ComBitPosition=405, ComBitSize=6, ComSignalType=UINT8, ComSystemTemplateSystemSignalRef=OBJ_GROUP_ID_002
            OBJ_ID_002_oRDR_TRACKER_OBJ_002_oPCAN_RADAR_ee2c567a_Tx: ComBitPosition=7, ComBitSize=8, ComSignalType=UINT8, ComSystemTemplateSystemSignalRef=OBJ_ID_002
            OBJ_MEASUREMENT_STATUS_002_oRDR_TRACKER_OBJ_002_oPCAN_RADAR_91fe24c7_Tx: ComBitPosition=14, ComBitSize=3, ComSignalType=UINT8, ComSystemTemplateSystemSignalRef=OBJ_MEASUREMENT_STATUS_002
            OBJ_MH_CRC16_002_oRDR_TRACKER_OBJ_002_oPCAN_RADAR_ed9e93fb_Tx: ComBitPosition=495, ComBitSize=16, ComSignalType=UINT16, ComSystemTemplateSystemSignalRef=OBJ_MH_CRC16_002
            OBJ_MH_CYCLE_COUNTER_002_oRDR_TRACKER_OBJ_002_oPCAN_RADAR_9c7ac91a_Tx: ComBitPosition=487, ComBitSize=8, ComSignalType=UINT8, ComSystemTemplateSystemSignalRef=OBJ_MH_CYCLE_COUNTER_002
            OBJ_MOVEMENT_STATUS_002_oRDR_TRACKER_OBJ_002_oPCAN_RADAR_be50b18b_Tx: ComBitPosition=196, ComBitSize=3, ComSignalType=UINT8, ComSystemTemplateSystemSignalRef=OBJ_MOVEMENT_STATUS_002
            OBJ_POS_ERR_CRR_COEF_002_oRDR_TRACKER_OBJ_002_oPCAN_RADAR_2e2f71b1_Tx: ComBitPosition=415, ComBitSize=8, ComSignalType=UINT8, ComSystemTemplateSystemSignalRef=OBJ_POS_ERR_CRR_COEF_002
            OBJ_POS_LAT_002_oRDR_TRACKER_OBJ_002_oPCAN_RADAR_cc808cfd_Tx: ComBitPosition=79, ComBitSize=16, ComSignalType=UINT16, ComSystemTemplateSystemSignalRef=OBJ_POS_LAT_002
            OBJ_POS_LAT_ERR_002_oRDR_TRACKER_OBJ_002_oPCAN_RADAR_c8ccdcca_Tx: ComBitPosition=103, ComBitSize=8, ComSignalType=UINT8, ComSystemTemplateSystemSignalRef=OBJ_POS_LAT_ERR_002
            OBJ_POS_LONG_002_oRDR_TRACKER_OBJ_002_oPCAN_RADAR_7d206732_Tx: ComBitPosition=63, ComBitSize=16, ComSignalType=UINT16, ComSystemTemplateSystemSignalRef=OBJ_POS_LONG_002
            OBJ_POS_LONG_ERR_002_oRDR_TRACKER_OBJ_002_oPCAN_RADAR_51342228_Tx: ComBitPosition=95, ComBitSize=8, ComSignalType=UINT8, ComSystemTemplateSystemSignalRef=OBJ_POS_LONG_ERR_002
            OBJ_RCS_002_oRDR_TRACKER_OBJ_002_oPCAN_RADAR_ee4fdafa_Tx: ComBitPosition=351, ComBitSize=7, ComSignalType=UINT8, ComSystemTemplateSystemSignalRef=OBJ_RCS_002
            OBJ_REF_PT_LAT_OFFSET_002_oRDR_TRACKER_OBJ_002_oPCAN_RADAR_1b72b18f_Tx: ComBitPosition=370, ComBitSize=14, ComSignalType=UINT16, ComSystemTemplateSystemSignalRef=OBJ_REF_PT_LAT_OFFSET_002
            OBJ_REF_PT_LONG_OFFSET_002_oRDR_TRACKER_OBJ_002_oPCAN_RADAR_5420418c_Tx: ComBitPosition=357, ComBitSize=14, ComSignalType=UINT16, ComSystemTemplateSystemSignalRef=OBJ_REF_PT_LONG_OFFSET_002
            OBJ_TIMESTAMP_OFFSET_002_oRDR_TRACKER_OBJ_002_oPCAN_RADAR_eee3daac_Tx: ComBitPosition=247, ComBitSize=8, ComSignalType=UINT8, ComSystemTemplateSystemSignalRef=OBJ_TIMESTAMP_OFFSET_002
            OBJ_TRACK_MOTION_MODEL_002_oRDR_TRACKER_OBJ_002_oPCAN_RADAR_22e0db71_Tx: ComBitPosition=9, ComBitSize=2, ComSignalType=UINT8, ComSystemTemplateSystemSignalRef=OBJ_TRACK_MOTION_MODEL_002
            OBJ_VEH_TRACK_FLAG_002_oRDR_TRACKER_OBJ_002_oPCAN_RADAR_a0ca2d2c_Tx: ComBitPosition=10, ComBitSize=1, ComSignalType=BOOLEAN, ComSystemTemplateSystemSignalRef=OBJ_VEH_TRACK_FLAG_002
            OBJ_VELOCITY_ERR_CRR_COEF_002_oRDR_TRACKER_OBJ_002_oPCAN_RADAR_87554c50_Tx: ComBitPosition=423, ComBitSize=8, ComSignalType=UINT8, ComSystemTemplateSystemSignalRef=OBJ_VELOCITY_ERR_CRR_COEF_002
            OBJ_VELOCITY_LAT_002_oRDR_TRACKER_OBJ_002_oPCAN_RADAR_88e3c9da_Tx: ComBitPosition=126, ComBitSize=15, ComSignalType=UINT16, ComSystemTemplateSystemSignalRef=OBJ_VELOCITY_LAT_002
            OBJ_VELOCITY_LAT_ERR_002_oRDR_TRACKER_OBJ_002_oPCAN_RADAR_bc19b98b_Tx: ComBitPosition=151, ComBitSize=8, ComSignalType=UINT8, ComSystemTemplateSystemSignalRef=OBJ_VELOCITY_LAT_ERR_002
            OBJ_VELOCITY_LONG_002_oRDR_TRACKER_OBJ_002_oPCAN_RADAR_d86eb11c_Tx: ComBitPosition=110, ComBitSize=15, ComSignalType=UINT16, ComSystemTemplateSystemSignalRef=OBJ_VELOCITY_LONG_002
            OBJ_VELOCITY_LONG_ERR_002_oRDR_TRACKER_OBJ_002_oPCAN_RADAR_509b864b_Tx: ComBitPosition=143, ComBitSize=8, ComSignalType=UINT8, ComSystemTemplateSystemSignalRef=OBJ_VELOCITY_LONG_ERR_002
            OBJ_YAW_ANGLE_002_oRDR_TRACKER_OBJ_002_oPCAN_RADAR_645f8d9a_Tx: ComBitPosition=155, ComBitSize=12, ComSignalType=UINT16, ComSystemTemplateSystemSignalRef=OBJ_YAW_ANGLE_002
            OBJ_YAW_ANGLE_ERR_002_oRDR_TRACKER_OBJ_002_oPCAN_RADAR_b1528b4d_Tx: ComBitPosition=175, ComBitSize=7, ComSignalType=UINT8, ComSystemTemplateSystemSignalRef=OBJ_YAW_ANGLE_ERR_002
            OBJ_YAW_RATE_002_oRDR_TRACKER_OBJ_002_oPCAN_RADAR_41d0a8dd_Tx: ComBitPosition=399, ComBitSize=10, ComSignalType=UINT16, ComSystemTemplateSystemSignalRef=OBJ_YAW_RATE_002
            OBJ_YAW_RATE_ERR_002_oRDR_TRACKER_OBJ_002_oPCAN_RADAR_7e083f01_Tx: ComBitPosition=388, ComBitSize=5, ComSignalType=UINT8, ComSystemTemplateSystemSignalRef=OBJ_YAW_RATE_ERR_002
        SG_TrackerObject003_oRDR_TRACKER_OBJ_003_oPCAN_RADAR_8ce669ba_Tx: ComSystemTemplateSignalGroupRef=SG_TrackerObject003
          49 x ComGroupSignal, all with ComSignalEndianness=BIG_ENDIAN, ComSignalInitValue=0, ComTransferProperty=PENDING:
            OBJ_ACCELERATION_LAT_003_oRDR_TRACKER_OBJ_003_oPCAN_RADAR_82c232cd_Tx: ComBitPosition=177, ComBitSize=10, ComSignalType=UINT16, ComSystemTemplateSystemSignalRef=OBJ_ACCELERATION_LAT_003
            OBJ_ACCELERATION_LAT_ERR_003_oRDR_TRACKER_OBJ_003_oPCAN_RADAR_57360873_Tx: ComBitPosition=223, ComBitSize=8, ComSignalType=UINT8, ComSystemTemplateSystemSignalRef=OBJ_ACCELERATION_LAT_ERR_003
            OBJ_ACCELERATION_LONG_003_oRDR_TRACKER_OBJ_003_oPCAN_RADAR_f0326b2d_Tx: ComBitPosition=193, ComBitSize=10, ComSignalType=UINT16, ComSystemTemplateSystemSignalRef=OBJ_ACCELERATION_LONG_003
            OBJ_ACCELERATION_LONG_ERR_003_oRDR_TRACKER_OBJ_003_oPCAN_RADAR_4893add9_Tx: ComBitPosition=215, ComBitSize=8, ComSignalType=UINT8, ComSystemTemplateSystemSignalRef=OBJ_ACCELERATION_LONG_ERR_003
            OBJ_ACCEL_ERR_CRR_COEF_003_oRDR_TRACKER_OBJ_003_oPCAN_RADAR_e8308cbf_Tx: ComBitPosition=431, ComBitSize=8, ComSignalType=UINT8, ComSystemTemplateSystemSignalRef=OBJ_ACCEL_ERR_CRR_COEF_003
            OBJ_ALIVE_TIME_003_oRDR_TRACKER_OBJ_003_oPCAN_RADAR_90532091_Tx: ComBitPosition=255, ComBitSize=16, ComSignalType=UINT16, ComSystemTemplateSystemSignalRef=OBJ_ALIVE_TIME_003
            OBJ_CLS_TYPE1_003_oRDR_TRACKER_OBJ_003_oPCAN_RADAR_0788c1b7_Tx: ComBitPosition=271, ComBitSize=4, ComSignalType=UINT8, ComSystemTemplateSystemSignalRef=OBJ_CLS_TYPE1_003
            OBJ_CLS_TYPE1_PROB_003_oRDR_TRACKER_OBJ_003_oPCAN_RADAR_afd01644_Tx: ComBitPosition=303, ComBitSize=8, ComSignalType=UINT8, ComSystemTemplateSystemSignalRef=OBJ_CLS_TYPE1_PROB_003
            OBJ_CLS_TYPE2_003_oRDR_TRACKER_OBJ_003_oPCAN_RADAR_4a60c1d0_Tx: ComBitPosition=267, ComBitSize=4, ComSignalType=UINT8, ComSystemTemplateSystemSignalRef=OBJ_CLS_TYPE2_003
            OBJ_CLS_TYPE2_PROB_003_oRDR_TRACKER_OBJ_003_oPCAN_RADAR_66e40d49_Tx: ComBitPosition=311, ComBitSize=8, ComSignalType=UINT8, ComSystemTemplateSystemSignalRef=OBJ_CLS_TYPE2_PROB_003
            OBJ_CLS_TYPE3_003_oRDR_TRACKER_OBJ_003_oPCAN_RADAR_c7e83c32_Tx: ComBitPosition=279, ComBitSize=4, ComSignalType=UINT8, ComSystemTemplateSystemSignalRef=OBJ_CLS_TYPE3_003
            OBJ_CLS_TYPE3_PROB_003_oRDR_TRACKER_OBJ_003_oPCAN_RADAR_21f7fbb2_Tx: ComBitPosition=319, ComBitSize=8, ComSignalType=UINT8, ComSystemTemplateSystemSignalRef=OBJ_CLS_TYPE3_PROB_003
            OBJ_CLS_TYPE4_003_oRDR_TRACKER_OBJ_003_oPCAN_RADAR_d1b0c11e_Tx: ComBitPosition=275, ComBitSize=4, ComSignalType=UINT8, ComSystemTemplateSystemSignalRef=OBJ_CLS_TYPE4_003
            OBJ_CLS_TYPE4_PROB_003_oRDR_TRACKER_OBJ_003_oPCAN_RADAR_2ffd3d12_Tx: ComBitPosition=327, ComBitSize=8, ComSignalType=UINT8, ComSystemTemplateSystemSignalRef=OBJ_CLS_TYPE4_PROB_003
            OBJ_CLS_TYPE5_003_oRDR_TRACKER_OBJ_003_oPCAN_RADAR_5c383cfc_Tx: ComBitPosition=287, ComBitSize=4, ComSignalType=UINT8, ComSystemTemplateSystemSignalRef=OBJ_CLS_TYPE5_003
            OBJ_CLS_TYPE5_PROB_003_oRDR_TRACKER_OBJ_003_oPCAN_RADAR_68eecbe9_Tx: ComBitPosition=335, ComBitSize=8, ComSignalType=UINT8, ComSystemTemplateSystemSignalRef=OBJ_CLS_TYPE5_PROB_003
            OBJ_CLS_TYPE6_003_oRDR_TRACKER_OBJ_003_oPCAN_RADAR_11d03c9b_Tx: ComBitPosition=282, ComBitSize=4, ComSignalType=UINT8, ComSystemTemplateSystemSignalRef=OBJ_CLS_TYPE6_003
            OBJ_CLS_TYPE6_PROB_003_oRDR_TRACKER_OBJ_003_oPCAN_RADAR_a1dad0e4_Tx: ComBitPosition=343, ComBitSize=8, ComSignalType=UINT8, ComSystemTemplateSystemSignalRef=OBJ_CLS_TYPE6_PROB_003
            OBJ_DIMENSION_LENGTH_003_oRDR_TRACKER_OBJ_003_oPCAN_RADAR_451692f3_Tx: ComBitPosition=37, ComBitSize=12, ComSignalType=UINT16, ComSystemTemplateSystemSignalRef=OBJ_DIMENSION_LENGTH_003
            OBJ_DIMENSION_LENGTH_ERR_003_oRDR_TRACKER_OBJ_003_oPCAN_RADAR_7eee8d89_Tx: ComBitPosition=41, ComBitSize=10, ComSignalType=UINT16, ComSystemTemplateSystemSignalRef=OBJ_DIMENSION_LENGTH_ERR_003
            OBJ_DIMENSION_WIDTH_003_oRDR_TRACKER_OBJ_003_oPCAN_RADAR_66d8655e_Tx: ComBitPosition=17, ComBitSize=10, ComSignalType=UINT16, ComSystemTemplateSystemSignalRef=OBJ_DIMENSION_WIDTH_003
            OBJ_DIMENSION_WIDTH_ERR_003_oRDR_TRACKER_OBJ_003_oPCAN_RADAR_867aa2b6_Tx: ComBitPosition=23, ComBitSize=6, ComSignalType=UINT8, ComSystemTemplateSystemSignalRef=OBJ_DIMENSION_WIDTH_ERR_003
            OBJ_EXISTENCE_PROB_003_oRDR_TRACKER_OBJ_003_oPCAN_RADAR_6d64e163_Tx: ComBitPosition=229, ComBitSize=14, ComSignalType=UINT16, ComSystemTemplateSystemSignalRef=OBJ_EXISTENCE_PROB_003
            OBJ_GROUP_ID_003_oRDR_TRACKER_OBJ_003_oPCAN_RADAR_e416f5ce_Tx: ComBitPosition=405, ComBitSize=6, ComSignalType=UINT8, ComSystemTemplateSystemSignalRef=OBJ_GROUP_ID_003
            OBJ_ID_003_oRDR_TRACKER_OBJ_003_oPCAN_RADAR_1738dec9_Tx: ComBitPosition=7, ComBitSize=8, ComSignalType=UINT8, ComSystemTemplateSystemSignalRef=OBJ_ID_003
            OBJ_MEASUREMENT_STATUS_003_oRDR_TRACKER_OBJ_003_oPCAN_RADAR_68eaac74_Tx: ComBitPosition=14, ComBitSize=3, ComSignalType=UINT8, ComSystemTemplateSystemSignalRef=OBJ_MEASUREMENT_STATUS_003
            OBJ_MH_CRC16_003_oRDR_TRACKER_OBJ_003_oPCAN_RADAR_148a1b48_Tx: ComBitPosition=495, ComBitSize=16, ComSignalType=UINT16, ComSystemTemplateSystemSignalRef=OBJ_MH_CRC16_003
            OBJ_MH_CYCLE_COUNTER_003_oRDR_TRACKER_OBJ_003_oPCAN_RADAR_656e41a9_Tx: ComBitPosition=487, ComBitSize=8, ComSignalType=UINT8, ComSystemTemplateSystemSignalRef=OBJ_MH_CYCLE_COUNTER_003
            OBJ_MOVEMENT_STATUS_003_oRDR_TRACKER_OBJ_003_oPCAN_RADAR_47443938_Tx: ComBitPosition=196, ComBitSize=3, ComSignalType=UINT8, ComSystemTemplateSystemSignalRef=OBJ_MOVEMENT_STATUS_003
            OBJ_POS_ERR_CRR_COEF_003_oRDR_TRACKER_OBJ_003_oPCAN_RADAR_d73bf902_Tx: ComBitPosition=415, ComBitSize=8, ComSignalType=UINT8, ComSystemTemplateSystemSignalRef=OBJ_POS_ERR_CRR_COEF_003
            OBJ_POS_LAT_003_oRDR_TRACKER_OBJ_003_oPCAN_RADAR_3594044e_Tx: ComBitPosition=79, ComBitSize=16, ComSignalType=UINT16, ComSystemTemplateSystemSignalRef=OBJ_POS_LAT_003
            OBJ_POS_LAT_ERR_003_oRDR_TRACKER_OBJ_003_oPCAN_RADAR_31d85479_Tx: ComBitPosition=103, ComBitSize=8, ComSignalType=UINT8, ComSystemTemplateSystemSignalRef=OBJ_POS_LAT_ERR_003
            OBJ_POS_LONG_003_oRDR_TRACKER_OBJ_003_oPCAN_RADAR_8434ef81_Tx: ComBitPosition=63, ComBitSize=16, ComSignalType=UINT16, ComSystemTemplateSystemSignalRef=OBJ_POS_LONG_003
            OBJ_POS_LONG_ERR_003_oRDR_TRACKER_OBJ_003_oPCAN_RADAR_a820aa9b_Tx: ComBitPosition=95, ComBitSize=8, ComSignalType=UINT8, ComSystemTemplateSystemSignalRef=OBJ_POS_LONG_ERR_003
            OBJ_RCS_003_oRDR_TRACKER_OBJ_003_oPCAN_RADAR_175b5249_Tx: ComBitPosition=351, ComBitSize=7, ComSignalType=UINT8, ComSystemTemplateSystemSignalRef=OBJ_RCS_003
            OBJ_REF_PT_LAT_OFFSET_003_oRDR_TRACKER_OBJ_003_oPCAN_RADAR_e266393c_Tx: ComBitPosition=370, ComBitSize=14, ComSignalType=UINT16, ComSystemTemplateSystemSignalRef=OBJ_REF_PT_LAT_OFFSET_003
            OBJ_REF_PT_LONG_OFFSET_003_oRDR_TRACKER_OBJ_003_oPCAN_RADAR_ad34c93f_Tx: ComBitPosition=357, ComBitSize=14, ComSignalType=UINT16, ComSystemTemplateSystemSignalRef=OBJ_REF_PT_LONG_OFFSET_003
            OBJ_TIMESTAMP_OFFSET_003_oRDR_TRACKER_OBJ_003_oPCAN_RADAR_17f7521f_Tx: ComBitPosition=247, ComBitSize=8, ComSignalType=UINT8, ComSystemTemplateSystemSignalRef=OBJ_TIMESTAMP_OFFSET_003
            OBJ_TRACK_MOTION_MODEL_003_oRDR_TRACKER_OBJ_003_oPCAN_RADAR_dbf453c2_Tx: ComBitPosition=9, ComBitSize=2, ComSignalType=UINT8, ComSystemTemplateSystemSignalRef=OBJ_TRACK_MOTION_MODEL_003
            OBJ_VEH_TRACK_FLAG_003_oRDR_TRACKER_OBJ_003_oPCAN_RADAR_59dea59f_Tx: ComBitPosition=10, ComBitSize=1, ComSignalType=BOOLEAN, ComSystemTemplateSystemSignalRef=OBJ_VEH_TRACK_FLAG_003
            OBJ_VELOCITY_ERR_CRR_COEF_003_oRDR_TRACKER_OBJ_003_oPCAN_RADAR_7e41c4e3_Tx: ComBitPosition=423, ComBitSize=8, ComSignalType=UINT8, ComSystemTemplateSystemSignalRef=OBJ_VELOCITY_ERR_CRR_COEF_003
            OBJ_VELOCITY_LAT_003_oRDR_TRACKER_OBJ_003_oPCAN_RADAR_71f74169_Tx: ComBitPosition=126, ComBitSize=15, ComSignalType=UINT16, ComSystemTemplateSystemSignalRef=OBJ_VELOCITY_LAT_003
            OBJ_VELOCITY_LAT_ERR_003_oRDR_TRACKER_OBJ_003_oPCAN_RADAR_450d3138_Tx: ComBitPosition=151, ComBitSize=8, ComSignalType=UINT8, ComSystemTemplateSystemSignalRef=OBJ_VELOCITY_LAT_ERR_003
            OBJ_VELOCITY_LONG_003_oRDR_TRACKER_OBJ_003_oPCAN_RADAR_217a39af_Tx: ComBitPosition=110, ComBitSize=15, ComSignalType=UINT16, ComSystemTemplateSystemSignalRef=OBJ_VELOCITY_LONG_003
            OBJ_VELOCITY_LONG_ERR_003_oRDR_TRACKER_OBJ_003_oPCAN_RADAR_a98f0ef8_Tx: ComBitPosition=143, ComBitSize=8, ComSignalType=UINT8, ComSystemTemplateSystemSignalRef=OBJ_VELOCITY_LONG_ERR_003
            OBJ_YAW_ANGLE_003_oRDR_TRACKER_OBJ_003_oPCAN_RADAR_9d4b0529_Tx: ComBitPosition=155, ComBitSize=12, ComSignalType=UINT16, ComSystemTemplateSystemSignalRef=OBJ_YAW_ANGLE_003
            OBJ_YAW_ANGLE_ERR_003_oRDR_TRACKER_OBJ_003_oPCAN_RADAR_484603fe_Tx: ComBitPosition=175, ComBitSize=7, ComSignalType=UINT8, ComSystemTemplateSystemSignalRef=OBJ_YAW_ANGLE_ERR_003
            OBJ_YAW_RATE_003_oRDR_TRACKER_OBJ_003_oPCAN_RADAR_b8c4206e_Tx: ComBitPosition=399, ComBitSize=10, ComSignalType=UINT16, ComSystemTemplateSystemSignalRef=OBJ_YAW_RATE_003
            OBJ_YAW_RATE_ERR_003_oRDR_TRACKER_OBJ_003_oPCAN_RADAR_871cb7b2_Tx: ComBitPosition=388, ComBitSize=5, ComSignalType=UINT8, ComSystemTemplateSystemSignalRef=OBJ_YAW_RATE_ERR_003
        SG_TrackerObject004_oRDR_TRACKER_OBJ_004_oPCAN_RADAR_0e1ad860_Tx: ComSystemTemplateSignalGroupRef=SG_TrackerObject004
          49 x ComGroupSignal, all with ComSignalEndianness=BIG_ENDIAN, ComSignalInitValue=0, ComTransferProperty=PENDING:
            OBJ_ACCELERATION_LAT_004_oRDR_TRACKER_OBJ_004_oPCAN_RADAR_003e8317_Tx: ComBitPosition=177, ComBitSize=10, ComSignalType=UINT16, ComSystemTemplateSystemSignalRef=OBJ_ACCELERATION_LAT_004
            OBJ_ACCELERATION_LAT_ERR_004_oRDR_TRACKER_OBJ_004_oPCAN_RADAR_d5cab9a9_Tx: ComBitPosition=223, ComBitSize=8, ComSignalType=UINT8, ComSystemTemplateSystemSignalRef=OBJ_ACCELERATION_LAT_ERR_004
            OBJ_ACCELERATION_LONG_004_oRDR_TRACKER_OBJ_004_oPCAN_RADAR_72cedaf7_Tx: ComBitPosition=193, ComBitSize=10, ComSignalType=UINT16, ComSystemTemplateSystemSignalRef=OBJ_ACCELERATION_LONG_004
            OBJ_ACCELERATION_LONG_ERR_004_oRDR_TRACKER_OBJ_004_oPCAN_RADAR_ca6f1c03_Tx: ComBitPosition=215, ComBitSize=8, ComSignalType=UINT8, ComSystemTemplateSystemSignalRef=OBJ_ACCELERATION_LONG_ERR_004
            OBJ_ACCEL_ERR_CRR_COEF_004_oRDR_TRACKER_OBJ_004_oPCAN_RADAR_6acc3d65_Tx: ComBitPosition=431, ComBitSize=8, ComSignalType=UINT8, ComSystemTemplateSystemSignalRef=OBJ_ACCEL_ERR_CRR_COEF_004
            OBJ_ALIVE_TIME_004_oRDR_TRACKER_OBJ_004_oPCAN_RADAR_12af914b_Tx: ComBitPosition=255, ComBitSize=16, ComSignalType=UINT16, ComSystemTemplateSystemSignalRef=OBJ_ALIVE_TIME_004
            OBJ_CLS_TYPE1_004_oRDR_TRACKER_OBJ_004_oPCAN_RADAR_8574706d_Tx: ComBitPosition=271, ComBitSize=4, ComSignalType=UINT8, ComSystemTemplateSystemSignalRef=OBJ_CLS_TYPE1_004
            OBJ_CLS_TYPE1_PROB_004_oRDR_TRACKER_OBJ_004_oPCAN_RADAR_2d2ca79e_Tx: ComBitPosition=303, ComBitSize=8, ComSignalType=UINT8, ComSystemTemplateSystemSignalRef=OBJ_CLS_TYPE1_PROB_004
            OBJ_CLS_TYPE2_004_oRDR_TRACKER_OBJ_004_oPCAN_RADAR_c89c700a_Tx: ComBitPosition=267, ComBitSize=4, ComSignalType=UINT8, ComSystemTemplateSystemSignalRef=OBJ_CLS_TYPE2_004
            OBJ_CLS_TYPE2_PROB_004_oRDR_TRACKER_OBJ_004_oPCAN_RADAR_e418bc93_Tx: ComBitPosition=311, ComBitSize=8, ComSignalType=UINT8, ComSystemTemplateSystemSignalRef=OBJ_CLS_TYPE2_PROB_004
            OBJ_CLS_TYPE3_004_oRDR_TRACKER_OBJ_004_oPCAN_RADAR_45148de8_Tx: ComBitPosition=279, ComBitSize=4, ComSignalType=UINT8, ComSystemTemplateSystemSignalRef=OBJ_CLS_TYPE3_004
            OBJ_CLS_TYPE3_PROB_004_oRDR_TRACKER_OBJ_004_oPCAN_RADAR_a30b4a68_Tx: ComBitPosition=319, ComBitSize=8, ComSignalType=UINT8, ComSystemTemplateSystemSignalRef=OBJ_CLS_TYPE3_PROB_004
            OBJ_CLS_TYPE4_004_oRDR_TRACKER_OBJ_004_oPCAN_RADAR_534c70c4_Tx: ComBitPosition=275, ComBitSize=4, ComSignalType=UINT8, ComSystemTemplateSystemSignalRef=OBJ_CLS_TYPE4_004
            OBJ_CLS_TYPE4_PROB_004_oRDR_TRACKER_OBJ_004_oPCAN_RADAR_ad018cc8_Tx: ComBitPosition=327, ComBitSize=8, ComSignalType=UINT8, ComSystemTemplateSystemSignalRef=OBJ_CLS_TYPE4_PROB_004
            OBJ_CLS_TYPE5_004_oRDR_TRACKER_OBJ_004_oPCAN_RADAR_dec48d26_Tx: ComBitPosition=287, ComBitSize=4, ComSignalType=UINT8, ComSystemTemplateSystemSignalRef=OBJ_CLS_TYPE5_004
            OBJ_CLS_TYPE5_PROB_004_oRDR_TRACKER_OBJ_004_oPCAN_RADAR_ea127a33_Tx: ComBitPosition=335, ComBitSize=8, ComSignalType=UINT8, ComSystemTemplateSystemSignalRef=OBJ_CLS_TYPE5_PROB_004
            OBJ_CLS_TYPE6_004_oRDR_TRACKER_OBJ_004_oPCAN_RADAR_932c8d41_Tx: ComBitPosition=282, ComBitSize=4, ComSignalType=UINT8, ComSystemTemplateSystemSignalRef=OBJ_CLS_TYPE6_004
            OBJ_CLS_TYPE6_PROB_004_oRDR_TRACKER_OBJ_004_oPCAN_RADAR_2326613e_Tx: ComBitPosition=343, ComBitSize=8, ComSignalType=UINT8, ComSystemTemplateSystemSignalRef=OBJ_CLS_TYPE6_PROB_004
            OBJ_DIMENSION_LENGTH_004_oRDR_TRACKER_OBJ_004_oPCAN_RADAR_c7ea2329_Tx: ComBitPosition=37, ComBitSize=12, ComSignalType=UINT16, ComSystemTemplateSystemSignalRef=OBJ_DIMENSION_LENGTH_004
            OBJ_DIMENSION_LENGTH_ERR_004_oRDR_TRACKER_OBJ_004_oPCAN_RADAR_fc123c53_Tx: ComBitPosition=41, ComBitSize=10, ComSignalType=UINT16, ComSystemTemplateSystemSignalRef=OBJ_DIMENSION_LENGTH_ERR_004
            OBJ_DIMENSION_WIDTH_004_oRDR_TRACKER_OBJ_004_oPCAN_RADAR_e424d484_Tx: ComBitPosition=17, ComBitSize=10, ComSignalType=UINT16, ComSystemTemplateSystemSignalRef=OBJ_DIMENSION_WIDTH_004
            OBJ_DIMENSION_WIDTH_ERR_004_oRDR_TRACKER_OBJ_004_oPCAN_RADAR_0486136c_Tx: ComBitPosition=23, ComBitSize=6, ComSignalType=UINT8, ComSystemTemplateSystemSignalRef=OBJ_DIMENSION_WIDTH_ERR_004
            OBJ_EXISTENCE_PROB_004_oRDR_TRACKER_OBJ_004_oPCAN_RADAR_ef9850b9_Tx: ComBitPosition=229, ComBitSize=14, ComSignalType=UINT16, ComSystemTemplateSystemSignalRef=OBJ_EXISTENCE_PROB_004
            OBJ_GROUP_ID_004_oRDR_TRACKER_OBJ_004_oPCAN_RADAR_66ea4414_Tx: ComBitPosition=405, ComBitSize=6, ComSignalType=UINT8, ComSystemTemplateSystemSignalRef=OBJ_GROUP_ID_004
            OBJ_ID_004_oRDR_TRACKER_OBJ_004_oPCAN_RADAR_95c46f13_Tx: ComBitPosition=7, ComBitSize=8, ComSignalType=UINT8, ComSystemTemplateSystemSignalRef=OBJ_ID_004
            OBJ_MEASUREMENT_STATUS_004_oRDR_TRACKER_OBJ_004_oPCAN_RADAR_ea161dae_Tx: ComBitPosition=14, ComBitSize=3, ComSignalType=UINT8, ComSystemTemplateSystemSignalRef=OBJ_MEASUREMENT_STATUS_004
            OBJ_MH_CRC16_004_oRDR_TRACKER_OBJ_004_oPCAN_RADAR_9676aa92_Tx: ComBitPosition=495, ComBitSize=16, ComSignalType=UINT16, ComSystemTemplateSystemSignalRef=OBJ_MH_CRC16_004
            OBJ_MH_CYCLE_COUNTER_004_oRDR_TRACKER_OBJ_004_oPCAN_RADAR_e792f073_Tx: ComBitPosition=487, ComBitSize=8, ComSignalType=UINT8, ComSystemTemplateSystemSignalRef=OBJ_MH_CYCLE_COUNTER_004
            OBJ_MOVEMENT_STATUS_004_oRDR_TRACKER_OBJ_004_oPCAN_RADAR_c5b888e2_Tx: ComBitPosition=196, ComBitSize=3, ComSignalType=UINT8, ComSystemTemplateSystemSignalRef=OBJ_MOVEMENT_STATUS_004
            OBJ_POS_ERR_CRR_COEF_004_oRDR_TRACKER_OBJ_004_oPCAN_RADAR_55c748d8_Tx: ComBitPosition=415, ComBitSize=8, ComSignalType=UINT8, ComSystemTemplateSystemSignalRef=OBJ_POS_ERR_CRR_COEF_004
            OBJ_POS_LAT_004_oRDR_TRACKER_OBJ_004_oPCAN_RADAR_b768b594_Tx: ComBitPosition=79, ComBitSize=16, ComSignalType=UINT16, ComSystemTemplateSystemSignalRef=OBJ_POS_LAT_004
            OBJ_POS_LAT_ERR_004_oRDR_TRACKER_OBJ_004_oPCAN_RADAR_b324e5a3_Tx: ComBitPosition=103, ComBitSize=8, ComSignalType=UINT8, ComSystemTemplateSystemSignalRef=OBJ_POS_LAT_ERR_004
            OBJ_POS_LONG_004_oRDR_TRACKER_OBJ_004_oPCAN_RADAR_06c85e5b_Tx: ComBitPosition=63, ComBitSize=16, ComSignalType=UINT16, ComSystemTemplateSystemSignalRef=OBJ_POS_LONG_004
            OBJ_POS_LONG_ERR_004_oRDR_TRACKER_OBJ_004_oPCAN_RADAR_2adc1b41_Tx: ComBitPosition=95, ComBitSize=8, ComSignalType=UINT8, ComSystemTemplateSystemSignalRef=OBJ_POS_LONG_ERR_004
            OBJ_RCS_004_oRDR_TRACKER_OBJ_004_oPCAN_RADAR_95a7e393_Tx: ComBitPosition=351, ComBitSize=7, ComSignalType=UINT8, ComSystemTemplateSystemSignalRef=OBJ_RCS_004
            OBJ_REF_PT_LAT_OFFSET_004_oRDR_TRACKER_OBJ_004_oPCAN_RADAR_609a88e6_Tx: ComBitPosition=370, ComBitSize=14, ComSignalType=UINT16, ComSystemTemplateSystemSignalRef=OBJ_REF_PT_LAT_OFFSET_004
            OBJ_REF_PT_LONG_OFFSET_004_oRDR_TRACKER_OBJ_004_oPCAN_RADAR_2fc878e5_Tx: ComBitPosition=357, ComBitSize=14, ComSignalType=UINT16, ComSystemTemplateSystemSignalRef=OBJ_REF_PT_LONG_OFFSET_004
            OBJ_TIMESTAMP_OFFSET_004_oRDR_TRACKER_OBJ_004_oPCAN_RADAR_950be3c5_Tx: ComBitPosition=247, ComBitSize=8, ComSignalType=UINT8, ComSystemTemplateSystemSignalRef=OBJ_TIMESTAMP_OFFSET_004
            OBJ_TRACK_MOTION_MODEL_004_oRDR_TRACKER_OBJ_004_oPCAN_RADAR_5908e218_Tx: ComBitPosition=9, ComBitSize=2, ComSignalType=UINT8, ComSystemTemplateSystemSignalRef=OBJ_TRACK_MOTION_MODEL_004
            OBJ_VEH_TRACK_FLAG_004_oRDR_TRACKER_OBJ_004_oPCAN_RADAR_db221445_Tx: ComBitPosition=10, ComBitSize=1, ComSignalType=BOOLEAN, ComSystemTemplateSystemSignalRef=OBJ_VEH_TRACK_FLAG_004
            OBJ_VELOCITY_ERR_CRR_COEF_004_oRDR_TRACKER_OBJ_004_oPCAN_RADAR_fcbd7539_Tx: ComBitPosition=423, ComBitSize=8, ComSignalType=UINT8, ComSystemTemplateSystemSignalRef=OBJ_VELOCITY_ERR_CRR_COEF_004
            OBJ_VELOCITY_LAT_004_oRDR_TRACKER_OBJ_004_oPCAN_RADAR_f30bf0b3_Tx: ComBitPosition=126, ComBitSize=15, ComSignalType=UINT16, ComSystemTemplateSystemSignalRef=OBJ_VELOCITY_LAT_004
            OBJ_VELOCITY_LAT_ERR_004_oRDR_TRACKER_OBJ_004_oPCAN_RADAR_c7f180e2_Tx: ComBitPosition=151, ComBitSize=8, ComSignalType=UINT8, ComSystemTemplateSystemSignalRef=OBJ_VELOCITY_LAT_ERR_004
            OBJ_VELOCITY_LONG_004_oRDR_TRACKER_OBJ_004_oPCAN_RADAR_a3868875_Tx: ComBitPosition=110, ComBitSize=15, ComSignalType=UINT16, ComSystemTemplateSystemSignalRef=OBJ_VELOCITY_LONG_004
            OBJ_VELOCITY_LONG_ERR_004_oRDR_TRACKER_OBJ_004_oPCAN_RADAR_2b73bf22_Tx: ComBitPosition=143, ComBitSize=8, ComSignalType=UINT8, ComSystemTemplateSystemSignalRef=OBJ_VELOCITY_LONG_ERR_004
            OBJ_YAW_ANGLE_004_oRDR_TRACKER_OBJ_004_oPCAN_RADAR_1fb7b4f3_Tx: ComBitPosition=155, ComBitSize=12, ComSignalType=UINT16, ComSystemTemplateSystemSignalRef=OBJ_YAW_ANGLE_004
            OBJ_YAW_ANGLE_ERR_004_oRDR_TRACKER_OBJ_004_oPCAN_RADAR_cabab224_Tx: ComBitPosition=175, ComBitSize=7, ComSignalType=UINT8, ComSystemTemplateSystemSignalRef=OBJ_YAW_ANGLE_ERR_004
            OBJ_YAW_RATE_004_oRDR_TRACKER_OBJ_004_oPCAN_RADAR_3a3891b4_Tx: ComBitPosition=399, ComBitSize=10, ComSignalType=UINT16, ComSystemTemplateSystemSignalRef=OBJ_YAW_RATE_004
            OBJ_YAW_RATE_ERR_004_oRDR_TRACKER_OBJ_004_oPCAN_RADAR_05e00668_Tx: ComBitPosition=388, ComBitSize=5, ComSignalType=UINT8, ComSystemTemplateSystemSignalRef=OBJ_YAW_RATE_ERR_004
        SG_TrackerObject005_oRDR_TRACKER_OBJ_005_oPCAN_RADAR_f70e50d3_Tx: ComSystemTemplateSignalGroupRef=SG_TrackerObject005
          49 x ComGroupSignal, all with ComSignalEndianness=BIG_ENDIAN, ComSignalInitValue=0, ComTransferProperty=PENDING:
            OBJ_ACCELERATION_LAT_005_oRDR_TRACKER_OBJ_005_oPCAN_RADAR_f92a0ba4_Tx: ComBitPosition=177, ComBitSize=10, ComSignalType=UINT16, ComSystemTemplateSystemSignalRef=OBJ_ACCELERATION_LAT_005
            OBJ_ACCELERATION_LAT_ERR_005_oRDR_TRACKER_OBJ_005_oPCAN_RADAR_2cde311a_Tx: ComBitPosition=223, ComBitSize=8, ComSignalType=UINT8, ComSystemTemplateSystemSignalRef=OBJ_ACCELERATION_LAT_ERR_005
            OBJ_ACCELERATION_LONG_005_oRDR_TRACKER_OBJ_005_oPCAN_RADAR_8bda5244_Tx: ComBitPosition=193, ComBitSize=10, ComSignalType=UINT16, ComSystemTemplateSystemSignalRef=OBJ_ACCELERATION_LONG_005
            OBJ_ACCELERATION_LONG_ERR_005_oRDR_TRACKER_OBJ_005_oPCAN_RADAR_337b94b0_Tx: ComBitPosition=215, ComBitSize=8, ComSignalType=UINT8, ComSystemTemplateSystemSignalRef=OBJ_ACCELERATION_LONG_ERR_005
            OBJ_ACCEL_ERR_CRR_COEF_005_oRDR_TRACKER_OBJ_005_oPCAN_RADAR_93d8b5d6_Tx: ComBitPosition=431, ComBitSize=8, ComSignalType=UINT8, ComSystemTemplateSystemSignalRef=OBJ_ACCEL_ERR_CRR_COEF_005
            OBJ_ALIVE_TIME_005_oRDR_TRACKER_OBJ_005_oPCAN_RADAR_ebbb19f8_Tx: ComBitPosition=255, ComBitSize=16, ComSignalType=UINT16, ComSystemTemplateSystemSignalRef=OBJ_ALIVE_TIME_005
            OBJ_CLS_TYPE1_005_oRDR_TRACKER_OBJ_005_oPCAN_RADAR_7c60f8de_Tx: ComBitPosition=271, ComBitSize=4, ComSignalType=UINT8, ComSystemTemplateSystemSignalRef=OBJ_CLS_TYPE1_005
            OBJ_CLS_TYPE1_PROB_005_oRDR_TRACKER_OBJ_005_oPCAN_RADAR_d4382f2d_Tx: ComBitPosition=303, ComBitSize=8, ComSignalType=UINT8, ComSystemTemplateSystemSignalRef=OBJ_CLS_TYPE1_PROB_005
            OBJ_CLS_TYPE2_005_oRDR_TRACKER_OBJ_005_oPCAN_RADAR_3188f8b9_Tx: ComBitPosition=267, ComBitSize=4, ComSignalType=UINT8, ComSystemTemplateSystemSignalRef=OBJ_CLS_TYPE2_005
            OBJ_CLS_TYPE2_PROB_005_oRDR_TRACKER_OBJ_005_oPCAN_RADAR_1d0c3420_Tx: ComBitPosition=311, ComBitSize=8, ComSignalType=UINT8, ComSystemTemplateSystemSignalRef=OBJ_CLS_TYPE2_PROB_005
            OBJ_CLS_TYPE3_005_oRDR_TRACKER_OBJ_005_oPCAN_RADAR_bc00055b_Tx: ComBitPosition=279, ComBitSize=4, ComSignalType=UINT8, ComSystemTemplateSystemSignalRef=OBJ_CLS_TYPE3_005
            OBJ_CLS_TYPE3_PROB_005_oRDR_TRACKER_OBJ_005_oPCAN_RADAR_5a1fc2db_Tx: ComBitPosition=319, ComBitSize=8, ComSignalType=UINT8, ComSystemTemplateSystemSignalRef=OBJ_CLS_TYPE3_PROB_005
            OBJ_CLS_TYPE4_005_oRDR_TRACKER_OBJ_005_oPCAN_RADAR_aa58f877_Tx: ComBitPosition=275, ComBitSize=4, ComSignalType=UINT8, ComSystemTemplateSystemSignalRef=OBJ_CLS_TYPE4_005
            OBJ_CLS_TYPE4_PROB_005_oRDR_TRACKER_OBJ_005_oPCAN_RADAR_5415047b_Tx: ComBitPosition=327, ComBitSize=8, ComSignalType=UINT8, ComSystemTemplateSystemSignalRef=OBJ_CLS_TYPE4_PROB_005
            OBJ_CLS_TYPE5_005_oRDR_TRACKER_OBJ_005_oPCAN_RADAR_27d00595_Tx: ComBitPosition=287, ComBitSize=4, ComSignalType=UINT8, ComSystemTemplateSystemSignalRef=OBJ_CLS_TYPE5_005
            OBJ_CLS_TYPE5_PROB_005_oRDR_TRACKER_OBJ_005_oPCAN_RADAR_1306f280_Tx: ComBitPosition=335, ComBitSize=8, ComSignalType=UINT8, ComSystemTemplateSystemSignalRef=OBJ_CLS_TYPE5_PROB_005
            OBJ_CLS_TYPE6_005_oRDR_TRACKER_OBJ_005_oPCAN_RADAR_6a3805f2_Tx: ComBitPosition=282, ComBitSize=4, ComSignalType=UINT8, ComSystemTemplateSystemSignalRef=OBJ_CLS_TYPE6_005
            OBJ_CLS_TYPE6_PROB_005_oRDR_TRACKER_OBJ_005_oPCAN_RADAR_da32e98d_Tx: ComBitPosition=343, ComBitSize=8, ComSignalType=UINT8, ComSystemTemplateSystemSignalRef=OBJ_CLS_TYPE6_PROB_005
            OBJ_DIMENSION_LENGTH_005_oRDR_TRACKER_OBJ_005_oPCAN_RADAR_3efeab9a_Tx: ComBitPosition=37, ComBitSize=12, ComSignalType=UINT16, ComSystemTemplateSystemSignalRef=OBJ_DIMENSION_LENGTH_005
            OBJ_DIMENSION_LENGTH_ERR_005_oRDR_TRACKER_OBJ_005_oPCAN_RADAR_0506b4e0_Tx: ComBitPosition=41, ComBitSize=10, ComSignalType=UINT16, ComSystemTemplateSystemSignalRef=OBJ_DIMENSION_LENGTH_ERR_005
            OBJ_DIMENSION_WIDTH_005_oRDR_TRACKER_OBJ_005_oPCAN_RADAR_1d305c37_Tx: ComBitPosition=17, ComBitSize=10, ComSignalType=UINT16, ComSystemTemplateSystemSignalRef=OBJ_DIMENSION_WIDTH_005
            OBJ_DIMENSION_WIDTH_ERR_005_oRDR_TRACKER_OBJ_005_oPCAN_RADAR_fd929bdf_Tx: ComBitPosition=23, ComBitSize=6, ComSignalType=UINT8, ComSystemTemplateSystemSignalRef=OBJ_DIMENSION_WIDTH_ERR_005
            OBJ_EXISTENCE_PROB_005_oRDR_TRACKER_OBJ_005_oPCAN_RADAR_168cd80a_Tx: ComBitPosition=229, ComBitSize=14, ComSignalType=UINT16, ComSystemTemplateSystemSignalRef=OBJ_EXISTENCE_PROB_005
            OBJ_GROUP_ID_005_oRDR_TRACKER_OBJ_005_oPCAN_RADAR_9ffecca7_Tx: ComBitPosition=405, ComBitSize=6, ComSignalType=UINT8, ComSystemTemplateSystemSignalRef=OBJ_GROUP_ID_005
            OBJ_ID_005_oRDR_TRACKER_OBJ_005_oPCAN_RADAR_6cd0e7a0_Tx: ComBitPosition=7, ComBitSize=8, ComSignalType=UINT8, ComSystemTemplateSystemSignalRef=OBJ_ID_005
            OBJ_MEASUREMENT_STATUS_005_oRDR_TRACKER_OBJ_005_oPCAN_RADAR_1302951d_Tx: ComBitPosition=14, ComBitSize=3, ComSignalType=UINT8, ComSystemTemplateSystemSignalRef=OBJ_MEASUREMENT_STATUS_005
            OBJ_MH_CRC16_005_oRDR_TRACKER_OBJ_005_oPCAN_RADAR_6f622221_Tx: ComBitPosition=495, ComBitSize=16, ComSignalType=UINT16, ComSystemTemplateSystemSignalRef=OBJ_MH_CRC16_005
            OBJ_MH_CYCLE_COUNTER_005_oRDR_TRACKER_OBJ_005_oPCAN_RADAR_1e8678c0_Tx: ComBitPosition=487, ComBitSize=8, ComSignalType=UINT8, ComSystemTemplateSystemSignalRef=OBJ_MH_CYCLE_COUNTER_005
            OBJ_MOVEMENT_STATUS_005_oRDR_TRACKER_OBJ_005_oPCAN_RADAR_3cac0051_Tx: ComBitPosition=196, ComBitSize=3, ComSignalType=UINT8, ComSystemTemplateSystemSignalRef=OBJ_MOVEMENT_STATUS_005
            OBJ_POS_ERR_CRR_COEF_005_oRDR_TRACKER_OBJ_005_oPCAN_RADAR_acd3c06b_Tx: ComBitPosition=415, ComBitSize=8, ComSignalType=UINT8, ComSystemTemplateSystemSignalRef=OBJ_POS_ERR_CRR_COEF_005
            OBJ_POS_LAT_005_oRDR_TRACKER_OBJ_005_oPCAN_RADAR_4e7c3d27_Tx: ComBitPosition=79, ComBitSize=16, ComSignalType=UINT16, ComSystemTemplateSystemSignalRef=OBJ_POS_LAT_005
            OBJ_POS_LAT_ERR_005_oRDR_TRACKER_OBJ_005_oPCAN_RADAR_4a306d10_Tx: ComBitPosition=103, ComBitSize=8, ComSignalType=UINT8, ComSystemTemplateSystemSignalRef=OBJ_POS_LAT_ERR_005
            OBJ_POS_LONG_005_oRDR_TRACKER_OBJ_005_oPCAN_RADAR_ffdcd6e8_Tx: ComBitPosition=63, ComBitSize=16, ComSignalType=UINT16, ComSystemTemplateSystemSignalRef=OBJ_POS_LONG_005
            OBJ_POS_LONG_ERR_005_oRDR_TRACKER_OBJ_005_oPCAN_RADAR_d3c893f2_Tx: ComBitPosition=95, ComBitSize=8, ComSignalType=UINT8, ComSystemTemplateSystemSignalRef=OBJ_POS_LONG_ERR_005
            OBJ_RCS_005_oRDR_TRACKER_OBJ_005_oPCAN_RADAR_6cb36b20_Tx: ComBitPosition=351, ComBitSize=7, ComSignalType=UINT8, ComSystemTemplateSystemSignalRef=OBJ_RCS_005
            OBJ_REF_PT_LAT_OFFSET_005_oRDR_TRACKER_OBJ_005_oPCAN_RADAR_998e0055_Tx: ComBitPosition=370, ComBitSize=14, ComSignalType=UINT16, ComSystemTemplateSystemSignalRef=OBJ_REF_PT_LAT_OFFSET_005
            OBJ_REF_PT_LONG_OFFSET_005_oRDR_TRACKER_OBJ_005_oPCAN_RADAR_d6dcf056_Tx: ComBitPosition=357, ComBitSize=14, ComSignalType=UINT16, ComSystemTemplateSystemSignalRef=OBJ_REF_PT_LONG_OFFSET_005
            OBJ_TIMESTAMP_OFFSET_005_oRDR_TRACKER_OBJ_005_oPCAN_RADAR_6c1f6b76_Tx: ComBitPosition=247, ComBitSize=8, ComSignalType=UINT8, ComSystemTemplateSystemSignalRef=OBJ_TIMESTAMP_OFFSET_005
            OBJ_TRACK_MOTION_MODEL_005_oRDR_TRACKER_OBJ_005_oPCAN_RADAR_a01c6aab_Tx: ComBitPosition=9, ComBitSize=2, ComSignalType=UINT8, ComSystemTemplateSystemSignalRef=OBJ_TRACK_MOTION_MODEL_005
            OBJ_VEH_TRACK_FLAG_005_oRDR_TRACKER_OBJ_005_oPCAN_RADAR_22369cf6_Tx: ComBitPosition=10, ComBitSize=1, ComSignalType=BOOLEAN, ComSystemTemplateSystemSignalRef=OBJ_VEH_TRACK_FLAG_005
            OBJ_VELOCITY_ERR_CRR_COEF_005_oRDR_TRACKER_OBJ_005_oPCAN_RADAR_05a9fd8a_Tx: ComBitPosition=423, ComBitSize=8, ComSignalType=UINT8, ComSystemTemplateSystemSignalRef=OBJ_VELOCITY_ERR_CRR_COEF_005
            OBJ_VELOCITY_LAT_005_oRDR_TRACKER_OBJ_005_oPCAN_RADAR_0a1f7800_Tx: ComBitPosition=126, ComBitSize=15, ComSignalType=UINT16, ComSystemTemplateSystemSignalRef=OBJ_VELOCITY_LAT_005
            OBJ_VELOCITY_LAT_ERR_005_oRDR_TRACKER_OBJ_005_oPCAN_RADAR_3ee50851_Tx: ComBitPosition=151, ComBitSize=8, ComSignalType=UINT8, ComSystemTemplateSystemSignalRef=OBJ_VELOCITY_LAT_ERR_005
            OBJ_VELOCITY_LONG_005_oRDR_TRACKER_OBJ_005_oPCAN_RADAR_5a9200c6_Tx: ComBitPosition=110, ComBitSize=15, ComSignalType=UINT16, ComSystemTemplateSystemSignalRef=OBJ_VELOCITY_LONG_005
            OBJ_VELOCITY_LONG_ERR_005_oRDR_TRACKER_OBJ_005_oPCAN_RADAR_d2673791_Tx: ComBitPosition=143, ComBitSize=8, ComSignalType=UINT8, ComSystemTemplateSystemSignalRef=OBJ_VELOCITY_LONG_ERR_005
            OBJ_YAW_ANGLE_005_oRDR_TRACKER_OBJ_005_oPCAN_RADAR_e6a33c40_Tx: ComBitPosition=155, ComBitSize=12, ComSignalType=UINT16, ComSystemTemplateSystemSignalRef=OBJ_YAW_ANGLE_005
            OBJ_YAW_ANGLE_ERR_005_oRDR_TRACKER_OBJ_005_oPCAN_RADAR_33ae3a97_Tx: ComBitPosition=175, ComBitSize=7, ComSignalType=UINT8, ComSystemTemplateSystemSignalRef=OBJ_YAW_ANGLE_ERR_005
            OBJ_YAW_RATE_005_oRDR_TRACKER_OBJ_005_oPCAN_RADAR_c32c1907_Tx: ComBitPosition=399, ComBitSize=10, ComSignalType=UINT16, ComSystemTemplateSystemSignalRef=OBJ_YAW_RATE_005
            OBJ_YAW_RATE_ERR_005_oRDR_TRACKER_OBJ_005_oPCAN_RADAR_fcf48edb_Tx: ComBitPosition=388, ComBitSize=5, ComSignalType=UINT8, ComSystemTemplateSystemSignalRef=OBJ_YAW_RATE_ERR_005
        SG_TrackerObject006_oRDR_TRACKER_OBJ_006_oPCAN_RADAR_2742cf47_Tx: ComSystemTemplateSignalGroupRef=SG_TrackerObject006
          49 x ComGroupSignal, all with ComSignalEndianness=BIG_ENDIAN, ComSignalInitValue=0, ComTransferProperty=PENDING:
            OBJ_ACCELERATION_LAT_006_oRDR_TRACKER_OBJ_006_oPCAN_RADAR_29669430_Tx: ComBitPosition=177, ComBitSize=10, ComSignalType=UINT16, ComSystemTemplateSystemSignalRef=OBJ_ACCELERATION_LAT_006
            OBJ_ACCELERATION_LAT_ERR_006_oRDR_TRACKER_OBJ_006_oPCAN_RADAR_fc92ae8e_Tx: ComBitPosition=223, ComBitSize=8, ComSignalType=UINT8, ComSystemTemplateSystemSignalRef=OBJ_ACCELERATION_LAT_ERR_006
            OBJ_ACCELERATION_LONG_006_oRDR_TRACKER_OBJ_006_oPCAN_RADAR_5b96cdd0_Tx: ComBitPosition=193, ComBitSize=10, ComSignalType=UINT16, ComSystemTemplateSystemSignalRef=OBJ_ACCELERATION_LONG_006
            OBJ_ACCELERATION_LONG_ERR_006_oRDR_TRACKER_OBJ_006_oPCAN_RADAR_e3370b24_Tx: ComBitPosition=215, ComBitSize=8, ComSignalType=UINT8, ComSystemTemplateSystemSignalRef=OBJ_ACCELERATION_LONG_ERR_006
            OBJ_ACCEL_ERR_CRR_COEF_006_oRDR_TRACKER_OBJ_006_oPCAN_RADAR_43942a42_Tx: ComBitPosition=431, ComBitSize=8, ComSignalType=UINT8, ComSystemTemplateSystemSignalRef=OBJ_ACCEL_ERR_CRR_COEF_006
            OBJ_ALIVE_TIME_006_oRDR_TRACKER_OBJ_006_oPCAN_RADAR_3bf7866c_Tx: ComBitPosition=255, ComBitSize=16, ComSignalType=UINT16, ComSystemTemplateSystemSignalRef=OBJ_ALIVE_TIME_006
            OBJ_CLS_TYPE1_006_oRDR_TRACKER_OBJ_006_oPCAN_RADAR_ac2c674a_Tx: ComBitPosition=271, ComBitSize=4, ComSignalType=UINT8, ComSystemTemplateSystemSignalRef=OBJ_CLS_TYPE1_006
            OBJ_CLS_TYPE1_PROB_006_oRDR_TRACKER_OBJ_006_oPCAN_RADAR_0474b0b9_Tx: ComBitPosition=303, ComBitSize=8, ComSignalType=UINT8, ComSystemTemplateSystemSignalRef=OBJ_CLS_TYPE1_PROB_006
            OBJ_CLS_TYPE2_006_oRDR_TRACKER_OBJ_006_oPCAN_RADAR_e1c4672d_Tx: ComBitPosition=267, ComBitSize=4, ComSignalType=UINT8, ComSystemTemplateSystemSignalRef=OBJ_CLS_TYPE2_006
            OBJ_CLS_TYPE2_PROB_006_oRDR_TRACKER_OBJ_006_oPCAN_RADAR_cd40abb4_Tx: ComBitPosition=311, ComBitSize=8, ComSignalType=UINT8, ComSystemTemplateSystemSignalRef=OBJ_CLS_TYPE2_PROB_006
            OBJ_CLS_TYPE3_006_oRDR_TRACKER_OBJ_006_oPCAN_RADAR_6c4c9acf_Tx: ComBitPosition=279, ComBitSize=4, ComSignalType=UINT8, ComSystemTemplateSystemSignalRef=OBJ_CLS_TYPE3_006
            OBJ_CLS_TYPE3_PROB_006_oRDR_TRACKER_OBJ_006_oPCAN_RADAR_8a535d4f_Tx: ComBitPosition=319, ComBitSize=8, ComSignalType=UINT8, ComSystemTemplateSystemSignalRef=OBJ_CLS_TYPE3_PROB_006
            OBJ_CLS_TYPE4_006_oRDR_TRACKER_OBJ_006_oPCAN_RADAR_7a1467e3_Tx: ComBitPosition=275, ComBitSize=4, ComSignalType=UINT8, ComSystemTemplateSystemSignalRef=OBJ_CLS_TYPE4_006
            OBJ_CLS_TYPE4_PROB_006_oRDR_TRACKER_OBJ_006_oPCAN_RADAR_84599bef_Tx: ComBitPosition=327, ComBitSize=8, ComSignalType=UINT8, ComSystemTemplateSystemSignalRef=OBJ_CLS_TYPE4_PROB_006
            OBJ_CLS_TYPE5_006_oRDR_TRACKER_OBJ_006_oPCAN_RADAR_f79c9a01_Tx: ComBitPosition=287, ComBitSize=4, ComSignalType=UINT8, ComSystemTemplateSystemSignalRef=OBJ_CLS_TYPE5_006
            OBJ_CLS_TYPE5_PROB_006_oRDR_TRACKER_OBJ_006_oPCAN_RADAR_c34a6d14_Tx: ComBitPosition=335, ComBitSize=8, ComSignalType=UINT8, ComSystemTemplateSystemSignalRef=OBJ_CLS_TYPE5_PROB_006
            OBJ_CLS_TYPE6_006_oRDR_TRACKER_OBJ_006_oPCAN_RADAR_ba749a66_Tx: ComBitPosition=282, ComBitSize=4, ComSignalType=UINT8, ComSystemTemplateSystemSignalRef=OBJ_CLS_TYPE6_006
            OBJ_CLS_TYPE6_PROB_006_oRDR_TRACKER_OBJ_006_oPCAN_RADAR_0a7e7619_Tx: ComBitPosition=343, ComBitSize=8, ComSignalType=UINT8, ComSystemTemplateSystemSignalRef=OBJ_CLS_TYPE6_PROB_006
            OBJ_DIMENSION_LENGTH_006_oRDR_TRACKER_OBJ_006_oPCAN_RADAR_eeb2340e_Tx: ComBitPosition=37, ComBitSize=12, ComSignalType=UINT16, ComSystemTemplateSystemSignalRef=OBJ_DIMENSION_LENGTH_006
            OBJ_DIMENSION_LENGTH_ERR_006_oRDR_TRACKER_OBJ_006_oPCAN_RADAR_d54a2b74_Tx: ComBitPosition=41, ComBitSize=10, ComSignalType=UINT16, ComSystemTemplateSystemSignalRef=OBJ_DIMENSION_LENGTH_ERR_006
            OBJ_DIMENSION_WIDTH_006_oRDR_TRACKER_OBJ_006_oPCAN_RADAR_cd7cc3a3_Tx: ComBitPosition=17, ComBitSize=10, ComSignalType=UINT16, ComSystemTemplateSystemSignalRef=OBJ_DIMENSION_WIDTH_006
            OBJ_DIMENSION_WIDTH_ERR_006_oRDR_TRACKER_OBJ_006_oPCAN_RADAR_2dde044b_Tx: ComBitPosition=23, ComBitSize=6, ComSignalType=UINT8, ComSystemTemplateSystemSignalRef=OBJ_DIMENSION_WIDTH_ERR_006
            OBJ_EXISTENCE_PROB_006_oRDR_TRACKER_OBJ_006_oPCAN_RADAR_c6c0479e_Tx: ComBitPosition=229, ComBitSize=14, ComSignalType=UINT16, ComSystemTemplateSystemSignalRef=OBJ_EXISTENCE_PROB_006
            OBJ_GROUP_ID_006_oRDR_TRACKER_OBJ_006_oPCAN_RADAR_4fb25333_Tx: ComBitPosition=405, ComBitSize=6, ComSignalType=UINT8, ComSystemTemplateSystemSignalRef=OBJ_GROUP_ID_006
            OBJ_ID_006_oRDR_TRACKER_OBJ_006_oPCAN_RADAR_bc9c7834_Tx: ComBitPosition=7, ComBitSize=8, ComSignalType=UINT8, ComSystemTemplateSystemSignalRef=OBJ_ID_006
            OBJ_MEASUREMENT_STATUS_006_oRDR_TRACKER_OBJ_006_oPCAN_RADAR_c34e0a89_Tx: ComBitPosition=14, ComBitSize=3, ComSignalType=UINT8, ComSystemTemplateSystemSignalRef=OBJ_MEASUREMENT_STATUS_006
            OBJ_MH_CRC16_006_oRDR_TRACKER_OBJ_006_oPCAN_RADAR_bf2ebdb5_Tx: ComBitPosition=495, ComBitSize=16, ComSignalType=UINT16, ComSystemTemplateSystemSignalRef=OBJ_MH_CRC16_006
            OBJ_MH_CYCLE_COUNTER_006_oRDR_TRACKER_OBJ_006_oPCAN_RADAR_cecae754_Tx: ComBitPosition=487, ComBitSize=8, ComSignalType=UINT8, ComSystemTemplateSystemSignalRef=OBJ_MH_CYCLE_COUNTER_006
            OBJ_MOVEMENT_STATUS_006_oRDR_TRACKER_OBJ_006_oPCAN_RADAR_ece09fc5_Tx: ComBitPosition=196, ComBitSize=3, ComSignalType=UINT8, ComSystemTemplateSystemSignalRef=OBJ_MOVEMENT_STATUS_006
            OBJ_POS_ERR_CRR_COEF_006_oRDR_TRACKER_OBJ_006_oPCAN_RADAR_7c9f5fff_Tx: ComBitPosition=415, ComBitSize=8, ComSignalType=UINT8, ComSystemTemplateSystemSignalRef=OBJ_POS_ERR_CRR_COEF_006
            OBJ_POS_LAT_006_oRDR_TRACKER_OBJ_006_oPCAN_RADAR_9e30a2b3_Tx: ComBitPosition=79, ComBitSize=16, ComSignalType=UINT16, ComSystemTemplateSystemSignalRef=OBJ_POS_LAT_006
            OBJ_POS_LAT_ERR_006_oRDR_TRACKER_OBJ_006_oPCAN_RADAR_9a7cf284_Tx: ComBitPosition=103, ComBitSize=8, ComSignalType=UINT8, ComSystemTemplateSystemSignalRef=OBJ_POS_LAT_ERR_006
            OBJ_POS_LONG_006_oRDR_TRACKER_OBJ_006_oPCAN_RADAR_2f90497c_Tx: ComBitPosition=63, ComBitSize=16, ComSignalType=UINT16, ComSystemTemplateSystemSignalRef=OBJ_POS_LONG_006
            OBJ_POS_LONG_ERR_006_oRDR_TRACKER_OBJ_006_oPCAN_RADAR_03840c66_Tx: ComBitPosition=95, ComBitSize=8, ComSignalType=UINT8, ComSystemTemplateSystemSignalRef=OBJ_POS_LONG_ERR_006
            OBJ_RCS_006_oRDR_TRACKER_OBJ_006_oPCAN_RADAR_bcfff4b4_Tx: ComBitPosition=351, ComBitSize=7, ComSignalType=UINT8, ComSystemTemplateSystemSignalRef=OBJ_RCS_006
            OBJ_REF_PT_LAT_OFFSET_006_oRDR_TRACKER_OBJ_006_oPCAN_RADAR_49c29fc1_Tx: ComBitPosition=370, ComBitSize=14, ComSignalType=UINT16, ComSystemTemplateSystemSignalRef=OBJ_REF_PT_LAT_OFFSET_006
            OBJ_REF_PT_LONG_OFFSET_006_oRDR_TRACKER_OBJ_006_oPCAN_RADAR_06906fc2_Tx: ComBitPosition=357, ComBitSize=14, ComSignalType=UINT16, ComSystemTemplateSystemSignalRef=OBJ_REF_PT_LONG_OFFSET_006
            OBJ_TIMESTAMP_OFFSET_006_oRDR_TRACKER_OBJ_006_oPCAN_RADAR_bc53f4e2_Tx: ComBitPosition=247, ComBitSize=8, ComSignalType=UINT8, ComSystemTemplateSystemSignalRef=OBJ_TIMESTAMP_OFFSET_006
            OBJ_TRACK_MOTION_MODEL_006_oRDR_TRACKER_OBJ_006_oPCAN_RADAR_7050f53f_Tx: ComBitPosition=9, ComBitSize=2, ComSignalType=UINT8, ComSystemTemplateSystemSignalRef=OBJ_TRACK_MOTION_MODEL_006
            OBJ_VEH_TRACK_FLAG_006_oRDR_TRACKER_OBJ_006_oPCAN_RADAR_f27a0362_Tx: ComBitPosition=10, ComBitSize=1, ComSignalType=BOOLEAN, ComSystemTemplateSystemSignalRef=OBJ_VEH_TRACK_FLAG_006
            OBJ_VELOCITY_ERR_CRR_COEF_006_oRDR_TRACKER_OBJ_006_oPCAN_RADAR_d5e5621e_Tx: ComBitPosition=423, ComBitSize=8, ComSignalType=UINT8, ComSystemTemplateSystemSignalRef=OBJ_VELOCITY_ERR_CRR_COEF_006
            OBJ_VELOCITY_LAT_006_oRDR_TRACKER_OBJ_006_oPCAN_RADAR_da53e794_Tx: ComBitPosition=126, ComBitSize=15, ComSignalType=UINT16, ComSystemTemplateSystemSignalRef=OBJ_VELOCITY_LAT_006
            OBJ_VELOCITY_LAT_ERR_006_oRDR_TRACKER_OBJ_006_oPCAN_RADAR_eea997c5_Tx: ComBitPosition=151, ComBitSize=8, ComSignalType=UINT8, ComSystemTemplateSystemSignalRef=OBJ_VELOCITY_LAT_ERR_006
            OBJ_VELOCITY_LONG_006_oRDR_TRACKER_OBJ_006_oPCAN_RADAR_8ade9f52_Tx: ComBitPosition=110, ComBitSize=15, ComSignalType=UINT16, ComSystemTemplateSystemSignalRef=OBJ_VELOCITY_LONG_006
            OBJ_VELOCITY_LONG_ERR_006_oRDR_TRACKER_OBJ_006_oPCAN_RADAR_022ba805_Tx: ComBitPosition=143, ComBitSize=8, ComSignalType=UINT8, ComSystemTemplateSystemSignalRef=OBJ_VELOCITY_LONG_ERR_006
            OBJ_YAW_ANGLE_006_oRDR_TRACKER_OBJ_006_oPCAN_RADAR_36efa3d4_Tx: ComBitPosition=155, ComBitSize=12, ComSignalType=UINT16, ComSystemTemplateSystemSignalRef=OBJ_YAW_ANGLE_006
            OBJ_YAW_ANGLE_ERR_006_oRDR_TRACKER_OBJ_006_oPCAN_RADAR_e3e2a503_Tx: ComBitPosition=175, ComBitSize=7, ComSignalType=UINT8, ComSystemTemplateSystemSignalRef=OBJ_YAW_ANGLE_ERR_006
            OBJ_YAW_RATE_006_oRDR_TRACKER_OBJ_006_oPCAN_RADAR_13608693_Tx: ComBitPosition=399, ComBitSize=10, ComSignalType=UINT16, ComSystemTemplateSystemSignalRef=OBJ_YAW_RATE_006
            OBJ_YAW_RATE_ERR_006_oRDR_TRACKER_OBJ_006_oPCAN_RADAR_2cb8114f_Tx: ComBitPosition=388, ComBitSize=5, ComSignalType=UINT8, ComSystemTemplateSystemSignalRef=OBJ_YAW_RATE_ERR_006
        SG_TrackerObject007_oRDR_TRACKER_OBJ_007_oPCAN_RADAR_de5647f4_Tx: ComSystemTemplateSignalGroupRef=SG_TrackerObject007
          49 x ComGroupSignal, all with ComSignalEndianness=BIG_ENDIAN, ComSignalInitValue=0, ComTransferProperty=PENDING:
            OBJ_ACCELERATION_LAT_007_oRDR_TRACKER_OBJ_007_oPCAN_RADAR_d0721c83_Tx: ComBitPosition=177, ComBitSize=10, ComSignalType=UINT16, ComSystemTemplateSystemSignalRef=OBJ_ACCELERATION_LAT_007
            OBJ_ACCELERATION_LAT_ERR_007_oRDR_TRACKER_OBJ_007_oPCAN_RADAR_0586263d_Tx: ComBitPosition=223, ComBitSize=8, ComSignalType=UINT8, ComSystemTemplateSystemSignalRef=OBJ_ACCELERATION_LAT_ERR_007
            OBJ_ACCELERATION_LONG_007_oRDR_TRACKER_OBJ_007_oPCAN_RADAR_a2824563_Tx: ComBitPosition=193, ComBitSize=10, ComSignalType=UINT16, ComSystemTemplateSystemSignalRef=OBJ_ACCELERATION_LONG_007
            OBJ_ACCELERATION_LONG_ERR_007_oRDR_TRACKER_OBJ_007_oPCAN_RADAR_1a238397_Tx: ComBitPosition=215, ComBitSize=8, ComSignalType=UINT8, ComSystemTemplateSystemSignalRef=OBJ_ACCELERATION_LONG_ERR_007
            OBJ_ACCEL_ERR_CRR_COEF_007_oRDR_TRACKER_OBJ_007_oPCAN_RADAR_ba80a2f1_Tx: ComBitPosition=431, ComBitSize=8, ComSignalType=UINT8, ComSystemTemplateSystemSignalRef=OBJ_ACCEL_ERR_CRR_COEF_007
            OBJ_ALIVE_TIME_007_oRDR_TRACKER_OBJ_007_oPCAN_RADAR_c2e30edf_Tx: ComBitPosition=255, ComBitSize=16, ComSignalType=UINT16, ComSystemTemplateSystemSignalRef=OBJ_ALIVE_TIME_007
            OBJ_CLS_TYPE1_007_oRDR_TRACKER_OBJ_007_oPCAN_RADAR_5538eff9_Tx: ComBitPosition=271, ComBitSize=4, ComSignalType=UINT8, ComSystemTemplateSystemSignalRef=OBJ_CLS_TYPE1_007
            OBJ_CLS_TYPE1_PROB_007_oRDR_TRACKER_OBJ_007_oPCAN_RADAR_fd60380a_Tx: ComBitPosition=303, ComBitSize=8, ComSignalType=UINT8, ComSystemTemplateSystemSignalRef=OBJ_CLS_TYPE1_PROB_007
            OBJ_CLS_TYPE2_007_oRDR_TRACKER_OBJ_007_oPCAN_RADAR_18d0ef9e_Tx: ComBitPosition=267, ComBitSize=4, ComSignalType=UINT8, ComSystemTemplateSystemSignalRef=OBJ_CLS_TYPE2_007
            OBJ_CLS_TYPE2_PROB_007_oRDR_TRACKER_OBJ_007_oPCAN_RADAR_34542307_Tx: ComBitPosition=311, ComBitSize=8, ComSignalType=UINT8, ComSystemTemplateSystemSignalRef=OBJ_CLS_TYPE2_PROB_007
            OBJ_CLS_TYPE3_007_oRDR_TRACKER_OBJ_007_oPCAN_RADAR_9558127c_Tx: ComBitPosition=279, ComBitSize=4, ComSignalType=UINT8, ComSystemTemplateSystemSignalRef=OBJ_CLS_TYPE3_007
            OBJ_CLS_TYPE3_PROB_007_oRDR_TRACKER_OBJ_007_oPCAN_RADAR_7347d5fc_Tx: ComBitPosition=319, ComBitSize=8, ComSignalType=UINT8, ComSystemTemplateSystemSignalRef=OBJ_CLS_TYPE3_PROB_007
            OBJ_CLS_TYPE4_007_oRDR_TRACKER_OBJ_007_oPCAN_RADAR_8300ef50_Tx: ComBitPosition=275, ComBitSize=4, ComSignalType=UINT8, ComSystemTemplateSystemSignalRef=OBJ_CLS_TYPE4_007
            OBJ_CLS_TYPE4_PROB_007_oRDR_TRACKER_OBJ_007_oPCAN_RADAR_7d4d135c_Tx: ComBitPosition=327, ComBitSize=8, ComSignalType=UINT8, ComSystemTemplateSystemSignalRef=OBJ_CLS_TYPE4_PROB_007
            OBJ_CLS_TYPE5_007_oRDR_TRACKER_OBJ_007_oPCAN_RADAR_0e8812b2_Tx: ComBitPosition=287, ComBitSize=4, ComSignalType=UINT8, ComSystemTemplateSystemSignalRef=OBJ_CLS_TYPE5_007
            OBJ_CLS_TYPE5_PROB_007_oRDR_TRACKER_OBJ_007_oPCAN_RADAR_3a5ee5a7_Tx: ComBitPosition=335, ComBitSize=8, ComSignalType=UINT8, ComSystemTemplateSystemSignalRef=OBJ_CLS_TYPE5_PROB_007
            OBJ_CLS_TYPE6_007_oRDR_TRACKER_OBJ_007_oPCAN_RADAR_436012d5_Tx: ComBitPosition=282, ComBitSize=4, ComSignalType=UINT8, ComSystemTemplateSystemSignalRef=OBJ_CLS_TYPE6_007
            OBJ_CLS_TYPE6_PROB_007_oRDR_TRACKER_OBJ_007_oPCAN_RADAR_f36afeaa_Tx: ComBitPosition=343, ComBitSize=8, ComSignalType=UINT8, ComSystemTemplateSystemSignalRef=OBJ_CLS_TYPE6_PROB_007
            OBJ_DIMENSION_LENGTH_007_oRDR_TRACKER_OBJ_007_oPCAN_RADAR_17a6bcbd_Tx: ComBitPosition=37, ComBitSize=12, ComSignalType=UINT16, ComSystemTemplateSystemSignalRef=OBJ_DIMENSION_LENGTH_007
            OBJ_DIMENSION_LENGTH_ERR_007_oRDR_TRACKER_OBJ_007_oPCAN_RADAR_2c5ea3c7_Tx: ComBitPosition=41, ComBitSize=10, ComSignalType=UINT16, ComSystemTemplateSystemSignalRef=OBJ_DIMENSION_LENGTH_ERR_007
            OBJ_DIMENSION_WIDTH_007_oRDR_TRACKER_OBJ_007_oPCAN_RADAR_34684b10_Tx: ComBitPosition=17, ComBitSize=10, ComSignalType=UINT16, ComSystemTemplateSystemSignalRef=OBJ_DIMENSION_WIDTH_007
            OBJ_DIMENSION_WIDTH_ERR_007_oRDR_TRACKER_OBJ_007_oPCAN_RADAR_d4ca8cf8_Tx: ComBitPosition=23, ComBitSize=6, ComSignalType=UINT8, ComSystemTemplateSystemSignalRef=OBJ_DIMENSION_WIDTH_ERR_007
            OBJ_EXISTENCE_PROB_007_oRDR_TRACKER_OBJ_007_oPCAN_RADAR_3fd4cf2d_Tx: ComBitPosition=229, ComBitSize=14, ComSignalType=UINT16, ComSystemTemplateSystemSignalRef=OBJ_EXISTENCE_PROB_007
            OBJ_GROUP_ID_007_oRDR_TRACKER_OBJ_007_oPCAN_RADAR_b6a6db80_Tx: ComBitPosition=405, ComBitSize=6, ComSignalType=UINT8, ComSystemTemplateSystemSignalRef=OBJ_GROUP_ID_007
            OBJ_ID_007_oRDR_TRACKER_OBJ_007_oPCAN_RADAR_4588f087_Tx: ComBitPosition=7, ComBitSize=8, ComSignalType=UINT8, ComSystemTemplateSystemSignalRef=OBJ_ID_007
            OBJ_MEASUREMENT_STATUS_007_oRDR_TRACKER_OBJ_007_oPCAN_RADAR_3a5a823a_Tx: ComBitPosition=14, ComBitSize=3, ComSignalType=UINT8, ComSystemTemplateSystemSignalRef=OBJ_MEASUREMENT_STATUS_007
            OBJ_MH_CRC16_007_oRDR_TRACKER_OBJ_007_oPCAN_RADAR_463a3506_Tx: ComBitPosition=495, ComBitSize=16, ComSignalType=UINT16, ComSystemTemplateSystemSignalRef=OBJ_MH_CRC16_007
            OBJ_MH_CYCLE_COUNTER_007_oRDR_TRACKER_OBJ_007_oPCAN_RADAR_37de6fe7_Tx: ComBitPosition=487, ComBitSize=8, ComSignalType=UINT8, ComSystemTemplateSystemSignalRef=OBJ_MH_CYCLE_COUNTER_007
            OBJ_MOVEMENT_STATUS_007_oRDR_TRACKER_OBJ_007_oPCAN_RADAR_15f41776_Tx: ComBitPosition=196, ComBitSize=3, ComSignalType=UINT8, ComSystemTemplateSystemSignalRef=OBJ_MOVEMENT_STATUS_007
            OBJ_POS_ERR_CRR_COEF_007_oRDR_TRACKER_OBJ_007_oPCAN_RADAR_858bd74c_Tx: ComBitPosition=415, ComBitSize=8, ComSignalType=UINT8, ComSystemTemplateSystemSignalRef=OBJ_POS_ERR_CRR_COEF_007
            OBJ_POS_LAT_007_oRDR_TRACKER_OBJ_007_oPCAN_RADAR_67242a00_Tx: ComBitPosition=79, ComBitSize=16, ComSignalType=UINT16, ComSystemTemplateSystemSignalRef=OBJ_POS_LAT_007
            OBJ_POS_LAT_ERR_007_oRDR_TRACKER_OBJ_007_oPCAN_RADAR_63687a37_Tx: ComBitPosition=103, ComBitSize=8, ComSignalType=UINT8, ComSystemTemplateSystemSignalRef=OBJ_POS_LAT_ERR_007
            OBJ_POS_LONG_007_oRDR_TRACKER_OBJ_007_oPCAN_RADAR_d684c1cf_Tx: ComBitPosition=63, ComBitSize=16, ComSignalType=UINT16, ComSystemTemplateSystemSignalRef=OBJ_POS_LONG_007
            OBJ_POS_LONG_ERR_007_oRDR_TRACKER_OBJ_007_oPCAN_RADAR_fa9084d5_Tx: ComBitPosition=95, ComBitSize=8, ComSignalType=UINT8, ComSystemTemplateSystemSignalRef=OBJ_POS_LONG_ERR_007
            OBJ_RCS_007_oRDR_TRACKER_OBJ_007_oPCAN_RADAR_45eb7c07_Tx: ComBitPosition=351, ComBitSize=7, ComSignalType=UINT8, ComSystemTemplateSystemSignalRef=OBJ_RCS_007
            OBJ_REF_PT_LAT_OFFSET_007_oRDR_TRACKER_OBJ_007_oPCAN_RADAR_b0d61772_Tx: ComBitPosition=370, ComBitSize=14, ComSignalType=UINT16, ComSystemTemplateSystemSignalRef=OBJ_REF_PT_LAT_OFFSET_007
            OBJ_REF_PT_LONG_OFFSET_007_oRDR_TRACKER_OBJ_007_oPCAN_RADAR_ff84e771_Tx: ComBitPosition=357, ComBitSize=14, ComSignalType=UINT16, ComSystemTemplateSystemSignalRef=OBJ_REF_PT_LONG_OFFSET_007
            OBJ_TIMESTAMP_OFFSET_007_oRDR_TRACKER_OBJ_007_oPCAN_RADAR_45477c51_Tx: ComBitPosition=247, ComBitSize=8, ComSignalType=UINT8, ComSystemTemplateSystemSignalRef=OBJ_TIMESTAMP_OFFSET_007
            OBJ_TRACK_MOTION_MODEL_007_oRDR_TRACKER_OBJ_007_oPCAN_RADAR_89447d8c_Tx: ComBitPosition=9, ComBitSize=2, ComSignalType=UINT8, ComSystemTemplateSystemSignalRef=OBJ_TRACK_MOTION_MODEL_007
            OBJ_VEH_TRACK_FLAG_007_oRDR_TRACKER_OBJ_007_oPCAN_RADAR_0b6e8bd1_Tx: ComBitPosition=10, ComBitSize=1, ComSignalType=BOOLEAN, ComSystemTemplateSystemSignalRef=OBJ_VEH_TRACK_FLAG_007
            OBJ_VELOCITY_ERR_CRR_COEF_007_oRDR_TRACKER_OBJ_007_oPCAN_RADAR_2cf1eaad_Tx: ComBitPosition=423, ComBitSize=8, ComSignalType=UINT8, ComSystemTemplateSystemSignalRef=OBJ_VELOCITY_ERR_CRR_COEF_007
            OBJ_VELOCITY_LAT_007_oRDR_TRACKER_OBJ_007_oPCAN_RADAR_23476f27_Tx: ComBitPosition=126, ComBitSize=15, ComSignalType=UINT16, ComSystemTemplateSystemSignalRef=OBJ_VELOCITY_LAT_007
            OBJ_VELOCITY_LAT_ERR_007_oRDR_TRACKER_OBJ_007_oPCAN_RADAR_17bd1f76_Tx: ComBitPosition=151, ComBitSize=8, ComSignalType=UINT8, ComSystemTemplateSystemSignalRef=OBJ_VELOCITY_LAT_ERR_007
            OBJ_VELOCITY_LONG_007_oRDR_TRACKER_OBJ_007_oPCAN_RADAR_73ca17e1_Tx: ComBitPosition=110, ComBitSize=15, ComSignalType=UINT16, ComSystemTemplateSystemSignalRef=OBJ_VELOCITY_LONG_007
            OBJ_VELOCITY_LONG_ERR_007_oRDR_TRACKER_OBJ_007_oPCAN_RADAR_fb3f20b6_Tx: ComBitPosition=143, ComBitSize=8, ComSignalType=UINT8, ComSystemTemplateSystemSignalRef=OBJ_VELOCITY_LONG_ERR_007
            OBJ_YAW_ANGLE_007_oRDR_TRACKER_OBJ_007_oPCAN_RADAR_cffb2b67_Tx: ComBitPosition=155, ComBitSize=12, ComSignalType=UINT16, ComSystemTemplateSystemSignalRef=OBJ_YAW_ANGLE_007
            OBJ_YAW_ANGLE_ERR_007_oRDR_TRACKER_OBJ_007_oPCAN_RADAR_1af62db0_Tx: ComBitPosition=175, ComBitSize=7, ComSignalType=UINT8, ComSystemTemplateSystemSignalRef=OBJ_YAW_ANGLE_ERR_007
            OBJ_YAW_RATE_007_oRDR_TRACKER_OBJ_007_oPCAN_RADAR_ea740e20_Tx: ComBitPosition=399, ComBitSize=10, ComSignalType=UINT16, ComSystemTemplateSystemSignalRef=OBJ_YAW_RATE_007
            OBJ_YAW_RATE_ERR_007_oRDR_TRACKER_OBJ_007_oPCAN_RADAR_d5ac99fc_Tx: ComBitPosition=388, ComBitSize=5, ComSignalType=UINT8, ComSystemTemplateSystemSignalRef=OBJ_YAW_RATE_ERR_007
        SG_TrackerObject008_oRDR_TRACKER_OBJ_008_oPCAN_RADAR_f9caaab2_Tx: ComSystemTemplateSignalGroupRef=SG_TrackerObject008
          49 x ComGroupSignal, all with ComSignalEndianness=BIG_ENDIAN, ComSignalInitValue=0, ComTransferProperty=PENDING:
            OBJ_ACCELERATION_LAT_008_oRDR_TRACKER_OBJ_008_oPCAN_RADAR_f7eef1c5_Tx: ComBitPosition=177, ComBitSize=10, ComSignalType=UINT16, ComSystemTemplateSystemSignalRef=OBJ_ACCELERATION_LAT_008
            OBJ_ACCELERATION_LAT_ERR_008_oRDR_TRACKER_OBJ_008_oPCAN_RADAR_221acb7b_Tx: ComBitPosition=223, ComBitSize=8, ComSignalType=UINT8, ComSystemTemplateSystemSignalRef=OBJ_ACCELERATION_LAT_ERR_008
            OBJ_ACCELERATION_LONG_008_oRDR_TRACKER_OBJ_008_oPCAN_RADAR_851ea825_Tx: ComBitPosition=193, ComBitSize=10, ComSignalType=UINT16, ComSystemTemplateSystemSignalRef=OBJ_ACCELERATION_LONG_008
            OBJ_ACCELERATION_LONG_ERR_008_oRDR_TRACKER_OBJ_008_oPCAN_RADAR_3dbf6ed1_Tx: ComBitPosition=215, ComBitSize=8, ComSignalType=UINT8, ComSystemTemplateSystemSignalRef=OBJ_ACCELERATION_LONG_ERR_008
            OBJ_ACCEL_ERR_CRR_COEF_008_oRDR_TRACKER_OBJ_008_oPCAN_RADAR_9d1c4fb7_Tx: ComBitPosition=431, ComBitSize=8, ComSignalType=UINT8, ComSystemTemplateSystemSignalRef=OBJ_ACCEL_ERR_CRR_COEF_008
            OBJ_ALIVE_TIME_008_oRDR_TRACKER_OBJ_008_oPCAN_RADAR_e57fe399_Tx: ComBitPosition=255, ComBitSize=16, ComSignalType=UINT16, ComSystemTemplateSystemSignalRef=OBJ_ALIVE_TIME_008
            OBJ_CLS_TYPE1_008_oRDR_TRACKER_OBJ_008_oPCAN_RADAR_72a402bf_Tx: ComBitPosition=271, ComBitSize=4, ComSignalType=UINT8, ComSystemTemplateSystemSignalRef=OBJ_CLS_TYPE1_008
            OBJ_CLS_TYPE1_PROB_008_oRDR_TRACKER_OBJ_008_oPCAN_RADAR_dafcd54c_Tx: ComBitPosition=303, ComBitSize=8, ComSignalType=UINT8, ComSystemTemplateSystemSignalRef=OBJ_CLS_TYPE1_PROB_008
            OBJ_CLS_TYPE2_008_oRDR_TRACKER_OBJ_008_oPCAN_RADAR_3f4c02d8_Tx: ComBitPosition=267, ComBitSize=4, ComSignalType=UINT8, ComSystemTemplateSystemSignalRef=OBJ_CLS_TYPE2_008
            OBJ_CLS_TYPE2_PROB_008_oRDR_TRACKER_OBJ_008_oPCAN_RADAR_13c8ce41_Tx: ComBitPosition=311, ComBitSize=8, ComSignalType=UINT8, ComSystemTemplateSystemSignalRef=OBJ_CLS_TYPE2_PROB_008
            OBJ_CLS_TYPE3_008_oRDR_TRACKER_OBJ_008_oPCAN_RADAR_b2c4ff3a_Tx: ComBitPosition=279, ComBitSize=4, ComSignalType=UINT8, ComSystemTemplateSystemSignalRef=OBJ_CLS_TYPE3_008
            OBJ_CLS_TYPE3_PROB_008_oRDR_TRACKER_OBJ_008_oPCAN_RADAR_54db38ba_Tx: ComBitPosition=319, ComBitSize=8, ComSignalType=UINT8, ComSystemTemplateSystemSignalRef=OBJ_CLS_TYPE3_PROB_008
            OBJ_CLS_TYPE4_008_oRDR_TRACKER_OBJ_008_oPCAN_RADAR_a49c0216_Tx: ComBitPosition=275, ComBitSize=4, ComSignalType=UINT8, ComSystemTemplateSystemSignalRef=OBJ_CLS_TYPE4_008
            OBJ_CLS_TYPE4_PROB_008_oRDR_TRACKER_OBJ_008_oPCAN_RADAR_5ad1fe1a_Tx: ComBitPosition=327, ComBitSize=8, ComSignalType=UINT8, ComSystemTemplateSystemSignalRef=OBJ_CLS_TYPE4_PROB_008
            OBJ_CLS_TYPE5_008_oRDR_TRACKER_OBJ_008_oPCAN_RADAR_2914fff4_Tx: ComBitPosition=287, ComBitSize=4, ComSignalType=UINT8, ComSystemTemplateSystemSignalRef=OBJ_CLS_TYPE5_008
            OBJ_CLS_TYPE5_PROB_008_oRDR_TRACKER_OBJ_008_oPCAN_RADAR_1dc208e1_Tx: ComBitPosition=335, ComBitSize=8, ComSignalType=UINT8, ComSystemTemplateSystemSignalRef=OBJ_CLS_TYPE5_PROB_008
            OBJ_CLS_TYPE6_008_oRDR_TRACKER_OBJ_008_oPCAN_RADAR_64fcff93_Tx: ComBitPosition=282, ComBitSize=4, ComSignalType=UINT8, ComSystemTemplateSystemSignalRef=OBJ_CLS_TYPE6_008
            OBJ_CLS_TYPE6_PROB_008_oRDR_TRACKER_OBJ_008_oPCAN_RADAR_d4f613ec_Tx: ComBitPosition=343, ComBitSize=8, ComSignalType=UINT8, ComSystemTemplateSystemSignalRef=OBJ_CLS_TYPE6_PROB_008
            OBJ_DIMENSION_LENGTH_008_oRDR_TRACKER_OBJ_008_oPCAN_RADAR_303a51fb_Tx: ComBitPosition=37, ComBitSize=12, ComSignalType=UINT16, ComSystemTemplateSystemSignalRef=OBJ_DIMENSION_LENGTH_008
            OBJ_DIMENSION_LENGTH_ERR_008_oRDR_TRACKER_OBJ_008_oPCAN_RADAR_0bc24e81_Tx: ComBitPosition=41, ComBitSize=10, ComSignalType=UINT16, ComSystemTemplateSystemSignalRef=OBJ_DIMENSION_LENGTH_ERR_008
            OBJ_DIMENSION_WIDTH_008_oRDR_TRACKER_OBJ_008_oPCAN_RADAR_13f4a656_Tx: ComBitPosition=17, ComBitSize=10, ComSignalType=UINT16, ComSystemTemplateSystemSignalRef=OBJ_DIMENSION_WIDTH_008
            OBJ_DIMENSION_WIDTH_ERR_008_oRDR_TRACKER_OBJ_008_oPCAN_RADAR_f35661be_Tx: ComBitPosition=23, ComBitSize=6, ComSignalType=UINT8, ComSystemTemplateSystemSignalRef=OBJ_DIMENSION_WIDTH_ERR_008
            OBJ_EXISTENCE_PROB_008_oRDR_TRACKER_OBJ_008_oPCAN_RADAR_1848226b_Tx: ComBitPosition=229, ComBitSize=14, ComSignalType=UINT16, ComSystemTemplateSystemSignalRef=OBJ_EXISTENCE_PROB_008
            OBJ_GROUP_ID_008_oRDR_TRACKER_OBJ_008_oPCAN_RADAR_913a36c6_Tx: ComBitPosition=405, ComBitSize=6, ComSignalType=UINT8, ComSystemTemplateSystemSignalRef=OBJ_GROUP_ID_008
            OBJ_ID_008_oRDR_TRACKER_OBJ_008_oPCAN_RADAR_62141dc1_Tx: ComBitPosition=7, ComBitSize=8, ComSignalType=UINT8, ComSystemTemplateSystemSignalRef=OBJ_ID_008
            OBJ_MEASUREMENT_STATUS_008_oRDR_TRACKER_OBJ_008_oPCAN_RADAR_1dc66f7c_Tx: ComBitPosition=14, ComBitSize=3, ComSignalType=UINT8, ComSystemTemplateSystemSignalRef=OBJ_MEASUREMENT_STATUS_008
            OBJ_MH_CRC16_008_oRDR_TRACKER_OBJ_008_oPCAN_RADAR_61a6d840_Tx: ComBitPosition=495, ComBitSize=16, ComSignalType=UINT16, ComSystemTemplateSystemSignalRef=OBJ_MH_CRC16_008
            OBJ_MH_CYCLE_COUNTER_008_oRDR_TRACKER_OBJ_008_oPCAN_RADAR_104282a1_Tx: ComBitPosition=487, ComBitSize=8, ComSignalType=UINT8, ComSystemTemplateSystemSignalRef=OBJ_MH_CYCLE_COUNTER_008
            OBJ_MOVEMENT_STATUS_008_oRDR_TRACKER_OBJ_008_oPCAN_RADAR_3268fa30_Tx: ComBitPosition=196, ComBitSize=3, ComSignalType=UINT8, ComSystemTemplateSystemSignalRef=OBJ_MOVEMENT_STATUS_008
            OBJ_POS_ERR_CRR_COEF_008_oRDR_TRACKER_OBJ_008_oPCAN_RADAR_a2173a0a_Tx: ComBitPosition=415, ComBitSize=8, ComSignalType=UINT8, ComSystemTemplateSystemSignalRef=OBJ_POS_ERR_CRR_COEF_008
            OBJ_POS_LAT_008_oRDR_TRACKER_OBJ_008_oPCAN_RADAR_40b8c746_Tx: ComBitPosition=79, ComBitSize=16, ComSignalType=UINT16, ComSystemTemplateSystemSignalRef=OBJ_POS_LAT_008
            OBJ_POS_LAT_ERR_008_oRDR_TRACKER_OBJ_008_oPCAN_RADAR_44f49771_Tx: ComBitPosition=103, ComBitSize=8, ComSignalType=UINT8, ComSystemTemplateSystemSignalRef=OBJ_POS_LAT_ERR_008
            OBJ_POS_LONG_008_oRDR_TRACKER_OBJ_008_oPCAN_RADAR_f1182c89_Tx: ComBitPosition=63, ComBitSize=16, ComSignalType=UINT16, ComSystemTemplateSystemSignalRef=OBJ_POS_LONG_008
            OBJ_POS_LONG_ERR_008_oRDR_TRACKER_OBJ_008_oPCAN_RADAR_dd0c6993_Tx: ComBitPosition=95, ComBitSize=8, ComSignalType=UINT8, ComSystemTemplateSystemSignalRef=OBJ_POS_LONG_ERR_008
            OBJ_RCS_008_oRDR_TRACKER_OBJ_008_oPCAN_RADAR_62779141_Tx: ComBitPosition=351, ComBitSize=7, ComSignalType=UINT8, ComSystemTemplateSystemSignalRef=OBJ_RCS_008
            OBJ_REF_PT_LAT_OFFSET_008_oRDR_TRACKER_OBJ_008_oPCAN_RADAR_974afa34_Tx: ComBitPosition=370, ComBitSize=14, ComSignalType=UINT16, ComSystemTemplateSystemSignalRef=OBJ_REF_PT_LAT_OFFSET_008
            OBJ_REF_PT_LONG_OFFSET_008_oRDR_TRACKER_OBJ_008_oPCAN_RADAR_d8180a37_Tx: ComBitPosition=357, ComBitSize=14, ComSignalType=UINT16, ComSystemTemplateSystemSignalRef=OBJ_REF_PT_LONG_OFFSET_008
            OBJ_TIMESTAMP_OFFSET_008_oRDR_TRACKER_OBJ_008_oPCAN_RADAR_62db9117_Tx: ComBitPosition=247, ComBitSize=8, ComSignalType=UINT8, ComSystemTemplateSystemSignalRef=OBJ_TIMESTAMP_OFFSET_008
            OBJ_TRACK_MOTION_MODEL_008_oRDR_TRACKER_OBJ_008_oPCAN_RADAR_aed890ca_Tx: ComBitPosition=9, ComBitSize=2, ComSignalType=UINT8, ComSystemTemplateSystemSignalRef=OBJ_TRACK_MOTION_MODEL_008
            OBJ_VEH_TRACK_FLAG_008_oRDR_TRACKER_OBJ_008_oPCAN_RADAR_2cf26697_Tx: ComBitPosition=10, ComBitSize=1, ComSignalType=BOOLEAN, ComSystemTemplateSystemSignalRef=OBJ_VEH_TRACK_FLAG_008
            OBJ_VELOCITY_ERR_CRR_COEF_008_oRDR_TRACKER_OBJ_008_oPCAN_RADAR_0b6d07eb_Tx: ComBitPosition=423, ComBitSize=8, ComSignalType=UINT8, ComSystemTemplateSystemSignalRef=OBJ_VELOCITY_ERR_CRR_COEF_008
            OBJ_VELOCITY_LAT_008_oRDR_TRACKER_OBJ_008_oPCAN_RADAR_04db8261_Tx: ComBitPosition=126, ComBitSize=15, ComSignalType=UINT16, ComSystemTemplateSystemSignalRef=OBJ_VELOCITY_LAT_008
            OBJ_VELOCITY_LAT_ERR_008_oRDR_TRACKER_OBJ_008_oPCAN_RADAR_3021f230_Tx: ComBitPosition=151, ComBitSize=8, ComSignalType=UINT8, ComSystemTemplateSystemSignalRef=OBJ_VELOCITY_LAT_ERR_008
            OBJ_VELOCITY_LONG_008_oRDR_TRACKER_OBJ_008_oPCAN_RADAR_5456faa7_Tx: ComBitPosition=110, ComBitSize=15, ComSignalType=UINT16, ComSystemTemplateSystemSignalRef=OBJ_VELOCITY_LONG_008
            OBJ_VELOCITY_LONG_ERR_008_oRDR_TRACKER_OBJ_008_oPCAN_RADAR_dca3cdf0_Tx: ComBitPosition=143, ComBitSize=8, ComSignalType=UINT8, ComSystemTemplateSystemSignalRef=OBJ_VELOCITY_LONG_ERR_008
            OBJ_YAW_ANGLE_008_oRDR_TRACKER_OBJ_008_oPCAN_RADAR_e867c621_Tx: ComBitPosition=155, ComBitSize=12, ComSignalType=UINT16, ComSystemTemplateSystemSignalRef=OBJ_YAW_ANGLE_008
            OBJ_YAW_ANGLE_ERR_008_oRDR_TRACKER_OBJ_008_oPCAN_RADAR_3d6ac0f6_Tx: ComBitPosition=175, ComBitSize=7, ComSignalType=UINT8, ComSystemTemplateSystemSignalRef=OBJ_YAW_ANGLE_ERR_008
            OBJ_YAW_RATE_008_oRDR_TRACKER_OBJ_008_oPCAN_RADAR_cde8e366_Tx: ComBitPosition=399, ComBitSize=10, ComSignalType=UINT16, ComSystemTemplateSystemSignalRef=OBJ_YAW_RATE_008
            OBJ_YAW_RATE_ERR_008_oRDR_TRACKER_OBJ_008_oPCAN_RADAR_f23074ba_Tx: ComBitPosition=388, ComBitSize=5, ComSignalType=UINT8, ComSystemTemplateSystemSignalRef=OBJ_YAW_RATE_ERR_008
        SG_TrackerObject009_oRDR_TRACKER_OBJ_009_oPCAN_RADAR_00de2201_Tx: ComSystemTemplateSignalGroupRef=SG_TrackerObject009
          49 x ComGroupSignal, all with ComSignalEndianness=BIG_ENDIAN, ComSignalInitValue=0, ComTransferProperty=PENDING:
            OBJ_ACCELERATION_LAT_009_oRDR_TRACKER_OBJ_009_oPCAN_RADAR_0efa7976_Tx: ComBitPosition=177, ComBitSize=10, ComSignalType=UINT16, ComSystemTemplateSystemSignalRef=OBJ_ACCELERATION_LAT_009
            OBJ_ACCELERATION_LAT_ERR_009_oRDR_TRACKER_OBJ_009_oPCAN_RADAR_db0e43c8_Tx: ComBitPosition=223, ComBitSize=8, ComSignalType=UINT8, ComSystemTemplateSystemSignalRef=OBJ_ACCELERATION_LAT_ERR_009
            OBJ_ACCELERATION_LONG_009_oRDR_TRACKER_OBJ_009_oPCAN_RADAR_7c0a2096_Tx: ComBitPosition=193, ComBitSize=10, ComSignalType=UINT16, ComSystemTemplateSystemSignalRef=OBJ_ACCELERATION_LONG_009
            OBJ_ACCELERATION_LONG_ERR_009_oRDR_TRACKER_OBJ_009_oPCAN_RADAR_c4abe662_Tx: ComBitPosition=215, ComBitSize=8, ComSignalType=UINT8, ComSystemTemplateSystemSignalRef=OBJ_ACCELERATION_LONG_ERR_009
            OBJ_ACCEL_ERR_CRR_COEF_009_oRDR_TRACKER_OBJ_009_oPCAN_RADAR_6408c704_Tx: ComBitPosition=431, ComBitSize=8, ComSignalType=UINT8, ComSystemTemplateSystemSignalRef=OBJ_ACCEL_ERR_CRR_COEF_009
            OBJ_ALIVE_TIME_009_oRDR_TRACKER_OBJ_009_oPCAN_RADAR_1c6b6b2a_Tx: ComBitPosition=255, ComBitSize=16, ComSignalType=UINT16, ComSystemTemplateSystemSignalRef=OBJ_ALIVE_TIME_009
            OBJ_CLS_TYPE1_009_oRDR_TRACKER_OBJ_009_oPCAN_RADAR_8bb08a0c_Tx: ComBitPosition=271, ComBitSize=4, ComSignalType=UINT8, ComSystemTemplateSystemSignalRef=OBJ_CLS_TYPE1_009
            OBJ_CLS_TYPE1_PROB_009_oRDR_TRACKER_OBJ_009_oPCAN_RADAR_23e85dff_Tx: ComBitPosition=303, ComBitSize=8, ComSignalType=UINT8, ComSystemTemplateSystemSignalRef=OBJ_CLS_TYPE1_PROB_009
            OBJ_CLS_TYPE2_009_oRDR_TRACKER_OBJ_009_oPCAN_RADAR_c6588a6b_Tx: ComBitPosition=267, ComBitSize=4, ComSignalType=UINT8, ComSystemTemplateSystemSignalRef=OBJ_CLS_TYPE2_009
            OBJ_CLS_TYPE2_PROB_009_oRDR_TRACKER_OBJ_009_oPCAN_RADAR_eadc46f2_Tx: ComBitPosition=311, ComBitSize=8, ComSignalType=UINT8, ComSystemTemplateSystemSignalRef=OBJ_CLS_TYPE2_PROB_009
            OBJ_CLS_TYPE3_009_oRDR_TRACKER_OBJ_009_oPCAN_RADAR_4bd07789_Tx: ComBitPosition=279, ComBitSize=4, ComSignalType=UINT8, ComSystemTemplateSystemSignalRef=OBJ_CLS_TYPE3_009
            OBJ_CLS_TYPE3_PROB_009_oRDR_TRACKER_OBJ_009_oPCAN_RADAR_adcfb009_Tx: ComBitPosition=319, ComBitSize=8, ComSignalType=UINT8, ComSystemTemplateSystemSignalRef=OBJ_CLS_TYPE3_PROB_009
            OBJ_CLS_TYPE4_009_oRDR_TRACKER_OBJ_009_oPCAN_RADAR_5d888aa5_Tx: ComBitPosition=275, ComBitSize=4, ComSignalType=UINT8, ComSystemTemplateSystemSignalRef=OBJ_CLS_TYPE4_009
            OBJ_CLS_TYPE4_PROB_009_oRDR_TRACKER_OBJ_009_oPCAN_RADAR_a3c576a9_Tx: ComBitPosition=327, ComBitSize=8, ComSignalType=UINT8, ComSystemTemplateSystemSignalRef=OBJ_CLS_TYPE4_PROB_009
            OBJ_CLS_TYPE5_009_oRDR_TRACKER_OBJ_009_oPCAN_RADAR_d0007747_Tx: ComBitPosition=287, ComBitSize=4, ComSignalType=UINT8, ComSystemTemplateSystemSignalRef=OBJ_CLS_TYPE5_009
            OBJ_CLS_TYPE5_PROB_009_oRDR_TRACKER_OBJ_009_oPCAN_RADAR_e4d68052_Tx: ComBitPosition=335, ComBitSize=8, ComSignalType=UINT8, ComSystemTemplateSystemSignalRef=OBJ_CLS_TYPE5_PROB_009
            OBJ_CLS_TYPE6_009_oRDR_TRACKER_OBJ_009_oPCAN_RADAR_9de87720_Tx: ComBitPosition=282, ComBitSize=4, ComSignalType=UINT8, ComSystemTemplateSystemSignalRef=OBJ_CLS_TYPE6_009
            OBJ_CLS_TYPE6_PROB_009_oRDR_TRACKER_OBJ_009_oPCAN_RADAR_2de29b5f_Tx: ComBitPosition=343, ComBitSize=8, ComSignalType=UINT8, ComSystemTemplateSystemSignalRef=OBJ_CLS_TYPE6_PROB_009
            OBJ_DIMENSION_LENGTH_009_oRDR_TRACKER_OBJ_009_oPCAN_RADAR_c92ed948_Tx: ComBitPosition=37, ComBitSize=12, ComSignalType=UINT16, ComSystemTemplateSystemSignalRef=OBJ_DIMENSION_LENGTH_009
            OBJ_DIMENSION_LENGTH_ERR_009_oRDR_TRACKER_OBJ_009_oPCAN_RADAR_f2d6c632_Tx: ComBitPosition=41, ComBitSize=10, ComSignalType=UINT16, ComSystemTemplateSystemSignalRef=OBJ_DIMENSION_LENGTH_ERR_009
            OBJ_DIMENSION_WIDTH_009_oRDR_TRACKER_OBJ_009_oPCAN_RADAR_eae02ee5_Tx: ComBitPosition=17, ComBitSize=10, ComSignalType=UINT16, ComSystemTemplateSystemSignalRef=OBJ_DIMENSION_WIDTH_009
            OBJ_DIMENSION_WIDTH_ERR_009_oRDR_TRACKER_OBJ_009_oPCAN_RADAR_0a42e90d_Tx: ComBitPosition=23, ComBitSize=6, ComSignalType=UINT8, ComSystemTemplateSystemSignalRef=OBJ_DIMENSION_WIDTH_ERR_009
            OBJ_EXISTENCE_PROB_009_oRDR_TRACKER_OBJ_009_oPCAN_RADAR_e15caad8_Tx: ComBitPosition=229, ComBitSize=14, ComSignalType=UINT16, ComSystemTemplateSystemSignalRef=OBJ_EXISTENCE_PROB_009
            OBJ_GROUP_ID_009_oRDR_TRACKER_OBJ_009_oPCAN_RADAR_682ebe75_Tx: ComBitPosition=405, ComBitSize=6, ComSignalType=UINT8, ComSystemTemplateSystemSignalRef=OBJ_GROUP_ID_009
            OBJ_ID_009_oRDR_TRACKER_OBJ_009_oPCAN_RADAR_9b009572_Tx: ComBitPosition=7, ComBitSize=8, ComSignalType=UINT8, ComSystemTemplateSystemSignalRef=OBJ_ID_009
            OBJ_MEASUREMENT_STATUS_009_oRDR_TRACKER_OBJ_009_oPCAN_RADAR_e4d2e7cf_Tx: ComBitPosition=14, ComBitSize=3, ComSignalType=UINT8, ComSystemTemplateSystemSignalRef=OBJ_MEASUREMENT_STATUS_009
            OBJ_MH_CRC16_009_oRDR_TRACKER_OBJ_009_oPCAN_RADAR_98b250f3_Tx: ComBitPosition=495, ComBitSize=16, ComSignalType=UINT16, ComSystemTemplateSystemSignalRef=OBJ_MH_CRC16_009
            OBJ_MH_CYCLE_COUNTER_009_oRDR_TRACKER_OBJ_009_oPCAN_RADAR_e9560a12_Tx: ComBitPosition=487, ComBitSize=8, ComSignalType=UINT8, ComSystemTemplateSystemSignalRef=OBJ_MH_CYCLE_COUNTER_009
            OBJ_MOVEMENT_STATUS_009_oRDR_TRACKER_OBJ_009_oPCAN_RADAR_cb7c7283_Tx: ComBitPosition=196, ComBitSize=3, ComSignalType=UINT8, ComSystemTemplateSystemSignalRef=OBJ_MOVEMENT_STATUS_009
            OBJ_POS_ERR_CRR_COEF_009_oRDR_TRACKER_OBJ_009_oPCAN_RADAR_5b03b2b9_Tx: ComBitPosition=415, ComBitSize=8, ComSignalType=UINT8, ComSystemTemplateSystemSignalRef=OBJ_POS_ERR_CRR_COEF_009
            OBJ_POS_LAT_009_oRDR_TRACKER_OBJ_009_oPCAN_RADAR_b9ac4ff5_Tx: ComBitPosition=79, ComBitSize=16, ComSignalType=UINT16, ComSystemTemplateSystemSignalRef=OBJ_POS_LAT_009
            OBJ_POS_LAT_ERR_009_oRDR_TRACKER_OBJ_009_oPCAN_RADAR_bde01fc2_Tx: ComBitPosition=103, ComBitSize=8, ComSignalType=UINT8, ComSystemTemplateSystemSignalRef=OBJ_POS_LAT_ERR_009
            OBJ_POS_LONG_009_oRDR_TRACKER_OBJ_009_oPCAN_RADAR_080ca43a_Tx: ComBitPosition=63, ComBitSize=16, ComSignalType=UINT16, ComSystemTemplateSystemSignalRef=OBJ_POS_LONG_009
            OBJ_POS_LONG_ERR_009_oRDR_TRACKER_OBJ_009_oPCAN_RADAR_2418e120_Tx: ComBitPosition=95, ComBitSize=8, ComSignalType=UINT8, ComSystemTemplateSystemSignalRef=OBJ_POS_LONG_ERR_009
            OBJ_RCS_009_oRDR_TRACKER_OBJ_009_oPCAN_RADAR_9b6319f2_Tx: ComBitPosition=351, ComBitSize=7, ComSignalType=UINT8, ComSystemTemplateSystemSignalRef=OBJ_RCS_009
            OBJ_REF_PT_LAT_OFFSET_009_oRDR_TRACKER_OBJ_009_oPCAN_RADAR_6e5e7287_Tx: ComBitPosition=370, ComBitSize=14, ComSignalType=UINT16, ComSystemTemplateSystemSignalRef=OBJ_REF_PT_LAT_OFFSET_009
            OBJ_REF_PT_LONG_OFFSET_009_oRDR_TRACKER_OBJ_009_oPCAN_RADAR_210c8284_Tx: ComBitPosition=357, ComBitSize=14, ComSignalType=UINT16, ComSystemTemplateSystemSignalRef=OBJ_REF_PT_LONG_OFFSET_009
            OBJ_TIMESTAMP_OFFSET_009_oRDR_TRACKER_OBJ_009_oPCAN_RADAR_9bcf19a4_Tx: ComBitPosition=247, ComBitSize=8, ComSignalType=UINT8, ComSystemTemplateSystemSignalRef=OBJ_TIMESTAMP_OFFSET_009
            OBJ_TRACK_MOTION_MODEL_009_oRDR_TRACKER_OBJ_009_oPCAN_RADAR_57cc1879_Tx: ComBitPosition=9, ComBitSize=2, ComSignalType=UINT8, ComSystemTemplateSystemSignalRef=OBJ_TRACK_MOTION_MODEL_009
            OBJ_VEH_TRACK_FLAG_009_oRDR_TRACKER_OBJ_009_oPCAN_RADAR_d5e6ee24_Tx: ComBitPosition=10, ComBitSize=1, ComSignalType=BOOLEAN, ComSystemTemplateSystemSignalRef=OBJ_VEH_TRACK_FLAG_009
            OBJ_VELOCITY_ERR_CRR_COEF_009_oRDR_TRACKER_OBJ_009_oPCAN_RADAR_f2798f58_Tx: ComBitPosition=423, ComBitSize=8, ComSignalType=UINT8, ComSystemTemplateSystemSignalRef=OBJ_VELOCITY_ERR_CRR_COEF_009
            OBJ_VELOCITY_LAT_009_oRDR_TRACKER_OBJ_009_oPCAN_RADAR_fdcf0ad2_Tx: ComBitPosition=126, ComBitSize=15, ComSignalType=UINT16, ComSystemTemplateSystemSignalRef=OBJ_VELOCITY_LAT_009
            OBJ_VELOCITY_LAT_ERR_009_oRDR_TRACKER_OBJ_009_oPCAN_RADAR_c9357a83_Tx: ComBitPosition=151, ComBitSize=8, ComSignalType=UINT8, ComSystemTemplateSystemSignalRef=OBJ_VELOCITY_LAT_ERR_009
            OBJ_VELOCITY_LONG_009_oRDR_TRACKER_OBJ_009_oPCAN_RADAR_ad427214_Tx: ComBitPosition=110, ComBitSize=15, ComSignalType=UINT16, ComSystemTemplateSystemSignalRef=OBJ_VELOCITY_LONG_009
            OBJ_VELOCITY_LONG_ERR_009_oRDR_TRACKER_OBJ_009_oPCAN_RADAR_25b74543_Tx: ComBitPosition=143, ComBitSize=8, ComSignalType=UINT8, ComSystemTemplateSystemSignalRef=OBJ_VELOCITY_LONG_ERR_009
            OBJ_YAW_ANGLE_009_oRDR_TRACKER_OBJ_009_oPCAN_RADAR_11734e92_Tx: ComBitPosition=155, ComBitSize=12, ComSignalType=UINT16, ComSystemTemplateSystemSignalRef=OBJ_YAW_ANGLE_009
            OBJ_YAW_ANGLE_ERR_009_oRDR_TRACKER_OBJ_009_oPCAN_RADAR_c47e4845_Tx: ComBitPosition=175, ComBitSize=7, ComSignalType=UINT8, ComSystemTemplateSystemSignalRef=OBJ_YAW_ANGLE_ERR_009
            OBJ_YAW_RATE_009_oRDR_TRACKER_OBJ_009_oPCAN_RADAR_34fc6bd5_Tx: ComBitPosition=399, ComBitSize=10, ComSignalType=UINT16, ComSystemTemplateSystemSignalRef=OBJ_YAW_RATE_009
            OBJ_YAW_RATE_ERR_009_oRDR_TRACKER_OBJ_009_oPCAN_RADAR_0b24fc09_Tx: ComBitPosition=388, ComBitSize=5, ComSignalType=UINT8, ComSystemTemplateSystemSignalRef=OBJ_YAW_RATE_ERR_009
        SG_TrackerObject010_oRDR_TRACKER_OBJ_010_oPCAN_RADAR_0e3b0090_Tx: ComSystemTemplateSignalGroupRef=SG_TrackerObject010
          49 x ComGroupSignal, all with ComSignalEndianness=BIG_ENDIAN, ComSignalInitValue=0, ComTransferProperty=PENDING:
            OBJ_ACCELERATION_LAT_010_oRDR_TRACKER_OBJ_010_oPCAN_RADAR_001f5be7_Tx: ComBitPosition=177, ComBitSize=10, ComSignalType=UINT16, ComSystemTemplateSystemSignalRef=OBJ_ACCELERATION_LAT_010
            OBJ_ACCELERATION_LAT_ERR_010_oRDR_TRACKER_OBJ_010_oPCAN_RADAR_d5eb6159_Tx: ComBitPosition=223, ComBitSize=8, ComSignalType=UINT8, ComSystemTemplateSystemSignalRef=OBJ_ACCELERATION_LAT_ERR_010
            OBJ_ACCELERATION_LONG_010_oRDR_TRACKER_OBJ_010_oPCAN_RADAR_72ef0207_Tx: ComBitPosition=193, ComBitSize=10, ComSignalType=UINT16, ComSystemTemplateSystemSignalRef=OBJ_ACCELERATION_LONG_010
            OBJ_ACCELERATION_LONG_ERR_010_oRDR_TRACKER_OBJ_010_oPCAN_RADAR_ca4ec4f3_Tx: ComBitPosition=215, ComBitSize=8, ComSignalType=UINT8, ComSystemTemplateSystemSignalRef=OBJ_ACCELERATION_LONG_ERR_010
            OBJ_ACCEL_ERR_CRR_COEF_010_oRDR_TRACKER_OBJ_010_oPCAN_RADAR_6aede595_Tx: ComBitPosition=431, ComBitSize=8, ComSignalType=UINT8, ComSystemTemplateSystemSignalRef=OBJ_ACCEL_ERR_CRR_COEF_010
            OBJ_ALIVE_TIME_010_oRDR_TRACKER_OBJ_010_oPCAN_RADAR_128e49bb_Tx: ComBitPosition=255, ComBitSize=16, ComSignalType=UINT16, ComSystemTemplateSystemSignalRef=OBJ_ALIVE_TIME_010
            OBJ_CLS_TYPE1_010_oRDR_TRACKER_OBJ_010_oPCAN_RADAR_8555a89d_Tx: ComBitPosition=271, ComBitSize=4, ComSignalType=UINT8, ComSystemTemplateSystemSignalRef=OBJ_CLS_TYPE1_010
            OBJ_CLS_TYPE1_PROB_010_oRDR_TRACKER_OBJ_010_oPCAN_RADAR_2d0d7f6e_Tx: ComBitPosition=303, ComBitSize=8, ComSignalType=UINT8, ComSystemTemplateSystemSignalRef=OBJ_CLS_TYPE1_PROB_010
            OBJ_CLS_TYPE2_010_oRDR_TRACKER_OBJ_010_oPCAN_RADAR_c8bda8fa_Tx: ComBitPosition=267, ComBitSize=4, ComSignalType=UINT8, ComSystemTemplateSystemSignalRef=OBJ_CLS_TYPE2_010
            OBJ_CLS_TYPE2_PROB_010_oRDR_TRACKER_OBJ_010_oPCAN_RADAR_e4396463_Tx: ComBitPosition=311, ComBitSize=8, ComSignalType=UINT8, ComSystemTemplateSystemSignalRef=OBJ_CLS_TYPE2_PROB_010
            OBJ_CLS_TYPE3_010_oRDR_TRACKER_OBJ_010_oPCAN_RADAR_45355518_Tx: ComBitPosition=279, ComBitSize=4, ComSignalType=UINT8, ComSystemTemplateSystemSignalRef=OBJ_CLS_TYPE3_010
            OBJ_CLS_TYPE3_PROB_010_oRDR_TRACKER_OBJ_010_oPCAN_RADAR_a32a9298_Tx: ComBitPosition=319, ComBitSize=8, ComSignalType=UINT8, ComSystemTemplateSystemSignalRef=OBJ_CLS_TYPE3_PROB_010
            OBJ_CLS_TYPE4_010_oRDR_TRACKER_OBJ_010_oPCAN_RADAR_536da834_Tx: ComBitPosition=275, ComBitSize=4, ComSignalType=UINT8, ComSystemTemplateSystemSignalRef=OBJ_CLS_TYPE4_010
            OBJ_CLS_TYPE4_PROB_010_oRDR_TRACKER_OBJ_010_oPCAN_RADAR_ad205438_Tx: ComBitPosition=327, ComBitSize=8, ComSignalType=UINT8, ComSystemTemplateSystemSignalRef=OBJ_CLS_TYPE4_PROB_010
            OBJ_CLS_TYPE5_010_oRDR_TRACKER_OBJ_010_oPCAN_RADAR_dee555d6_Tx: ComBitPosition=287, ComBitSize=4, ComSignalType=UINT8, ComSystemTemplateSystemSignalRef=OBJ_CLS_TYPE5_010
            OBJ_CLS_TYPE5_PROB_010_oRDR_TRACKER_OBJ_010_oPCAN_RADAR_ea33a2c3_Tx: ComBitPosition=335, ComBitSize=8, ComSignalType=UINT8, ComSystemTemplateSystemSignalRef=OBJ_CLS_TYPE5_PROB_010
            OBJ_CLS_TYPE6_010_oRDR_TRACKER_OBJ_010_oPCAN_RADAR_930d55b1_Tx: ComBitPosition=282, ComBitSize=4, ComSignalType=UINT8, ComSystemTemplateSystemSignalRef=OBJ_CLS_TYPE6_010
            OBJ_CLS_TYPE6_PROB_010_oRDR_TRACKER_OBJ_010_oPCAN_RADAR_2307b9ce_Tx: ComBitPosition=343, ComBitSize=8, ComSignalType=UINT8, ComSystemTemplateSystemSignalRef=OBJ_CLS_TYPE6_PROB_010
            OBJ_DIMENSION_LENGTH_010_oRDR_TRACKER_OBJ_010_oPCAN_RADAR_c7cbfbd9_Tx: ComBitPosition=37, ComBitSize=12, ComSignalType=UINT16, ComSystemTemplateSystemSignalRef=OBJ_DIMENSION_LENGTH_010
            OBJ_DIMENSION_LENGTH_ERR_010_oRDR_TRACKER_OBJ_010_oPCAN_RADAR_fc33e4a3_Tx: ComBitPosition=41, ComBitSize=10, ComSignalType=UINT16, ComSystemTemplateSystemSignalRef=OBJ_DIMENSION_LENGTH_ERR_010
            OBJ_DIMENSION_WIDTH_010_oRDR_TRACKER_OBJ_010_oPCAN_RADAR_e4050c74_Tx: ComBitPosition=17, ComBitSize=10, ComSignalType=UINT16, ComSystemTemplateSystemSignalRef=OBJ_DIMENSION_WIDTH_010
            OBJ_DIMENSION_WIDTH_ERR_010_oRDR_TRACKER_OBJ_010_oPCAN_RADAR_04a7cb9c_Tx: ComBitPosition=23, ComBitSize=6, ComSignalType=UINT8, ComSystemTemplateSystemSignalRef=OBJ_DIMENSION_WIDTH_ERR_010
            OBJ_EXISTENCE_PROB_010_oRDR_TRACKER_OBJ_010_oPCAN_RADAR_efb98849_Tx: ComBitPosition=229, ComBitSize=14, ComSignalType=UINT16, ComSystemTemplateSystemSignalRef=OBJ_EXISTENCE_PROB_010
            OBJ_GROUP_ID_010_oRDR_TRACKER_OBJ_010_oPCAN_RADAR_66cb9ce4_Tx: ComBitPosition=405, ComBitSize=6, ComSignalType=UINT8, ComSystemTemplateSystemSignalRef=OBJ_GROUP_ID_010
            OBJ_ID_010_oRDR_TRACKER_OBJ_010_oPCAN_RADAR_95e5b7e3_Tx: ComBitPosition=7, ComBitSize=8, ComSignalType=UINT8, ComSystemTemplateSystemSignalRef=OBJ_ID_010
            OBJ_MEASUREMENT_STATUS_010_oRDR_TRACKER_OBJ_010_oPCAN_RADAR_ea37c55e_Tx: ComBitPosition=14, ComBitSize=3, ComSignalType=UINT8, ComSystemTemplateSystemSignalRef=OBJ_MEASUREMENT_STATUS_010
            OBJ_MH_CRC16_010_oRDR_TRACKER_OBJ_010_oPCAN_RADAR_96577262_Tx: ComBitPosition=495, ComBitSize=16, ComSignalType=UINT16, ComSystemTemplateSystemSignalRef=OBJ_MH_CRC16_010
            OBJ_MH_CYCLE_COUNTER_010_oRDR_TRACKER_OBJ_010_oPCAN_RADAR_e7b32883_Tx: ComBitPosition=487, ComBitSize=8, ComSignalType=UINT8, ComSystemTemplateSystemSignalRef=OBJ_MH_CYCLE_COUNTER_010
            OBJ_MOVEMENT_STATUS_010_oRDR_TRACKER_OBJ_010_oPCAN_RADAR_c5995012_Tx: ComBitPosition=196, ComBitSize=3, ComSignalType=UINT8, ComSystemTemplateSystemSignalRef=OBJ_MOVEMENT_STATUS_010
            OBJ_POS_ERR_CRR_COEF_010_oRDR_TRACKER_OBJ_010_oPCAN_RADAR_55e69028_Tx: ComBitPosition=415, ComBitSize=8, ComSignalType=UINT8, ComSystemTemplateSystemSignalRef=OBJ_POS_ERR_CRR_COEF_010
            OBJ_POS_LAT_010_oRDR_TRACKER_OBJ_010_oPCAN_RADAR_b7496d64_Tx: ComBitPosition=79, ComBitSize=16, ComSignalType=UINT16, ComSystemTemplateSystemSignalRef=OBJ_POS_LAT_010
            OBJ_POS_LAT_ERR_010_oRDR_TRACKER_OBJ_010_oPCAN_RADAR_b3053d53_Tx: ComBitPosition=103, ComBitSize=8, ComSignalType=UINT8, ComSystemTemplateSystemSignalRef=OBJ_POS_LAT_ERR_010
            OBJ_POS_LONG_010_oRDR_TRACKER_OBJ_010_oPCAN_RADAR_06e986ab_Tx: ComBitPosition=63, ComBitSize=16, ComSignalType=UINT16, ComSystemTemplateSystemSignalRef=OBJ_POS_LONG_010
            OBJ_POS_LONG_ERR_010_oRDR_TRACKER_OBJ_010_oPCAN_RADAR_2afdc3b1_Tx: ComBitPosition=95, ComBitSize=8, ComSignalType=UINT8, ComSystemTemplateSystemSignalRef=OBJ_POS_LONG_ERR_010
            OBJ_RCS_010_oRDR_TRACKER_OBJ_010_oPCAN_RADAR_95863b63_Tx: ComBitPosition=351, ComBitSize=7, ComSignalType=UINT8, ComSystemTemplateSystemSignalRef=OBJ_RCS_010
            OBJ_REF_PT_LAT_OFFSET_010_oRDR_TRACKER_OBJ_010_oPCAN_RADAR_60bb5016_Tx: ComBitPosition=370, ComBitSize=14, ComSignalType=UINT16, ComSystemTemplateSystemSignalRef=OBJ_REF_PT_LAT_OFFSET_010
            OBJ_REF_PT_LONG_OFFSET_010_oRDR_TRACKER_OBJ_010_oPCAN_RADAR_2fe9a015_Tx: ComBitPosition=357, ComBitSize=14, ComSignalType=UINT16, ComSystemTemplateSystemSignalRef=OBJ_REF_PT_LONG_OFFSET_010
            OBJ_TIMESTAMP_OFFSET_010_oRDR_TRACKER_OBJ_010_oPCAN_RADAR_952a3b35_Tx: ComBitPosition=247, ComBitSize=8, ComSignalType=UINT8, ComSystemTemplateSystemSignalRef=OBJ_TIMESTAMP_OFFSET_010
            OBJ_TRACK_MOTION_MODEL_010_oRDR_TRACKER_OBJ_010_oPCAN_RADAR_59293ae8_Tx: ComBitPosition=9, ComBitSize=2, ComSignalType=UINT8, ComSystemTemplateSystemSignalRef=OBJ_TRACK_MOTION_MODEL_010
            OBJ_VEH_TRACK_FLAG_010_oRDR_TRACKER_OBJ_010_oPCAN_RADAR_db03ccb5_Tx: ComBitPosition=10, ComBitSize=1, ComSignalType=BOOLEAN, ComSystemTemplateSystemSignalRef=OBJ_VEH_TRACK_FLAG_010
            OBJ_VELOCITY_ERR_CRR_COEF_010_oRDR_TRACKER_OBJ_010_oPCAN_RADAR_fc9cadc9_Tx: ComBitPosition=423, ComBitSize=8, ComSignalType=UINT8, ComSystemTemplateSystemSignalRef=OBJ_VELOCITY_ERR_CRR_COEF_010
            OBJ_VELOCITY_LAT_010_oRDR_TRACKER_OBJ_010_oPCAN_RADAR_f32a2843_Tx: ComBitPosition=126, ComBitSize=15, ComSignalType=UINT16, ComSystemTemplateSystemSignalRef=OBJ_VELOCITY_LAT_010
            OBJ_VELOCITY_LAT_ERR_010_oRDR_TRACKER_OBJ_010_oPCAN_RADAR_c7d05812_Tx: ComBitPosition=151, ComBitSize=8, ComSignalType=UINT8, ComSystemTemplateSystemSignalRef=OBJ_VELOCITY_LAT_ERR_010
            OBJ_VELOCITY_LONG_010_oRDR_TRACKER_OBJ_010_oPCAN_RADAR_a3a75085_Tx: ComBitPosition=110, ComBitSize=15, ComSignalType=UINT16, ComSystemTemplateSystemSignalRef=OBJ_VELOCITY_LONG_010
            OBJ_VELOCITY_LONG_ERR_010_oRDR_TRACKER_OBJ_010_oPCAN_RADAR_2b5267d2_Tx: ComBitPosition=143, ComBitSize=8, ComSignalType=UINT8, ComSystemTemplateSystemSignalRef=OBJ_VELOCITY_LONG_ERR_010
            OBJ_YAW_ANGLE_010_oRDR_TRACKER_OBJ_010_oPCAN_RADAR_1f966c03_Tx: ComBitPosition=155, ComBitSize=12, ComSignalType=UINT16, ComSystemTemplateSystemSignalRef=OBJ_YAW_ANGLE_010
            OBJ_YAW_ANGLE_ERR_010_oRDR_TRACKER_OBJ_010_oPCAN_RADAR_ca9b6ad4_Tx: ComBitPosition=175, ComBitSize=7, ComSignalType=UINT8, ComSystemTemplateSystemSignalRef=OBJ_YAW_ANGLE_ERR_010
            OBJ_YAW_RATE_010_oRDR_TRACKER_OBJ_010_oPCAN_RADAR_3a194944_Tx: ComBitPosition=399, ComBitSize=10, ComSignalType=UINT16, ComSystemTemplateSystemSignalRef=OBJ_YAW_RATE_010
            OBJ_YAW_RATE_ERR_010_oRDR_TRACKER_OBJ_010_oPCAN_RADAR_05c1de98_Tx: ComBitPosition=388, ComBitSize=5, ComSignalType=UINT8, ComSystemTemplateSystemSignalRef=OBJ_YAW_RATE_ERR_010
        SG_TrackerObject011_oRDR_TRACKER_OBJ_011_oPCAN_RADAR_f72f8823_Tx: ComSystemTemplateSignalGroupRef=SG_TrackerObject011
          49 x ComGroupSignal, all with ComSignalEndianness=BIG_ENDIAN, ComSignalInitValue=0, ComTransferProperty=PENDING:
            OBJ_ACCELERATION_LAT_011_oRDR_TRACKER_OBJ_011_oPCAN_RADAR_f90bd354_Tx: ComBitPosition=177, ComBitSize=10, ComSignalType=UINT16, ComSystemTemplateSystemSignalRef=OBJ_ACCELERATION_LAT_011
            OBJ_ACCELERATION_LAT_ERR_011_oRDR_TRACKER_OBJ_011_oPCAN_RADAR_2cffe9ea_Tx: ComBitPosition=223, ComBitSize=8, ComSignalType=UINT8, ComSystemTemplateSystemSignalRef=OBJ_ACCELERATION_LAT_ERR_011
            OBJ_ACCELERATION_LONG_011_oRDR_TRACKER_OBJ_011_oPCAN_RADAR_8bfb8ab4_Tx: ComBitPosition=193, ComBitSize=10, ComSignalType=UINT16, ComSystemTemplateSystemSignalRef=OBJ_ACCELERATION_LONG_011
            OBJ_ACCELERATION_LONG_ERR_011_oRDR_TRACKER_OBJ_011_oPCAN_RADAR_335a4c40_Tx: ComBitPosition=215, ComBitSize=8, ComSignalType=UINT8, ComSystemTemplateSystemSignalRef=OBJ_ACCELERATION_LONG_ERR_011
            OBJ_ACCEL_ERR_CRR_COEF_011_oRDR_TRACKER_OBJ_011_oPCAN_RADAR_93f96d26_Tx: ComBitPosition=431, ComBitSize=8, ComSignalType=UINT8, ComSystemTemplateSystemSignalRef=OBJ_ACCEL_ERR_CRR_COEF_011
            OBJ_ALIVE_TIME_011_oRDR_TRACKER_OBJ_011_oPCAN_RADAR_eb9ac108_Tx: ComBitPosition=255, ComBitSize=16, ComSignalType=UINT16, ComSystemTemplateSystemSignalRef=OBJ_ALIVE_TIME_011
            OBJ_CLS_TYPE1_011_oRDR_TRACKER_OBJ_011_oPCAN_RADAR_7c41202e_Tx: ComBitPosition=271, ComBitSize=4, ComSignalType=UINT8, ComSystemTemplateSystemSignalRef=OBJ_CLS_TYPE1_011
            OBJ_CLS_TYPE1_PROB_011_oRDR_TRACKER_OBJ_011_oPCAN_RADAR_d419f7dd_Tx: ComBitPosition=303, ComBitSize=8, ComSignalType=UINT8, ComSystemTemplateSystemSignalRef=OBJ_CLS_TYPE1_PROB_011
            OBJ_CLS_TYPE2_011_oRDR_TRACKER_OBJ_011_oPCAN_RADAR_31a92049_Tx: ComBitPosition=267, ComBitSize=4, ComSignalType=UINT8, ComSystemTemplateSystemSignalRef=OBJ_CLS_TYPE2_011
            OBJ_CLS_TYPE2_PROB_011_oRDR_TRACKER_OBJ_011_oPCAN_RADAR_1d2decd0_Tx: ComBitPosition=311, ComBitSize=8, ComSignalType=UINT8, ComSystemTemplateSystemSignalRef=OBJ_CLS_TYPE2_PROB_011
            OBJ_CLS_TYPE3_011_oRDR_TRACKER_OBJ_011_oPCAN_RADAR_bc21ddab_Tx: ComBitPosition=279, ComBitSize=4, ComSignalType=UINT8, ComSystemTemplateSystemSignalRef=OBJ_CLS_TYPE3_011
            OBJ_CLS_TYPE3_PROB_011_oRDR_TRACKER_OBJ_011_oPCAN_RADAR_5a3e1a2b_Tx: ComBitPosition=319, ComBitSize=8, ComSignalType=UINT8, ComSystemTemplateSystemSignalRef=OBJ_CLS_TYPE3_PROB_011
            OBJ_CLS_TYPE4_011_oRDR_TRACKER_OBJ_011_oPCAN_RADAR_aa792087_Tx: ComBitPosition=275, ComBitSize=4, ComSignalType=UINT8, ComSystemTemplateSystemSignalRef=OBJ_CLS_TYPE4_011
            OBJ_CLS_TYPE4_PROB_011_oRDR_TRACKER_OBJ_011_oPCAN_RADAR_5434dc8b_Tx: ComBitPosition=327, ComBitSize=8, ComSignalType=UINT8, ComSystemTemplateSystemSignalRef=OBJ_CLS_TYPE4_PROB_011
            OBJ_CLS_TYPE5_011_oRDR_TRACKER_OBJ_011_oPCAN_RADAR_27f1dd65_Tx: ComBitPosition=287, ComBitSize=4, ComSignalType=UINT8, ComSystemTemplateSystemSignalRef=OBJ_CLS_TYPE5_011
            OBJ_CLS_TYPE5_PROB_011_oRDR_TRACKER_OBJ_011_oPCAN_RADAR_13272a70_Tx: ComBitPosition=335, ComBitSize=8, ComSignalType=UINT8, ComSystemTemplateSystemSignalRef=OBJ_CLS_TYPE5_PROB_011
            OBJ_CLS_TYPE6_011_oRDR_TRACKER_OBJ_011_oPCAN_RADAR_6a19dd02_Tx: ComBitPosition=282, ComBitSize=4, ComSignalType=UINT8, ComSystemTemplateSystemSignalRef=OBJ_CLS_TYPE6_011
            OBJ_CLS_TYPE6_PROB_011_oRDR_TRACKER_OBJ_011_oPCAN_RADAR_da13317d_Tx: ComBitPosition=343, ComBitSize=8, ComSignalType=UINT8, ComSystemTemplateSystemSignalRef=OBJ_CLS_TYPE6_PROB_011
            OBJ_DIMENSION_LENGTH_011_oRDR_TRACKER_OBJ_011_oPCAN_RADAR_3edf736a_Tx: ComBitPosition=37, ComBitSize=12, ComSignalType=UINT16, ComSystemTemplateSystemSignalRef=OBJ_DIMENSION_LENGTH_011
            OBJ_DIMENSION_LENGTH_ERR_011_oRDR_TRACKER_OBJ_011_oPCAN_RADAR_05276c10_Tx: ComBitPosition=41, ComBitSize=10, ComSignalType=UINT16, ComSystemTemplateSystemSignalRef=OBJ_DIMENSION_LENGTH_ERR_011
            OBJ_DIMENSION_WIDTH_011_oRDR_TRACKER_OBJ_011_oPCAN_RADAR_1d1184c7_Tx: ComBitPosition=17, ComBitSize=10, ComSignalType=UINT16, ComSystemTemplateSystemSignalRef=OBJ_DIMENSION_WIDTH_011
            OBJ_DIMENSION_WIDTH_ERR_011_oRDR_TRACKER_OBJ_011_oPCAN_RADAR_fdb3432f_Tx: ComBitPosition=23, ComBitSize=6, ComSignalType=UINT8, ComSystemTemplateSystemSignalRef=OBJ_DIMENSION_WIDTH_ERR_011
            OBJ_EXISTENCE_PROB_011_oRDR_TRACKER_OBJ_011_oPCAN_RADAR_16ad00fa_Tx: ComBitPosition=229, ComBitSize=14, ComSignalType=UINT16, ComSystemTemplateSystemSignalRef=OBJ_EXISTENCE_PROB_011
            OBJ_GROUP_ID_011_oRDR_TRACKER_OBJ_011_oPCAN_RADAR_9fdf1457_Tx: ComBitPosition=405, ComBitSize=6, ComSignalType=UINT8, ComSystemTemplateSystemSignalRef=OBJ_GROUP_ID_011
            OBJ_ID_011_oRDR_TRACKER_OBJ_011_oPCAN_RADAR_6cf13f50_Tx: ComBitPosition=7, ComBitSize=8, ComSignalType=UINT8, ComSystemTemplateSystemSignalRef=OBJ_ID_011
            OBJ_MEASUREMENT_STATUS_011_oRDR_TRACKER_OBJ_011_oPCAN_RADAR_13234ded_Tx: ComBitPosition=14, ComBitSize=3, ComSignalType=UINT8, ComSystemTemplateSystemSignalRef=OBJ_MEASUREMENT_STATUS_011
            OBJ_MH_CRC16_011_oRDR_TRACKER_OBJ_011_oPCAN_RADAR_6f43fad1_Tx: ComBitPosition=495, ComBitSize=16, ComSignalType=UINT16, ComSystemTemplateSystemSignalRef=OBJ_MH_CRC16_011
            OBJ_MH_CYCLE_COUNTER_011_oRDR_TRACKER_OBJ_011_oPCAN_RADAR_1ea7a030_Tx: ComBitPosition=487, ComBitSize=8, ComSignalType=UINT8, ComSystemTemplateSystemSignalRef=OBJ_MH_CYCLE_COUNTER_011
            OBJ_MOVEMENT_STATUS_011_oRDR_TRACKER_OBJ_011_oPCAN_RADAR_3c8dd8a1_Tx: ComBitPosition=196, ComBitSize=3, ComSignalType=UINT8, ComSystemTemplateSystemSignalRef=OBJ_MOVEMENT_STATUS_011
            OBJ_POS_ERR_CRR_COEF_011_oRDR_TRACKER_OBJ_011_oPCAN_RADAR_acf2189b_Tx: ComBitPosition=415, ComBitSize=8, ComSignalType=UINT8, ComSystemTemplateSystemSignalRef=OBJ_POS_ERR_CRR_COEF_011
            OBJ_POS_LAT_011_oRDR_TRACKER_OBJ_011_oPCAN_RADAR_4e5de5d7_Tx: ComBitPosition=79, ComBitSize=16, ComSignalType=UINT16, ComSystemTemplateSystemSignalRef=OBJ_POS_LAT_011
            OBJ_POS_LAT_ERR_011_oRDR_TRACKER_OBJ_011_oPCAN_RADAR_4a11b5e0_Tx: ComBitPosition=103, ComBitSize=8, ComSignalType=UINT8, ComSystemTemplateSystemSignalRef=OBJ_POS_LAT_ERR_011
            OBJ_POS_LONG_011_oRDR_TRACKER_OBJ_011_oPCAN_RADAR_fffd0e18_Tx: ComBitPosition=63, ComBitSize=16, ComSignalType=UINT16, ComSystemTemplateSystemSignalRef=OBJ_POS_LONG_011
            OBJ_POS_LONG_ERR_011_oRDR_TRACKER_OBJ_011_oPCAN_RADAR_d3e94b02_Tx: ComBitPosition=95, ComBitSize=8, ComSignalType=UINT8, ComSystemTemplateSystemSignalRef=OBJ_POS_LONG_ERR_011
            OBJ_RCS_011_oRDR_TRACKER_OBJ_011_oPCAN_RADAR_6c92b3d0_Tx: ComBitPosition=351, ComBitSize=7, ComSignalType=UINT8, ComSystemTemplateSystemSignalRef=OBJ_RCS_011
            OBJ_REF_PT_LAT_OFFSET_011_oRDR_TRACKER_OBJ_011_oPCAN_RADAR_99afd8a5_Tx: ComBitPosition=370, ComBitSize=14, ComSignalType=UINT16, ComSystemTemplateSystemSignalRef=OBJ_REF_PT_LAT_OFFSET_011
            OBJ_REF_PT_LONG_OFFSET_011_oRDR_TRACKER_OBJ_011_oPCAN_RADAR_d6fd28a6_Tx: ComBitPosition=357, ComBitSize=14, ComSignalType=UINT16, ComSystemTemplateSystemSignalRef=OBJ_REF_PT_LONG_OFFSET_011
            OBJ_TIMESTAMP_OFFSET_011_oRDR_TRACKER_OBJ_011_oPCAN_RADAR_6c3eb386_Tx: ComBitPosition=247, ComBitSize=8, ComSignalType=UINT8, ComSystemTemplateSystemSignalRef=OBJ_TIMESTAMP_OFFSET_011
            OBJ_TRACK_MOTION_MODEL_011_oRDR_TRACKER_OBJ_011_oPCAN_RADAR_a03db25b_Tx: ComBitPosition=9, ComBitSize=2, ComSignalType=UINT8, ComSystemTemplateSystemSignalRef=OBJ_TRACK_MOTION_MODEL_011
            OBJ_VEH_TRACK_FLAG_011_oRDR_TRACKER_OBJ_011_oPCAN_RADAR_22174406_Tx: ComBitPosition=10, ComBitSize=1, ComSignalType=BOOLEAN, ComSystemTemplateSystemSignalRef=OBJ_VEH_TRACK_FLAG_011
            OBJ_VELOCITY_ERR_CRR_COEF_011_oRDR_TRACKER_OBJ_011_oPCAN_RADAR_0588257a_Tx: ComBitPosition=423, ComBitSize=8, ComSignalType=UINT8, ComSystemTemplateSystemSignalRef=OBJ_VELOCITY_ERR_CRR_COEF_011
            OBJ_VELOCITY_LAT_011_oRDR_TRACKER_OBJ_011_oPCAN_RADAR_0a3ea0f0_Tx: ComBitPosition=126, ComBitSize=15, ComSignalType=UINT16, ComSystemTemplateSystemSignalRef=OBJ_VELOCITY_LAT_011
            OBJ_VELOCITY_LAT_ERR_011_oRDR_TRACKER_OBJ_011_oPCAN_RADAR_3ec4d0a1_Tx: ComBitPosition=151, ComBitSize=8, ComSignalType=UINT8, ComSystemTemplateSystemSignalRef=OBJ_VELOCITY_LAT_ERR_011
            OBJ_VELOCITY_LONG_011_oRDR_TRACKER_OBJ_011_oPCAN_RADAR_5ab3d836_Tx: ComBitPosition=110, ComBitSize=15, ComSignalType=UINT16, ComSystemTemplateSystemSignalRef=OBJ_VELOCITY_LONG_011
            OBJ_VELOCITY_LONG_ERR_011_oRDR_TRACKER_OBJ_011_oPCAN_RADAR_d246ef61_Tx: ComBitPosition=143, ComBitSize=8, ComSignalType=UINT8, ComSystemTemplateSystemSignalRef=OBJ_VELOCITY_LONG_ERR_011
            OBJ_YAW_ANGLE_011_oRDR_TRACKER_OBJ_011_oPCAN_RADAR_e682e4b0_Tx: ComBitPosition=155, ComBitSize=12, ComSignalType=UINT16, ComSystemTemplateSystemSignalRef=OBJ_YAW_ANGLE_011
            OBJ_YAW_ANGLE_ERR_011_oRDR_TRACKER_OBJ_011_oPCAN_RADAR_338fe267_Tx: ComBitPosition=175, ComBitSize=7, ComSignalType=UINT8, ComSystemTemplateSystemSignalRef=OBJ_YAW_ANGLE_ERR_011
            OBJ_YAW_RATE_011_oRDR_TRACKER_OBJ_011_oPCAN_RADAR_c30dc1f7_Tx: ComBitPosition=399, ComBitSize=10, ComSignalType=UINT16, ComSystemTemplateSystemSignalRef=OBJ_YAW_RATE_011
            OBJ_YAW_RATE_ERR_011_oRDR_TRACKER_OBJ_011_oPCAN_RADAR_fcd5562b_Tx: ComBitPosition=388, ComBitSize=5, ComSignalType=UINT8, ComSystemTemplateSystemSignalRef=OBJ_YAW_RATE_ERR_011
        SG_TrackerObject012_oRDR_TRACKER_OBJ_012_oPCAN_RADAR_276317b7_Tx: ComSystemTemplateSignalGroupRef=SG_TrackerObject012
          49 x ComGroupSignal, all with ComSignalEndianness=BIG_ENDIAN, ComSignalInitValue=0, ComTransferProperty=PENDING:
            OBJ_ACCELERATION_LAT_012_oRDR_TRACKER_OBJ_012_oPCAN_RADAR_29474cc0_Tx: ComBitPosition=177, ComBitSize=10, ComSignalType=UINT16, ComSystemTemplateSystemSignalRef=OBJ_ACCELERATION_LAT_012
            OBJ_ACCELERATION_LAT_ERR_012_oRDR_TRACKER_OBJ_012_oPCAN_RADAR_fcb3767e_Tx: ComBitPosition=223, ComBitSize=8, ComSignalType=UINT8, ComSystemTemplateSystemSignalRef=OBJ_ACCELERATION_LAT_ERR_012
            OBJ_ACCELERATION_LONG_012_oRDR_TRACKER_OBJ_012_oPCAN_RADAR_5bb71520_Tx: ComBitPosition=193, ComBitSize=10, ComSignalType=UINT16, ComSystemTemplateSystemSignalRef=OBJ_ACCELERATION_LONG_012
            OBJ_ACCELERATION_LONG_ERR_012_oRDR_TRACKER_OBJ_012_oPCAN_RADAR_e316d3d4_Tx: ComBitPosition=215, ComBitSize=8, ComSignalType=UINT8, ComSystemTemplateSystemSignalRef=OBJ_ACCELERATION_LONG_ERR_012
            OBJ_ACCEL_ERR_CRR_COEF_012_oRDR_TRACKER_OBJ_012_oPCAN_RADAR_43b5f2b2_Tx: ComBitPosition=431, ComBitSize=8, ComSignalType=UINT8, ComSystemTemplateSystemSignalRef=OBJ_ACCEL_ERR_CRR_COEF_012
            OBJ_ALIVE_TIME_012_oRDR_TRACKER_OBJ_012_oPCAN_RADAR_3bd65e9c_Tx: ComBitPosition=255, ComBitSize=16, ComSignalType=UINT16, ComSystemTemplateSystemSignalRef=OBJ_ALIVE_TIME_012
            OBJ_CLS_TYPE1_012_oRDR_TRACKER_OBJ_012_oPCAN_RADAR_ac0dbfba_Tx: ComBitPosition=271, ComBitSize=4, ComSignalType=UINT8, ComSystemTemplateSystemSignalRef=OBJ_CLS_TYPE1_012
            OBJ_CLS_TYPE1_PROB_012_oRDR_TRACKER_OBJ_012_oPCAN_RADAR_04556849_Tx: ComBitPosition=303, ComBitSize=8, ComSignalType=UINT8, ComSystemTemplateSystemSignalRef=OBJ_CLS_TYPE1_PROB_012
            OBJ_CLS_TYPE2_012_oRDR_TRACKER_OBJ_012_oPCAN_RADAR_e1e5bfdd_Tx: ComBitPosition=267, ComBitSize=4, ComSignalType=UINT8, ComSystemTemplateSystemSignalRef=OBJ_CLS_TYPE2_012
            OBJ_CLS_TYPE2_PROB_012_oRDR_TRACKER_OBJ_012_oPCAN_RADAR_cd617344_Tx: ComBitPosition=311, ComBitSize=8, ComSignalType=UINT8, ComSystemTemplateSystemSignalRef=OBJ_CLS_TYPE2_PROB_012
            OBJ_CLS_TYPE3_012_oRDR_TRACKER_OBJ_012_oPCAN_RADAR_6c6d423f_Tx: ComBitPosition=279, ComBitSize=4, ComSignalType=UINT8, ComSystemTemplateSystemSignalRef=OBJ_CLS_TYPE3_012
            OBJ_CLS_TYPE3_PROB_012_oRDR_TRACKER_OBJ_012_oPCAN_RADAR_8a7285bf_Tx: ComBitPosition=319, ComBitSize=8, ComSignalType=UINT8, ComSystemTemplateSystemSignalRef=OBJ_CLS_TYPE3_PROB_012
            OBJ_CLS_TYPE4_012_oRDR_TRACKER_OBJ_012_oPCAN_RADAR_7a35bf13_Tx: ComBitPosition=275, ComBitSize=4, ComSignalType=UINT8, ComSystemTemplateSystemSignalRef=OBJ_CLS_TYPE4_012
            OBJ_CLS_TYPE4_PROB_012_oRDR_TRACKER_OBJ_012_oPCAN_RADAR_8478431f_Tx: ComBitPosition=327, ComBitSize=8, ComSignalType=UINT8, ComSystemTemplateSystemSignalRef=OBJ_CLS_TYPE4_PROB_012
            OBJ_CLS_TYPE5_012_oRDR_TRACKER_OBJ_012_oPCAN_RADAR_f7bd42f1_Tx: ComBitPosition=287, ComBitSize=4, ComSignalType=UINT8, ComSystemTemplateSystemSignalRef=OBJ_CLS_TYPE5_012
            OBJ_CLS_TYPE5_PROB_012_oRDR_TRACKER_OBJ_012_oPCAN_RADAR_c36bb5e4_Tx: ComBitPosition=335, ComBitSize=8, ComSignalType=UINT8, ComSystemTemplateSystemSignalRef=OBJ_CLS_TYPE5_PROB_012
            OBJ_CLS_TYPE6_012_oRDR_TRACKER_OBJ_012_oPCAN_RADAR_ba554296_Tx: ComBitPosition=282, ComBitSize=4, ComSignalType=UINT8, ComSystemTemplateSystemSignalRef=OBJ_CLS_TYPE6_012
            OBJ_CLS_TYPE6_PROB_012_oRDR_TRACKER_OBJ_012_oPCAN_RADAR_0a5faee9_Tx: ComBitPosition=343, ComBitSize=8, ComSignalType=UINT8, ComSystemTemplateSystemSignalRef=OBJ_CLS_TYPE6_PROB_012
            OBJ_DIMENSION_LENGTH_012_oRDR_TRACKER_OBJ_012_oPCAN_RADAR_ee93ecfe_Tx: ComBitPosition=37, ComBitSize=12, ComSignalType=UINT16, ComSystemTemplateSystemSignalRef=OBJ_DIMENSION_LENGTH_012
            OBJ_DIMENSION_LENGTH_ERR_012_oRDR_TRACKER_OBJ_012_oPCAN_RADAR_d56bf384_Tx: ComBitPosition=41, ComBitSize=10, ComSignalType=UINT16, ComSystemTemplateSystemSignalRef=OBJ_DIMENSION_LENGTH_ERR_012
            OBJ_DIMENSION_WIDTH_012_oRDR_TRACKER_OBJ_012_oPCAN_RADAR_cd5d1b53_Tx: ComBitPosition=17, ComBitSize=10, ComSignalType=UINT16, ComSystemTemplateSystemSignalRef=OBJ_DIMENSION_WIDTH_012
            OBJ_DIMENSION_WIDTH_ERR_012_oRDR_TRACKER_OBJ_012_oPCAN_RADAR_2dffdcbb_Tx: ComBitPosition=23, ComBitSize=6, ComSignalType=UINT8, ComSystemTemplateSystemSignalRef=OBJ_DIMENSION_WIDTH_ERR_012
            OBJ_EXISTENCE_PROB_012_oRDR_TRACKER_OBJ_012_oPCAN_RADAR_c6e19f6e_Tx: ComBitPosition=229, ComBitSize=14, ComSignalType=UINT16, ComSystemTemplateSystemSignalRef=OBJ_EXISTENCE_PROB_012
            OBJ_GROUP_ID_012_oRDR_TRACKER_OBJ_012_oPCAN_RADAR_4f938bc3_Tx: ComBitPosition=405, ComBitSize=6, ComSignalType=UINT8, ComSystemTemplateSystemSignalRef=OBJ_GROUP_ID_012
            OBJ_ID_012_oRDR_TRACKER_OBJ_012_oPCAN_RADAR_bcbda0c4_Tx: ComBitPosition=7, ComBitSize=8, ComSignalType=UINT8, ComSystemTemplateSystemSignalRef=OBJ_ID_012
            OBJ_MEASUREMENT_STATUS_012_oRDR_TRACKER_OBJ_012_oPCAN_RADAR_c36fd279_Tx: ComBitPosition=14, ComBitSize=3, ComSignalType=UINT8, ComSystemTemplateSystemSignalRef=OBJ_MEASUREMENT_STATUS_012
            OBJ_MH_CRC16_012_oRDR_TRACKER_OBJ_012_oPCAN_RADAR_bf0f6545_Tx: ComBitPosition=495, ComBitSize=16, ComSignalType=UINT16, ComSystemTemplateSystemSignalRef=OBJ_MH_CRC16_012
            OBJ_MH_CYCLE_COUNTER_012_oRDR_TRACKER_OBJ_012_oPCAN_RADAR_ceeb3fa4_Tx: ComBitPosition=487, ComBitSize=8, ComSignalType=UINT8, ComSystemTemplateSystemSignalRef=OBJ_MH_CYCLE_COUNTER_012
            OBJ_MOVEMENT_STATUS_012_oRDR_TRACKER_OBJ_012_oPCAN_RADAR_ecc14735_Tx: ComBitPosition=196, ComBitSize=3, ComSignalType=UINT8, ComSystemTemplateSystemSignalRef=OBJ_MOVEMENT_STATUS_012
            OBJ_POS_ERR_CRR_COEF_012_oRDR_TRACKER_OBJ_012_oPCAN_RADAR_7cbe870f_Tx: ComBitPosition=415, ComBitSize=8, ComSignalType=UINT8, ComSystemTemplateSystemSignalRef=OBJ_POS_ERR_CRR_COEF_012
            OBJ_POS_LAT_012_oRDR_TRACKER_OBJ_012_oPCAN_RADAR_9e117a43_Tx: ComBitPosition=79, ComBitSize=16, ComSignalType=UINT16, ComSystemTemplateSystemSignalRef=OBJ_POS_LAT_012
            OBJ_POS_LAT_ERR_012_oRDR_TRACKER_OBJ_012_oPCAN_RADAR_9a5d2a74_Tx: ComBitPosition=103, ComBitSize=8, ComSignalType=UINT8, ComSystemTemplateSystemSignalRef=OBJ_POS_LAT_ERR_012
            OBJ_POS_LONG_012_oRDR_TRACKER_OBJ_012_oPCAN_RADAR_2fb1918c_Tx: ComBitPosition=63, ComBitSize=16, ComSignalType=UINT16, ComSystemTemplateSystemSignalRef=OBJ_POS_LONG_012
            OBJ_POS_LONG_ERR_012_oRDR_TRACKER_OBJ_012_oPCAN_RADAR_03a5d496_Tx: ComBitPosition=95, ComBitSize=8, ComSignalType=UINT8, ComSystemTemplateSystemSignalRef=OBJ_POS_LONG_ERR_012
            OBJ_RCS_012_oRDR_TRACKER_OBJ_012_oPCAN_RADAR_bcde2c44_Tx: ComBitPosition=351, ComBitSize=7, ComSignalType=UINT8, ComSystemTemplateSystemSignalRef=OBJ_RCS_012
            OBJ_REF_PT_LAT_OFFSET_012_oRDR_TRACKER_OBJ_012_oPCAN_RADAR_49e34731_Tx: ComBitPosition=370, ComBitSize=14, ComSignalType=UINT16, ComSystemTemplateSystemSignalRef=OBJ_REF_PT_LAT_OFFSET_012
            OBJ_REF_PT_LONG_OFFSET_012_oRDR_TRACKER_OBJ_012_oPCAN_RADAR_06b1b732_Tx: ComBitPosition=357, ComBitSize=14, ComSignalType=UINT16, ComSystemTemplateSystemSignalRef=OBJ_REF_PT_LONG_OFFSET_012
            OBJ_TIMESTAMP_OFFSET_012_oRDR_TRACKER_OBJ_012_oPCAN_RADAR_bc722c12_Tx: ComBitPosition=247, ComBitSize=8, ComSignalType=UINT8, ComSystemTemplateSystemSignalRef=OBJ_TIMESTAMP_OFFSET_012
            OBJ_TRACK_MOTION_MODEL_012_oRDR_TRACKER_OBJ_012_oPCAN_RADAR_70712dcf_Tx: ComBitPosition=9, ComBitSize=2, ComSignalType=UINT8, ComSystemTemplateSystemSignalRef=OBJ_TRACK_MOTION_MODEL_012
            OBJ_VEH_TRACK_FLAG_012_oRDR_TRACKER_OBJ_012_oPCAN_RADAR_f25bdb92_Tx: ComBitPosition=10, ComBitSize=1, ComSignalType=BOOLEAN, ComSystemTemplateSystemSignalRef=OBJ_VEH_TRACK_FLAG_012
            OBJ_VELOCITY_ERR_CRR_COEF_012_oRDR_TRACKER_OBJ_012_oPCAN_RADAR_d5c4baee_Tx: ComBitPosition=423, ComBitSize=8, ComSignalType=UINT8, ComSystemTemplateSystemSignalRef=OBJ_VELOCITY_ERR_CRR_COEF_012
            OBJ_VELOCITY_LAT_012_oRDR_TRACKER_OBJ_012_oPCAN_RADAR_da723f64_Tx: ComBitPosition=126, ComBitSize=15, ComSignalType=UINT16, ComSystemTemplateSystemSignalRef=OBJ_VELOCITY_LAT_012
            OBJ_VELOCITY_LAT_ERR_012_oRDR_TRACKER_OBJ_012_oPCAN_RADAR_ee884f35_Tx: ComBitPosition=151, ComBitSize=8, ComSignalType=UINT8, ComSystemTemplateSystemSignalRef=OBJ_VELOCITY_LAT_ERR_012
            OBJ_VELOCITY_LONG_012_oRDR_TRACKER_OBJ_012_oPCAN_RADAR_8aff47a2_Tx: ComBitPosition=110, ComBitSize=15, ComSignalType=UINT16, ComSystemTemplateSystemSignalRef=OBJ_VELOCITY_LONG_012
            OBJ_VELOCITY_LONG_ERR_012_oRDR_TRACKER_OBJ_012_oPCAN_RADAR_020a70f5_Tx: ComBitPosition=143, ComBitSize=8, ComSignalType=UINT8, ComSystemTemplateSystemSignalRef=OBJ_VELOCITY_LONG_ERR_012
            OBJ_YAW_ANGLE_012_oRDR_TRACKER_OBJ_012_oPCAN_RADAR_36ce7b24_Tx: ComBitPosition=155, ComBitSize=12, ComSignalType=UINT16, ComSystemTemplateSystemSignalRef=OBJ_YAW_ANGLE_012
            OBJ_YAW_ANGLE_ERR_012_oRDR_TRACKER_OBJ_012_oPCAN_RADAR_e3c37df3_Tx: ComBitPosition=175, ComBitSize=7, ComSignalType=UINT8, ComSystemTemplateSystemSignalRef=OBJ_YAW_ANGLE_ERR_012
            OBJ_YAW_RATE_012_oRDR_TRACKER_OBJ_012_oPCAN_RADAR_13415e63_Tx: ComBitPosition=399, ComBitSize=10, ComSignalType=UINT16, ComSystemTemplateSystemSignalRef=OBJ_YAW_RATE_012
            OBJ_YAW_RATE_ERR_012_oRDR_TRACKER_OBJ_012_oPCAN_RADAR_2c99c9bf_Tx: ComBitPosition=388, ComBitSize=5, ComSignalType=UINT8, ComSystemTemplateSystemSignalRef=OBJ_YAW_RATE_ERR_012
        SG_TrackerObject013_oRDR_TRACKER_OBJ_013_oPCAN_RADAR_de779f04_Tx: ComSystemTemplateSignalGroupRef=SG_TrackerObject013
          49 x ComGroupSignal, all with ComSignalEndianness=BIG_ENDIAN, ComSignalInitValue=0, ComTransferProperty=PENDING:
            OBJ_ACCELERATION_LAT_013_oRDR_TRACKER_OBJ_013_oPCAN_RADAR_d053c473_Tx: ComBitPosition=177, ComBitSize=10, ComSignalType=UINT16, ComSystemTemplateSystemSignalRef=OBJ_ACCELERATION_LAT_013
            OBJ_ACCELERATION_LAT_ERR_013_oRDR_TRACKER_OBJ_013_oPCAN_RADAR_05a7fecd_Tx: ComBitPosition=223, ComBitSize=8, ComSignalType=UINT8, ComSystemTemplateSystemSignalRef=OBJ_ACCELERATION_LAT_ERR_013
            OBJ_ACCELERATION_LONG_013_oRDR_TRACKER_OBJ_013_oPCAN_RADAR_a2a39d93_Tx: ComBitPosition=193, ComBitSize=10, ComSignalType=UINT16, ComSystemTemplateSystemSignalRef=OBJ_ACCELERATION_LONG_013
            OBJ_ACCELERATION_LONG_ERR_013_oRDR_TRACKER_OBJ_013_oPCAN_RADAR_1a025b67_Tx: ComBitPosition=215, ComBitSize=8, ComSignalType=UINT8, ComSystemTemplateSystemSignalRef=OBJ_ACCELERATION_LONG_ERR_013
            OBJ_ACCEL_ERR_CRR_COEF_013_oRDR_TRACKER_OBJ_013_oPCAN_RADAR_baa17a01_Tx: ComBitPosition=431, ComBitSize=8, ComSignalType=UINT8, ComSystemTemplateSystemSignalRef=OBJ_ACCEL_ERR_CRR_COEF_013
            OBJ_ALIVE_TIME_013_oRDR_TRACKER_OBJ_013_oPCAN_RADAR_c2c2d62f_Tx: ComBitPosition=255, ComBitSize=16, ComSignalType=UINT16, ComSystemTemplateSystemSignalRef=OBJ_ALIVE_TIME_013
            OBJ_CLS_TYPE1_013_oRDR_TRACKER_OBJ_013_oPCAN_RADAR_55193709_Tx: ComBitPosition=271, ComBitSize=4, ComSignalType=UINT8, ComSystemTemplateSystemSignalRef=OBJ_CLS_TYPE1_013
            OBJ_CLS_TYPE1_PROB_013_oRDR_TRACKER_OBJ_013_oPCAN_RADAR_fd41e0fa_Tx: ComBitPosition=303, ComBitSize=8, ComSignalType=UINT8, ComSystemTemplateSystemSignalRef=OBJ_CLS_TYPE1_PROB_013
            OBJ_CLS_TYPE2_013_oRDR_TRACKER_OBJ_013_oPCAN_RADAR_18f1376e_Tx: ComBitPosition=267, ComBitSize=4, ComSignalType=UINT8, ComSystemTemplateSystemSignalRef=OBJ_CLS_TYPE2_013
            OBJ_CLS_TYPE2_PROB_013_oRDR_TRACKER_OBJ_013_oPCAN_RADAR_3475fbf7_Tx: ComBitPosition=311, ComBitSize=8, ComSignalType=UINT8, ComSystemTemplateSystemSignalRef=OBJ_CLS_TYPE2_PROB_013
            OBJ_CLS_TYPE3_013_oRDR_TRACKER_OBJ_013_oPCAN_RADAR_9579ca8c_Tx: ComBitPosition=279, ComBitSize=4, ComSignalType=UINT8, ComSystemTemplateSystemSignalRef=OBJ_CLS_TYPE3_013
            OBJ_CLS_TYPE3_PROB_013_oRDR_TRACKER_OBJ_013_oPCAN_RADAR_73660d0c_Tx: ComBitPosition=319, ComBitSize=8, ComSignalType=UINT8, ComSystemTemplateSystemSignalRef=OBJ_CLS_TYPE3_PROB_013
            OBJ_CLS_TYPE4_013_oRDR_TRACKER_OBJ_013_oPCAN_RADAR_832137a0_Tx: ComBitPosition=275, ComBitSize=4, ComSignalType=UINT8, ComSystemTemplateSystemSignalRef=OBJ_CLS_TYPE4_013
            OBJ_CLS_TYPE4_PROB_013_oRDR_TRACKER_OBJ_013_oPCAN_RADAR_7d6ccbac_Tx: ComBitPosition=327, ComBitSize=8, ComSignalType=UINT8, ComSystemTemplateSystemSignalRef=OBJ_CLS_TYPE4_PROB_013
            OBJ_CLS_TYPE5_013_oRDR_TRACKER_OBJ_013_oPCAN_RADAR_0ea9ca42_Tx: ComBitPosition=287, ComBitSize=4, ComSignalType=UINT8, ComSystemTemplateSystemSignalRef=OBJ_CLS_TYPE5_013
            OBJ_CLS_TYPE5_PROB_013_oRDR_TRACKER_OBJ_013_oPCAN_RADAR_3a7f3d57_Tx: ComBitPosition=335, ComBitSize=8, ComSignalType=UINT8, ComSystemTemplateSystemSignalRef=OBJ_CLS_TYPE5_PROB_013
            OBJ_CLS_TYPE6_013_oRDR_TRACKER_OBJ_013_oPCAN_RADAR_4341ca25_Tx: ComBitPosition=282, ComBitSize=4, ComSignalType=UINT8, ComSystemTemplateSystemSignalRef=OBJ_CLS_TYPE6_013
            OBJ_CLS_TYPE6_PROB_013_oRDR_TRACKER_OBJ_013_oPCAN_RADAR_f34b265a_Tx: ComBitPosition=343, ComBitSize=8, ComSignalType=UINT8, ComSystemTemplateSystemSignalRef=OBJ_CLS_TYPE6_PROB_013
            OBJ_DIMENSION_LENGTH_013_oRDR_TRACKER_OBJ_013_oPCAN_RADAR_1787644d_Tx: ComBitPosition=37, ComBitSize=12, ComSignalType=UINT16, ComSystemTemplateSystemSignalRef=OBJ_DIMENSION_LENGTH_013
            OBJ_DIMENSION_LENGTH_ERR_013_oRDR_TRACKER_OBJ_013_oPCAN_RADAR_2c7f7b37_Tx: ComBitPosition=41, ComBitSize=10, ComSignalType=UINT16, ComSystemTemplateSystemSignalRef=OBJ_DIMENSION_LENGTH_ERR_013
            OBJ_DIMENSION_WIDTH_013_oRDR_TRACKER_OBJ_013_oPCAN_RADAR_344993e0_Tx: ComBitPosition=17, ComBitSize=10, ComSignalType=UINT16, ComSystemTemplateSystemSignalRef=OBJ_DIMENSION_WIDTH_013
            OBJ_DIMENSION_WIDTH_ERR_013_oRDR_TRACKER_OBJ_013_oPCAN_RADAR_d4eb5408_Tx: ComBitPosition=23, ComBitSize=6, ComSignalType=UINT8, ComSystemTemplateSystemSignalRef=OBJ_DIMENSION_WIDTH_ERR_013
            OBJ_EXISTENCE_PROB_013_oRDR_TRACKER_OBJ_013_oPCAN_RADAR_3ff517dd_Tx: ComBitPosition=229, ComBitSize=14, ComSignalType=UINT16, ComSystemTemplateSystemSignalRef=OBJ_EXISTENCE_PROB_013
            OBJ_GROUP_ID_013_oRDR_TRACKER_OBJ_013_oPCAN_RADAR_b6870370_Tx: ComBitPosition=405, ComBitSize=6, ComSignalType=UINT8, ComSystemTemplateSystemSignalRef=OBJ_GROUP_ID_013
            OBJ_ID_013_oRDR_TRACKER_OBJ_013_oPCAN_RADAR_45a92877_Tx: ComBitPosition=7, ComBitSize=8, ComSignalType=UINT8, ComSystemTemplateSystemSignalRef=OBJ_ID_013
            OBJ_MEASUREMENT_STATUS_013_oRDR_TRACKER_OBJ_013_oPCAN_RADAR_3a7b5aca_Tx: ComBitPosition=14, ComBitSize=3, ComSignalType=UINT8, ComSystemTemplateSystemSignalRef=OBJ_MEASUREMENT_STATUS_013
            OBJ_MH_CRC16_013_oRDR_TRACKER_OBJ_013_oPCAN_RADAR_461bedf6_Tx: ComBitPosition=495, ComBitSize=16, ComSignalType=UINT16, ComSystemTemplateSystemSignalRef=OBJ_MH_CRC16_013
            OBJ_MH_CYCLE_COUNTER_013_oRDR_TRACKER_OBJ_013_oPCAN_RADAR_37ffb717_Tx: ComBitPosition=487, ComBitSize=8, ComSignalType=UINT8, ComSystemTemplateSystemSignalRef=OBJ_MH_CYCLE_COUNTER_013
            OBJ_MOVEMENT_STATUS_013_oRDR_TRACKER_OBJ_013_oPCAN_RADAR_15d5cf86_Tx: ComBitPosition=196, ComBitSize=3, ComSignalType=UINT8, ComSystemTemplateSystemSignalRef=OBJ_MOVEMENT_STATUS_013
            OBJ_POS_ERR_CRR_COEF_013_oRDR_TRACKER_OBJ_013_oPCAN_RADAR_85aa0fbc_Tx: ComBitPosition=415, ComBitSize=8, ComSignalType=UINT8, ComSystemTemplateSystemSignalRef=OBJ_POS_ERR_CRR_COEF_013
            OBJ_POS_LAT_013_oRDR_TRACKER_OBJ_013_oPCAN_RADAR_6705f2f0_Tx: ComBitPosition=79, ComBitSize=16, ComSignalType=UINT16, ComSystemTemplateSystemSignalRef=OBJ_POS_LAT_013
            OBJ_POS_LAT_ERR_013_oRDR_TRACKER_OBJ_013_oPCAN_RADAR_6349a2c7_Tx: ComBitPosition=103, ComBitSize=8, ComSignalType=UINT8, ComSystemTemplateSystemSignalRef=OBJ_POS_LAT_ERR_013
            OBJ_POS_LONG_013_oRDR_TRACKER_OBJ_013_oPCAN_RADAR_d6a5193f_Tx: ComBitPosition=63, ComBitSize=16, ComSignalType=UINT16, ComSystemTemplateSystemSignalRef=OBJ_POS_LONG_013
            OBJ_POS_LONG_ERR_013_oRDR_TRACKER_OBJ_013_oPCAN_RADAR_fab15c25_Tx: ComBitPosition=95, ComBitSize=8, ComSignalType=UINT8, ComSystemTemplateSystemSignalRef=OBJ_POS_LONG_ERR_013
            OBJ_RCS_013_oRDR_TRACKER_OBJ_013_oPCAN_RADAR_45caa4f7_Tx: ComBitPosition=351, ComBitSize=7, ComSignalType=UINT8, ComSystemTemplateSystemSignalRef=OBJ_RCS_013
            OBJ_REF_PT_LAT_OFFSET_013_oRDR_TRACKER_OBJ_013_oPCAN_RADAR_b0f7cf82_Tx: ComBitPosition=370, ComBitSize=14, ComSignalType=UINT16, ComSystemTemplateSystemSignalRef=OBJ_REF_PT_LAT_OFFSET_013
            OBJ_REF_PT_LONG_OFFSET_013_oRDR_TRACKER_OBJ_013_oPCAN_RADAR_ffa53f81_Tx: ComBitPosition=357, ComBitSize=14, ComSignalType=UINT16, ComSystemTemplateSystemSignalRef=OBJ_REF_PT_LONG_OFFSET_013
            OBJ_TIMESTAMP_OFFSET_013_oRDR_TRACKER_OBJ_013_oPCAN_RADAR_4566a4a1_Tx: ComBitPosition=247, ComBitSize=8, ComSignalType=UINT8, ComSystemTemplateSystemSignalRef=OBJ_TIMESTAMP_OFFSET_013
            OBJ_TRACK_MOTION_MODEL_013_oRDR_TRACKER_OBJ_013_oPCAN_RADAR_8965a57c_Tx: ComBitPosition=9, ComBitSize=2, ComSignalType=UINT8, ComSystemTemplateSystemSignalRef=OBJ_TRACK_MOTION_MODEL_013
            OBJ_VEH_TRACK_FLAG_013_oRDR_TRACKER_OBJ_013_oPCAN_RADAR_0b4f5321_Tx: ComBitPosition=10, ComBitSize=1, ComSignalType=BOOLEAN, ComSystemTemplateSystemSignalRef=OBJ_VEH_TRACK_FLAG_013
            OBJ_VELOCITY_ERR_CRR_COEF_013_oRDR_TRACKER_OBJ_013_oPCAN_RADAR_2cd0325d_Tx: ComBitPosition=423, ComBitSize=8, ComSignalType=UINT8, ComSystemTemplateSystemSignalRef=OBJ_VELOCITY_ERR_CRR_COEF_013
            OBJ_VELOCITY_LAT_013_oRDR_TRACKER_OBJ_013_oPCAN_RADAR_2366b7d7_Tx: ComBitPosition=126, ComBitSize=15, ComSignalType=UINT16, ComSystemTemplateSystemSignalRef=OBJ_VELOCITY_LAT_013
            OBJ_VELOCITY_LAT_ERR_013_oRDR_TRACKER_OBJ_013_oPCAN_RADAR_179cc786_Tx: ComBitPosition=151, ComBitSize=8, ComSignalType=UINT8, ComSystemTemplateSystemSignalRef=OBJ_VELOCITY_LAT_ERR_013
            OBJ_VELOCITY_LONG_013_oRDR_TRACKER_OBJ_013_oPCAN_RADAR_73ebcf11_Tx: ComBitPosition=110, ComBitSize=15, ComSignalType=UINT16, ComSystemTemplateSystemSignalRef=OBJ_VELOCITY_LONG_013
            OBJ_VELOCITY_LONG_ERR_013_oRDR_TRACKER_OBJ_013_oPCAN_RADAR_fb1ef846_Tx: ComBitPosition=143, ComBitSize=8, ComSignalType=UINT8, ComSystemTemplateSystemSignalRef=OBJ_VELOCITY_LONG_ERR_013
            OBJ_YAW_ANGLE_013_oRDR_TRACKER_OBJ_013_oPCAN_RADAR_cfdaf397_Tx: ComBitPosition=155, ComBitSize=12, ComSignalType=UINT16, ComSystemTemplateSystemSignalRef=OBJ_YAW_ANGLE_013
            OBJ_YAW_ANGLE_ERR_013_oRDR_TRACKER_OBJ_013_oPCAN_RADAR_1ad7f540_Tx: ComBitPosition=175, ComBitSize=7, ComSignalType=UINT8, ComSystemTemplateSystemSignalRef=OBJ_YAW_ANGLE_ERR_013
            OBJ_YAW_RATE_013_oRDR_TRACKER_OBJ_013_oPCAN_RADAR_ea55d6d0_Tx: ComBitPosition=399, ComBitSize=10, ComSignalType=UINT16, ComSystemTemplateSystemSignalRef=OBJ_YAW_RATE_013
            OBJ_YAW_RATE_ERR_013_oRDR_TRACKER_OBJ_013_oPCAN_RADAR_d58d410c_Tx: ComBitPosition=388, ComBitSize=5, ComSignalType=UINT8, ComSystemTemplateSystemSignalRef=OBJ_YAW_RATE_ERR_013
        SG_TrackerObject014_oRDR_TRACKER_OBJ_014_oPCAN_RADAR_5c8b2ede_Tx: ComSystemTemplateSignalGroupRef=SG_TrackerObject014
          49 x ComGroupSignal, all with ComSignalEndianness=BIG_ENDIAN, ComSignalInitValue=0, ComTransferProperty=PENDING:
            OBJ_ACCELERATION_LAT_014_oRDR_TRACKER_OBJ_014_oPCAN_RADAR_52af75a9_Tx: ComBitPosition=177, ComBitSize=10, ComSignalType=UINT16, ComSystemTemplateSystemSignalRef=OBJ_ACCELERATION_LAT_014
            OBJ_ACCELERATION_LAT_ERR_014_oRDR_TRACKER_OBJ_014_oPCAN_RADAR_875b4f17_Tx: ComBitPosition=223, ComBitSize=8, ComSignalType=UINT8, ComSystemTemplateSystemSignalRef=OBJ_ACCELERATION_LAT_ERR_014
            OBJ_ACCELERATION_LONG_014_oRDR_TRACKER_OBJ_014_oPCAN_RADAR_205f2c49_Tx: ComBitPosition=193, ComBitSize=10, ComSignalType=UINT16, ComSystemTemplateSystemSignalRef=OBJ_ACCELERATION_LONG_014
            OBJ_ACCELERATION_LONG_ERR_014_oRDR_TRACKER_OBJ_014_oPCAN_RADAR_98feeabd_Tx: ComBitPosition=215, ComBitSize=8, ComSignalType=UINT8, ComSystemTemplateSystemSignalRef=OBJ_ACCELERATION_LONG_ERR_014
            OBJ_ACCEL_ERR_CRR_COEF_014_oRDR_TRACKER_OBJ_014_oPCAN_RADAR_385dcbdb_Tx: ComBitPosition=431, ComBitSize=8, ComSignalType=UINT8, ComSystemTemplateSystemSignalRef=OBJ_ACCEL_ERR_CRR_COEF_014
            OBJ_ALIVE_TIME_014_oRDR_TRACKER_OBJ_014_oPCAN_RADAR_403e67f5_Tx: ComBitPosition=255, ComBitSize=16, ComSignalType=UINT16, ComSystemTemplateSystemSignalRef=OBJ_ALIVE_TIME_014
            OBJ_CLS_TYPE1_014_oRDR_TRACKER_OBJ_014_oPCAN_RADAR_d7e586d3_Tx: ComBitPosition=271, ComBitSize=4, ComSignalType=UINT8, ComSystemTemplateSystemSignalRef=OBJ_CLS_TYPE1_014
            OBJ_CLS_TYPE1_PROB_014_oRDR_TRACKER_OBJ_014_oPCAN_RADAR_7fbd5120_Tx: ComBitPosition=303, ComBitSize=8, ComSignalType=UINT8, ComSystemTemplateSystemSignalRef=OBJ_CLS_TYPE1_PROB_014
            OBJ_CLS_TYPE2_014_oRDR_TRACKER_OBJ_014_oPCAN_RADAR_9a0d86b4_Tx: ComBitPosition=267, ComBitSize=4, ComSignalType=UINT8, ComSystemTemplateSystemSignalRef=OBJ_CLS_TYPE2_014
            OBJ_CLS_TYPE2_PROB_014_oRDR_TRACKER_OBJ_014_oPCAN_RADAR_b6894a2d_Tx: ComBitPosition=311, ComBitSize=8, ComSignalType=UINT8, ComSystemTemplateSystemSignalRef=OBJ_CLS_TYPE2_PROB_014
            OBJ_CLS_TYPE3_014_oRDR_TRACKER_OBJ_014_oPCAN_RADAR_17857b56_Tx: ComBitPosition=279, ComBitSize=4, ComSignalType=UINT8, ComSystemTemplateSystemSignalRef=OBJ_CLS_TYPE3_014
            OBJ_CLS_TYPE3_PROB_014_oRDR_TRACKER_OBJ_014_oPCAN_RADAR_f19abcd6_Tx: ComBitPosition=319, ComBitSize=8, ComSignalType=UINT8, ComSystemTemplateSystemSignalRef=OBJ_CLS_TYPE3_PROB_014
            OBJ_CLS_TYPE4_014_oRDR_TRACKER_OBJ_014_oPCAN_RADAR_01dd867a_Tx: ComBitPosition=275, ComBitSize=4, ComSignalType=UINT8, ComSystemTemplateSystemSignalRef=OBJ_CLS_TYPE4_014
            OBJ_CLS_TYPE4_PROB_014_oRDR_TRACKER_OBJ_014_oPCAN_RADAR_ff907a76_Tx: ComBitPosition=327, ComBitSize=8, ComSignalType=UINT8, ComSystemTemplateSystemSignalRef=OBJ_CLS_TYPE4_PROB_014
            OBJ_CLS_TYPE5_014_oRDR_TRACKER_OBJ_014_oPCAN_RADAR_8c557b98_Tx: ComBitPosition=287, ComBitSize=4, ComSignalType=UINT8, ComSystemTemplateSystemSignalRef=OBJ_CLS_TYPE5_014
            OBJ_CLS_TYPE5_PROB_014_oRDR_TRACKER_OBJ_014_oPCAN_RADAR_b8838c8d_Tx: ComBitPosition=335, ComBitSize=8, ComSignalType=UINT8, ComSystemTemplateSystemSignalRef=OBJ_CLS_TYPE5_PROB_014
            OBJ_CLS_TYPE6_014_oRDR_TRACKER_OBJ_014_oPCAN_RADAR_c1bd7bff_Tx: ComBitPosition=282, ComBitSize=4, ComSignalType=UINT8, ComSystemTemplateSystemSignalRef=OBJ_CLS_TYPE6_014
            OBJ_CLS_TYPE6_PROB_014_oRDR_TRACKER_OBJ_014_oPCAN_RADAR_71b79780_Tx: ComBitPosition=343, ComBitSize=8, ComSignalType=UINT8, ComSystemTemplateSystemSignalRef=OBJ_CLS_TYPE6_PROB_014
            OBJ_DIMENSION_LENGTH_014_oRDR_TRACKER_OBJ_014_oPCAN_RADAR_957bd597_Tx: ComBitPosition=37, ComBitSize=12, ComSignalType=UINT16, ComSystemTemplateSystemSignalRef=OBJ_DIMENSION_LENGTH_014
            OBJ_DIMENSION_LENGTH_ERR_014_oRDR_TRACKER_OBJ_014_oPCAN_RADAR_ae83caed_Tx: ComBitPosition=41, ComBitSize=10, ComSignalType=UINT16, ComSystemTemplateSystemSignalRef=OBJ_DIMENSION_LENGTH_ERR_014
            OBJ_DIMENSION_WIDTH_014_oRDR_TRACKER_OBJ_014_oPCAN_RADAR_b6b5223a_Tx: ComBitPosition=17, ComBitSize=10, ComSignalType=UINT16, ComSystemTemplateSystemSignalRef=OBJ_DIMENSION_WIDTH_014
            OBJ_DIMENSION_WIDTH_ERR_014_oRDR_TRACKER_OBJ_014_oPCAN_RADAR_5617e5d2_Tx: ComBitPosition=23, ComBitSize=6, ComSignalType=UINT8, ComSystemTemplateSystemSignalRef=OBJ_DIMENSION_WIDTH_ERR_014
            OBJ_EXISTENCE_PROB_014_oRDR_TRACKER_OBJ_014_oPCAN_RADAR_bd09a607_Tx: ComBitPosition=229, ComBitSize=14, ComSignalType=UINT16, ComSystemTemplateSystemSignalRef=OBJ_EXISTENCE_PROB_014
            OBJ_GROUP_ID_014_oRDR_TRACKER_OBJ_014_oPCAN_RADAR_347bb2aa_Tx: ComBitPosition=405, ComBitSize=6, ComSignalType=UINT8, ComSystemTemplateSystemSignalRef=OBJ_GROUP_ID_014
            OBJ_ID_014_oRDR_TRACKER_OBJ_014_oPCAN_RADAR_c75599ad_Tx: ComBitPosition=7, ComBitSize=8, ComSignalType=UINT8, ComSystemTemplateSystemSignalRef=OBJ_ID_014
            OBJ_MEASUREMENT_STATUS_014_oRDR_TRACKER_OBJ_014_oPCAN_RADAR_b887eb10_Tx: ComBitPosition=14, ComBitSize=3, ComSignalType=UINT8, ComSystemTemplateSystemSignalRef=OBJ_MEASUREMENT_STATUS_014
            OBJ_MH_CRC16_014_oRDR_TRACKER_OBJ_014_oPCAN_RADAR_c4e75c2c_Tx: ComBitPosition=495, ComBitSize=16, ComSignalType=UINT16, ComSystemTemplateSystemSignalRef=OBJ_MH_CRC16_014
            OBJ_MH_CYCLE_COUNTER_014_oRDR_TRACKER_OBJ_014_oPCAN_RADAR_b50306cd_Tx: ComBitPosition=487, ComBitSize=8, ComSignalType=UINT8, ComSystemTemplateSystemSignalRef=OBJ_MH_CYCLE_COUNTER_014
            OBJ_MOVEMENT_STATUS_014_oRDR_TRACKER_OBJ_014_oPCAN_RADAR_97297e5c_Tx: ComBitPosition=196, ComBitSize=3, ComSignalType=UINT8, ComSystemTemplateSystemSignalRef=OBJ_MOVEMENT_STATUS_014
            OBJ_POS_ERR_CRR_COEF_014_oRDR_TRACKER_OBJ_014_oPCAN_RADAR_0756be66_Tx: ComBitPosition=415, ComBitSize=8, ComSignalType=UINT8, ComSystemTemplateSystemSignalRef=OBJ_POS_ERR_CRR_COEF_014
            OBJ_POS_LAT_014_oRDR_TRACKER_OBJ_014_oPCAN_RADAR_e5f9432a_Tx: ComBitPosition=79, ComBitSize=16, ComSignalType=UINT16, ComSystemTemplateSystemSignalRef=OBJ_POS_LAT_014
            OBJ_POS_LAT_ERR_014_oRDR_TRACKER_OBJ_014_oPCAN_RADAR_e1b5131d_Tx: ComBitPosition=103, ComBitSize=8, ComSignalType=UINT8, ComSystemTemplateSystemSignalRef=OBJ_POS_LAT_ERR_014
            OBJ_POS_LONG_014_oRDR_TRACKER_OBJ_014_oPCAN_RADAR_5459a8e5_Tx: ComBitPosition=63, ComBitSize=16, ComSignalType=UINT16, ComSystemTemplateSystemSignalRef=OBJ_POS_LONG_014
            OBJ_POS_LONG_ERR_014_oRDR_TRACKER_OBJ_014_oPCAN_RADAR_784dedff_Tx: ComBitPosition=95, ComBitSize=8, ComSignalType=UINT8, ComSystemTemplateSystemSignalRef=OBJ_POS_LONG_ERR_014
            OBJ_RCS_014_oRDR_TRACKER_OBJ_014_oPCAN_RADAR_c736152d_Tx: ComBitPosition=351, ComBitSize=7, ComSignalType=UINT8, ComSystemTemplateSystemSignalRef=OBJ_RCS_014
            OBJ_REF_PT_LAT_OFFSET_014_oRDR_TRACKER_OBJ_014_oPCAN_RADAR_320b7e58_Tx: ComBitPosition=370, ComBitSize=14, ComSignalType=UINT16, ComSystemTemplateSystemSignalRef=OBJ_REF_PT_LAT_OFFSET_014
            OBJ_REF_PT_LONG_OFFSET_014_oRDR_TRACKER_OBJ_014_oPCAN_RADAR_7d598e5b_Tx: ComBitPosition=357, ComBitSize=14, ComSignalType=UINT16, ComSystemTemplateSystemSignalRef=OBJ_REF_PT_LONG_OFFSET_014
            OBJ_TIMESTAMP_OFFSET_014_oRDR_TRACKER_OBJ_014_oPCAN_RADAR_c79a157b_Tx: ComBitPosition=247, ComBitSize=8, ComSignalType=UINT8, ComSystemTemplateSystemSignalRef=OBJ_TIMESTAMP_OFFSET_014
            OBJ_TRACK_MOTION_MODEL_014_oRDR_TRACKER_OBJ_014_oPCAN_RADAR_0b9914a6_Tx: ComBitPosition=9, ComBitSize=2, ComSignalType=UINT8, ComSystemTemplateSystemSignalRef=OBJ_TRACK_MOTION_MODEL_014
            OBJ_VEH_TRACK_FLAG_014_oRDR_TRACKER_OBJ_014_oPCAN_RADAR_89b3e2fb_Tx: ComBitPosition=10, ComBitSize=1, ComSignalType=BOOLEAN, ComSystemTemplateSystemSignalRef=OBJ_VEH_TRACK_FLAG_014
            OBJ_VELOCITY_ERR_CRR_COEF_014_oRDR_TRACKER_OBJ_014_oPCAN_RADAR_ae2c8387_Tx: ComBitPosition=423, ComBitSize=8, ComSignalType=UINT8, ComSystemTemplateSystemSignalRef=OBJ_VELOCITY_ERR_CRR_COEF_014
            OBJ_VELOCITY_LAT_014_oRDR_TRACKER_OBJ_014_oPCAN_RADAR_a19a060d_Tx: ComBitPosition=126, ComBitSize=15, ComSignalType=UINT16, ComSystemTemplateSystemSignalRef=OBJ_VELOCITY_LAT_014
            OBJ_VELOCITY_LAT_ERR_014_oRDR_TRACKER_OBJ_014_oPCAN_RADAR_9560765c_Tx: ComBitPosition=151, ComBitSize=8, ComSignalType=UINT8, ComSystemTemplateSystemSignalRef=OBJ_VELOCITY_LAT_ERR_014
            OBJ_VELOCITY_LONG_014_oRDR_TRACKER_OBJ_014_oPCAN_RADAR_f1177ecb_Tx: ComBitPosition=110, ComBitSize=15, ComSignalType=UINT16, ComSystemTemplateSystemSignalRef=OBJ_VELOCITY_LONG_014
            OBJ_VELOCITY_LONG_ERR_014_oRDR_TRACKER_OBJ_014_oPCAN_RADAR_79e2499c_Tx: ComBitPosition=143, ComBitSize=8, ComSignalType=UINT8, ComSystemTemplateSystemSignalRef=OBJ_VELOCITY_LONG_ERR_014
            OBJ_YAW_ANGLE_014_oRDR_TRACKER_OBJ_014_oPCAN_RADAR_4d26424d_Tx: ComBitPosition=155, ComBitSize=12, ComSignalType=UINT16, ComSystemTemplateSystemSignalRef=OBJ_YAW_ANGLE_014
            OBJ_YAW_ANGLE_ERR_014_oRDR_TRACKER_OBJ_014_oPCAN_RADAR_982b449a_Tx: ComBitPosition=175, ComBitSize=7, ComSignalType=UINT8, ComSystemTemplateSystemSignalRef=OBJ_YAW_ANGLE_ERR_014
            OBJ_YAW_RATE_014_oRDR_TRACKER_OBJ_014_oPCAN_RADAR_68a9670a_Tx: ComBitPosition=399, ComBitSize=10, ComSignalType=UINT16, ComSystemTemplateSystemSignalRef=OBJ_YAW_RATE_014
            OBJ_YAW_RATE_ERR_014_oRDR_TRACKER_OBJ_014_oPCAN_RADAR_5771f0d6_Tx: ComBitPosition=388, ComBitSize=5, ComSignalType=UINT8, ComSystemTemplateSystemSignalRef=OBJ_YAW_RATE_ERR_014
        SG_TrackerObject015_oRDR_TRACKER_OBJ_015_oPCAN_RADAR_a59fa66d_Tx: ComSystemTemplateSignalGroupRef=SG_TrackerObject015
          49 x ComGroupSignal, all with ComSignalEndianness=BIG_ENDIAN, ComSignalInitValue=0, ComTransferProperty=PENDING:
            OBJ_ACCELERATION_LAT_015_oRDR_TRACKER_OBJ_015_oPCAN_RADAR_abbbfd1a_Tx: ComBitPosition=177, ComBitSize=10, ComSignalType=UINT16, ComSystemTemplateSystemSignalRef=OBJ_ACCELERATION_LAT_015
            OBJ_ACCELERATION_LAT_ERR_015_oRDR_TRACKER_OBJ_015_oPCAN_RADAR_7e4fc7a4_Tx: ComBitPosition=223, ComBitSize=8, ComSignalType=UINT8, ComSystemTemplateSystemSignalRef=OBJ_ACCELERATION_LAT_ERR_015
            OBJ_ACCELERATION_LONG_015_oRDR_TRACKER_OBJ_015_oPCAN_RADAR_d94ba4fa_Tx: ComBitPosition=193, ComBitSize=10, ComSignalType=UINT16, ComSystemTemplateSystemSignalRef=OBJ_ACCELERATION_LONG_015
            OBJ_ACCELERATION_LONG_ERR_015_oRDR_TRACKER_OBJ_015_oPCAN_RADAR_61ea620e_Tx: ComBitPosition=215, ComBitSize=8, ComSignalType=UINT8, ComSystemTemplateSystemSignalRef=OBJ_ACCELERATION_LONG_ERR_015
            OBJ_ACCEL_ERR_CRR_COEF_015_oRDR_TRACKER_OBJ_015_oPCAN_RADAR_c1494368_Tx: ComBitPosition=431, ComBitSize=8, ComSignalType=UINT8, ComSystemTemplateSystemSignalRef=OBJ_ACCEL_ERR_CRR_COEF_015
            OBJ_ALIVE_TIME_015_oRDR_TRACKER_OBJ_015_oPCAN_RADAR_b92aef46_Tx: ComBitPosition=255, ComBitSize=16, ComSignalType=UINT16, ComSystemTemplateSystemSignalRef=OBJ_ALIVE_TIME_015
            OBJ_CLS_TYPE1_015_oRDR_TRACKER_OBJ_015_oPCAN_RADAR_2ef10e60_Tx: ComBitPosition=271, ComBitSize=4, ComSignalType=UINT8, ComSystemTemplateSystemSignalRef=OBJ_CLS_TYPE1_015
            OBJ_CLS_TYPE1_PROB_015_oRDR_TRACKER_OBJ_015_oPCAN_RADAR_86a9d993_Tx: ComBitPosition=303, ComBitSize=8, ComSignalType=UINT8, ComSystemTemplateSystemSignalRef=OBJ_CLS_TYPE1_PROB_015
            OBJ_CLS_TYPE2_015_oRDR_TRACKER_OBJ_015_oPCAN_RADAR_63190e07_Tx: ComBitPosition=267, ComBitSize=4, ComSignalType=UINT8, ComSystemTemplateSystemSignalRef=OBJ_CLS_TYPE2_015
            OBJ_CLS_TYPE2_PROB_015_oRDR_TRACKER_OBJ_015_oPCAN_RADAR_4f9dc29e_Tx: ComBitPosition=311, ComBitSize=8, ComSignalType=UINT8, ComSystemTemplateSystemSignalRef=OBJ_CLS_TYPE2_PROB_015
            OBJ_CLS_TYPE3_015_oRDR_TRACKER_OBJ_015_oPCAN_RADAR_ee91f3e5_Tx: ComBitPosition=279, ComBitSize=4, ComSignalType=UINT8, ComSystemTemplateSystemSignalRef=OBJ_CLS_TYPE3_015
            OBJ_CLS_TYPE3_PROB_015_oRDR_TRACKER_OBJ_015_oPCAN_RADAR_088e3465_Tx: ComBitPosition=319, ComBitSize=8, ComSignalType=UINT8, ComSystemTemplateSystemSignalRef=OBJ_CLS_TYPE3_PROB_015
            OBJ_CLS_TYPE4_015_oRDR_TRACKER_OBJ_015_oPCAN_RADAR_f8c90ec9_Tx: ComBitPosition=275, ComBitSize=4, ComSignalType=UINT8, ComSystemTemplateSystemSignalRef=OBJ_CLS_TYPE4_015
            OBJ_CLS_TYPE4_PROB_015_oRDR_TRACKER_OBJ_015_oPCAN_RADAR_0684f2c5_Tx: ComBitPosition=327, ComBitSize=8, ComSignalType=UINT8, ComSystemTemplateSystemSignalRef=OBJ_CLS_TYPE4_PROB_015
            OBJ_CLS_TYPE5_015_oRDR_TRACKER_OBJ_015_oPCAN_RADAR_7541f32b_Tx: ComBitPosition=287, ComBitSize=4, ComSignalType=UINT8, ComSystemTemplateSystemSignalRef=OBJ_CLS_TYPE5_015
            OBJ_CLS_TYPE5_PROB_015_oRDR_TRACKER_OBJ_015_oPCAN_RADAR_4197043e_Tx: ComBitPosition=335, ComBitSize=8, ComSignalType=UINT8, ComSystemTemplateSystemSignalRef=OBJ_CLS_TYPE5_PROB_015
            OBJ_CLS_TYPE6_015_oRDR_TRACKER_OBJ_015_oPCAN_RADAR_38a9f34c_Tx: ComBitPosition=282, ComBitSize=4, ComSignalType=UINT8, ComSystemTemplateSystemSignalRef=OBJ_CLS_TYPE6_015
            OBJ_CLS_TYPE6_PROB_015_oRDR_TRACKER_OBJ_015_oPCAN_RADAR_88a31f33_Tx: ComBitPosition=343, ComBitSize=8, ComSignalType=UINT8, ComSystemTemplateSystemSignalRef=OBJ_CLS_TYPE6_PROB_015
            OBJ_DIMENSION_LENGTH_015_oRDR_TRACKER_OBJ_015_oPCAN_RADAR_6c6f5d24_Tx: ComBitPosition=37, ComBitSize=12, ComSignalType=UINT16, ComSystemTemplateSystemSignalRef=OBJ_DIMENSION_LENGTH_015
            OBJ_DIMENSION_LENGTH_ERR_015_oRDR_TRACKER_OBJ_015_oPCAN_RADAR_5797425e_Tx: ComBitPosition=41, ComBitSize=10, ComSignalType=UINT16, ComSystemTemplateSystemSignalRef=OBJ_DIMENSION_LENGTH_ERR_015
            OBJ_DIMENSION_WIDTH_015_oRDR_TRACKER_OBJ_015_oPCAN_RADAR_4fa1aa89_Tx: ComBitPosition=17, ComBitSize=10, ComSignalType=UINT16, ComSystemTemplateSystemSignalRef=OBJ_DIMENSION_WIDTH_015
            OBJ_DIMENSION_WIDTH_ERR_015_oRDR_TRACKER_OBJ_015_oPCAN_RADAR_af036d61_Tx: ComBitPosition=23, ComBitSize=6, ComSignalType=UINT8, ComSystemTemplateSystemSignalRef=OBJ_DIMENSION_WIDTH_ERR_015
            OBJ_EXISTENCE_PROB_015_oRDR_TRACKER_OBJ_015_oPCAN_RADAR_441d2eb4_Tx: ComBitPosition=229, ComBitSize=14, ComSignalType=UINT16, ComSystemTemplateSystemSignalRef=OBJ_EXISTENCE_PROB_015
            OBJ_GROUP_ID_015_oRDR_TRACKER_OBJ_015_oPCAN_RADAR_cd6f3a19_Tx: ComBitPosition=405, ComBitSize=6, ComSignalType=UINT8, ComSystemTemplateSystemSignalRef=OBJ_GROUP_ID_015
            OBJ_ID_015_oRDR_TRACKER_OBJ_015_oPCAN_RADAR_3e41111e_Tx: ComBitPosition=7, ComBitSize=8, ComSignalType=UINT8, ComSystemTemplateSystemSignalRef=OBJ_ID_015
            OBJ_MEASUREMENT_STATUS_015_oRDR_TRACKER_OBJ_015_oPCAN_RADAR_419363a3_Tx: ComBitPosition=14, ComBitSize=3, ComSignalType=UINT8, ComSystemTemplateSystemSignalRef=OBJ_MEASUREMENT_STATUS_015
            OBJ_MH_CRC16_015_oRDR_TRACKER_OBJ_015_oPCAN_RADAR_3df3d49f_Tx: ComBitPosition=495, ComBitSize=16, ComSignalType=UINT16, ComSystemTemplateSystemSignalRef=OBJ_MH_CRC16_015
            OBJ_MH_CYCLE_COUNTER_015_oRDR_TRACKER_OBJ_015_oPCAN_RADAR_4c178e7e_Tx: ComBitPosition=487, ComBitSize=8, ComSignalType=UINT8, ComSystemTemplateSystemSignalRef=OBJ_MH_CYCLE_COUNTER_015
            OBJ_MOVEMENT_STATUS_015_oRDR_TRACKER_OBJ_015_oPCAN_RADAR_6e3df6ef_Tx: ComBitPosition=196, ComBitSize=3, ComSignalType=UINT8, ComSystemTemplateSystemSignalRef=OBJ_MOVEMENT_STATUS_015
            OBJ_POS_ERR_CRR_COEF_015_oRDR_TRACKER_OBJ_015_oPCAN_RADAR_fe4236d5_Tx: ComBitPosition=415, ComBitSize=8, ComSignalType=UINT8, ComSystemTemplateSystemSignalRef=OBJ_POS_ERR_CRR_COEF_015
            OBJ_POS_LAT_015_oRDR_TRACKER_OBJ_015_oPCAN_RADAR_1cedcb99_Tx: ComBitPosition=79, ComBitSize=16, ComSignalType=UINT16, ComSystemTemplateSystemSignalRef=OBJ_POS_LAT_015
            OBJ_POS_LAT_ERR_015_oRDR_TRACKER_OBJ_015_oPCAN_RADAR_18a19bae_Tx: ComBitPosition=103, ComBitSize=8, ComSignalType=UINT8, ComSystemTemplateSystemSignalRef=OBJ_POS_LAT_ERR_015
            OBJ_POS_LONG_015_oRDR_TRACKER_OBJ_015_oPCAN_RADAR_ad4d2056_Tx: ComBitPosition=63, ComBitSize=16, ComSignalType=UINT16, ComSystemTemplateSystemSignalRef=OBJ_POS_LONG_015
            OBJ_POS_LONG_ERR_015_oRDR_TRACKER_OBJ_015_oPCAN_RADAR_8159654c_Tx: ComBitPosition=95, ComBitSize=8, ComSignalType=UINT8, ComSystemTemplateSystemSignalRef=OBJ_POS_LONG_ERR_015
            OBJ_RCS_015_oRDR_TRACKER_OBJ_015_oPCAN_RADAR_3e229d9e_Tx: ComBitPosition=351, ComBitSize=7, ComSignalType=UINT8, ComSystemTemplateSystemSignalRef=OBJ_RCS_015
            OBJ_REF_PT_LAT_OFFSET_015_oRDR_TRACKER_OBJ_015_oPCAN_RADAR_cb1ff6eb_Tx: ComBitPosition=370, ComBitSize=14, ComSignalType=UINT16, ComSystemTemplateSystemSignalRef=OBJ_REF_PT_LAT_OFFSET_015
            OBJ_REF_PT_LONG_OFFSET_015_oRDR_TRACKER_OBJ_015_oPCAN_RADAR_844d06e8_Tx: ComBitPosition=357, ComBitSize=14, ComSignalType=UINT16, ComSystemTemplateSystemSignalRef=OBJ_REF_PT_LONG_OFFSET_015
            OBJ_TIMESTAMP_OFFSET_015_oRDR_TRACKER_OBJ_015_oPCAN_RADAR_3e8e9dc8_Tx: ComBitPosition=247, ComBitSize=8, ComSignalType=UINT8, ComSystemTemplateSystemSignalRef=OBJ_TIMESTAMP_OFFSET_015
            OBJ_TRACK_MOTION_MODEL_015_oRDR_TRACKER_OBJ_015_oPCAN_RADAR_f28d9c15_Tx: ComBitPosition=9, ComBitSize=2, ComSignalType=UINT8, ComSystemTemplateSystemSignalRef=OBJ_TRACK_MOTION_MODEL_015
            OBJ_VEH_TRACK_FLAG_015_oRDR_TRACKER_OBJ_015_oPCAN_RADAR_70a76a48_Tx: ComBitPosition=10, ComBitSize=1, ComSignalType=BOOLEAN, ComSystemTemplateSystemSignalRef=OBJ_VEH_TRACK_FLAG_015
            OBJ_VELOCITY_ERR_CRR_COEF_015_oRDR_TRACKER_OBJ_015_oPCAN_RADAR_57380b34_Tx: ComBitPosition=423, ComBitSize=8, ComSignalType=UINT8, ComSystemTemplateSystemSignalRef=OBJ_VELOCITY_ERR_CRR_COEF_015
            OBJ_VELOCITY_LAT_015_oRDR_TRACKER_OBJ_015_oPCAN_RADAR_588e8ebe_Tx: ComBitPosition=126, ComBitSize=15, ComSignalType=UINT16, ComSystemTemplateSystemSignalRef=OBJ_VELOCITY_LAT_015
            OBJ_VELOCITY_LAT_ERR_015_oRDR_TRACKER_OBJ_015_oPCAN_RADAR_6c74feef_Tx: ComBitPosition=151, ComBitSize=8, ComSignalType=UINT8, ComSystemTemplateSystemSignalRef=OBJ_VELOCITY_LAT_ERR_015
            OBJ_VELOCITY_LONG_015_oRDR_TRACKER_OBJ_015_oPCAN_RADAR_0803f678_Tx: ComBitPosition=110, ComBitSize=15, ComSignalType=UINT16, ComSystemTemplateSystemSignalRef=OBJ_VELOCITY_LONG_015
            OBJ_VELOCITY_LONG_ERR_015_oRDR_TRACKER_OBJ_015_oPCAN_RADAR_80f6c12f_Tx: ComBitPosition=143, ComBitSize=8, ComSignalType=UINT8, ComSystemTemplateSystemSignalRef=OBJ_VELOCITY_LONG_ERR_015
            OBJ_YAW_ANGLE_015_oRDR_TRACKER_OBJ_015_oPCAN_RADAR_b432cafe_Tx: ComBitPosition=155, ComBitSize=12, ComSignalType=UINT16, ComSystemTemplateSystemSignalRef=OBJ_YAW_ANGLE_015
            OBJ_YAW_ANGLE_ERR_015_oRDR_TRACKER_OBJ_015_oPCAN_RADAR_613fcc29_Tx: ComBitPosition=175, ComBitSize=7, ComSignalType=UINT8, ComSystemTemplateSystemSignalRef=OBJ_YAW_ANGLE_ERR_015
            OBJ_YAW_RATE_015_oRDR_TRACKER_OBJ_015_oPCAN_RADAR_91bdefb9_Tx: ComBitPosition=399, ComBitSize=10, ComSignalType=UINT16, ComSystemTemplateSystemSignalRef=OBJ_YAW_RATE_015
            OBJ_YAW_RATE_ERR_015_oRDR_TRACKER_OBJ_015_oPCAN_RADAR_ae657865_Tx: ComBitPosition=388, ComBitSize=5, ComSignalType=UINT8, ComSystemTemplateSystemSignalRef=OBJ_YAW_RATE_ERR_015
        SG_TrackerObject016_oRDR_TRACKER_OBJ_016_oPCAN_RADAR_75d339f9_Tx: ComSystemTemplateSignalGroupRef=SG_TrackerObject016
          49 x ComGroupSignal, all with ComSignalEndianness=BIG_ENDIAN, ComSignalInitValue=0, ComTransferProperty=PENDING:
            OBJ_ACCELERATION_LAT_016_oRDR_TRACKER_OBJ_016_oPCAN_RADAR_7bf7628e_Tx: ComBitPosition=177, ComBitSize=10, ComSignalType=UINT16, ComSystemTemplateSystemSignalRef=OBJ_ACCELERATION_LAT_016
            OBJ_ACCELERATION_LAT_ERR_016_oRDR_TRACKER_OBJ_016_oPCAN_RADAR_ae035830_Tx: ComBitPosition=223, ComBitSize=8, ComSignalType=UINT8, ComSystemTemplateSystemSignalRef=OBJ_ACCELERATION_LAT_ERR_016
            OBJ_ACCELERATION_LONG_016_oRDR_TRACKER_OBJ_016_oPCAN_RADAR_09073b6e_Tx: ComBitPosition=193, ComBitSize=10, ComSignalType=UINT16, ComSystemTemplateSystemSignalRef=OBJ_ACCELERATION_LONG_016
            OBJ_ACCELERATION_LONG_ERR_016_oRDR_TRACKER_OBJ_016_oPCAN_RADAR_b1a6fd9a_Tx: ComBitPosition=215, ComBitSize=8, ComSignalType=UINT8, ComSystemTemplateSystemSignalRef=OBJ_ACCELERATION_LONG_ERR_016
            OBJ_ACCEL_ERR_CRR_COEF_016_oRDR_TRACKER_OBJ_016_oPCAN_RADAR_1105dcfc_Tx: ComBitPosition=431, ComBitSize=8, ComSignalType=UINT8, ComSystemTemplateSystemSignalRef=OBJ_ACCEL_ERR_CRR_COEF_016
            OBJ_ALIVE_TIME_016_oRDR_TRACKER_OBJ_016_oPCAN_RADAR_696670d2_Tx: ComBitPosition=255, ComBitSize=16, ComSignalType=UINT16, ComSystemTemplateSystemSignalRef=OBJ_ALIVE_TIME_016
            OBJ_CLS_TYPE1_016_oRDR_TRACKER_OBJ_016_oPCAN_RADAR_febd91f4_Tx: ComBitPosition=271, ComBitSize=4, ComSignalType=UINT8, ComSystemTemplateSystemSignalRef=OBJ_CLS_TYPE1_016
            OBJ_CLS_TYPE1_PROB_016_oRDR_TRACKER_OBJ_016_oPCAN_RADAR_56e54607_Tx: ComBitPosition=303, ComBitSize=8, ComSignalType=UINT8, ComSystemTemplateSystemSignalRef=OBJ_CLS_TYPE1_PROB_016
            OBJ_CLS_TYPE2_016_oRDR_TRACKER_OBJ_016_oPCAN_RADAR_b3559193_Tx: ComBitPosition=267, ComBitSize=4, ComSignalType=UINT8, ComSystemTemplateSystemSignalRef=OBJ_CLS_TYPE2_016
            OBJ_CLS_TYPE2_PROB_016_oRDR_TRACKER_OBJ_016_oPCAN_RADAR_9fd15d0a_Tx: ComBitPosition=311, ComBitSize=8, ComSignalType=UINT8, ComSystemTemplateSystemSignalRef=OBJ_CLS_TYPE2_PROB_016
            OBJ_CLS_TYPE3_016_oRDR_TRACKER_OBJ_016_oPCAN_RADAR_3edd6c71_Tx: ComBitPosition=279, ComBitSize=4, ComSignalType=UINT8, ComSystemTemplateSystemSignalRef=OBJ_CLS_TYPE3_016
            OBJ_CLS_TYPE3_PROB_016_oRDR_TRACKER_OBJ_016_oPCAN_RADAR_d8c2abf1_Tx: ComBitPosition=319, ComBitSize=8, ComSignalType=UINT8, ComSystemTemplateSystemSignalRef=OBJ_CLS_TYPE3_PROB_016
            OBJ_CLS_TYPE4_016_oRDR_TRACKER_OBJ_016_oPCAN_RADAR_2885915d_Tx: ComBitPosition=275, ComBitSize=4, ComSignalType=UINT8, ComSystemTemplateSystemSignalRef=OBJ_CLS_TYPE4_016
            OBJ_CLS_TYPE4_PROB_016_oRDR_TRACKER_OBJ_016_oPCAN_RADAR_d6c86d51_Tx: ComBitPosition=327, ComBitSize=8, ComSignalType=UINT8, ComSystemTemplateSystemSignalRef=OBJ_CLS_TYPE4_PROB_016
            OBJ_CLS_TYPE5_016_oRDR_TRACKER_OBJ_016_oPCAN_RADAR_a50d6cbf_Tx: ComBitPosition=287, ComBitSize=4, ComSignalType=UINT8, ComSystemTemplateSystemSignalRef=OBJ_CLS_TYPE5_016
            OBJ_CLS_TYPE5_PROB_016_oRDR_TRACKER_OBJ_016_oPCAN_RADAR_91db9baa_Tx: ComBitPosition=335, ComBitSize=8, ComSignalType=UINT8, ComSystemTemplateSystemSignalRef=OBJ_CLS_TYPE5_PROB_016
            OBJ_CLS_TYPE6_016_oRDR_TRACKER_OBJ_016_oPCAN_RADAR_e8e56cd8_Tx: ComBitPosition=282, ComBitSize=4, ComSignalType=UINT8, ComSystemTemplateSystemSignalRef=OBJ_CLS_TYPE6_016
            OBJ_CLS_TYPE6_PROB_016_oRDR_TRACKER_OBJ_016_oPCAN_RADAR_58ef80a7_Tx: ComBitPosition=343, ComBitSize=8, ComSignalType=UINT8, ComSystemTemplateSystemSignalRef=OBJ_CLS_TYPE6_PROB_016
            OBJ_DIMENSION_LENGTH_016_oRDR_TRACKER_OBJ_016_oPCAN_RADAR_bc23c2b0_Tx: ComBitPosition=37, ComBitSize=12, ComSignalType=UINT16, ComSystemTemplateSystemSignalRef=OBJ_DIMENSION_LENGTH_016
            OBJ_DIMENSION_LENGTH_ERR_016_oRDR_TRACKER_OBJ_016_oPCAN_RADAR_87dbddca_Tx: ComBitPosition=41, ComBitSize=10, ComSignalType=UINT16, ComSystemTemplateSystemSignalRef=OBJ_DIMENSION_LENGTH_ERR_016
            OBJ_DIMENSION_WIDTH_016_oRDR_TRACKER_OBJ_016_oPCAN_RADAR_9fed351d_Tx: ComBitPosition=17, ComBitSize=10, ComSignalType=UINT16, ComSystemTemplateSystemSignalRef=OBJ_DIMENSION_WIDTH_016
            OBJ_DIMENSION_WIDTH_ERR_016_oRDR_TRACKER_OBJ_016_oPCAN_RADAR_7f4ff2f5_Tx: ComBitPosition=23, ComBitSize=6, ComSignalType=UINT8, ComSystemTemplateSystemSignalRef=OBJ_DIMENSION_WIDTH_ERR_016
            OBJ_EXISTENCE_PROB_016_oRDR_TRACKER_OBJ_016_oPCAN_RADAR_9451b120_Tx: ComBitPosition=229, ComBitSize=14, ComSignalType=UINT16, ComSystemTemplateSystemSignalRef=OBJ_EXISTENCE_PROB_016
            OBJ_GROUP_ID_016_oRDR_TRACKER_OBJ_016_oPCAN_RADAR_1d23a58d_Tx: ComBitPosition=405, ComBitSize=6, ComSignalType=UINT8, ComSystemTemplateSystemSignalRef=OBJ_GROUP_ID_016
            OBJ_ID_016_oRDR_TRACKER_OBJ_016_oPCAN_RADAR_ee0d8e8a_Tx: ComBitPosition=7, ComBitSize=8, ComSignalType=UINT8, ComSystemTemplateSystemSignalRef=OBJ_ID_016
            OBJ_MEASUREMENT_STATUS_016_oRDR_TRACKER_OBJ_016_oPCAN_RADAR_91dffc37_Tx: ComBitPosition=14, ComBitSize=3, ComSignalType=UINT8, ComSystemTemplateSystemSignalRef=OBJ_MEASUREMENT_STATUS_016
            OBJ_MH_CRC16_016_oRDR_TRACKER_OBJ_016_oPCAN_RADAR_edbf4b0b_Tx: ComBitPosition=495, ComBitSize=16, ComSignalType=UINT16, ComSystemTemplateSystemSignalRef=OBJ_MH_CRC16_016
            OBJ_MH_CYCLE_COUNTER_016_oRDR_TRACKER_OBJ_016_oPCAN_RADAR_9c5b11ea_Tx: ComBitPosition=487, ComBitSize=8, ComSignalType=UINT8, ComSystemTemplateSystemSignalRef=OBJ_MH_CYCLE_COUNTER_016
            OBJ_MOVEMENT_STATUS_016_oRDR_TRACKER_OBJ_016_oPCAN_RADAR_be71697b_Tx: ComBitPosition=196, ComBitSize=3, ComSignalType=UINT8, ComSystemTemplateSystemSignalRef=OBJ_MOVEMENT_STATUS_016
            OBJ_POS_ERR_CRR_COEF_016_oRDR_TRACKER_OBJ_016_oPCAN_RADAR_2e0ea941_Tx: ComBitPosition=415, ComBitSize=8, ComSignalType=UINT8, ComSystemTemplateSystemSignalRef=OBJ_POS_ERR_CRR_COEF_016
            OBJ_POS_LAT_016_oRDR_TRACKER_OBJ_016_oPCAN_RADAR_cca1540d_Tx: ComBitPosition=79, ComBitSize=16, ComSignalType=UINT16, ComSystemTemplateSystemSignalRef=OBJ_POS_LAT_016
            OBJ_POS_LAT_ERR_016_oRDR_TRACKER_OBJ_016_oPCAN_RADAR_c8ed043a_Tx: ComBitPosition=103, ComBitSize=8, ComSignalType=UINT8, ComSystemTemplateSystemSignalRef=OBJ_POS_LAT_ERR_016
            OBJ_POS_LONG_016_oRDR_TRACKER_OBJ_016_oPCAN_RADAR_7d01bfc2_Tx: ComBitPosition=63, ComBitSize=16, ComSignalType=UINT16, ComSystemTemplateSystemSignalRef=OBJ_POS_LONG_016
            OBJ_POS_LONG_ERR_016_oRDR_TRACKER_OBJ_016_oPCAN_RADAR_5115fad8_Tx: ComBitPosition=95, ComBitSize=8, ComSignalType=UINT8, ComSystemTemplateSystemSignalRef=OBJ_POS_LONG_ERR_016
            OBJ_RCS_016_oRDR_TRACKER_OBJ_016_oPCAN_RADAR_ee6e020a_Tx: ComBitPosition=351, ComBitSize=7, ComSignalType=UINT8, ComSystemTemplateSystemSignalRef=OBJ_RCS_016
            OBJ_REF_PT_LAT_OFFSET_016_oRDR_TRACKER_OBJ_016_oPCAN_RADAR_1b53697f_Tx: ComBitPosition=370, ComBitSize=14, ComSignalType=UINT16, ComSystemTemplateSystemSignalRef=OBJ_REF_PT_LAT_OFFSET_016
            OBJ_REF_PT_LONG_OFFSET_016_oRDR_TRACKER_OBJ_016_oPCAN_RADAR_5401997c_Tx: ComBitPosition=357, ComBitSize=14, ComSignalType=UINT16, ComSystemTemplateSystemSignalRef=OBJ_REF_PT_LONG_OFFSET_016
            OBJ_TIMESTAMP_OFFSET_016_oRDR_TRACKER_OBJ_016_oPCAN_RADAR_eec2025c_Tx: ComBitPosition=247, ComBitSize=8, ComSignalType=UINT8, ComSystemTemplateSystemSignalRef=OBJ_TIMESTAMP_OFFSET_016
            OBJ_TRACK_MOTION_MODEL_016_oRDR_TRACKER_OBJ_016_oPCAN_RADAR_22c10381_Tx: ComBitPosition=9, ComBitSize=2, ComSignalType=UINT8, ComSystemTemplateSystemSignalRef=OBJ_TRACK_MOTION_MODEL_016
            OBJ_VEH_TRACK_FLAG_016_oRDR_TRACKER_OBJ_016_oPCAN_RADAR_a0ebf5dc_Tx: ComBitPosition=10, ComBitSize=1, ComSignalType=BOOLEAN, ComSystemTemplateSystemSignalRef=OBJ_VEH_TRACK_FLAG_016
            OBJ_VELOCITY_ERR_CRR_COEF_016_oRDR_TRACKER_OBJ_016_oPCAN_RADAR_877494a0_Tx: ComBitPosition=423, ComBitSize=8, ComSignalType=UINT8, ComSystemTemplateSystemSignalRef=OBJ_VELOCITY_ERR_CRR_COEF_016
            OBJ_VELOCITY_LAT_016_oRDR_TRACKER_OBJ_016_oPCAN_RADAR_88c2112a_Tx: ComBitPosition=126, ComBitSize=15, ComSignalType=UINT16, ComSystemTemplateSystemSignalRef=OBJ_VELOCITY_LAT_016
            OBJ_VELOCITY_LAT_ERR_016_oRDR_TRACKER_OBJ_016_oPCAN_RADAR_bc38617b_Tx: ComBitPosition=151, ComBitSize=8, ComSignalType=UINT8, ComSystemTemplateSystemSignalRef=OBJ_VELOCITY_LAT_ERR_016
            OBJ_VELOCITY_LONG_016_oRDR_TRACKER_OBJ_016_oPCAN_RADAR_d84f69ec_Tx: ComBitPosition=110, ComBitSize=15, ComSignalType=UINT16, ComSystemTemplateSystemSignalRef=OBJ_VELOCITY_LONG_016
            OBJ_VELOCITY_LONG_ERR_016_oRDR_TRACKER_OBJ_016_oPCAN_RADAR_50ba5ebb_Tx: ComBitPosition=143, ComBitSize=8, ComSignalType=UINT8, ComSystemTemplateSystemSignalRef=OBJ_VELOCITY_LONG_ERR_016
            OBJ_YAW_ANGLE_016_oRDR_TRACKER_OBJ_016_oPCAN_RADAR_647e556a_Tx: ComBitPosition=155, ComBitSize=12, ComSignalType=UINT16, ComSystemTemplateSystemSignalRef=OBJ_YAW_ANGLE_016
            OBJ_YAW_ANGLE_ERR_016_oRDR_TRACKER_OBJ_016_oPCAN_RADAR_b17353bd_Tx: ComBitPosition=175, ComBitSize=7, ComSignalType=UINT8, ComSystemTemplateSystemSignalRef=OBJ_YAW_ANGLE_ERR_016
            OBJ_YAW_RATE_016_oRDR_TRACKER_OBJ_016_oPCAN_RADAR_41f1702d_Tx: ComBitPosition=399, ComBitSize=10, ComSignalType=UINT16, ComSystemTemplateSystemSignalRef=OBJ_YAW_RATE_016
            OBJ_YAW_RATE_ERR_016_oRDR_TRACKER_OBJ_016_oPCAN_RADAR_7e29e7f1_Tx: ComBitPosition=388, ComBitSize=5, ComSignalType=UINT8, ComSystemTemplateSystemSignalRef=OBJ_YAW_RATE_ERR_016
        SG_TrackerObject017_oRDR_TRACKER_OBJ_017_oPCAN_RADAR_8cc7b14a_Tx: ComSystemTemplateSignalGroupRef=SG_TrackerObject017
          49 x ComGroupSignal, all with ComSignalEndianness=BIG_ENDIAN, ComSignalInitValue=0, ComTransferProperty=PENDING:
            OBJ_ACCELERATION_LAT_017_oRDR_TRACKER_OBJ_017_oPCAN_RADAR_82e3ea3d_Tx: ComBitPosition=177, ComBitSize=10, ComSignalType=UINT16, ComSystemTemplateSystemSignalRef=OBJ_ACCELERATION_LAT_017
            OBJ_ACCELERATION_LAT_ERR_017_oRDR_TRACKER_OBJ_017_oPCAN_RADAR_5717d083_Tx: ComBitPosition=223, ComBitSize=8, ComSignalType=UINT8, ComSystemTemplateSystemSignalRef=OBJ_ACCELERATION_LAT_ERR_017
            OBJ_ACCELERATION_LONG_017_oRDR_TRACKER_OBJ_017_oPCAN_RADAR_f013b3dd_Tx: ComBitPosition=193, ComBitSize=10, ComSignalType=UINT16, ComSystemTemplateSystemSignalRef=OBJ_ACCELERATION_LONG_017
            OBJ_ACCELERATION_LONG_ERR_017_oRDR_TRACKER_OBJ_017_oPCAN_RADAR_48b27529_Tx: ComBitPosition=215, ComBitSize=8, ComSignalType=UINT8, ComSystemTemplateSystemSignalRef=OBJ_ACCELERATION_LONG_ERR_017
            OBJ_ACCEL_ERR_CRR_COEF_017_oRDR_TRACKER_OBJ_017_oPCAN_RADAR_e811544f_Tx: ComBitPosition=431, ComBitSize=8, ComSignalType=UINT8, ComSystemTemplateSystemSignalRef=OBJ_ACCEL_ERR_CRR_COEF_017
            OBJ_ALIVE_TIME_017_oRDR_TRACKER_OBJ_017_oPCAN_RADAR_9072f861_Tx: ComBitPosition=255, ComBitSize=16, ComSignalType=UINT16, ComSystemTemplateSystemSignalRef=OBJ_ALIVE_TIME_017
            OBJ_CLS_TYPE1_017_oRDR_TRACKER_OBJ_017_oPCAN_RADAR_07a91947_Tx: ComBitPosition=271, ComBitSize=4, ComSignalType=UINT8, ComSystemTemplateSystemSignalRef=OBJ_CLS_TYPE1_017
            OBJ_CLS_TYPE1_PROB_017_oRDR_TRACKER_OBJ_017_oPCAN_RADAR_aff1ceb4_Tx: ComBitPosition=303, ComBitSize=8, ComSignalType=UINT8, ComSystemTemplateSystemSignalRef=OBJ_CLS_TYPE1_PROB_017
            OBJ_CLS_TYPE2_017_oRDR_TRACKER_OBJ_017_oPCAN_RADAR_4a411920_Tx: ComBitPosition=267, ComBitSize=4, ComSignalType=UINT8, ComSystemTemplateSystemSignalRef=OBJ_CLS_TYPE2_017
            OBJ_CLS_TYPE2_PROB_017_oRDR_TRACKER_OBJ_017_oPCAN_RADAR_66c5d5b9_Tx: ComBitPosition=311, ComBitSize=8, ComSignalType=UINT8, ComSystemTemplateSystemSignalRef=OBJ_CLS_TYPE2_PROB_017
            OBJ_CLS_TYPE3_017_oRDR_TRACKER_OBJ_017_oPCAN_RADAR_c7c9e4c2_Tx: ComBitPosition=279, ComBitSize=4, ComSignalType=UINT8, ComSystemTemplateSystemSignalRef=OBJ_CLS_TYPE3_017
            OBJ_CLS_TYPE3_PROB_017_oRDR_TRACKER_OBJ_017_oPCAN_RADAR_21d62342_Tx: ComBitPosition=319, ComBitSize=8, ComSignalType=UINT8, ComSystemTemplateSystemSignalRef=OBJ_CLS_TYPE3_PROB_017
            OBJ_CLS_TYPE4_017_oRDR_TRACKER_OBJ_017_oPCAN_RADAR_d19119ee_Tx: ComBitPosition=275, ComBitSize=4, ComSignalType=UINT8, ComSystemTemplateSystemSignalRef=OBJ_CLS_TYPE4_017
            OBJ_CLS_TYPE4_PROB_017_oRDR_TRACKER_OBJ_017_oPCAN_RADAR_2fdce5e2_Tx: ComBitPosition=327, ComBitSize=8, ComSignalType=UINT8, ComSystemTemplateSystemSignalRef=OBJ_CLS_TYPE4_PROB_017
            OBJ_CLS_TYPE5_017_oRDR_TRACKER_OBJ_017_oPCAN_RADAR_5c19e40c_Tx: ComBitPosition=287, ComBitSize=4, ComSignalType=UINT8, ComSystemTemplateSystemSignalRef=OBJ_CLS_TYPE5_017
            OBJ_CLS_TYPE5_PROB_017_oRDR_TRACKER_OBJ_017_oPCAN_RADAR_68cf1319_Tx: ComBitPosition=335, ComBitSize=8, ComSignalType=UINT8, ComSystemTemplateSystemSignalRef=OBJ_CLS_TYPE5_PROB_017
            OBJ_CLS_TYPE6_017_oRDR_TRACKER_OBJ_017_oPCAN_RADAR_11f1e46b_Tx: ComBitPosition=282, ComBitSize=4, ComSignalType=UINT8, ComSystemTemplateSystemSignalRef=OBJ_CLS_TYPE6_017
            OBJ_CLS_TYPE6_PROB_017_oRDR_TRACKER_OBJ_017_oPCAN_RADAR_a1fb0814_Tx: ComBitPosition=343, ComBitSize=8, ComSignalType=UINT8, ComSystemTemplateSystemSignalRef=OBJ_CLS_TYPE6_PROB_017
            OBJ_DIMENSION_LENGTH_017_oRDR_TRACKER_OBJ_017_oPCAN_RADAR_45374a03_Tx: ComBitPosition=37, ComBitSize=12, ComSignalType=UINT16, ComSystemTemplateSystemSignalRef=OBJ_DIMENSION_LENGTH_017
            OBJ_DIMENSION_LENGTH_ERR_017_oRDR_TRACKER_OBJ_017_oPCAN_RADAR_7ecf5579_Tx: ComBitPosition=41, ComBitSize=10, ComSignalType=UINT16, ComSystemTemplateSystemSignalRef=OBJ_DIMENSION_LENGTH_ERR_017
            OBJ_DIMENSION_WIDTH_017_oRDR_TRACKER_OBJ_017_oPCAN_RADAR_66f9bdae_Tx: ComBitPosition=17, ComBitSize=10, ComSignalType=UINT16, ComSystemTemplateSystemSignalRef=OBJ_DIMENSION_WIDTH_017
            OBJ_DIMENSION_WIDTH_ERR_017_oRDR_TRACKER_OBJ_017_oPCAN_RADAR_865b7a46_Tx: ComBitPosition=23, ComBitSize=6, ComSignalType=UINT8, ComSystemTemplateSystemSignalRef=OBJ_DIMENSION_WIDTH_ERR_017
            OBJ_EXISTENCE_PROB_017_oRDR_TRACKER_OBJ_017_oPCAN_RADAR_6d453993_Tx: ComBitPosition=229, ComBitSize=14, ComSignalType=UINT16, ComSystemTemplateSystemSignalRef=OBJ_EXISTENCE_PROB_017
            OBJ_GROUP_ID_017_oRDR_TRACKER_OBJ_017_oPCAN_RADAR_e4372d3e_Tx: ComBitPosition=405, ComBitSize=6, ComSignalType=UINT8, ComSystemTemplateSystemSignalRef=OBJ_GROUP_ID_017
            OBJ_ID_017_oRDR_TRACKER_OBJ_017_oPCAN_RADAR_17190639_Tx: ComBitPosition=7, ComBitSize=8, ComSignalType=UINT8, ComSystemTemplateSystemSignalRef=OBJ_ID_017
            OBJ_MEASUREMENT_STATUS_017_oRDR_TRACKER_OBJ_017_oPCAN_RADAR_68cb7484_Tx: ComBitPosition=14, ComBitSize=3, ComSignalType=UINT8, ComSystemTemplateSystemSignalRef=OBJ_MEASUREMENT_STATUS_017
            OBJ_MH_CRC16_017_oRDR_TRACKER_OBJ_017_oPCAN_RADAR_14abc3b8_Tx: ComBitPosition=495, ComBitSize=16, ComSignalType=UINT16, ComSystemTemplateSystemSignalRef=OBJ_MH_CRC16_017
            OBJ_MH_CYCLE_COUNTER_017_oRDR_TRACKER_OBJ_017_oPCAN_RADAR_654f9959_Tx: ComBitPosition=487, ComBitSize=8, ComSignalType=UINT8, ComSystemTemplateSystemSignalRef=OBJ_MH_CYCLE_COUNTER_017
            OBJ_MOVEMENT_STATUS_017_oRDR_TRACKER_OBJ_017_oPCAN_RADAR_4765e1c8_Tx: ComBitPosition=196, ComBitSize=3, ComSignalType=UINT8, ComSystemTemplateSystemSignalRef=OBJ_MOVEMENT_STATUS_017
            OBJ_POS_ERR_CRR_COEF_017_oRDR_TRACKER_OBJ_017_oPCAN_RADAR_d71a21f2_Tx: ComBitPosition=415, ComBitSize=8, ComSignalType=UINT8, ComSystemTemplateSystemSignalRef=OBJ_POS_ERR_CRR_COEF_017
            OBJ_POS_LAT_017_oRDR_TRACKER_OBJ_017_oPCAN_RADAR_35b5dcbe_Tx: ComBitPosition=79, ComBitSize=16, ComSignalType=UINT16, ComSystemTemplateSystemSignalRef=OBJ_POS_LAT_017
            OBJ_POS_LAT_ERR_017_oRDR_TRACKER_OBJ_017_oPCAN_RADAR_31f98c89_Tx: ComBitPosition=103, ComBitSize=8, ComSignalType=UINT8, ComSystemTemplateSystemSignalRef=OBJ_POS_LAT_ERR_017
            OBJ_POS_LONG_017_oRDR_TRACKER_OBJ_017_oPCAN_RADAR_84153771_Tx: ComBitPosition=63, ComBitSize=16, ComSignalType=UINT16, ComSystemTemplateSystemSignalRef=OBJ_POS_LONG_017
            OBJ_POS_LONG_ERR_017_oRDR_TRACKER_OBJ_017_oPCAN_RADAR_a801726b_Tx: ComBitPosition=95, ComBitSize=8, ComSignalType=UINT8, ComSystemTemplateSystemSignalRef=OBJ_POS_LONG_ERR_017
            OBJ_RCS_017_oRDR_TRACKER_OBJ_017_oPCAN_RADAR_177a8ab9_Tx: ComBitPosition=351, ComBitSize=7, ComSignalType=UINT8, ComSystemTemplateSystemSignalRef=OBJ_RCS_017
            OBJ_REF_PT_LAT_OFFSET_017_oRDR_TRACKER_OBJ_017_oPCAN_RADAR_e247e1cc_Tx: ComBitPosition=370, ComBitSize=14, ComSignalType=UINT16, ComSystemTemplateSystemSignalRef=OBJ_REF_PT_LAT_OFFSET_017
            OBJ_REF_PT_LONG_OFFSET_017_oRDR_TRACKER_OBJ_017_oPCAN_RADAR_ad1511cf_Tx: ComBitPosition=357, ComBitSize=14, ComSignalType=UINT16, ComSystemTemplateSystemSignalRef=OBJ_REF_PT_LONG_OFFSET_017
            OBJ_TIMESTAMP_OFFSET_017_oRDR_TRACKER_OBJ_017_oPCAN_RADAR_17d68aef_Tx: ComBitPosition=247, ComBitSize=8, ComSignalType=UINT8, ComSystemTemplateSystemSignalRef=OBJ_TIMESTAMP_OFFSET_017
            OBJ_TRACK_MOTION_MODEL_017_oRDR_TRACKER_OBJ_017_oPCAN_RADAR_dbd58b32_Tx: ComBitPosition=9, ComBitSize=2, ComSignalType=UINT8, ComSystemTemplateSystemSignalRef=OBJ_TRACK_MOTION_MODEL_017
            OBJ_VEH_TRACK_FLAG_017_oRDR_TRACKER_OBJ_017_oPCAN_RADAR_59ff7d6f_Tx: ComBitPosition=10, ComBitSize=1, ComSignalType=BOOLEAN, ComSystemTemplateSystemSignalRef=OBJ_VEH_TRACK_FLAG_017
            OBJ_VELOCITY_ERR_CRR_COEF_017_oRDR_TRACKER_OBJ_017_oPCAN_RADAR_7e601c13_Tx: ComBitPosition=423, ComBitSize=8, ComSignalType=UINT8, ComSystemTemplateSystemSignalRef=OBJ_VELOCITY_ERR_CRR_COEF_017
            OBJ_VELOCITY_LAT_017_oRDR_TRACKER_OBJ_017_oPCAN_RADAR_71d69999_Tx: ComBitPosition=126, ComBitSize=15, ComSignalType=UINT16, ComSystemTemplateSystemSignalRef=OBJ_VELOCITY_LAT_017
            OBJ_VELOCITY_LAT_ERR_017_oRDR_TRACKER_OBJ_017_oPCAN_RADAR_452ce9c8_Tx: ComBitPosition=151, ComBitSize=8, ComSignalType=UINT8, ComSystemTemplateSystemSignalRef=OBJ_VELOCITY_LAT_ERR_017
            OBJ_VELOCITY_LONG_017_oRDR_TRACKER_OBJ_017_oPCAN_RADAR_215be15f_Tx: ComBitPosition=110, ComBitSize=15, ComSignalType=UINT16, ComSystemTemplateSystemSignalRef=OBJ_VELOCITY_LONG_017
            OBJ_VELOCITY_LONG_ERR_017_oRDR_TRACKER_OBJ_017_oPCAN_RADAR_a9aed608_Tx: ComBitPosition=143, ComBitSize=8, ComSignalType=UINT8, ComSystemTemplateSystemSignalRef=OBJ_VELOCITY_LONG_ERR_017
            OBJ_YAW_ANGLE_017_oRDR_TRACKER_OBJ_017_oPCAN_RADAR_9d6addd9_Tx: ComBitPosition=155, ComBitSize=12, ComSignalType=UINT16, ComSystemTemplateSystemSignalRef=OBJ_YAW_ANGLE_017
            OBJ_YAW_ANGLE_ERR_017_oRDR_TRACKER_OBJ_017_oPCAN_RADAR_4867db0e_Tx: ComBitPosition=175, ComBitSize=7, ComSignalType=UINT8, ComSystemTemplateSystemSignalRef=OBJ_YAW_ANGLE_ERR_017
            OBJ_YAW_RATE_017_oRDR_TRACKER_OBJ_017_oPCAN_RADAR_b8e5f89e_Tx: ComBitPosition=399, ComBitSize=10, ComSignalType=UINT16, ComSystemTemplateSystemSignalRef=OBJ_YAW_RATE_017
            OBJ_YAW_RATE_ERR_017_oRDR_TRACKER_OBJ_017_oPCAN_RADAR_873d6f42_Tx: ComBitPosition=388, ComBitSize=5, ComSignalType=UINT8, ComSystemTemplateSystemSignalRef=OBJ_YAW_RATE_ERR_017
        SG_TrackerObject018_oRDR_TRACKER_OBJ_018_oPCAN_RADAR_ab5b5c0c_Tx: ComSystemTemplateSignalGroupRef=SG_TrackerObject018
          49 x ComGroupSignal, all with ComSignalEndianness=BIG_ENDIAN, ComSignalInitValue=0, ComTransferProperty=PENDING:
            OBJ_ACCELERATION_LAT_018_oRDR_TRACKER_OBJ_018_oPCAN_RADAR_a57f077b_Tx: ComBitPosition=177, ComBitSize=10, ComSignalType=UINT16, ComSystemTemplateSystemSignalRef=OBJ_ACCELERATION_LAT_018
            OBJ_ACCELERATION_LAT_ERR_018_oRDR_TRACKER_OBJ_018_oPCAN_RADAR_708b3dc5_Tx: ComBitPosition=223, ComBitSize=8, ComSignalType=UINT8, ComSystemTemplateSystemSignalRef=OBJ_ACCELERATION_LAT_ERR_018
            OBJ_ACCELERATION_LONG_018_oRDR_TRACKER_OBJ_018_oPCAN_RADAR_d78f5e9b_Tx: ComBitPosition=193, ComBitSize=10, ComSignalType=UINT16, ComSystemTemplateSystemSignalRef=OBJ_ACCELERATION_LONG_018
            OBJ_ACCELERATION_LONG_ERR_018_oRDR_TRACKER_OBJ_018_oPCAN_RADAR_6f2e986f_Tx: ComBitPosition=215, ComBitSize=8, ComSignalType=UINT8, ComSystemTemplateSystemSignalRef=OBJ_ACCELERATION_LONG_ERR_018
            OBJ_ACCEL_ERR_CRR_COEF_018_oRDR_TRACKER_OBJ_018_oPCAN_RADAR_cf8db909_Tx: ComBitPosition=431, ComBitSize=8, ComSignalType=UINT8, ComSystemTemplateSystemSignalRef=OBJ_ACCEL_ERR_CRR_COEF_018
            OBJ_ALIVE_TIME_018_oRDR_TRACKER_OBJ_018_oPCAN_RADAR_b7ee1527_Tx: ComBitPosition=255, ComBitSize=16, ComSignalType=UINT16, ComSystemTemplateSystemSignalRef=OBJ_ALIVE_TIME_018
            OBJ_CLS_TYPE1_018_oRDR_TRACKER_OBJ_018_oPCAN_RADAR_2035f401_Tx: ComBitPosition=271, ComBitSize=4, ComSignalType=UINT8, ComSystemTemplateSystemSignalRef=OBJ_CLS_TYPE1_018
            OBJ_CLS_TYPE1_PROB_018_oRDR_TRACKER_OBJ_018_oPCAN_RADAR_886d23f2_Tx: ComBitPosition=303, ComBitSize=8, ComSignalType=UINT8, ComSystemTemplateSystemSignalRef=OBJ_CLS_TYPE1_PROB_018
            OBJ_CLS_TYPE2_018_oRDR_TRACKER_OBJ_018_oPCAN_RADAR_6dddf466_Tx: ComBitPosition=267, ComBitSize=4, ComSignalType=UINT8, ComSystemTemplateSystemSignalRef=OBJ_CLS_TYPE2_018
            OBJ_CLS_TYPE2_PROB_018_oRDR_TRACKER_OBJ_018_oPCAN_RADAR_415938ff_Tx: ComBitPosition=311, ComBitSize=8, ComSignalType=UINT8, ComSystemTemplateSystemSignalRef=OBJ_CLS_TYPE2_PROB_018
            OBJ_CLS_TYPE3_018_oRDR_TRACKER_OBJ_018_oPCAN_RADAR_e0550984_Tx: ComBitPosition=279, ComBitSize=4, ComSignalType=UINT8, ComSystemTemplateSystemSignalRef=OBJ_CLS_TYPE3_018
            OBJ_CLS_TYPE3_PROB_018_oRDR_TRACKER_OBJ_018_oPCAN_RADAR_064ace04_Tx: ComBitPosition=319, ComBitSize=8, ComSignalType=UINT8, ComSystemTemplateSystemSignalRef=OBJ_CLS_TYPE3_PROB_018
            OBJ_CLS_TYPE4_018_oRDR_TRACKER_OBJ_018_oPCAN_RADAR_f60df4a8_Tx: ComBitPosition=275, ComBitSize=4, ComSignalType=UINT8, ComSystemTemplateSystemSignalRef=OBJ_CLS_TYPE4_018
            OBJ_CLS_TYPE4_PROB_018_oRDR_TRACKER_OBJ_018_oPCAN_RADAR_084008a4_Tx: ComBitPosition=327, ComBitSize=8, ComSignalType=UINT8, ComSystemTemplateSystemSignalRef=OBJ_CLS_TYPE4_PROB_018
            OBJ_CLS_TYPE5_018_oRDR_TRACKER_OBJ_018_oPCAN_RADAR_7b85094a_Tx: ComBitPosition=287, ComBitSize=4, ComSignalType=UINT8, ComSystemTemplateSystemSignalRef=OBJ_CLS_TYPE5_018
            OBJ_CLS_TYPE5_PROB_018_oRDR_TRACKER_OBJ_018_oPCAN_RADAR_4f53fe5f_Tx: ComBitPosition=335, ComBitSize=8, ComSignalType=UINT8, ComSystemTemplateSystemSignalRef=OBJ_CLS_TYPE5_PROB_018
            OBJ_CLS_TYPE6_018_oRDR_TRACKER_OBJ_018_oPCAN_RADAR_366d092d_Tx: ComBitPosition=282, ComBitSize=4, ComSignalType=UINT8, ComSystemTemplateSystemSignalRef=OBJ_CLS_TYPE6_018
            OBJ_CLS_TYPE6_PROB_018_oRDR_TRACKER_OBJ_018_oPCAN_RADAR_8667e552_Tx: ComBitPosition=343, ComBitSize=8, ComSignalType=UINT8, ComSystemTemplateSystemSignalRef=OBJ_CLS_TYPE6_PROB_018
            OBJ_DIMENSION_LENGTH_018_oRDR_TRACKER_OBJ_018_oPCAN_RADAR_62aba745_Tx: ComBitPosition=37, ComBitSize=12, ComSignalType=UINT16, ComSystemTemplateSystemSignalRef=OBJ_DIMENSION_LENGTH_018
            OBJ_DIMENSION_LENGTH_ERR_018_oRDR_TRACKER_OBJ_018_oPCAN_RADAR_5953b83f_Tx: ComBitPosition=41, ComBitSize=10, ComSignalType=UINT16, ComSystemTemplateSystemSignalRef=OBJ_DIMENSION_LENGTH_ERR_018
            OBJ_DIMENSION_WIDTH_018_oRDR_TRACKER_OBJ_018_oPCAN_RADAR_416550e8_Tx: ComBitPosition=17, ComBitSize=10, ComSignalType=UINT16, ComSystemTemplateSystemSignalRef=OBJ_DIMENSION_WIDTH_018
            OBJ_DIMENSION_WIDTH_ERR_018_oRDR_TRACKER_OBJ_018_oPCAN_RADAR_a1c79700_Tx: ComBitPosition=23, ComBitSize=6, ComSignalType=UINT8, ComSystemTemplateSystemSignalRef=OBJ_DIMENSION_WIDTH_ERR_018
            OBJ_EXISTENCE_PROB_018_oRDR_TRACKER_OBJ_018_oPCAN_RADAR_4ad9d4d5_Tx: ComBitPosition=229, ComBitSize=14, ComSignalType=UINT16, ComSystemTemplateSystemSignalRef=OBJ_EXISTENCE_PROB_018
            OBJ_GROUP_ID_018_oRDR_TRACKER_OBJ_018_oPCAN_RADAR_c3abc078_Tx: ComBitPosition=405, ComBitSize=6, ComSignalType=UINT8, ComSystemTemplateSystemSignalRef=OBJ_GROUP_ID_018
            OBJ_ID_018_oRDR_TRACKER_OBJ_018_oPCAN_RADAR_3085eb7f_Tx: ComBitPosition=7, ComBitSize=8, ComSignalType=UINT8, ComSystemTemplateSystemSignalRef=OBJ_ID_018
            OBJ_MEASUREMENT_STATUS_018_oRDR_TRACKER_OBJ_018_oPCAN_RADAR_4f5799c2_Tx: ComBitPosition=14, ComBitSize=3, ComSignalType=UINT8, ComSystemTemplateSystemSignalRef=OBJ_MEASUREMENT_STATUS_018
            OBJ_MH_CRC16_018_oRDR_TRACKER_OBJ_018_oPCAN_RADAR_33372efe_Tx: ComBitPosition=495, ComBitSize=16, ComSignalType=UINT16, ComSystemTemplateSystemSignalRef=OBJ_MH_CRC16_018
            OBJ_MH_CYCLE_COUNTER_018_oRDR_TRACKER_OBJ_018_oPCAN_RADAR_42d3741f_Tx: ComBitPosition=487, ComBitSize=8, ComSignalType=UINT8, ComSystemTemplateSystemSignalRef=OBJ_MH_CYCLE_COUNTER_018
            OBJ_MOVEMENT_STATUS_018_oRDR_TRACKER_OBJ_018_oPCAN_RADAR_60f90c8e_Tx: ComBitPosition=196, ComBitSize=3, ComSignalType=UINT8, ComSystemTemplateSystemSignalRef=OBJ_MOVEMENT_STATUS_018
            OBJ_POS_ERR_CRR_COEF_018_oRDR_TRACKER_OBJ_018_oPCAN_RADAR_f086ccb4_Tx: ComBitPosition=415, ComBitSize=8, ComSignalType=UINT8, ComSystemTemplateSystemSignalRef=OBJ_POS_ERR_CRR_COEF_018
            OBJ_POS_LAT_018_oRDR_TRACKER_OBJ_018_oPCAN_RADAR_122931f8_Tx: ComBitPosition=79, ComBitSize=16, ComSignalType=UINT16, ComSystemTemplateSystemSignalRef=OBJ_POS_LAT_018
            OBJ_POS_LAT_ERR_018_oRDR_TRACKER_OBJ_018_oPCAN_RADAR_166561cf_Tx: ComBitPosition=103, ComBitSize=8, ComSignalType=UINT8, ComSystemTemplateSystemSignalRef=OBJ_POS_LAT_ERR_018
            OBJ_POS_LONG_018_oRDR_TRACKER_OBJ_018_oPCAN_RADAR_a389da37_Tx: ComBitPosition=63, ComBitSize=16, ComSignalType=UINT16, ComSystemTemplateSystemSignalRef=OBJ_POS_LONG_018
            OBJ_POS_LONG_ERR_018_oRDR_TRACKER_OBJ_018_oPCAN_RADAR_8f9d9f2d_Tx: ComBitPosition=95, ComBitSize=8, ComSignalType=UINT8, ComSystemTemplateSystemSignalRef=OBJ_POS_LONG_ERR_018
            OBJ_RCS_018_oRDR_TRACKER_OBJ_018_oPCAN_RADAR_30e667ff_Tx: ComBitPosition=351, ComBitSize=7, ComSignalType=UINT8, ComSystemTemplateSystemSignalRef=OBJ_RCS_018
            OBJ_REF_PT_LAT_OFFSET_018_oRDR_TRACKER_OBJ_018_oPCAN_RADAR_c5db0c8a_Tx: ComBitPosition=370, ComBitSize=14, ComSignalType=UINT16, ComSystemTemplateSystemSignalRef=OBJ_REF_PT_LAT_OFFSET_018
            OBJ_REF_PT_LONG_OFFSET_018_oRDR_TRACKER_OBJ_018_oPCAN_RADAR_8a89fc89_Tx: ComBitPosition=357, ComBitSize=14, ComSignalType=UINT16, ComSystemTemplateSystemSignalRef=OBJ_REF_PT_LONG_OFFSET_018
            OBJ_TIMESTAMP_OFFSET_018_oRDR_TRACKER_OBJ_018_oPCAN_RADAR_304a67a9_Tx: ComBitPosition=247, ComBitSize=8, ComSignalType=UINT8, ComSystemTemplateSystemSignalRef=OBJ_TIMESTAMP_OFFSET_018
            OBJ_TRACK_MOTION_MODEL_018_oRDR_TRACKER_OBJ_018_oPCAN_RADAR_fc496674_Tx: ComBitPosition=9, ComBitSize=2, ComSignalType=UINT8, ComSystemTemplateSystemSignalRef=OBJ_TRACK_MOTION_MODEL_018
            OBJ_VEH_TRACK_FLAG_018_oRDR_TRACKER_OBJ_018_oPCAN_RADAR_7e639029_Tx: ComBitPosition=10, ComBitSize=1, ComSignalType=BOOLEAN, ComSystemTemplateSystemSignalRef=OBJ_VEH_TRACK_FLAG_018
            OBJ_VELOCITY_ERR_CRR_COEF_018_oRDR_TRACKER_OBJ_018_oPCAN_RADAR_59fcf155_Tx: ComBitPosition=423, ComBitSize=8, ComSignalType=UINT8, ComSystemTemplateSystemSignalRef=OBJ_VELOCITY_ERR_CRR_COEF_018
            OBJ_VELOCITY_LAT_018_oRDR_TRACKER_OBJ_018_oPCAN_RADAR_564a74df_Tx: ComBitPosition=126, ComBitSize=15, ComSignalType=UINT16, ComSystemTemplateSystemSignalRef=OBJ_VELOCITY_LAT_018
            OBJ_VELOCITY_LAT_ERR_018_oRDR_TRACKER_OBJ_018_oPCAN_RADAR_62b0048e_Tx: ComBitPosition=151, ComBitSize=8, ComSignalType=UINT8, ComSystemTemplateSystemSignalRef=OBJ_VELOCITY_LAT_ERR_018
            OBJ_VELOCITY_LONG_018_oRDR_TRACKER_OBJ_018_oPCAN_RADAR_06c70c19_Tx: ComBitPosition=110, ComBitSize=15, ComSignalType=UINT16, ComSystemTemplateSystemSignalRef=OBJ_VELOCITY_LONG_018
            OBJ_VELOCITY_LONG_ERR_018_oRDR_TRACKER_OBJ_018_oPCAN_RADAR_8e323b4e_Tx: ComBitPosition=143, ComBitSize=8, ComSignalType=UINT8, ComSystemTemplateSystemSignalRef=OBJ_VELOCITY_LONG_ERR_018
            OBJ_YAW_ANGLE_018_oRDR_TRACKER_OBJ_018_oPCAN_RADAR_baf6309f_Tx: ComBitPosition=155, ComBitSize=12, ComSignalType=UINT16, ComSystemTemplateSystemSignalRef=OBJ_YAW_ANGLE_018
            OBJ_YAW_ANGLE_ERR_018_oRDR_TRACKER_OBJ_018_oPCAN_RADAR_6ffb3648_Tx: ComBitPosition=175, ComBitSize=7, ComSignalType=UINT8, ComSystemTemplateSystemSignalRef=OBJ_YAW_ANGLE_ERR_018
            OBJ_YAW_RATE_018_oRDR_TRACKER_OBJ_018_oPCAN_RADAR_9f7915d8_Tx: ComBitPosition=399, ComBitSize=10, ComSignalType=UINT16, ComSystemTemplateSystemSignalRef=OBJ_YAW_RATE_018
            OBJ_YAW_RATE_ERR_018_oRDR_TRACKER_OBJ_018_oPCAN_RADAR_a0a18204_Tx: ComBitPosition=388, ComBitSize=5, ComSignalType=UINT8, ComSystemTemplateSystemSignalRef=OBJ_YAW_RATE_ERR_018
        SG_TrackerObject019_oRDR_TRACKER_OBJ_019_oPCAN_RADAR_524fd4bf_Tx: ComSystemTemplateSignalGroupRef=SG_TrackerObject019
          49 x ComGroupSignal, all with ComSignalEndianness=BIG_ENDIAN, ComSignalInitValue=0, ComTransferProperty=PENDING:
            OBJ_ACCELERATION_LAT_019_oRDR_TRACKER_OBJ_019_oPCAN_RADAR_5c6b8fc8_Tx: ComBitPosition=177, ComBitSize=10, ComSignalType=UINT16, ComSystemTemplateSystemSignalRef=OBJ_ACCELERATION_LAT_019
            OBJ_ACCELERATION_LAT_ERR_019_oRDR_TRACKER_OBJ_019_oPCAN_RADAR_899fb576_Tx: ComBitPosition=223, ComBitSize=8, ComSignalType=UINT8, ComSystemTemplateSystemSignalRef=OBJ_ACCELERATION_LAT_ERR_019
            OBJ_ACCELERATION_LONG_019_oRDR_TRACKER_OBJ_019_oPCAN_RADAR_2e9bd628_Tx: ComBitPosition=193, ComBitSize=10, ComSignalType=UINT16, ComSystemTemplateSystemSignalRef=OBJ_ACCELERATION_LONG_019
            OBJ_ACCELERATION_LONG_ERR_019_oRDR_TRACKER_OBJ_019_oPCAN_RADAR_963a10dc_Tx: ComBitPosition=215, ComBitSize=8, ComSignalType=UINT8, ComSystemTemplateSystemSignalRef=OBJ_ACCELERATION_LONG_ERR_019
            OBJ_ACCEL_ERR_CRR_COEF_019_oRDR_TRACKER_OBJ_019_oPCAN_RADAR_369931ba_Tx: ComBitPosition=431, ComBitSize=8, ComSignalType=UINT8, ComSystemTemplateSystemSignalRef=OBJ_ACCEL_ERR_CRR_COEF_019
            OBJ_ALIVE_TIME_019_oRDR_TRACKER_OBJ_019_oPCAN_RADAR_4efa9d94_Tx: ComBitPosition=255, ComBitSize=16, ComSignalType=UINT16, ComSystemTemplateSystemSignalRef=OBJ_ALIVE_TIME_019
            OBJ_CLS_TYPE1_019_oRDR_TRACKER_OBJ_019_oPCAN_RADAR_d9217cb2_Tx: ComBitPosition=271, ComBitSize=4, ComSignalType=UINT8, ComSystemTemplateSystemSignalRef=OBJ_CLS_TYPE1_019
            OBJ_CLS_TYPE1_PROB_019_oRDR_TRACKER_OBJ_019_oPCAN_RADAR_7179ab41_Tx: ComBitPosition=303, ComBitSize=8, ComSignalType=UINT8, ComSystemTemplateSystemSignalRef=OBJ_CLS_TYPE1_PROB_019
            OBJ_CLS_TYPE2_019_oRDR_TRACKER_OBJ_019_oPCAN_RADAR_94c97cd5_Tx: ComBitPosition=267, ComBitSize=4, ComSignalType=UINT8, ComSystemTemplateSystemSignalRef=OBJ_CLS_TYPE2_019
            OBJ_CLS_TYPE2_PROB_019_oRDR_TRACKER_OBJ_019_oPCAN_RADAR_b84db04c_Tx: ComBitPosition=311, ComBitSize=8, ComSignalType=UINT8, ComSystemTemplateSystemSignalRef=OBJ_CLS_TYPE2_PROB_019
            OBJ_CLS_TYPE3_019_oRDR_TRACKER_OBJ_019_oPCAN_RADAR_19418137_Tx: ComBitPosition=279, ComBitSize=4, ComSignalType=UINT8, ComSystemTemplateSystemSignalRef=OBJ_CLS_TYPE3_019
            OBJ_CLS_TYPE3_PROB_019_oRDR_TRACKER_OBJ_019_oPCAN_RADAR_ff5e46b7_Tx: ComBitPosition=319, ComBitSize=8, ComSignalType=UINT8, ComSystemTemplateSystemSignalRef=OBJ_CLS_TYPE3_PROB_019
            OBJ_CLS_TYPE4_019_oRDR_TRACKER_OBJ_019_oPCAN_RADAR_0f197c1b_Tx: ComBitPosition=275, ComBitSize=4, ComSignalType=UINT8, ComSystemTemplateSystemSignalRef=OBJ_CLS_TYPE4_019
            OBJ_CLS_TYPE4_PROB_019_oRDR_TRACKER_OBJ_019_oPCAN_RADAR_f1548017_Tx: ComBitPosition=327, ComBitSize=8, ComSignalType=UINT8, ComSystemTemplateSystemSignalRef=OBJ_CLS_TYPE4_PROB_019
            OBJ_CLS_TYPE5_019_oRDR_TRACKER_OBJ_019_oPCAN_RADAR_829181f9_Tx: ComBitPosition=287, ComBitSize=4, ComSignalType=UINT8, ComSystemTemplateSystemSignalRef=OBJ_CLS_TYPE5_019
            OBJ_CLS_TYPE5_PROB_019_oRDR_TRACKER_OBJ_019_oPCAN_RADAR_b64776ec_Tx: ComBitPosition=335, ComBitSize=8, ComSignalType=UINT8, ComSystemTemplateSystemSignalRef=OBJ_CLS_TYPE5_PROB_019
            OBJ_CLS_TYPE6_019_oRDR_TRACKER_OBJ_019_oPCAN_RADAR_cf79819e_Tx: ComBitPosition=282, ComBitSize=4, ComSignalType=UINT8, ComSystemTemplateSystemSignalRef=OBJ_CLS_TYPE6_019
            OBJ_CLS_TYPE6_PROB_019_oRDR_TRACKER_OBJ_019_oPCAN_RADAR_7f736de1_Tx: ComBitPosition=343, ComBitSize=8, ComSignalType=UINT8, ComSystemTemplateSystemSignalRef=OBJ_CLS_TYPE6_PROB_019
            OBJ_DIMENSION_LENGTH_019_oRDR_TRACKER_OBJ_019_oPCAN_RADAR_9bbf2ff6_Tx: ComBitPosition=37, ComBitSize=12, ComSignalType=UINT16, ComSystemTemplateSystemSignalRef=OBJ_DIMENSION_LENGTH_019
            OBJ_DIMENSION_LENGTH_ERR_019_oRDR_TRACKER_OBJ_019_oPCAN_RADAR_a047308c_Tx: ComBitPosition=41, ComBitSize=10, ComSignalType=UINT16, ComSystemTemplateSystemSignalRef=OBJ_DIMENSION_LENGTH_ERR_019
            OBJ_DIMENSION_WIDTH_019_oRDR_TRACKER_OBJ_019_oPCAN_RADAR_b871d85b_Tx: ComBitPosition=17, ComBitSize=10, ComSignalType=UINT16, ComSystemTemplateSystemSignalRef=OBJ_DIMENSION_WIDTH_019
            OBJ_DIMENSION_WIDTH_ERR_019_oRDR_TRACKER_OBJ_019_oPCAN_RADAR_58d31fb3_Tx: ComBitPosition=23, ComBitSize=6, ComSignalType=UINT8, ComSystemTemplateSystemSignalRef=OBJ_DIMENSION_WIDTH_ERR_019
            OBJ_EXISTENCE_PROB_019_oRDR_TRACKER_OBJ_019_oPCAN_RADAR_b3cd5c66_Tx: ComBitPosition=229, ComBitSize=14, ComSignalType=UINT16, ComSystemTemplateSystemSignalRef=OBJ_EXISTENCE_PROB_019
            OBJ_GROUP_ID_019_oRDR_TRACKER_OBJ_019_oPCAN_RADAR_3abf48cb_Tx: ComBitPosition=405, ComBitSize=6, ComSignalType=UINT8, ComSystemTemplateSystemSignalRef=OBJ_GROUP_ID_019
            OBJ_ID_019_oRDR_TRACKER_OBJ_019_oPCAN_RADAR_c99163cc_Tx: ComBitPosition=7, ComBitSize=8, ComSignalType=UINT8, ComSystemTemplateSystemSignalRef=OBJ_ID_019
            OBJ_MEASUREMENT_STATUS_019_oRDR_TRACKER_OBJ_019_oPCAN_RADAR_b6431171_Tx: ComBitPosition=14, ComBitSize=3, ComSignalType=UINT8, ComSystemTemplateSystemSignalRef=OBJ_MEASUREMENT_STATUS_019
            OBJ_MH_CRC16_019_oRDR_TRACKER_OBJ_019_oPCAN_RADAR_ca23a64d_Tx: ComBitPosition=495, ComBitSize=16, ComSignalType=UINT16, ComSystemTemplateSystemSignalRef=OBJ_MH_CRC16_019
            OBJ_MH_CYCLE_COUNTER_019_oRDR_TRACKER_OBJ_019_oPCAN_RADAR_bbc7fcac_Tx: ComBitPosition=487, ComBitSize=8, ComSignalType=UINT8, ComSystemTemplateSystemSignalRef=OBJ_MH_CYCLE_COUNTER_019
            OBJ_MOVEMENT_STATUS_019_oRDR_TRACKER_OBJ_019_oPCAN_RADAR_99ed843d_Tx: ComBitPosition=196, ComBitSize=3, ComSignalType=UINT8, ComSystemTemplateSystemSignalRef=OBJ_MOVEMENT_STATUS_019
            OBJ_POS_ERR_CRR_COEF_019_oRDR_TRACKER_OBJ_019_oPCAN_RADAR_09924407_Tx: ComBitPosition=415, ComBitSize=8, ComSignalType=UINT8, ComSystemTemplateSystemSignalRef=OBJ_POS_ERR_CRR_COEF_019
            OBJ_POS_LAT_019_oRDR_TRACKER_OBJ_019_oPCAN_RADAR_eb3db94b_Tx: ComBitPosition=79, ComBitSize=16, ComSignalType=UINT16, ComSystemTemplateSystemSignalRef=OBJ_POS_LAT_019
            OBJ_POS_LAT_ERR_019_oRDR_TRACKER_OBJ_019_oPCAN_RADAR_ef71e97c_Tx: ComBitPosition=103, ComBitSize=8, ComSignalType=UINT8, ComSystemTemplateSystemSignalRef=OBJ_POS_LAT_ERR_019
            OBJ_POS_LONG_019_oRDR_TRACKER_OBJ_019_oPCAN_RADAR_5a9d5284_Tx: ComBitPosition=63, ComBitSize=16, ComSignalType=UINT16, ComSystemTemplateSystemSignalRef=OBJ_POS_LONG_019
            OBJ_POS_LONG_ERR_019_oRDR_TRACKER_OBJ_019_oPCAN_RADAR_7689179e_Tx: ComBitPosition=95, ComBitSize=8, ComSignalType=UINT8, ComSystemTemplateSystemSignalRef=OBJ_POS_LONG_ERR_019
            OBJ_RCS_019_oRDR_TRACKER_OBJ_019_oPCAN_RADAR_c9f2ef4c_Tx: ComBitPosition=351, ComBitSize=7, ComSignalType=UINT8, ComSystemTemplateSystemSignalRef=OBJ_RCS_019
            OBJ_REF_PT_LAT_OFFSET_019_oRDR_TRACKER_OBJ_019_oPCAN_RADAR_3ccf8439_Tx: ComBitPosition=370, ComBitSize=14, ComSignalType=UINT16, ComSystemTemplateSystemSignalRef=OBJ_REF_PT_LAT_OFFSET_019
            OBJ_REF_PT_LONG_OFFSET_019_oRDR_TRACKER_OBJ_019_oPCAN_RADAR_739d743a_Tx: ComBitPosition=357, ComBitSize=14, ComSignalType=UINT16, ComSystemTemplateSystemSignalRef=OBJ_REF_PT_LONG_OFFSET_019
            OBJ_TIMESTAMP_OFFSET_019_oRDR_TRACKER_OBJ_019_oPCAN_RADAR_c95eef1a_Tx: ComBitPosition=247, ComBitSize=8, ComSignalType=UINT8, ComSystemTemplateSystemSignalRef=OBJ_TIMESTAMP_OFFSET_019
            OBJ_TRACK_MOTION_MODEL_019_oRDR_TRACKER_OBJ_019_oPCAN_RADAR_055deec7_Tx: ComBitPosition=9, ComBitSize=2, ComSignalType=UINT8, ComSystemTemplateSystemSignalRef=OBJ_TRACK_MOTION_MODEL_019
            OBJ_VEH_TRACK_FLAG_019_oRDR_TRACKER_OBJ_019_oPCAN_RADAR_8777189a_Tx: ComBitPosition=10, ComBitSize=1, ComSignalType=BOOLEAN, ComSystemTemplateSystemSignalRef=OBJ_VEH_TRACK_FLAG_019
            OBJ_VELOCITY_ERR_CRR_COEF_019_oRDR_TRACKER_OBJ_019_oPCAN_RADAR_a0e879e6_Tx: ComBitPosition=423, ComBitSize=8, ComSignalType=UINT8, ComSystemTemplateSystemSignalRef=OBJ_VELOCITY_ERR_CRR_COEF_019
            OBJ_VELOCITY_LAT_019_oRDR_TRACKER_OBJ_019_oPCAN_RADAR_af5efc6c_Tx: ComBitPosition=126, ComBitSize=15, ComSignalType=UINT16, ComSystemTemplateSystemSignalRef=OBJ_VELOCITY_LAT_019
            OBJ_VELOCITY_LAT_ERR_019_oRDR_TRACKER_OBJ_019_oPCAN_RADAR_9ba48c3d_Tx: ComBitPosition=151, ComBitSize=8, ComSignalType=UINT8, ComSystemTemplateSystemSignalRef=OBJ_VELOCITY_LAT_ERR_019
            OBJ_VELOCITY_LONG_019_oRDR_TRACKER_OBJ_019_oPCAN_RADAR_ffd384aa_Tx: ComBitPosition=110, ComBitSize=15, ComSignalType=UINT16, ComSystemTemplateSystemSignalRef=OBJ_VELOCITY_LONG_019
            OBJ_VELOCITY_LONG_ERR_019_oRDR_TRACKER_OBJ_019_oPCAN_RADAR_7726b3fd_Tx: ComBitPosition=143, ComBitSize=8, ComSignalType=UINT8, ComSystemTemplateSystemSignalRef=OBJ_VELOCITY_LONG_ERR_019
            OBJ_YAW_ANGLE_019_oRDR_TRACKER_OBJ_019_oPCAN_RADAR_43e2b82c_Tx: ComBitPosition=155, ComBitSize=12, ComSignalType=UINT16, ComSystemTemplateSystemSignalRef=OBJ_YAW_ANGLE_019
            OBJ_YAW_ANGLE_ERR_019_oRDR_TRACKER_OBJ_019_oPCAN_RADAR_96efbefb_Tx: ComBitPosition=175, ComBitSize=7, ComSignalType=UINT8, ComSystemTemplateSystemSignalRef=OBJ_YAW_ANGLE_ERR_019
            OBJ_YAW_RATE_019_oRDR_TRACKER_OBJ_019_oPCAN_RADAR_666d9d6b_Tx: ComBitPosition=399, ComBitSize=10, ComSignalType=UINT16, ComSystemTemplateSystemSignalRef=OBJ_YAW_RATE_019
            OBJ_YAW_RATE_ERR_019_oRDR_TRACKER_OBJ_019_oPCAN_RADAR_59b50ab7_Tx: ComBitPosition=388, ComBitSize=5, ComSignalType=UINT8, ComSystemTemplateSystemSignalRef=OBJ_YAW_RATE_ERR_019
