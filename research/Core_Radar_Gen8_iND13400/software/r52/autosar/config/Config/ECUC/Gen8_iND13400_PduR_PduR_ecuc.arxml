[part 1 of 4: package /ActiveEcuC]
AUTOSAR XML (schema 00053)
package /ActiveEcuC
  module config PduR: implementation-config-variant=VARIANT-POST-BUILD-SELECTABLE, module-description=PduR_Impl
    PduRGeneral:
      PduRDevErrorDetect = true
      PduRVersionInfoApi = false
      PduRMetaDataSupport = false
      PduRPduCallback = false
      PduRSafeBswChecks = true
      PduREnableDeferredTransmission = false
      PduREnableDeferredReception = false
      PduRSupportMulticore = false
      PduRRoutingTypeGateway = true
      PduRSpinlockRetryCounter = 4294967295
      PduRExtendedErrorChecks = false
      PduRGeneration:
        PduROutOfBoundsWriteProtectionStrategy = NONE
        PduROutOfBoundsWriteSanitizer = false
        PduROutOfBoundsReadSanitizer = false
        PduRNumericalDataTypeMinimizationStrategy = WITH_CAST
        PduRReduceConstantData2Define = false
        PduRBoolDataInArrayOfStructStrategy = BITMASKING
        PduRDeduplicateIndirectedData = true
        PduRDataDeduplicationStrategy = WITH_CAST
        PduRReduceBoolDataByNegationThreshold = 2
        PduRReduceBoolDataByNumericalComparisonThreshold = 2
        PduRReduceBoolDataByNumericalRelationThreshold = 2
        PduRReduceBoolDataByNumericalOperandStrategy = WITH_ANY_VALUE
        PduRReduceNumericalDataByOffsetThreshold = 2
        PduRReduceNumericalDataByArraySubtractionThreshold = 2
        PduRReduceDataByStreaming = false
        PduRShortSymbols = false
        PduRInterfacesForDeactivatedData = false
        PduRReferringKeysInComments = false
        PduREnableAdditionalRAMDebugData = false
    PduRRoutingTables: PduRConfigurationId=0
      PduRRoutingTable
        305 x PduRRoutingPath, all with PduRMulticoreRoutingPath=false:
          SYS_VEHICLE_STATUS_oPCAN_RADAR_9bbcdf4b_Rx: PduRRoutingPathCommunicationType=COMMUNICATION_INTERFACE, PduRLockRef=PduRLock_PduRExclusiveArea
            PduRSrcPdu_fe2e3497 (PduRSrcPdu): PduRSourcePduHandleId=81, PduRSrcPduDirection=RECEIVE, PduRSrcPduRef=SYS_VEHICLE_STATUS_oPCAN_RADAR_9bbcdf4b_Rx, PduRSrcPduPduRBswModulesRef=CanIf
            SYS_VEHICLE_STATUS_oPCAN_RADAR_9bbcdf4b_Rx_fe2e3497_Rx (PduRDestPdu):
              PduRDestPduHandleId = 58
              PduRDestPduDirection = RECEIVE
              PduRDestPduRoutingType = API_FORWARDING
              PduRDestPduDataProcessing = IMMEDIATE
              PduRPduLengthHandlingStrategy = IGNORE
              PduRDestPduCrossPartitionDestination = false
              PduRTransmissionConfirmation = false
              PduRDestPduRef = SYS_VEHICLE_STATUS_oPCAN_RADAR_43e5dd0e_Rx
              PduRDestPduPduRBswModulesRef = Com
          RDR_TRACKER_OBJ_004_oPCAN_RADAR_33a84845_Tx: PduRRoutingPathCommunicationType=COMMUNICATION_INTERFACE, PduRLockRef=PduRLock_PduRExclusiveArea
            PduRSrcPdu_df2f5c14 (PduRSrcPdu):
              PduRSourcePduHandleId = 127
              PduRSrcPduDirection = TRANSMIT
              PduRSrcPduRef = RDR_TRACKER_OBJ_004_oPCAN_RADAR_33a84845_Tx
              PduRSrcPduPduRBswModulesRef = Com
            RDR_TRACKER_OBJ_004_oPCAN_RADAR_067dfb3d_Tx (PduRDestPdu):
              PduRDestPduHandleId = 129
              PduRDestPduDirection = TRANSMIT
              PduRDestPduRoutingType = API_FORWARDING
              PduRDestPduDataProcessing = IMMEDIATE
              PduRPduLengthHandlingStrategy = IGNORE
              PduRDestPduCrossPartitionDestination = false
              PduRDestPduDataProvision = PDUR_DIRECT
              PduRTransmissionConfirmation = false
              PduRDestPduRef = RDR_TRACKER_OBJ_004_oPCAN_RADAR_067dfb3d_Tx
              PduRDestPduPduRBswModulesRef = CanIf
          RDR_TRACKER_OBJ_058_oPCAN_RADAR_2db19fd3_Tx: PduRRoutingPathCommunicationType=COMMUNICATION_INTERFACE, PduRLockRef=PduRLock_PduRExclusiveArea
            PduRSrcPdu_33bf485e (PduRSrcPdu):
              PduRSourcePduHandleId = 181
              PduRSrcPduDirection = TRANSMIT
              PduRSrcPduRef = RDR_TRACKER_OBJ_058_oPCAN_RADAR_2db19fd3_Tx
              PduRSrcPduPduRBswModulesRef = Com
            RDR_TRACKER_OBJ_058_oPCAN_RADAR_07d92cc6_Tx (PduRDestPdu):
              PduRDestPduHandleId = 183
              PduRDestPduDirection = TRANSMIT
              PduRDestPduRoutingType = API_FORWARDING
              PduRDestPduDataProcessing = IMMEDIATE
              PduRPduLengthHandlingStrategy = IGNORE
              PduRDestPduCrossPartitionDestination = false
              PduRTransmissionConfirmation = false
              PduRDestPduDataProvision = PDUR_DIRECT
              PduRDestPduRef = RDR_TRACKER_OBJ_058_oPCAN_RADAR_07d92cc6_Tx
              PduRDestPduPduRBswModulesRef = CanIf
          RDR_DETECTION_085_088_oPCAN_RADAR_7df82e4e_Tx: PduRRoutingPathCommunicationType=COMMUNICATION_INTERFACE, PduRLockRef=PduRLock_PduRExclusiveArea
            PduRSrcPdu_b83eb6bf (PduRSrcPdu):
              PduRSourcePduHandleId = 40
              PduRSrcPduDirection = TRANSMIT
              PduRSrcPduRef = RDR_DETECTION_085_088_oPCAN_RADAR_7df82e4e_Tx
              PduRSrcPduPduRBswModulesRef = Com
            RDR_DETECTION_085_088_oPCAN_RADAR_4a134070_Tx (PduRDestPdu):
              PduRDestPduHandleId = 42
              PduRDestPduDirection = TRANSMIT
              PduRDestPduRoutingType = API_FORWARDING
              PduRDestPduDataProcessing = IMMEDIATE
              PduRPduLengthHandlingStrategy = IGNORE
              PduRDestPduCrossPartitionDestination = false
              PduRTransmissionConfirmation = false
              PduRDestPduDataProvision = PDUR_DIRECT
              PduRDestPduRef = RDR_DETECTION_085_088_oPCAN_RADAR_4a134070_Tx
              PduRDestPduPduRBswModulesRef = CanIf
          RDR_DETECTION_121_124_oPCAN_RADAR_3ae1f4de_Tx: PduRRoutingPathCommunicationType=COMMUNICATION_INTERFACE, PduRLockRef=PduRLock_PduRExclusiveArea
            PduRSrcPdu_00300665 (PduRSrcPdu):
              PduRSourcePduHandleId = 49
              PduRSrcPduDirection = TRANSMIT
              PduRSrcPduRef = RDR_DETECTION_121_124_oPCAN_RADAR_3ae1f4de_Tx
              PduRSrcPduPduRBswModulesRef = Com
            RDR_DETECTION_121_124_oPCAN_RADAR_d31ee235_Tx (PduRDestPdu):
              PduRDestPduHandleId = 51
              PduRDestPduDirection = TRANSMIT
              PduRDestPduRoutingType = API_FORWARDING
              PduRDestPduDataProcessing = IMMEDIATE
              PduRPduLengthHandlingStrategy = IGNORE
              PduRDestPduCrossPartitionDestination = false
              PduRTransmissionConfirmation = false
              PduRDestPduDataProvision = PDUR_DIRECT
              PduRDestPduRef = RDR_DETECTION_121_124_oPCAN_RADAR_d31ee235_Tx
              PduRDestPduPduRBswModulesRef = CanIf
          RDR_DETECTION_281_284_oPCAN_RADAR_4878071a_Tx: PduRRoutingPathCommunicationType=COMMUNICATION_INTERFACE, PduRLockRef=PduRLock_PduRExclusiveArea
            RDR_DETECTION_281_284_oPCAN_RADAR_4a30ea59_Tx (PduRDestPdu):
              PduRDestPduHandleId = 91
              PduRDestPduDirection = TRANSMIT
              PduRDestPduRoutingType = API_FORWARDING
              PduRDestPduDataProcessing = IMMEDIATE
              PduRPduLengthHandlingStrategy = IGNORE
              PduRDestPduCrossPartitionDestination = false
              PduRTransmissionConfirmation = false
              PduRDestPduDataProvision = PDUR_DIRECT
              PduRDestPduRef = RDR_DETECTION_281_284_oPCAN_RADAR_4a30ea59_Tx
              PduRDestPduPduRBswModulesRef = CanIf
            PduRSrcPdu_36891f02 (PduRSrcPdu):
              PduRSourcePduHandleId = 89
              PduRSrcPduDirection = TRANSMIT
              PduRSrcPduRef = RDR_DETECTION_281_284_oPCAN_RADAR_4878071a_Tx
              PduRSrcPduPduRBswModulesRef = Com
          RDR_TRACKER_OBJ_063_oPCAN_RADAR_b61905ab_Tx: PduRRoutingPathCommunicationType=COMMUNICATION_INTERFACE, PduRLockRef=PduRLock_PduRExclusiveArea
            RDR_TRACKER_OBJ_063_oPCAN_RADAR_5dadef50_Tx (PduRDestPdu):
              PduRDestPduHandleId = 188
              PduRDestPduDirection = TRANSMIT
              PduRDestPduRoutingType = API_FORWARDING
              PduRDestPduDataProcessing = IMMEDIATE
              PduRPduLengthHandlingStrategy = IGNORE
              PduRDestPduCrossPartitionDestination = false
              PduRTransmissionConfirmation = false
              PduRDestPduDataProvision = PDUR_DIRECT
              PduRDestPduRef = RDR_TRACKER_OBJ_063_oPCAN_RADAR_5dadef50_Tx
              PduRDestPduPduRBswModulesRef = CanIf
            PduRSrcPdu_21b8b528 (PduRSrcPdu):
              PduRSourcePduHandleId = 186
              PduRSrcPduDirection = TRANSMIT
              PduRSrcPduRef = RDR_TRACKER_OBJ_063_oPCAN_RADAR_b61905ab_Tx
              PduRSrcPduPduRBswModulesRef = Com
          RDR_DETECTION_189_192_oPCAN_RADAR_21a99aff_Tx: PduRRoutingPathCommunicationType=COMMUNICATION_INTERFACE, PduRLockRef=PduRLock_PduRExclusiveArea
            PduRSrcPdu_35c65891 (PduRSrcPdu):
              PduRSourcePduHandleId = 66
              PduRSrcPduDirection = TRANSMIT
              PduRSrcPduRef = RDR_DETECTION_189_192_oPCAN_RADAR_21a99aff_Tx
              PduRSrcPduPduRBswModulesRef = Com
            RDR_DETECTION_189_192_oPCAN_RADAR_5c7356d9_Tx (PduRDestPdu):
              PduRDestPduHandleId = 68
              PduRDestPduDirection = TRANSMIT
              PduRDestPduRoutingType = API_FORWARDING
              PduRDestPduDataProcessing = IMMEDIATE
              PduRPduLengthHandlingStrategy = IGNORE
              PduRDestPduCrossPartitionDestination = false
              PduRTransmissionConfirmation = false
              PduRDestPduDataProvision = PDUR_DIRECT
              PduRDestPduRef = RDR_DETECTION_189_192_oPCAN_RADAR_5c7356d9_Tx
              PduRDestPduPduRBswModulesRef = CanIf
          RDR_DETECTION_289_292_oPCAN_RADAR_9382762f_Tx: PduRRoutingPathCommunicationType=COMMUNICATION_INTERFACE, PduRLockRef=PduRLock_PduRExclusiveArea
            PduRSrcPdu_bd12da3a (PduRSrcPdu):
              PduRSourcePduHandleId = 91
              PduRSrcPduDirection = TRANSMIT
              PduRSrcPduRef = RDR_DETECTION_289_292_oPCAN_RADAR_9382762f_Tx
              PduRSrcPduPduRBswModulesRef = Com
            RDR_DETECTION_289_292_oPCAN_RADAR_043b743b_Tx (PduRDestPdu):
              PduRDestPduHandleId = 93
              PduRDestPduDirection = TRANSMIT
              PduRDestPduRoutingType = API_FORWARDING
              PduRDestPduDataProcessing = IMMEDIATE
              PduRPduLengthHandlingStrategy = IGNORE
              PduRDestPduCrossPartitionDestination = false
              PduRTransmissionConfirmation = false
              PduRDestPduDataProvision = PDUR_DIRECT
              PduRDestPduRef = RDR_DETECTION_289_292_oPCAN_RADAR_043b743b_Tx
              PduRDestPduPduRBswModulesRef = CanIf
          RDR_TRACKER_OBJ_037_oPCAN_RADAR_f2030150_Tx: PduRRoutingPathCommunicationType=COMMUNICATION_INTERFACE, PduRLockRef=PduRLock_PduRExclusiveArea
            RDR_TRACKER_OBJ_037_oPCAN_RADAR_30ecb972_Tx (PduRDestPdu):
              PduRDestPduHandleId = 162
              PduRDestPduDirection = TRANSMIT
              PduRDestPduRoutingType = API_FORWARDING
              PduRDestPduDataProcessing = IMMEDIATE
              PduRPduLengthHandlingStrategy = IGNORE
              PduRDestPduCrossPartitionDestination = false
              PduRTransmissionConfirmation = false
              PduRDestPduDataProvision = PDUR_DIRECT
              PduRDestPduRef = RDR_TRACKER_OBJ_037_oPCAN_RADAR_30ecb972_Tx
              PduRDestPduPduRBswModulesRef = CanIf
            PduRSrcPdu_1f03f8dd (PduRSrcPdu):
              PduRSourcePduHandleId = 160
              PduRSrcPduDirection = TRANSMIT
              PduRSrcPduRef = RDR_TRACKER_OBJ_037_oPCAN_RADAR_f2030150_Tx
              PduRSrcPduPduRBswModulesRef = Com
          RDR_DETECTION_285_288_oPCAN_RADAR_a1ca992e_Tx: PduRRoutingPathCommunicationType=COMMUNICATION_INTERFACE, PduRLockRef=PduRLock_PduRExclusiveArea
            RDR_DETECTION_285_288_oPCAN_RADAR_934c7ef3_Tx (PduRDestPdu):
              PduRDestPduHandleId = 92
              PduRDestPduDirection = TRANSMIT
              PduRDestPduRoutingType = API_FORWARDING
              PduRDestPduDataProcessing = IMMEDIATE
              PduRPduLengthHandlingStrategy = IGNORE
              PduRDestPduCrossPartitionDestination = false
              PduRTransmissionConfirmation = false
              PduRDestPduDataProvision = PDUR_DIRECT
              PduRDestPduRef = RDR_DETECTION_285_288_oPCAN_RADAR_934c7ef3_Tx
              PduRDestPduPduRBswModulesRef = CanIf
            PduRSrcPdu_412acf80 (PduRSrcPdu):
              PduRSourcePduHandleId = 90
              PduRSrcPduDirection = TRANSMIT
              PduRSrcPduRef = RDR_DETECTION_285_288_oPCAN_RADAR_a1ca992e_Tx
              PduRSrcPduPduRBswModulesRef = Com
          RDR_DETECTION_097_100_oPCAN_RADAR_96371edb_Tx: PduRRoutingPathCommunicationType=COMMUNICATION_INTERFACE, PduRLockRef=PduRLock_PduRExclusiveArea
            PduRSrcPdu_cfa1c4bc (PduRSrcPdu):
              PduRSourcePduHandleId = 43
              PduRSrcPduDirection = TRANSMIT
              PduRSrcPduRef = RDR_DETECTION_097_100_oPCAN_RADAR_96371edb_Tx
              PduRSrcPduPduRBswModulesRef = Com
            RDR_DETECTION_097_100_oPCAN_RADAR_41128c0d_Tx (PduRDestPdu):
              PduRDestPduHandleId = 45
              PduRDestPduDirection = TRANSMIT
              PduRDestPduRoutingType = API_FORWARDING
              PduRDestPduDataProcessing = IMMEDIATE
              PduRPduLengthHandlingStrategy = IGNORE
              PduRDestPduCrossPartitionDestination = false
              PduRTransmissionConfirmation = false
              PduRDestPduDataProvision = PDUR_DIRECT
              PduRDestPduRef = RDR_DETECTION_097_100_oPCAN_RADAR_41128c0d_Tx
              PduRDestPduPduRBswModulesRef = CanIf
          RDR_DETECTION_137_140_oPCAN_RADAR_4afcd417_Tx: PduRRoutingPathCommunicationType=COMMUNICATION_INTERFACE, PduRLockRef=PduRLock_PduRExclusiveArea
            RDR_DETECTION_137_140_oPCAN_RADAR_ea93c46f_Tx (PduRDestPdu):
              PduRDestPduHandleId = 55
              PduRDestPduDirection = TRANSMIT
              PduRDestPduRoutingType = API_FORWARDING
              PduRDestPduDataProcessing = IMMEDIATE
              PduRPduLengthHandlingStrategy = IGNORE
              PduRDestPduCrossPartitionDestination = false
              PduRTransmissionConfirmation = false
              PduRDestPduDataProvision = PDUR_DIRECT
              PduRDestPduRef = RDR_DETECTION_137_140_oPCAN_RADAR_ea93c46f_Tx
              PduRDestPduPduRBswModulesRef = CanIf
            PduRSrcPdu_688fe9f8 (PduRSrcPdu):
              PduRSourcePduHandleId = 53
              PduRSrcPduDirection = TRANSMIT
              PduRSrcPduRef = RDR_DETECTION_137_140_oPCAN_RADAR_4afcd417_Tx
              PduRSrcPduPduRBswModulesRef = Com
          RDR_TRACKER_OBJ_020_oPCAN_RADAR_127fe67e_Tx: PduRRoutingPathCommunicationType=COMMUNICATION_INTERFACE, PduRLockRef=PduRLock_PduRExclusiveArea
            RDR_TRACKER_OBJ_020_oPCAN_RADAR_94b31a9d_Tx (PduRDestPdu):
              PduRDestPduHandleId = 145
              PduRDestPduDirection = TRANSMIT
              PduRDestPduRoutingType = API_FORWARDING
              PduRDestPduDataProcessing = IMMEDIATE
              PduRPduLengthHandlingStrategy = IGNORE
              PduRDestPduCrossPartitionDestination = false
              PduRTransmissionConfirmation = false
              PduRDestPduDataProvision = PDUR_DIRECT
              PduRDestPduRef = RDR_TRACKER_OBJ_020_oPCAN_RADAR_94b31a9d_Tx
              PduRDestPduPduRBswModulesRef = CanIf
            PduRSrcPdu_f497a076 (PduRSrcPdu):
              PduRSourcePduHandleId = 143
              PduRSrcPduDirection = TRANSMIT
              PduRSrcPduRef = RDR_TRACKER_OBJ_020_oPCAN_RADAR_127fe67e_Tx
              PduRSrcPduPduRBswModulesRef = Com
          RDR_TRACKER_OBJ_033_oPCAN_RADAR_32ba6bc6_Tx: PduRRoutingPathCommunicationType=COMMUNICATION_INTERFACE, PduRLockRef=PduRLock_PduRExclusiveArea
            PduRSrcPdu_dd0274df (PduRSrcPdu):
              PduRSourcePduHandleId = 156
              PduRSrcPduDirection = TRANSMIT
              PduRSrcPduRef = RDR_TRACKER_OBJ_033_oPCAN_RADAR_32ba6bc6_Tx
              PduRSrcPduPduRBswModulesRef = Com
            RDR_TRACKER_OBJ_033_oPCAN_RADAR_eb26fabe_Tx (PduRDestPdu):
              PduRDestPduHandleId = 158
              PduRDestPduDirection = TRANSMIT
              PduRDestPduRoutingType = API_FORWARDING
              PduRDestPduDataProcessing = IMMEDIATE
              PduRPduLengthHandlingStrategy = IGNORE
              PduRDestPduCrossPartitionDestination = false
              PduRTransmissionConfirmation = false
              PduRDestPduDataProvision = PDUR_DIRECT
              PduRDestPduRef = RDR_TRACKER_OBJ_033_oPCAN_RADAR_eb26fabe_Tx
              PduRDestPduPduRBswModulesRef = CanIf
          RDR_DETECTION_161_164_oPCAN_RADAR_28e5acc3_Tx: PduRRoutingPathCommunicationType=COMMUNICATION_INTERFACE, PduRLockRef=PduRLock_PduRExclusiveArea
            RDR_DETECTION_161_164_oPCAN_RADAR_1aa75ba6_Tx (PduRDestPdu):
              PduRDestPduHandleId = 61
              PduRDestPduDirection = TRANSMIT
              PduRDestPduRoutingType = API_FORWARDING
              PduRDestPduDataProcessing = IMMEDIATE
              PduRPduLengthHandlingStrategy = IGNORE
              PduRDestPduCrossPartitionDestination = false
              PduRTransmissionConfirmation = false
              PduRDestPduDataProvision = PDUR_DIRECT
              PduRDestPduRef = RDR_DETECTION_161_164_oPCAN_RADAR_1aa75ba6_Tx
              PduRDestPduPduRBswModulesRef = CanIf
            PduRSrcPdu_5388ea8c (PduRSrcPdu):
              PduRSourcePduHandleId = 59
              PduRSrcPduDirection = TRANSMIT
              PduRSrcPduRef = RDR_DETECTION_161_164_oPCAN_RADAR_28e5acc3_Tx
              PduRSrcPduPduRBswModulesRef = Com
          RDR_TRACKER_OBJ_040_oPCAN_RADAR_eabdadc8_Tx: PduRRoutingPathCommunicationType=COMMUNICATION_INTERFACE, PduRLockRef=PduRLock_PduRExclusiveArea
            PduRSrcPdu_6a10def5 (PduRSrcPdu):
              PduRSourcePduHandleId = 163
              PduRSrcPduDirection = TRANSMIT
              PduRSrcPduRef = RDR_TRACKER_OBJ_040_oPCAN_RADAR_eabdadc8_Tx
              PduRSrcPduPduRBswModulesRef = Com
            RDR_TRACKER_OBJ_040_oPCAN_RADAR_4fbefc29_Tx (PduRDestPdu):
              PduRDestPduHandleId = 165
              PduRDestPduDirection = TRANSMIT
              PduRDestPduRoutingType = API_FORWARDING
              PduRDestPduDataProcessing = IMMEDIATE
              PduRPduLengthHandlingStrategy = IGNORE
              PduRDestPduCrossPartitionDestination = false
              PduRTransmissionConfirmation = false
              PduRDestPduDataProvision = PDUR_DIRECT
              PduRDestPduRef = RDR_TRACKER_OBJ_040_oPCAN_RADAR_4fbefc29_Tx
              PduRDestPduPduRBswModulesRef = CanIf
          RDR_DETECTION_109_112_oPCAN_RADAR_05a12ac5_Tx: PduRRoutingPathCommunicationType=COMMUNICATION_INTERFACE, PduRLockRef=PduRLock_PduRExclusiveArea
            RDR_DETECTION_109_112_oPCAN_RADAR_147123be_Tx (PduRDestPdu):
              PduRDestPduHandleId = 48
              PduRDestPduDirection = TRANSMIT
              PduRDestPduRoutingType = API_FORWARDING
              PduRDestPduDataProcessing = IMMEDIATE
              PduRPduLengthHandlingStrategy = IGNORE
              PduRDestPduCrossPartitionDestination = false
              PduRTransmissionConfirmation = false
              PduRDestPduDataProvision = PDUR_DIRECT
              PduRDestPduRef = RDR_DETECTION_109_112_oPCAN_RADAR_147123be_Tx
              PduRDestPduPduRBswModulesRef = CanIf
            PduRSrcPdu_c9a412e4 (PduRSrcPdu):
              PduRSourcePduHandleId = 46
              PduRSrcPduDirection = TRANSMIT
              PduRSrcPduRef = RDR_DETECTION_109_112_oPCAN_RADAR_05a12ac5_Tx
              PduRSrcPduPduRBswModulesRef = Com
          RDR_TRACKER_OBJ_048_oPCAN_RADAR_b0be7ea5_Tx: PduRRoutingPathCommunicationType=COMMUNICATION_INTERFACE, PduRLockRef=PduRLock_PduRExclusiveArea
            PduRSrcPdu_f6af31bc (PduRSrcPdu):
              PduRSourcePduHandleId = 171
              PduRSrcPduDirection = TRANSMIT
              PduRSrcPduRef = RDR_TRACKER_OBJ_048_oPCAN_RADAR_b0be7ea5_Tx
              PduRSrcPduPduRBswModulesRef = Com
            RDR_TRACKER_OBJ_048_oPCAN_RADAR_235b7df0_Tx (PduRDestPdu):
              PduRDestPduHandleId = 173
              PduRDestPduDirection = TRANSMIT
              PduRDestPduRoutingType = API_FORWARDING
              PduRDestPduDataProcessing = IMMEDIATE
              PduRPduLengthHandlingStrategy = IGNORE
              PduRDestPduCrossPartitionDestination = false
              PduRTransmissionConfirmation = false
              PduRDestPduDataProvision = PDUR_DIRECT
              PduRDestPduRef = RDR_TRACKER_OBJ_048_oPCAN_RADAR_235b7df0_Tx
              PduRDestPduPduRBswModulesRef = CanIf
          RDR_DETECTION_273_276_oPCAN_RADAR_5cf33208_Tx: PduRRoutingPathCommunicationType=COMMUNICATION_INTERFACE, PduRLockRef=PduRLock_PduRExclusiveArea
            RDR_DETECTION_273_276_oPCAN_RADAR_5c91dc09_Tx (PduRDestPdu):
              PduRDestPduHandleId = 89
              PduRDestPduDirection = TRANSMIT
              PduRDestPduRoutingType = API_FORWARDING
              PduRDestPduDataProcessing = IMMEDIATE
              PduRPduLengthHandlingStrategy = IGNORE
              PduRDestPduCrossPartitionDestination = false
              PduRTransmissionConfirmation = false
              PduRDestPduDataProvision = PDUR_DIRECT
              PduRDestPduRef = RDR_DETECTION_273_276_oPCAN_RADAR_5c91dc09_Tx
              PduRDestPduPduRBswModulesRef = CanIf
            PduRSrcPdu_3227631e (PduRSrcPdu):
              PduRSourcePduHandleId = 87
              PduRSrcPduDirection = TRANSMIT
              PduRSrcPduRef = RDR_DETECTION_273_276_oPCAN_RADAR_5cf33208_Tx
              PduRSrcPduPduRBswModulesRef = Com
          RDR_DETECTION_201_204_oPCAN_RADAR_6c70b720_Tx: PduRRoutingPathCommunicationType=COMMUNICATION_INTERFACE, PduRLockRef=PduRLock_PduRExclusiveArea
            PduRSrcPdu_11f019fd (PduRSrcPdu):
              PduRSourcePduHandleId = 69
              PduRSrcPduDirection = TRANSMIT
              PduRSrcPduRef = RDR_DETECTION_201_204_oPCAN_RADAR_6c70b720_Tx
              PduRSrcPduPduRBswModulesRef = Com
            RDR_DETECTION_201_204_oPCAN_RADAR_02329f3e_Tx (PduRDestPdu):
              PduRDestPduHandleId = 71
              PduRDestPduDirection = TRANSMIT
              PduRDestPduRoutingType = API_FORWARDING
              PduRDestPduDataProcessing = IMMEDIATE
              PduRPduLengthHandlingStrategy = IGNORE
              PduRDestPduCrossPartitionDestination = false
              PduRTransmissionConfirmation = false
              PduRDestPduDataProvision = PDUR_DIRECT
              PduRDestPduRef = RDR_DETECTION_201_204_oPCAN_RADAR_02329f3e_Tx
              PduRDestPduPduRBswModulesRef = CanIf
          RDR_TRACKER_OBJ_006_oPCAN_RADAR_53f4fd0e_Tx: PduRRoutingPathCommunicationType=COMMUNICATION_INTERFACE, PduRLockRef=PduRLock_PduRExclusiveArea
            PduRSrcPdu_65b951fc (PduRSrcPdu):
              PduRSourcePduHandleId = 129
              PduRSrcPduDirection = TRANSMIT
              PduRSrcPduRef = RDR_TRACKER_OBJ_006_oPCAN_RADAR_53f4fd0e_Tx
              PduRSrcPduPduRBswModulesRef = Com
            RDR_TRACKER_OBJ_006_oPCAN_RADAR_6b98dadb_Tx (PduRDestPdu):
              PduRDestPduHandleId = 131
              PduRDestPduDirection = TRANSMIT
              PduRDestPduRoutingType = API_FORWARDING
              PduRDestPduDataProcessing = IMMEDIATE
              PduRPduLengthHandlingStrategy = IGNORE
              PduRDestPduCrossPartitionDestination = false
              PduRTransmissionConfirmation = false
              PduRDestPduDataProvision = PDUR_DIRECT
              PduRDestPduRef = RDR_TRACKER_OBJ_006_oPCAN_RADAR_6b98dadb_Tx
              PduRDestPduPduRBswModulesRef = CanIf
          RDR_TRACKER_OBJ_035_oPCAN_RADAR_925fb41b_Tx: PduRRoutingPathCommunicationType=COMMUNICATION_INTERFACE, PduRLockRef=PduRLock_PduRExclusiveArea
            RDR_TRACKER_OBJ_035_oPCAN_RADAR_5d099894_Tx (PduRDestPdu):
              PduRDestPduHandleId = 160
              PduRDestPduDirection = TRANSMIT
              PduRDestPduRoutingType = API_FORWARDING
              PduRDestPduDataProcessing = IMMEDIATE
              PduRPduLengthHandlingStrategy = IGNORE
              PduRDestPduCrossPartitionDestination = false
              PduRTransmissionConfirmation = false
              PduRDestPduDataProvision = PDUR_DIRECT
              PduRDestPduRef = RDR_TRACKER_OBJ_035_oPCAN_RADAR_5d099894_Tx
              PduRDestPduPduRBswModulesRef = CanIf
            PduRSrcPdu_4371474b (PduRSrcPdu):
              PduRSourcePduHandleId = 158
              PduRSrcPduDirection = TRANSMIT
              PduRSrcPduRef = RDR_TRACKER_OBJ_035_oPCAN_RADAR_925fb41b_Tx
              PduRSrcPduPduRBswModulesRef = Com
          RDR_TRACKER_OBJ_024_oPCAN_RADAR_d2c68ce8_Tx: PduRRoutingPathCommunicationType=COMMUNICATION_INTERFACE, PduRLockRef=PduRLock_PduRExclusiveArea
            RDR_TRACKER_OBJ_024_oPCAN_RADAR_4f795951_Tx (PduRDestPdu):
              PduRDestPduHandleId = 149
              PduRDestPduDirection = TRANSMIT
              PduRDestPduRoutingType = API_FORWARDING
              PduRDestPduDataProcessing = IMMEDIATE
              PduRPduLengthHandlingStrategy = IGNORE
              PduRDestPduCrossPartitionDestination = false
              PduRTransmissionConfirmation = false
              PduRDestPduDataProvision = PDUR_DIRECT
              PduRDestPduRef = RDR_TRACKER_OBJ_024_oPCAN_RADAR_4f795951_Tx
              PduRDestPduPduRBswModulesRef = CanIf
            PduRSrcPdu_19ae22b0 (PduRSrcPdu):
              PduRSourcePduHandleId = 147
              PduRSrcPduDirection = TRANSMIT
              PduRSrcPduRef = RDR_TRACKER_OBJ_024_oPCAN_RADAR_d2c68ce8_Tx
              PduRSrcPduPduRBswModulesRef = Com
          RDR_DETECTION_389_392_oPCAN_RADAR_fd9b2d9f_Tx: PduRRoutingPathCommunicationType=COMMUNICATION_INTERFACE, PduRLockRef=PduRLock_PduRExclusiveArea
            RDR_DETECTION_389_392_oPCAN_RADAR_852c685a_Tx (PduRDestPdu):
              PduRDestPduHandleId = 118
              PduRDestPduDirection = TRANSMIT
              PduRDestPduRoutingType = API_FORWARDING
              PduRDestPduDataProcessing = IMMEDIATE
              PduRPduLengthHandlingStrategy = IGNORE
              PduRDestPduCrossPartitionDestination = false
              PduRTransmissionConfirmation = false
              PduRDestPduDataProvision = PDUR_DIRECT
              PduRDestPduRef = RDR_DETECTION_389_392_oPCAN_RADAR_852c685a_Tx
              PduRDestPduPduRBswModulesRef = CanIf
            PduRSrcPdu_4b04cdb6 (PduRSrcPdu):
              PduRSourcePduHandleId = 116
              PduRSrcPduDirection = TRANSMIT
              PduRSrcPduRef = RDR_DETECTION_389_392_oPCAN_RADAR_fd9b2d9f_Tx
              PduRSrcPduPduRBswModulesRef = Com
          RDR_TRACKER_OBJ_059_oPCAN_RADAR_f0274656_Tx: PduRRoutingPathCommunicationType=COMMUNICATION_INTERFACE, PduRLockRef=PduRLock_PduRExclusiveArea
            RDR_TRACKER_OBJ_059_oPCAN_RADAR_312bbc35_Tx (PduRDestPdu):
              PduRDestPduHandleId = 184
              PduRDestPduDirection = TRANSMIT
              PduRDestPduRoutingType = API_FORWARDING
              PduRDestPduDataProcessing = IMMEDIATE
              PduRPduLengthHandlingStrategy = IGNORE
              PduRDestPduCrossPartitionDestination = false
              PduRTransmissionConfirmation = false
              PduRDestPduDataProvision = PDUR_DIRECT
              PduRDestPduRef = RDR_TRACKER_OBJ_059_oPCAN_RADAR_312bbc35_Tx
              PduRDestPduPduRBswModulesRef = CanIf
            PduRSrcPdu_0565674b (PduRSrcPdu):
              PduRSourcePduHandleId = 182
              PduRSrcPduDirection = TRANSMIT
              PduRSrcPduRef = RDR_TRACKER_OBJ_059_oPCAN_RADAR_f0274656_Tx
              PduRSrcPduPduRBswModulesRef = Com
          RDR_DETECTION_145_148_oPCAN_RADAR_25ed9dd9_Tx: PduRRoutingPathCommunicationType=COMMUNICATION_INTERFACE, PduRLockRef=PduRLock_PduRExclusiveArea
            PduRSrcPdu_020b0f9a (PduRSrcPdu):
              PduRSourcePduHandleId = 55
              PduRSrcPduDirection = TRANSMIT
              PduRSrcPduRef = RDR_DETECTION_145_148_oPCAN_RADAR_25ed9dd9_Tx
              PduRSrcPduPduRBswModulesRef = Com
            RDR_DETECTION_145_148_oPCAN_RADAR_4abf90e5_Tx (PduRDestPdu):
              PduRDestPduHandleId = 57
              PduRDestPduDirection = TRANSMIT
              PduRDestPduRoutingType = API_FORWARDING
              PduRDestPduDataProcessing = IMMEDIATE
              PduRPduLengthHandlingStrategy = IGNORE
              PduRDestPduCrossPartitionDestination = false
              PduRTransmissionConfirmation = false
              PduRDestPduDataProvision = PDUR_DIRECT
              PduRDestPduRef = RDR_DETECTION_145_148_oPCAN_RADAR_4abf90e5_Tx
              PduRDestPduPduRBswModulesRef = CanIf
          RDR_TRACKER_OBJ_026_oPCAN_RADAR_b29a39a3_Tx: PduRRoutingPathCommunicationType=COMMUNICATION_INTERFACE, PduRLockRef=PduRLock_PduRExclusiveArea
            PduRSrcPdu_5471a133 (PduRSrcPdu):
              PduRSourcePduHandleId = 149
              PduRSrcPduDirection = TRANSMIT
              PduRSrcPduRef = RDR_TRACKER_OBJ_026_oPCAN_RADAR_b29a39a3_Tx
              PduRSrcPduPduRBswModulesRef = Com
            RDR_TRACKER_OBJ_026_oPCAN_RADAR_229c78b7_Tx (PduRDestPdu):
              PduRDestPduHandleId = 151
              PduRDestPduDirection = TRANSMIT
              PduRDestPduRoutingType = API_FORWARDING
              PduRDestPduDataProcessing = IMMEDIATE
              PduRPduLengthHandlingStrategy = IGNORE
              PduRDestPduCrossPartitionDestination = false
              PduRTransmissionConfirmation = false
              PduRDestPduDataProvision = PDUR_DIRECT
              PduRDestPduRef = RDR_TRACKER_OBJ_026_oPCAN_RADAR_229c78b7_Tx
              PduRDestPduPduRBswModulesRef = CanIf
          RDR_TRACKER_OBJ_008_oPCAN_RADAR_a912f1be_Tx: PduRRoutingPathCommunicationType=COMMUNICATION_INTERFACE, PduRLockRef=PduRLock_PduRExclusiveArea
            PduRSrcPdu_33e0b055 (PduRSrcPdu):
              PduRSourcePduHandleId = 131
              PduRSrcPduDirection = TRANSMIT
              PduRSrcPduRef = RDR_TRACKER_OBJ_008_oPCAN_RADAR_a912f1be_Tx
              PduRSrcPduPduRBswModulesRef = Com
            RDR_TRACKER_OBJ_008_oPCAN_RADAR_b1523928_Tx (PduRDestPdu):
              PduRDestPduHandleId = 133
              PduRDestPduDirection = TRANSMIT
              PduRDestPduRoutingType = API_FORWARDING
              PduRDestPduDataProcessing = IMMEDIATE
              PduRPduLengthHandlingStrategy = IGNORE
              PduRDestPduCrossPartitionDestination = false
              PduRTransmissionConfirmation = false
              PduRDestPduDataProvision = PDUR_DIRECT
              PduRDestPduRef = RDR_TRACKER_OBJ_008_oPCAN_RADAR_b1523928_Tx
              PduRDestPduPduRBswModulesRef = CanIf
          RDR_DETECTION_241_244_oPCAN_RADAR_7e74ef3d_Tx: PduRRoutingPathCommunicationType=COMMUNICATION_INTERFACE, PduRLockRef=PduRLock_PduRExclusiveArea
            PduRSrcPdu_f947f6e7 (PduRSrcPdu):
              PduRSourcePduHandleId = 79
              PduRSrcPduDirection = TRANSMIT
              PduRSrcPduRef = RDR_DETECTION_241_244_oPCAN_RADAR_7e74ef3d_Tx
              PduRSrcPduPduRBswModulesRef = Com
            RDR_DETECTION_241_244_oPCAN_RADAR_cb8b26ad_Tx (PduRDestPdu):
              PduRDestPduHandleId = 81
              PduRDestPduDirection = TRANSMIT
              PduRDestPduRoutingType = API_FORWARDING
              PduRDestPduDataProcessing = IMMEDIATE
              PduRPduLengthHandlingStrategy = IGNORE
              PduRDestPduCrossPartitionDestination = false
              PduRTransmissionConfirmation = false
              PduRDestPduDataProvision = PDUR_DIRECT
              PduRDestPduRef = RDR_DETECTION_241_244_oPCAN_RADAR_cb8b26ad_Tx
              PduRDestPduPduRBswModulesRef = CanIf
          RDR_DETECTION_265_268_oPCAN_RADAR_737cde27_Tx: PduRRoutingPathCommunicationType=COMMUNICATION_INTERFACE, PduRLockRef=PduRLock_PduRExclusiveArea
            PduRSrcPdu_3bc63c33 (PduRSrcPdu):
              PduRSourcePduHandleId = 85
              PduRSrcPduDirection = TRANSMIT
              PduRSrcPduRef = RDR_DETECTION_265_268_oPCAN_RADAR_737cde27_Tx
              PduRSrcPduPduRBswModulesRef = Com
            RDR_DETECTION_265_268_oPCAN_RADAR_9b93edee_Tx (PduRDestPdu):
              PduRDestPduHandleId = 87
              PduRDestPduDirection = TRANSMIT
              PduRDestPduRoutingType = API_FORWARDING
              PduRDestPduDataProcessing = IMMEDIATE
              PduRPduLengthHandlingStrategy = IGNORE
              PduRDestPduCrossPartitionDestination = false
              PduRTransmissionConfirmation = false
              PduRDestPduDataProvision = PDUR_DIRECT
              PduRDestPduRef = RDR_DETECTION_265_268_oPCAN_RADAR_9b93edee_Tx
              PduRDestPduPduRBswModulesRef = CanIf
          RDR_DETECTION_365_368_oPCAN_RADAR_1d658597_Tx: PduRRoutingPathCommunicationType=COMMUNICATION_INTERFACE, PduRLockRef=PduRLock_PduRExclusiveArea
            RDR_DETECTION_365_368_oPCAN_RADAR_1a84f18f_Tx (PduRDestPdu):
              PduRDestPduHandleId = 112
              PduRDestPduDirection = TRANSMIT
              PduRDestPduRoutingType = API_FORWARDING
              PduRDestPduDataProcessing = IMMEDIATE
              PduRPduLengthHandlingStrategy = IGNORE
              PduRDestPduCrossPartitionDestination = false
              PduRTransmissionConfirmation = false
              PduRDestPduDataProvision = PDUR_DIRECT
              PduRDestPduRef = RDR_DETECTION_365_368_oPCAN_RADAR_1a84f18f_Tx
              PduRDestPduPduRBswModulesRef = CanIf
            PduRSrcPdu_f3c9ccf6 (PduRSrcPdu):
              PduRSourcePduHandleId = 110
              PduRSrcPduDirection = TRANSMIT
              PduRSrcPduRef = RDR_DETECTION_365_368_oPCAN_RADAR_1d658597_Tx
              PduRSrcPduPduRBswModulesRef = Com
          RDR_DETECTION_229_232_oPCAN_RADAR_5330693b_Tx: PduRRoutingPathCommunicationType=COMMUNICATION_INTERFACE, PduRLockRef=PduRLock_PduRExclusiveArea
            RDR_DETECTION_229_232_oPCAN_RADAR_c55d5eb5_Tx (PduRDestPdu):
              PduRDestPduHandleId = 78
              PduRDestPduDirection = TRANSMIT
              PduRDestPduRoutingType = API_FORWARDING
              PduRDestPduDataProcessing = IMMEDIATE
              PduRPduLengthHandlingStrategy = IGNORE
              PduRDestPduCrossPartitionDestination = false
              PduRTransmissionConfirmation = false
              PduRDestPduDataProvision = PDUR_DIRECT
              PduRDestPduRef = RDR_DETECTION_229_232_oPCAN_RADAR_c55d5eb5_Tx
              PduRDestPduPduRBswModulesRef = CanIf
            PduRSrcPdu_928f6819 (PduRSrcPdu):
              PduRSourcePduHandleId = 76
              PduRSrcPduDirection = TRANSMIT
              PduRSrcPduRef = RDR_DETECTION_229_232_oPCAN_RADAR_5330693b_Tx
              PduRSrcPduPduRBswModulesRef = Com
          RDR_DETECTION_329_332_oPCAN_RADAR_3d29328b_Tx: PduRRoutingPathCommunicationType=COMMUNICATION_INTERFACE, PduRLockRef=PduRLock_PduRExclusiveArea
            RDR_DETECTION_329_332_oPCAN_RADAR_444a42d4_Tx (PduRDestPdu):
              PduRDestPduHandleId = 103
              PduRDestPduDirection = TRANSMIT
              PduRDestPduRoutingType = API_FORWARDING
              PduRDestPduDataProcessing = IMMEDIATE
              PduRPduLengthHandlingStrategy = IGNORE
              PduRDestPduCrossPartitionDestination = false
              PduRTransmissionConfirmation = false
              PduRDestPduDataProvision = PDUR_DIRECT
              PduRDestPduRef = RDR_DETECTION_329_332_oPCAN_RADAR_444a42d4_Tx
              PduRDestPduPduRBswModulesRef = CanIf
            PduRSrcPdu_06822de6 (PduRSrcPdu):
              PduRSourcePduHandleId = 101
              PduRSrcPduDirection = TRANSMIT
              PduRSrcPduRef = RDR_DETECTION_329_332_oPCAN_RADAR_3d29328b_Tx
              PduRSrcPduPduRBswModulesRef = Com
          RDR_TRACKER_OBJ_047_oPCAN_RADAR_97ceab90_Tx: PduRRoutingPathCommunicationType=COMMUNICATION_INTERFACE, PduRLockRef=PduRLock_PduRExclusiveArea
            PduRSrcPdu_d87193f4 (PduRSrcPdu):
              PduRSourcePduHandleId = 170
              PduRSrcPduDirection = TRANSMIT
              PduRSrcPduRef = RDR_TRACKER_OBJ_047_oPCAN_RADAR_97ceab90_Tx
              PduRSrcPduPduRBswModulesRef = Com
            RDR_TRACKER_OBJ_047_oPCAN_RADAR_cf630ef0_Tx (PduRDestPdu):
              PduRDestPduHandleId = 172
              PduRDestPduDirection = TRANSMIT
              PduRDestPduRoutingType = API_FORWARDING
              PduRDestPduDataProcessing = IMMEDIATE
              PduRPduLengthHandlingStrategy = IGNORE
              PduRDestPduCrossPartitionDestination = false
              PduRTransmissionConfirmation = false
              PduRDestPduDataProvision = PDUR_DIRECT
              PduRDestPduRef = RDR_TRACKER_OBJ_047_oPCAN_RADAR_cf630ef0_Tx
              PduRDestPduPduRBswModulesRef = CanIf
          RDR_TRACKER_OBJ_042_oPCAN_RADAR_8ae11883_Tx: PduRRoutingPathCommunicationType=COMMUNICATION_INTERFACE, PduRLockRef=PduRLock_PduRExclusiveArea
            RDR_TRACKER_OBJ_042_oPCAN_RADAR_225bddcf_Tx (PduRDestPdu):
              PduRDestPduHandleId = 167
              PduRDestPduDirection = TRANSMIT
              PduRDestPduRoutingType = API_FORWARDING
              PduRDestPduDataProcessing = IMMEDIATE
              PduRPduLengthHandlingStrategy = IGNORE
              PduRDestPduCrossPartitionDestination = false
              PduRTransmissionConfirmation = false
              PduRDestPduDataProvision = PDUR_DIRECT
              PduRDestPduRef = RDR_TRACKER_OBJ_042_oPCAN_RADAR_225bddcf_Tx
              PduRDestPduPduRBswModulesRef = CanIf
            PduRSrcPdu_f0a0a000 (PduRSrcPdu):
              PduRSourcePduHandleId = 165
              PduRSrcPduDirection = TRANSMIT
              PduRSrcPduRef = RDR_TRACKER_OBJ_042_oPCAN_RADAR_8ae11883_Tx
              PduRSrcPduPduRBswModulesRef = Com
          RDR_TRACKER_OBJ_027_oPCAN_RADAR_6f0ce026_Tx: PduRRoutingPathCommunicationType=COMMUNICATION_INTERFACE, PduRLockRef=PduRLock_PduRExclusiveArea
            RDR_TRACKER_OBJ_027_oPCAN_RADAR_146ee844_Tx (PduRDestPdu):
              PduRDestPduHandleId = 152
              PduRDestPduDirection = TRANSMIT
              PduRDestPduRoutingType = API_FORWARDING
              PduRDestPduDataProcessing = IMMEDIATE
              PduRPduLengthHandlingStrategy = IGNORE
              PduRDestPduCrossPartitionDestination = false
              PduRTransmissionConfirmation = false
              PduRDestPduDataProvision = PDUR_DIRECT
              PduRDestPduRef = RDR_TRACKER_OBJ_027_oPCAN_RADAR_146ee844_Tx
              PduRDestPduPduRBswModulesRef = CanIf
            PduRSrcPdu_4883c0e3 (PduRSrcPdu):
              PduRSourcePduHandleId = 150
              PduRSrcPduDirection = TRANSMIT
              PduRSrcPduRef = RDR_TRACKER_OBJ_027_oPCAN_RADAR_6f0ce026_Tx
              PduRSrcPduPduRBswModulesRef = Com
          RDR_DETECTION_173_176_oPCAN_RADAR_eed8ded8_Tx: PduRRoutingPathCommunicationType=COMMUNICATION_INTERFACE, PduRLockRef=PduRLock_PduRExclusiveArea
            PduRSrcPdu_aecd6860 (PduRSrcPdu):
              PduRSourcePduHandleId = 62
              PduRSrcPduDirection = TRANSMIT
              PduRSrcPduRef = RDR_DETECTION_173_176_oPCAN_RADAR_eed8ded8_Tx
              PduRSrcPduPduRBswModulesRef = Com
            RDR_DETECTION_173_176_oPCAN_RADAR_04d9feeb_Tx (PduRDestPdu):
              PduRDestPduHandleId = 64
              PduRDestPduDirection = TRANSMIT
              PduRDestPduRoutingType = API_FORWARDING
              PduRDestPduDataProcessing = IMMEDIATE
              PduRPduLengthHandlingStrategy = IGNORE
              PduRDestPduCrossPartitionDestination = false
              PduRTransmissionConfirmation = false
              PduRDestPduDataProvision = PDUR_DIRECT
              PduRDestPduRef = RDR_DETECTION_173_176_oPCAN_RADAR_04d9feeb_Tx
              PduRDestPduPduRBswModulesRef = CanIf
          RDR_DETECTION_317_320_oPCAN_RADAR_6bd84342_Tx: PduRRoutingPathCommunicationType=COMMUNICATION_INTERFACE, PduRLockRef=PduRLock_PduRExclusiveArea
            PduRSrcPdu_bb4876e0 (PduRSrcPdu):
              PduRSourcePduHandleId = 98
              PduRSrcPduDirection = TRANSMIT
              PduRSrcPduRef = RDR_DETECTION_317_320_oPCAN_RADAR_6bd84342_Tx
              PduRSrcPduPduRBswModulesRef = Com
            RDR_DETECTION_317_320_oPCAN_RADAR_28a1e1dd_Tx (PduRDestPdu):
              PduRDestPduHandleId = 100
              PduRDestPduDirection = TRANSMIT
              PduRDestPduRoutingType = API_FORWARDING
              PduRDestPduDataProcessing = IMMEDIATE
              PduRPduLengthHandlingStrategy = IGNORE
              PduRDestPduCrossPartitionDestination = false
              PduRTransmissionConfirmation = false
              PduRDestPduDataProvision = PDUR_DIRECT
              PduRDestPduRef = RDR_DETECTION_317_320_oPCAN_RADAR_28a1e1dd_Tx
              PduRDestPduPduRBswModulesRef = CanIf
          RDR_DETECTION_009_012_oPCAN_RADAR_6bb87175_Tx: PduRRoutingPathCommunicationType=COMMUNICATION_INTERFACE, PduRLockRef=PduRLock_PduRExclusiveArea
            RDR_DETECTION_009_012_oPCAN_RADAR_95663fdf_Tx (PduRDestPdu):
              PduRDestPduHandleId = 23
              PduRDestPduDirection = TRANSMIT
              PduRDestPduRoutingType = API_FORWARDING
              PduRDestPduDataProcessing = IMMEDIATE
              PduRPduLengthHandlingStrategy = IGNORE
              PduRDestPduCrossPartitionDestination = false
              PduRTransmissionConfirmation = false
              PduRDestPduDataProvision = PDUR_DIRECT
              PduRDestPduRef = RDR_DETECTION_009_012_oPCAN_RADAR_95663fdf_Tx
              PduRDestPduPduRBswModulesRef = CanIf
            PduRSrcPdu_af55dfb3 (PduRSrcPdu):
              PduRSourcePduHandleId = 21
              PduRSrcPduDirection = TRANSMIT
              PduRSrcPduRef = RDR_DETECTION_009_012_oPCAN_RADAR_6bb87175_Tx
              PduRSrcPduPduRBswModulesRef = Com
          RDR_TRACKER_OBJ_025_oPCAN_RADAR_0f50556d_Tx: PduRRoutingPathCommunicationType=COMMUNICATION_INTERFACE, PduRLockRef=PduRLock_PduRExclusiveArea
            RDR_TRACKER_OBJ_025_oPCAN_RADAR_798bc9a2_Tx (PduRDestPdu):
              PduRDestPduHandleId = 150
              PduRDestPduDirection = TRANSMIT
              PduRDestPduRoutingType = API_FORWARDING
              PduRDestPduDataProcessing = IMMEDIATE
              PduRPduLengthHandlingStrategy = IGNORE
              PduRDestPduCrossPartitionDestination = false
              PduRTransmissionConfirmation = false
              PduRDestPduDataProvision = PDUR_DIRECT
              PduRDestPduRef = RDR_TRACKER_OBJ_025_oPCAN_RADAR_798bc9a2_Tx
              PduRDestPduPduRBswModulesRef = CanIf
            PduRSrcPdu_46f2847a (PduRSrcPdu):
              PduRSourcePduHandleId = 148
              PduRSrcPduDirection = TRANSMIT
              PduRSrcPduRef = RDR_TRACKER_OBJ_025_oPCAN_RADAR_0f50556d_Tx
              PduRSrcPduPduRBswModulesRef = Com
          RDR_CAPABILITY_oPCAN_RADAR_18844568_Tx: PduRRoutingPathCommunicationType=COMMUNICATION_INTERFACE, PduRLockRef=PduRLock_PduRExclusiveArea
            PduRSrcPdu_3bf88f81 (PduRSrcPdu): PduRSourcePduHandleId=18, PduRSrcPduDirection=TRANSMIT, PduRSrcPduRef=RDR_CAPABILITY_oPCAN_RADAR_18844568_Tx, PduRSrcPduPduRBswModulesRef=Com
            RDR_CAPABILITY_oPCAN_RADAR_476dda7e_Tx (PduRDestPdu):
              PduRDestPduHandleId = 20
              PduRDestPduDirection = TRANSMIT
              PduRDestPduRoutingType = API_FORWARDING
              PduRDestPduDataProcessing = IMMEDIATE
              PduRPduLengthHandlingStrategy = IGNORE
              PduRDestPduCrossPartitionDestination = false
              PduRTransmissionConfirmation = false
              PduRDestPduDataProvision = PDUR_DIRECT
              PduRDestPduRef = RDR_CAPABILITY_oPCAN_RADAR_476dda7e_Tx
              PduRDestPduPduRBswModulesRef = CanIf
          RDR_TRACKER_OBJ_028_oPCAN_RADAR_487c3513_Tx: PduRRoutingPathCommunicationType=COMMUNICATION_INTERFACE, PduRLockRef=PduRLock_PduRExclusiveArea
            RDR_TRACKER_OBJ_028_oPCAN_RADAR_f8569b44_Tx (PduRDestPdu):
              PduRDestPduHandleId = 153
              PduRDestPduDirection = TRANSMIT
              PduRDestPduRoutingType = API_FORWARDING
              PduRDestPduDataProcessing = IMMEDIATE
              PduRPduLengthHandlingStrategy = IGNORE
              PduRDestPduCrossPartitionDestination = false
              PduRTransmissionConfirmation = false
              PduRDestPduDataProvision = PDUR_DIRECT
              PduRDestPduRef = RDR_TRACKER_OBJ_028_oPCAN_RADAR_f8569b44_Tx
              PduRDestPduPduRBswModulesRef = CanIf
            PduRSrcPdu_51be0ad3 (PduRSrcPdu):
              PduRSourcePduHandleId = 151
              PduRSrcPduDirection = TRANSMIT
              PduRSrcPduRef = RDR_TRACKER_OBJ_028_oPCAN_RADAR_487c3513_Tx
              PduRSrcPduPduRBswModulesRef = Com
          RDR_DETECTION_257_260_oPCAN_RADAR_17c540ef_Tx: PduRRoutingPathCommunicationType=COMMUNICATION_INTERFACE, PduRLockRef=PduRLock_PduRExclusiveArea
            RDR_DETECTION_257_260_oPCAN_RADAR_600f442f_Tx (PduRDestPdu):
              PduRDestPduHandleId = 85
              PduRDestPduDirection = TRANSMIT
              PduRDestPduRoutingType = API_FORWARDING
              PduRDestPduDataProcessing = IMMEDIATE
              PduRPduLengthHandlingStrategy = IGNORE
              PduRDestPduCrossPartitionDestination = false
              PduRTransmissionConfirmation = false
              PduRDestPduDataProvision = PDUR_DIRECT
              PduRDestPduRef = RDR_DETECTION_257_260_oPCAN_RADAR_600f442f_Tx
              PduRDestPduPduRBswModulesRef = CanIf
            PduRSrcPdu_4edeb339 (PduRSrcPdu):
              PduRSourcePduHandleId = 83
              PduRSrcPduDirection = TRANSMIT
              PduRSrcPduRef = RDR_DETECTION_257_260_oPCAN_RADAR_17c540ef_Tx
              PduRSrcPduPduRBswModulesRef = Com
          RDR_DETECTION_393_396_oPCAN_RADAR_e05c2eb1_Tx: PduRRoutingPathCommunicationType=COMMUNICATION_INTERFACE, PduRLockRef=PduRLock_PduRExclusiveArea
            PduRSrcPdu_35ccba72 (PduRSrcPdu):
              PduRSourcePduHandleId = 117
              PduRSrcPduDirection = TRANSMIT
              PduRSrcPduRef = RDR_DETECTION_393_396_oPCAN_RADAR_e05c2eb1_Tx
              PduRSrcPduPduRBswModulesRef = Com
            RDR_DETECTION_393_396_oPCAN_RADAR_d5595375_Tx (PduRDestPdu):
              PduRDestPduHandleId = 119
              PduRDestPduDirection = TRANSMIT
              PduRDestPduRoutingType = API_FORWARDING
              PduRDestPduDataProcessing = IMMEDIATE
              PduRPduLengthHandlingStrategy = IGNORE
              PduRDestPduCrossPartitionDestination = false
              PduRTransmissionConfirmation = false
              PduRDestPduDataProvision = PDUR_DIRECT
              PduRDestPduRef = RDR_DETECTION_393_396_oPCAN_RADAR_d5595375_Tx
              PduRDestPduPduRBswModulesRef = CanIf
          RDR_OBJ_STATUS_003_oPCAN_RADAR_84871644_Tx: PduRRoutingPathCommunicationType=COMMUNICATION_INTERFACE, PduRLockRef=PduRLock_PduRExclusiveArea
            RDR_OBJ_STATUS_003_oPCAN_RADAR_a1f801b3_Tx (PduRDestPdu):
              PduRDestPduHandleId = 123
              PduRDestPduDirection = TRANSMIT
              PduRDestPduRoutingType = API_FORWARDING
              PduRDestPduDataProcessing = IMMEDIATE
              PduRPduLengthHandlingStrategy = IGNORE
              PduRDestPduCrossPartitionDestination = false
              PduRTransmissionConfirmation = false
              PduRDestPduDataProvision = PDUR_DIRECT
              PduRDestPduRef = RDR_OBJ_STATUS_003_oPCAN_RADAR_a1f801b3_Tx
              PduRDestPduPduRBswModulesRef = CanIf
            PduRSrcPdu_298d5cfa (PduRSrcPdu): PduRSourcePduHandleId=121, PduRSrcPduDirection=TRANSMIT, PduRSrcPduRef=RDR_OBJ_STATUS_003_oPCAN_RADAR_84871644_Tx, PduRSrcPduPduRBswModulesRef=Com
          RDR_TRACKER_OBJ_032_oPCAN_RADAR_ef2cb243_Tx: PduRRoutingPathCommunicationType=COMMUNICATION_INTERFACE, PduRLockRef=PduRLock_PduRExclusiveArea
            PduRSrcPdu_0ef3b535 (PduRSrcPdu):
              PduRSourcePduHandleId = 155
              PduRSrcPduDirection = TRANSMIT
              PduRSrcPduRef = RDR_TRACKER_OBJ_032_oPCAN_RADAR_ef2cb243_Tx
              PduRSrcPduPduRBswModulesRef = Com
            RDR_TRACKER_OBJ_032_oPCAN_RADAR_ddd46a4d_Tx (PduRDestPdu):
              PduRDestPduHandleId = 157
              PduRDestPduDirection = TRANSMIT
              PduRDestPduRoutingType = API_FORWARDING
              PduRDestPduDataProcessing = IMMEDIATE
              PduRPduLengthHandlingStrategy = IGNORE
              PduRDestPduCrossPartitionDestination = false
              PduRTransmissionConfirmation = false
              PduRDestPduDataProvision = PDUR_DIRECT
              PduRDestPduRef = RDR_TRACKER_OBJ_032_oPCAN_RADAR_ddd46a4d_Tx
              PduRDestPduPduRBswModulesRef = CanIf
          RDR_DETECTION_381_384_oPCAN_RADAR_26615caa_Tx: PduRRoutingPathCommunicationType=COMMUNICATION_INTERFACE, PduRLockRef=PduRLock_PduRExclusiveArea
            PduRSrcPdu_559eb387 (PduRSrcPdu):
              PduRSourcePduHandleId = 114
              PduRSrcPduDirection = TRANSMIT
              PduRSrcPduRef = RDR_DETECTION_381_384_oPCAN_RADAR_26615caa_Tx
              PduRSrcPduPduRBswModulesRef = Com
            RDR_DETECTION_381_384_oPCAN_RADAR_cb27f638_Tx (PduRDestPdu):
              PduRDestPduHandleId = 116
              PduRDestPduDirection = TRANSMIT
              PduRDestPduRoutingType = API_FORWARDING
              PduRDestPduDataProcessing = IMMEDIATE
              PduRPduLengthHandlingStrategy = IGNORE
              PduRDestPduCrossPartitionDestination = false
              PduRTransmissionConfirmation = false
              PduRDestPduDataProvision = PDUR_DIRECT
              PduRDestPduRef = RDR_DETECTION_381_384_oPCAN_RADAR_cb27f638_Tx
              PduRDestPduPduRBswModulesRef = CanIf
          RDR_TRACKER_OBJ_007_oPCAN_RADAR_8e62248b_Tx: PduRRoutingPathCommunicationType=COMMUNICATION_INTERFACE, PduRLockRef=PduRLock_PduRExclusiveArea
            PduRSrcPdu_7d228420 (PduRSrcPdu):
              PduRSourcePduHandleId = 130
              PduRSrcPduDirection = TRANSMIT
              PduRSrcPduRef = RDR_TRACKER_OBJ_007_oPCAN_RADAR_8e62248b_Tx
              PduRSrcPduPduRBswModulesRef = Com
            RDR_TRACKER_OBJ_007_oPCAN_RADAR_5d6a4a28_Tx (PduRDestPdu):
              PduRDestPduHandleId = 132
              PduRDestPduDirection = TRANSMIT
              PduRDestPduRoutingType = API_FORWARDING
              PduRDestPduDataProcessing = IMMEDIATE
              PduRPduLengthHandlingStrategy = IGNORE
              PduRDestPduCrossPartitionDestination = false
              PduRTransmissionConfirmation = false
              PduRDestPduDataProvision = PDUR_DIRECT
              PduRDestPduRef = RDR_TRACKER_OBJ_007_oPCAN_RADAR_5d6a4a28_Tx
              PduRDestPduPduRBswModulesRef = CanIf
          RDR_DETECTION_001_004_oPCAN_RADAR_b0420040_Tx: PduRRoutingPathCommunicationType=COMMUNICATION_INTERFACE, PduRLockRef=PduRLock_PduRExclusiveArea
            RDR_DETECTION_001_004_oPCAN_RADAR_db6da1bd_Tx (PduRDestPdu):
              PduRDestPduHandleId = 21
              PduRDestPduDirection = TRANSMIT
              PduRDestPduRoutingType = API_FORWARDING
              PduRDestPduDataProcessing = IMMEDIATE
              PduRPduLengthHandlingStrategy = IGNORE
              PduRDestPduCrossPartitionDestination = false
              PduRTransmissionConfirmation = false
              PduRDestPduDataProvision = PDUR_DIRECT
              PduRDestPduRef = RDR_DETECTION_001_004_oPCAN_RADAR_db6da1bd_Tx
              PduRDestPduPduRBswModulesRef = CanIf
            PduRSrcPdu_16c46b0e (PduRSrcPdu):
              PduRSourcePduHandleId = 19
              PduRSrcPduDirection = TRANSMIT
              PduRSrcPduRef = RDR_DETECTION_001_004_oPCAN_RADAR_b0420040_Tx
              PduRSrcPduPduRBswModulesRef = Com
          RDR_TRACKER_OBJ_003_oPCAN_RADAR_4edb4e1d_Tx: PduRRoutingPathCommunicationType=COMMUNICATION_INTERFACE, PduRLockRef=PduRLock_PduRExclusiveArea
            PduRSrcPdu_097e15ef (PduRSrcPdu):
              PduRSourcePduHandleId = 126
              PduRSrcPduDirection = TRANSMIT
              PduRSrcPduRef = RDR_TRACKER_OBJ_003_oPCAN_RADAR_4edb4e1d_Tx
              PduRSrcPduPduRBswModulesRef = Com
            RDR_TRACKER_OBJ_003_oPCAN_RADAR_86a009e4_Tx (PduRDestPdu):
              PduRDestPduHandleId = 128
              PduRDestPduDirection = TRANSMIT
              PduRDestPduRoutingType = API_FORWARDING
              PduRDestPduDataProcessing = IMMEDIATE
              PduRPduLengthHandlingStrategy = IGNORE
              PduRDestPduCrossPartitionDestination = false
              PduRTransmissionConfirmation = false
              PduRDestPduDataProvision = PDUR_DIRECT
              PduRDestPduRef = RDR_TRACKER_OBJ_003_oPCAN_RADAR_86a009e4_Tx
              PduRDestPduPduRBswModulesRef = CanIf
          RDR_TRACKER_OBJ_046_oPCAN_RADAR_4a587215_Tx: PduRRoutingPathCommunicationType=COMMUNICATION_INTERFACE, PduRLockRef=PduRLock_PduRExclusiveArea
            PduRSrcPdu_862a0990 (PduRSrcPdu):
              PduRSourcePduHandleId = 169
              PduRSrcPduDirection = TRANSMIT
              PduRSrcPduRef = RDR_TRACKER_OBJ_046_oPCAN_RADAR_4a587215_Tx
              PduRSrcPduPduRBswModulesRef = Com
            RDR_TRACKER_OBJ_046_oPCAN_RADAR_f9919e03_Tx (PduRDestPdu):
              PduRDestPduHandleId = 171
              PduRDestPduDirection = TRANSMIT
              PduRDestPduRoutingType = API_FORWARDING
              PduRDestPduDataProcessing = IMMEDIATE
              PduRPduLengthHandlingStrategy = IGNORE
              PduRDestPduCrossPartitionDestination = false
              PduRTransmissionConfirmation = false
              PduRDestPduDataProvision = PDUR_DIRECT
              PduRDestPduRef = RDR_TRACKER_OBJ_046_oPCAN_RADAR_f9919e03_Tx
              PduRDestPduPduRBswModulesRef = CanIf
          RDR_DETECTION_349_352_oPCAN_RADAR_cb97c5b8_Tx: PduRRoutingPathCommunicationType=COMMUNICATION_INTERFACE, PduRLockRef=PduRLock_PduRExclusiveArea
            RDR_DETECTION_349_352_oPCAN_RADAR_0497a4ae_Tx (PduRDestPdu):
              PduRDestPduHandleId = 108
              PduRDestPduDirection = TRANSMIT
              PduRDestPduRoutingType = API_FORWARDING
              PduRDestPduDataProcessing = IMMEDIATE
              PduRPduLengthHandlingStrategy = IGNORE
              PduRDestPduCrossPartitionDestination = false
              PduRTransmissionConfirmation = false
              PduRDestPduDataProvision = PDUR_DIRECT
              PduRDestPduRef = RDR_DETECTION_349_352_oPCAN_RADAR_0497a4ae_Tx
              PduRDestPduPduRBswModulesRef = CanIf
            PduRSrcPdu_baa27a48 (PduRSrcPdu):
              PduRSourcePduHandleId = 106
              PduRSrcPduDirection = TRANSMIT
              PduRSrcPduRef = RDR_DETECTION_349_352_oPCAN_RADAR_cb97c5b8_Tx
              PduRSrcPduPduRBswModulesRef = Com
          RDR_DETECTION_357_360_oPCAN_RADAR_79dc1b5f_Tx: PduRRoutingPathCommunicationType=COMMUNICATION_INTERFACE, PduRLockRef=PduRLock_PduRExclusiveArea
            PduRSrcPdu_048c6441 (PduRSrcPdu):
              PduRSourcePduHandleId = 108
              PduRSrcPduDirection = TRANSMIT
              PduRSrcPduRef = RDR_DETECTION_357_360_oPCAN_RADAR_79dc1b5f_Tx
              PduRSrcPduPduRBswModulesRef = Com
            RDR_DETECTION_357_360_oPCAN_RADAR_e118584e_Tx (PduRDestPdu):
              PduRDestPduHandleId = 110
              PduRDestPduDirection = TRANSMIT
              PduRDestPduRoutingType = API_FORWARDING
              PduRDestPduDataProcessing = IMMEDIATE
              PduRPduLengthHandlingStrategy = IGNORE
              PduRDestPduCrossPartitionDestination = false
              PduRTransmissionConfirmation = false
              PduRDestPduDataProvision = PDUR_DIRECT
              PduRDestPduRef = RDR_DETECTION_357_360_oPCAN_RADAR_e118584e_Tx
              PduRDestPduPduRBswModulesRef = CanIf
          RDR_TRACKER_OBJ_036_oPCAN_RADAR_2f95d8d5_Tx: PduRRoutingPathCommunicationType=COMMUNICATION_INTERFACE, PduRLockRef=PduRLock_PduRExclusiveArea
            PduRSrcPdu_6ae4d5be (PduRSrcPdu):
              PduRSourcePduHandleId = 159
              PduRSrcPduDirection = TRANSMIT
              PduRSrcPduRef = RDR_TRACKER_OBJ_036_oPCAN_RADAR_2f95d8d5_Tx
              PduRSrcPduPduRBswModulesRef = Com
            RDR_TRACKER_OBJ_036_oPCAN_RADAR_061e2981_Tx (PduRDestPdu):
              PduRDestPduHandleId = 161
              PduRDestPduDirection = TRANSMIT
              PduRDestPduRoutingType = API_FORWARDING
              PduRDestPduDataProcessing = IMMEDIATE
              PduRPduLengthHandlingStrategy = IGNORE
              PduRDestPduCrossPartitionDestination = false
              PduRTransmissionConfirmation = false
              PduRDestPduDataProvision = PDUR_DIRECT
              PduRDestPduRef = RDR_TRACKER_OBJ_036_oPCAN_RADAR_061e2981_Tx
              PduRDestPduPduRBswModulesRef = CanIf
          RDR_TRACKER_OBJ_050_oPCAN_RADAR_77b24cbe_Tx: PduRRoutingPathCommunicationType=COMMUNICATION_INTERFACE, PduRLockRef=PduRLock_PduRExclusiveArea
            RDR_TRACKER_OBJ_050_oPCAN_RADAR_6b3cad1f_Tx (PduRDestPdu):
              PduRDestPduHandleId = 175
              PduRDestPduDirection = TRANSMIT
              PduRDestPduRoutingType = API_FORWARDING
              PduRDestPduDataProcessing = IMMEDIATE
              PduRPduLengthHandlingStrategy = IGNORE
              PduRDestPduCrossPartitionDestination = false
              PduRTransmissionConfirmation = false
              PduRDestPduDataProvision = PDUR_DIRECT
              PduRDestPduRef = RDR_TRACKER_OBJ_050_oPCAN_RADAR_6b3cad1f_Tx
              PduRDestPduPduRBswModulesRef = CanIf
            PduRSrcPdu_e27318ae (PduRSrcPdu):
              PduRSourcePduHandleId = 173
              PduRSrcPduDirection = TRANSMIT
              PduRSrcPduRef = RDR_TRACKER_OBJ_050_oPCAN_RADAR_77b24cbe_Tx
              PduRSrcPduPduRBswModulesRef = Com
          RDR_DETECTION_029_032_oPCAN_RADAR_8f02de5b_Tx: PduRRoutingPathCommunicationType=COMMUNICATION_INTERFACE, PduRLockRef=PduRLock_PduRExclusiveArea
            PduRSrcPdu_fd1f7138 (PduRSrcPdu):
              PduRSourcePduHandleId = 26
              PduRSrcPduDirection = TRANSMIT
              PduRSrcPduRef = RDR_DETECTION_029_032_oPCAN_RADAR_8f02de5b_Tx
              PduRSrcPduPduRBswModulesRef = Com
            RDR_DETECTION_029_032_oPCAN_RADAR_1c026036_Tx (PduRDestPdu):
              PduRDestPduHandleId = 28
              PduRDestPduDirection = TRANSMIT
              PduRDestPduRoutingType = API_FORWARDING
              PduRDestPduDataProcessing = IMMEDIATE
              PduRPduLengthHandlingStrategy = IGNORE
              PduRDestPduCrossPartitionDestination = false
              PduRTransmissionConfirmation = false
              PduRDestPduDataProvision = PDUR_DIRECT
              PduRDestPduRef = RDR_DETECTION_029_032_oPCAN_RADAR_1c026036_Tx
              PduRDestPduPduRBswModulesRef = CanIf
          RDR_DETECTION_237_240_oPCAN_RADAR_f8d738c7_Tx: PduRRoutingPathCommunicationType=COMMUNICATION_INTERFACE, PduRLockRef=PduRLock_PduRExclusiveArea
            PduRSrcPdu_81196a7c (PduRSrcPdu):
              PduRSourcePduHandleId = 78
              PduRSrcPduDirection = TRANSMIT
              PduRSrcPduRef = RDR_DETECTION_237_240_oPCAN_RADAR_f8d738c7_Tx
              PduRSrcPduPduRBswModulesRef = Com
            RDR_DETECTION_237_240_oPCAN_RADAR_b2dbe68d_Tx (PduRDestPdu):
              PduRDestPduHandleId = 80
              PduRDestPduDirection = TRANSMIT
              PduRDestPduRoutingType = API_FORWARDING
              PduRDestPduDataProcessing = IMMEDIATE
              PduRPduLengthHandlingStrategy = IGNORE
              PduRDestPduCrossPartitionDestination = false
              PduRTransmissionConfirmation = false
              PduRDestPduDataProvision = PDUR_DIRECT
              PduRDestPduRef = RDR_DETECTION_237_240_oPCAN_RADAR_b2dbe68d_Tx
              PduRDestPduPduRBswModulesRef = CanIf
          RDR_DETECTION_269_272_oPCAN_RADAR_41343126_Tx: PduRRoutingPathCommunicationType=COMMUNICATION_INTERFACE, PduRLockRef=PduRLock_PduRExclusiveArea
            PduRSrcPdu_cfcd6f6f (PduRSrcPdu):
              PduRSourcePduHandleId = 86
              PduRSrcPduDirection = TRANSMIT
              PduRSrcPduRef = RDR_DETECTION_269_272_oPCAN_RADAR_41343126_Tx
              PduRSrcPduPduRBswModulesRef = Com
            RDR_DETECTION_269_272_oPCAN_RADAR_0ce4e726_Tx (PduRDestPdu):
              PduRDestPduHandleId = 88
              PduRDestPduDirection = TRANSMIT
              PduRDestPduRoutingType = API_FORWARDING
              PduRDestPduDataProcessing = IMMEDIATE
              PduRPduLengthHandlingStrategy = IGNORE
              PduRDestPduCrossPartitionDestination = false
              PduRTransmissionConfirmation = false
              PduRDestPduDataProvision = PDUR_DIRECT
              PduRDestPduRef = RDR_DETECTION_269_272_oPCAN_RADAR_0ce4e726_Tx
              PduRDestPduPduRBswModulesRef = CanIf
          RDR_TRACKER_OBJ_043_oPCAN_RADAR_5777c106_Tx: PduRRoutingPathCommunicationType=COMMUNICATION_INTERFACE, PduRLockRef=PduRLock_PduRExclusiveArea
            PduRSrcPdu_2495f9d4 (PduRSrcPdu):
              PduRSourcePduHandleId = 166
              PduRSrcPduDirection = TRANSMIT
              PduRSrcPduRef = RDR_TRACKER_OBJ_043_oPCAN_RADAR_5777c106_Tx
              PduRSrcPduPduRBswModulesRef = Com
            RDR_TRACKER_OBJ_043_oPCAN_RADAR_14a94d3c_Tx (PduRDestPdu):
              PduRDestPduHandleId = 168
              PduRDestPduDirection = TRANSMIT
              PduRDestPduRoutingType = API_FORWARDING
              PduRDestPduDataProcessing = IMMEDIATE
              PduRPduLengthHandlingStrategy = IGNORE
              PduRDestPduCrossPartitionDestination = false
              PduRTransmissionConfirmation = false
              PduRDestPduDataProvision = PDUR_DIRECT
              PduRDestPduRef = RDR_TRACKER_OBJ_043_oPCAN_RADAR_14a94d3c_Tx
              PduRDestPduPduRBswModulesRef = CanIf
          RDR_DETECTION_217_220_oPCAN_RADAR_05c118f2_Tx: PduRRoutingPathCommunicationType=COMMUNICATION_INTERFACE, PduRLockRef=PduRLock_PduRExclusiveArea
            RDR_DETECTION_217_220_oPCAN_RADAR_a9b6fdbc_Tx (PduRDestPdu):
              PduRDestPduHandleId = 75
              PduRDestPduDirection = TRANSMIT
              PduRDestPduRoutingType = API_FORWARDING
              PduRDestPduDataProcessing = IMMEDIATE
              PduRPduLengthHandlingStrategy = IGNORE
              PduRDestPduCrossPartitionDestination = false
              PduRTransmissionConfirmation = false
              PduRDestPduDataProvision = PDUR_DIRECT
              PduRDestPduRef = RDR_DETECTION_217_220_oPCAN_RADAR_a9b6fdbc_Tx
              PduRDestPduPduRBswModulesRef = CanIf
            PduRSrcPdu_695ce72f (PduRSrcPdu):
              PduRSourcePduHandleId = 73
              PduRSrcPduDirection = TRANSMIT
              PduRSrcPduRef = RDR_DETECTION_217_220_oPCAN_RADAR_05c118f2_Tx
              PduRSrcPduPduRBswModulesRef = Com
          RDR_DETECTION_021_024_oPCAN_RADAR_54f8af6e_Tx: PduRRoutingPathCommunicationType=COMMUNICATION_INTERFACE, PduRLockRef=PduRLock_PduRExclusiveArea
            RDR_DETECTION_021_024_oPCAN_RADAR_5209fe54_Tx (PduRDestPdu):
              PduRDestPduHandleId = 26
              PduRDestPduDirection = TRANSMIT
              PduRDestPduRoutingType = API_FORWARDING
              PduRDestPduDataProcessing = IMMEDIATE
              PduRPduLengthHandlingStrategy = IGNORE
              PduRDestPduCrossPartitionDestination = false
              PduRTransmissionConfirmation = false
              PduRDestPduDataProvision = PDUR_DIRECT
              PduRDestPduRef = RDR_DETECTION_021_024_oPCAN_RADAR_5209fe54_Tx
              PduRDestPduPduRBswModulesRef = CanIf
            PduRSrcPdu_37235e8d (PduRSrcPdu):
              PduRSourcePduHandleId = 24
              PduRSrcPduDirection = TRANSMIT
              PduRSrcPduRef = RDR_DETECTION_021_024_oPCAN_RADAR_54f8af6e_Tx
              PduRSrcPduPduRBswModulesRef = Com
          RDR_ALIGNMENT_STATUS_001_oPCAN_RADAR_dd819ed8_Tx: PduRRoutingPathCommunicationType=COMMUNICATION_INTERFACE, PduRLockRef=PduRLock_PduRExclusiveArea
            PduRSrcPdu_ca318370 (PduRSrcPdu):
              PduRSourcePduHandleId = 15
              PduRSrcPduDirection = TRANSMIT
              PduRSrcPduRef = RDR_ALIGNMENT_STATUS_001_oPCAN_RADAR_dd819ed8_Tx
              PduRSrcPduPduRBswModulesRef = Com
            RDR_ALIGNMENT_STATUS_001_oPCAN_RADAR_4f94d655_Tx (PduRDestPdu):
              PduRDestPduHandleId = 17
              PduRDestPduDirection = TRANSMIT
              PduRDestPduRoutingType = API_FORWARDING
              PduRDestPduDataProcessing = IMMEDIATE
              PduRPduLengthHandlingStrategy = IGNORE
              PduRDestPduCrossPartitionDestination = false
              PduRTransmissionConfirmation = false
              PduRDestPduDataProvision = PDUR_DIRECT
              PduRDestPduRef = RDR_ALIGNMENT_STATUS_001_oPCAN_RADAR_4f94d655_Tx
              PduRDestPduPduRBswModulesRef = CanIf
          RDR_DETECTION_081_084_oPCAN_RADAR_944ab07a_Tx: PduRRoutingPathCommunicationType=COMMUNICATION_INTERFACE, PduRLockRef=PduRLock_PduRExclusiveArea
            RDR_DETECTION_081_084_oPCAN_RADAR_936fd4da_Tx (PduRDestPdu):
              PduRDestPduHandleId = 41
              PduRDestPduDirection = TRANSMIT
              PduRDestPduRoutingType = API_FORWARDING
              PduRDestPduDataProcessing = IMMEDIATE
              PduRPduLengthHandlingStrategy = IGNORE
              PduRDestPduCrossPartitionDestination = false
              PduRTransmissionConfirmation = false
              PduRDestPduDataProvision = PDUR_DIRECT
              PduRDestPduRef = RDR_DETECTION_081_084_oPCAN_RADAR_936fd4da_Tx
              PduRDestPduPduRBswModulesRef = CanIf
            PduRSrcPdu_721dbc05 (PduRSrcPdu):
              PduRSourcePduHandleId = 39
              PduRSrcPduDirection = TRANSMIT
              PduRSrcPduRef = RDR_DETECTION_081_084_oPCAN_RADAR_944ab07a_Tx
              PduRSrcPduPduRBswModulesRef = Com
          RDR_DETECTION_205_208_oPCAN_RADAR_85c22914_Tx: PduRRoutingPathCommunicationType=COMMUNICATION_INTERFACE, PduRLockRef=PduRLock_PduRExclusiveArea
            RDR_DETECTION_205_208_oPCAN_RADAR_db4e0b94_Tx (PduRDestPdu):
              PduRDestPduHandleId = 72
              PduRDestPduDirection = TRANSMIT
              PduRDestPduRoutingType = API_FORWARDING
              PduRDestPduDataProcessing = IMMEDIATE
              PduRPduLengthHandlingStrategy = IGNORE
              PduRDestPduCrossPartitionDestination = false
              PduRTransmissionConfirmation = false
              PduRDestPduDataProvision = PDUR_DIRECT
              PduRDestPduRef = RDR_DETECTION_205_208_oPCAN_RADAR_db4e0b94_Tx
              PduRDestPduPduRBswModulesRef = CanIf
            PduRSrcPdu_cbd20d2e (PduRSrcPdu):
              PduRSourcePduHandleId = 70
              PduRSrcPduDirection = TRANSMIT
              PduRSrcPduRef = RDR_DETECTION_205_208_oPCAN_RADAR_85c22914_Tx
              PduRSrcPduPduRBswModulesRef = Com
          RDR_DETECTION_213_216_oPCAN_RADAR_aa4dc53b_Tx: PduRRoutingPathCommunicationType=COMMUNICATION_INTERFACE, PduRLockRef=PduRLock_PduRExclusiveArea
            RDR_DETECTION_213_216_oPCAN_RADAR_1c4c3a73_Tx (PduRDestPdu):
              PduRDestPduHandleId = 74
              PduRDestPduDirection = TRANSMIT
              PduRDestPduRoutingType = API_FORWARDING
              PduRDestPduDataProcessing = IMMEDIATE
              PduRPduLengthHandlingStrategy = IGNORE
              PduRDestPduCrossPartitionDestination = false
              PduRTransmissionConfirmation = false
              PduRDestPduDataProvision = PDUR_DIRECT
              PduRDestPduRef = RDR_DETECTION_213_216_oPCAN_RADAR_1c4c3a73_Tx
              PduRDestPduPduRBswModulesRef = CanIf
            PduRSrcPdu_96ae5532 (PduRSrcPdu):
              PduRSourcePduHandleId = 72
              PduRSrcPduDirection = TRANSMIT
              PduRSrcPduRef = RDR_DETECTION_213_216_oPCAN_RADAR_aa4dc53b_Tx
              PduRSrcPduPduRBswModulesRef = Com
          RDR_TRACKER_OBJ_002_oPCAN_RADAR_934d9798_Tx: PduRRoutingPathCommunicationType=COMMUNICATION_INTERFACE, PduRLockRef=PduRLock_PduRExclusiveArea
            RDR_TRACKER_OBJ_002_oPCAN_RADAR_b0529917_Tx (PduRDestPdu):
              PduRDestPduHandleId = 127
              PduRDestPduDirection = TRANSMIT
              PduRDestPduRoutingType = API_FORWARDING
              PduRDestPduDataProcessing = IMMEDIATE
              PduRPduLengthHandlingStrategy = IGNORE
              PduRDestPduCrossPartitionDestination = false
              PduRTransmissionConfirmation = false
              PduRDestPduDataProvision = PDUR_DIRECT
              PduRDestPduRef = RDR_TRACKER_OBJ_002_oPCAN_RADAR_b0529917_Tx
              PduRDestPduPduRBswModulesRef = CanIf
            PduRSrcPdu_f66c45ff (PduRSrcPdu):
              PduRSourcePduHandleId = 125
              PduRSrcPduDirection = TRANSMIT
              PduRSrcPduRef = RDR_TRACKER_OBJ_002_oPCAN_RADAR_934d9798_Tx
              PduRSrcPduPduRBswModulesRef = Com
          RDR_TRACKER_OBJ_052_oPCAN_RADAR_17eef9f5_Tx: PduRRoutingPathCommunicationType=COMMUNICATION_INTERFACE, PduRLockRef=PduRLock_PduRExclusiveArea
            PduRSrcPdu_86f019cb (PduRSrcPdu):
              PduRSourcePduHandleId = 175
              PduRSrcPduDirection = TRANSMIT
              PduRSrcPduRef = RDR_TRACKER_OBJ_052_oPCAN_RADAR_17eef9f5_Tx
              PduRSrcPduPduRBswModulesRef = Com
            RDR_TRACKER_OBJ_052_oPCAN_RADAR_06d98cf9_Tx (PduRDestPdu):
              PduRDestPduHandleId = 177
              PduRDestPduDirection = TRANSMIT
              PduRDestPduRoutingType = API_FORWARDING
              PduRDestPduDataProcessing = IMMEDIATE
              PduRPduLengthHandlingStrategy = IGNORE
              PduRDestPduCrossPartitionDestination = false
              PduRTransmissionConfirmation = false
              PduRDestPduDataProvision = PDUR_DIRECT
              PduRDestPduRef = RDR_TRACKER_OBJ_052_oPCAN_RADAR_06d98cf9_Tx
              PduRDestPduPduRBswModulesRef = CanIf
          RDR_TRACKER_OBJ_057_oPCAN_RADAR_0ac14ae6_Tx: PduRRoutingPathCommunicationType=COMMUNICATION_INTERFACE, PduRLockRef=PduRLock_PduRExclusiveArea
            RDR_TRACKER_OBJ_057_oPCAN_RADAR_ebe15fc6_Tx (PduRDestPdu):
              PduRDestPduHandleId = 182
              PduRDestPduDirection = TRANSMIT
              PduRDestPduRoutingType = API_FORWARDING
              PduRDestPduDataProcessing = IMMEDIATE
              PduRPduLengthHandlingStrategy = IGNORE
              PduRDestPduCrossPartitionDestination = false
              PduRTransmissionConfirmation = false
              PduRDestPduDataProvision = PDUR_DIRECT
              PduRDestPduRef = RDR_TRACKER_OBJ_057_oPCAN_RADAR_ebe15fc6_Tx
              PduRDestPduPduRBswModulesRef = CanIf
            PduRSrcPdu_0eb6c97d (PduRSrcPdu):
              PduRSourcePduHandleId = 180
              PduRSrcPduDirection = TRANSMIT
              PduRSrcPduRef = RDR_TRACKER_OBJ_057_oPCAN_RADAR_0ac14ae6_Tx
              PduRSrcPduPduRBswModulesRef = Com
          RDR_DETECTION_181_184_oPCAN_RADAR_fa53ebca_Tx: PduRRoutingPathCommunicationType=COMMUNICATION_INTERFACE, PduRLockRef=PduRLock_PduRExclusiveArea
            RDR_DETECTION_181_184_oPCAN_RADAR_1278c8bb_Tx (PduRDestPdu):
              PduRDestPduHandleId = 66
              PduRDestPduDirection = TRANSMIT
              PduRDestPduRoutingType = API_FORWARDING
              PduRDestPduDataProcessing = IMMEDIATE
              PduRPduLengthHandlingStrategy = IGNORE
              PduRDestPduCrossPartitionDestination = false
              PduRTransmissionConfirmation = false
              PduRDestPduDataProvision = PDUR_DIRECT
              PduRDestPduRef = RDR_DETECTION_181_184_oPCAN_RADAR_1278c8bb_Tx
              PduRDestPduPduRBswModulesRef = CanIf
            PduRSrcPdu_ef0735fa (PduRSrcPdu):
              PduRSourcePduHandleId = 64
              PduRSrcPduDirection = TRANSMIT
              PduRSrcPduRef = RDR_DETECTION_181_184_oPCAN_RADAR_fa53ebca_Tx
              PduRSrcPduPduRBswModulesRef = Com
          RDR_DETECTION_245_248_oPCAN_RADAR_97c67109_Tx: PduRRoutingPathCommunicationType=COMMUNICATION_INTERFACE, PduRLockRef=PduRLock_PduRExclusiveArea
            RDR_DETECTION_245_248_oPCAN_RADAR_12f7b207_Tx (PduRDestPdu):
              PduRDestPduHandleId = 82
              PduRDestPduDirection = TRANSMIT
              PduRDestPduRoutingType = API_FORWARDING
              PduRDestPduDataProcessing = IMMEDIATE
              PduRPduLengthHandlingStrategy = IGNORE
              PduRDestPduCrossPartitionDestination = false
              PduRTransmissionConfirmation = false
              PduRDestPduDataProvision = PDUR_DIRECT
              PduRDestPduRef = RDR_DETECTION_245_248_oPCAN_RADAR_12f7b207_Tx
              PduRDestPduPduRBswModulesRef = CanIf
            PduRSrcPdu_20954a70 (PduRSrcPdu):
              PduRSourcePduHandleId = 80
              PduRSrcPduDirection = TRANSMIT
              PduRSrcPduRef = RDR_DETECTION_245_248_oPCAN_RADAR_97c67109_Tx
              PduRSrcPduPduRBswModulesRef = Com
          RDR_TRACKER_OBJ_021_oPCAN_RADAR_cfe93ffb_Tx: PduRRoutingPathCommunicationType=COMMUNICATION_INTERFACE, PduRLockRef=PduRLock_PduRExclusiveArea
            RDR_TRACKER_OBJ_021_oPCAN_RADAR_a2418a6e_Tx (PduRDestPdu):
              PduRDestPduHandleId = 146
              PduRDestPduDirection = TRANSMIT
              PduRDestPduRoutingType = API_FORWARDING
              PduRDestPduDataProcessing = IMMEDIATE
              PduRPduLengthHandlingStrategy = IGNORE
              PduRDestPduCrossPartitionDestination = false
              PduRTransmissionConfirmation = false
              PduRDestPduDataProvision = PDUR_DIRECT
              PduRDestPduRef = RDR_TRACKER_OBJ_021_oPCAN_RADAR_a2418a6e_Tx
              PduRDestPduPduRBswModulesRef = CanIf
            PduRSrcPdu_c5bcf08d (PduRSrcPdu):
              PduRSourcePduHandleId = 144
              PduRSrcPduDirection = TRANSMIT
              PduRSrcPduRef = RDR_TRACKER_OBJ_021_oPCAN_RADAR_cfe93ffb_Tx
              PduRSrcPduPduRBswModulesRef = Com
          RDR_DETECTION_377_380_oPCAN_RADAR_b793255c_Tx: PduRRoutingPathCommunicationType=COMMUNICATION_INTERFACE, PduRLockRef=PduRLock_PduRExclusiveArea
            PduRSrcPdu_c01c948e (PduRSrcPdu):
              PduRSourcePduHandleId = 113
              PduRSrcPduDirection = TRANSMIT
              PduRSrcPduRef = RDR_DETECTION_377_380_oPCAN_RADAR_b793255c_Tx
              PduRSrcPduPduRBswModulesRef = Com
            RDR_DETECTION_377_380_oPCAN_RADAR_0516cc8e_Tx (PduRDestPdu):
              PduRDestPduHandleId = 115
              PduRDestPduDirection = TRANSMIT
              PduRDestPduRoutingType = API_FORWARDING
              PduRDestPduDataProcessing = IMMEDIATE
              PduRPduLengthHandlingStrategy = IGNORE
              PduRDestPduCrossPartitionDestination = false
              PduRTransmissionConfirmation = false
              PduRDestPduDataProvision = PDUR_DIRECT
              PduRDestPduRef = RDR_DETECTION_377_380_oPCAN_RADAR_0516cc8e_Tx
              PduRDestPduPduRBswModulesRef = CanIf
          RDR_DETECTION_045_048_oPCAN_RADAR_4bf4c669_Tx: PduRRoutingPathCommunicationType=COMMUNICATION_INTERFACE, PduRLockRef=PduRLock_PduRExclusiveArea
            PduRSrcPdu_3986e7d5 (PduRSrcPdu):
              PduRSourcePduHandleId = 30
              PduRSrcPduDirection = TRANSMIT
              PduRSrcPduRef = RDR_DETECTION_045_048_oPCAN_RADAR_4bf4c669_Tx
              PduRSrcPduPduRBswModulesRef = Com
            RDR_DETECTION_045_048_oPCAN_RADAR_cba88c84_Tx (PduRDestPdu):
              PduRDestPduHandleId = 32
              PduRDestPduDirection = TRANSMIT
              PduRDestPduRoutingType = API_FORWARDING
              PduRDestPduDataProcessing = IMMEDIATE
              PduRPduLengthHandlingStrategy = IGNORE
              PduRDestPduCrossPartitionDestination = false
              PduRTransmissionConfirmation = false
              PduRDestPduDataProvision = PDUR_DIRECT
              PduRDestPduRef = RDR_DETECTION_045_048_oPCAN_RADAR_cba88c84_Tx
              PduRDestPduPduRBswModulesRef = CanIf
          RDR_DETECTION_177_180_oPCAN_RADAR_6ba1923c_Tx: PduRRoutingPathCommunicationType=COMMUNICATION_INTERFACE, PduRLockRef=PduRLock_PduRExclusiveArea
            RDR_DETECTION_177_180_oPCAN_RADAR_dc49f20d_Tx (PduRDestPdu):
              PduRDestPduHandleId = 65
              PduRDestPduDirection = TRANSMIT
              PduRDestPduRoutingType = API_FORWARDING
              PduRDestPduDataProcessing = IMMEDIATE
              PduRPduLengthHandlingStrategy = IGNORE
              PduRDestPduCrossPartitionDestination = false
              PduRTransmissionConfirmation = false
              PduRDestPduDataProvision = PDUR_DIRECT
              PduRDestPduRef = RDR_DETECTION_177_180_oPCAN_RADAR_dc49f20d_Tx
              PduRDestPduPduRBswModulesRef = CanIf
            PduRSrcPdu_8c7ce5f5 (PduRSrcPdu):
              PduRSourcePduHandleId = 63
              PduRSrcPduDirection = TRANSMIT
              PduRSrcPduRef = RDR_DETECTION_177_180_oPCAN_RADAR_6ba1923c_Tx
              PduRSrcPduPduRBswModulesRef = Com
          RDR_DETECTION_361_364_oPCAN_RADAR_f4d71ba3_Tx: PduRRoutingPathCommunicationType=COMMUNICATION_INTERFACE, PduRLockRef=PduRLock_PduRExclusiveArea
            RDR_DETECTION_361_364_oPCAN_RADAR_c3f86525_Tx (PduRDestPdu):
              PduRDestPduHandleId = 111
              PduRDestPduDirection = TRANSMIT
              PduRDestPduRoutingType = API_FORWARDING
              PduRDestPduDataProcessing = IMMEDIATE
              PduRPduLengthHandlingStrategy = IGNORE
              PduRDestPduCrossPartitionDestination = false
              PduRTransmissionConfirmation = false
              PduRDestPduDataProvision = PDUR_DIRECT
              PduRDestPduRef = RDR_DETECTION_361_364_oPCAN_RADAR_c3f86525_Tx
              PduRDestPduPduRBswModulesRef = CanIf
            PduRSrcPdu_861339c8 (PduRSrcPdu):
              PduRSourcePduHandleId = 109
              PduRSrcPduDirection = TRANSMIT
              PduRSrcPduRef = RDR_DETECTION_361_364_oPCAN_RADAR_f4d71ba3_Tx
              PduRSrcPduPduRBswModulesRef = Com
          RDR_TRACKER_OBJ_011_oPCAN_RADAR_b3881a20_Tx: PduRRoutingPathCommunicationType=COMMUNICATION_INTERFACE, PduRLockRef=PduRLock_PduRExclusiveArea
            PduRSrcPdu_c0e2a6b5 (PduRSrcPdu):
              PduRSourcePduHandleId = 134
              PduRSrcPduDirection = TRANSMIT
              PduRSrcPduRef = RDR_TRACKER_OBJ_011_oPCAN_RADAR_b3881a20_Tx
              PduRSrcPduPduRBswModulesRef = Com
            RDR_TRACKER_OBJ_011_oPCAN_RADAR_cfc77934_Tx (PduRDestPdu):
              PduRDestPduHandleId = 136
              PduRDestPduDirection = TRANSMIT
              PduRDestPduRoutingType = API_FORWARDING
              PduRDestPduDataProcessing = IMMEDIATE
              PduRPduLengthHandlingStrategy = IGNORE
              PduRDestPduCrossPartitionDestination = false
              PduRTransmissionConfirmation = false
              PduRDestPduDataProvision = PDUR_DIRECT
              PduRDestPduRef = RDR_TRACKER_OBJ_011_oPCAN_RADAR_cfc77934_Tx
              PduRDestPduPduRBswModulesRef = CanIf
          RDR_TRACKER_OBJ_049_oPCAN_RADAR_6d28a720_Tx: PduRRoutingPathCommunicationType=COMMUNICATION_INTERFACE, PduRLockRef=PduRLock_PduRExclusiveArea
            PduRSrcPdu_dee3be1f (PduRSrcPdu):
              PduRSourcePduHandleId = 172
              PduRSrcPduDirection = TRANSMIT
              PduRSrcPduRef = RDR_TRACKER_OBJ_049_oPCAN_RADAR_6d28a720_Tx
              PduRSrcPduPduRBswModulesRef = Com
            RDR_TRACKER_OBJ_049_oPCAN_RADAR_15a9ed03_Tx (PduRDestPdu):
              PduRDestPduHandleId = 174
              PduRDestPduDirection = TRANSMIT
              PduRDestPduRoutingType = API_FORWARDING
              PduRDestPduDataProcessing = IMMEDIATE
              PduRPduLengthHandlingStrategy = IGNORE
              PduRDestPduCrossPartitionDestination = false
              PduRTransmissionConfirmation = false
              PduRDestPduDataProvision = PDUR_DIRECT
              PduRDestPduRef = RDR_TRACKER_OBJ_049_oPCAN_RADAR_15a9ed03_Tx
              PduRDestPduPduRBswModulesRef = CanIf
          RDR_TRACKER_OBJ_061_oPCAN_RADAR_d645b0e0_Tx: PduRRoutingPathCommunicationType=COMMUNICATION_INTERFACE, PduRLockRef=PduRLock_PduRExclusiveArea
            PduRSrcPdu_345001f2 (PduRSrcPdu):
              PduRSourcePduHandleId = 184
              PduRSrcPduDirection = TRANSMIT
              PduRSrcPduRef = RDR_TRACKER_OBJ_061_oPCAN_RADAR_d645b0e0_Tx
              PduRSrcPduPduRBswModulesRef = Com
            RDR_TRACKER_OBJ_061_oPCAN_RADAR_3048ceb6_Tx (PduRDestPdu):
              PduRDestPduHandleId = 186
              PduRDestPduDirection = TRANSMIT
              PduRDestPduRoutingType = API_FORWARDING
              PduRDestPduDataProcessing = IMMEDIATE
              PduRPduLengthHandlingStrategy = IGNORE
              PduRDestPduCrossPartitionDestination = false
              PduRTransmissionConfirmation = false
              PduRDestPduDataProvision = PDUR_DIRECT
              PduRDestPduRef = RDR_TRACKER_OBJ_061_oPCAN_RADAR_3048ceb6_Tx
              PduRDestPduPduRBswModulesRef = CanIf
          RDR_DETECTION_373_376_oPCAN_RADAR_32ea69b8_Tx: PduRRoutingPathCommunicationType=COMMUNICATION_INTERFACE, PduRLockRef=PduRLock_PduRExclusiveArea
            PduRSrcPdu_b88d3c0a (PduRSrcPdu):
              PduRSourcePduHandleId = 112
              PduRSrcPduDirection = TRANSMIT
              PduRSrcPduRef = RDR_DETECTION_373_376_oPCAN_RADAR_32ea69b8_Tx
              PduRSrcPduPduRBswModulesRef = Com
            RDR_DETECTION_373_376_oPCAN_RADAR_dd86c068_Tx (PduRDestPdu):
              PduRDestPduHandleId = 114
              PduRDestPduDirection = TRANSMIT
              PduRDestPduRoutingType = API_FORWARDING
              PduRDestPduDataProcessing = IMMEDIATE
              PduRPduLengthHandlingStrategy = IGNORE
              PduRDestPduCrossPartitionDestination = false
              PduRTransmissionConfirmation = false
              PduRDestPduDataProvision = PDUR_DIRECT
              PduRDestPduRef = RDR_DETECTION_373_376_oPCAN_RADAR_dd86c068_Tx
              PduRDestPduPduRBswModulesRef = CanIf
          RDR_TRACKER_OBJ_001_oPCAN_RADAR_2e87fb56_Tx: PduRRoutingPathCommunicationType=COMMUNICATION_INTERFACE, PduRLockRef=PduRLock_PduRExclusiveArea
            RDR_TRACKER_OBJ_001_oPCAN_RADAR_eb452802_Tx (PduRDestPdu):
              PduRDestPduHandleId = 126
              PduRDestPduDirection = TRANSMIT
              PduRDestPduRoutingType = API_FORWARDING
              PduRDestPduDataProcessing = IMMEDIATE
              PduRPduLengthHandlingStrategy = IGNORE
              PduRDestPduCrossPartitionDestination = false
              PduRTransmissionConfirmation = false
              PduRDestPduDataProvision = PDUR_DIRECT
              PduRDestPduRef = RDR_TRACKER_OBJ_001_oPCAN_RADAR_eb452802_Tx
              PduRDestPduPduRBswModulesRef = CanIf
            PduRSrcPdu_c5c61ffe (PduRSrcPdu):
              PduRSourcePduHandleId = 124
              PduRSrcPduDirection = TRANSMIT
              PduRSrcPduRef = RDR_TRACKER_OBJ_001_oPCAN_RADAR_2e87fb56_Tx
              PduRSrcPduPduRBswModulesRef = Com
          RDR_TRACKER_OBJ_031_oPCAN_RADAR_52e6de8d_Tx: PduRRoutingPathCommunicationType=COMMUNICATION_INTERFACE, PduRLockRef=PduRLock_PduRExclusiveArea
            RDR_TRACKER_OBJ_031_oPCAN_RADAR_86c3db58_Tx (PduRDestPdu):
              PduRDestPduHandleId = 156
              PduRDestPduDirection = TRANSMIT
              PduRDestPduRoutingType = API_FORWARDING
              PduRDestPduDataProcessing = IMMEDIATE
              PduRPduLengthHandlingStrategy = IGNORE
              PduRDestPduCrossPartitionDestination = false
              PduRTransmissionConfirmation = false
              PduRDestPduDataProvision = PDUR_DIRECT
              PduRDestPduRef = RDR_TRACKER_OBJ_031_oPCAN_RADAR_86c3db58_Tx
              PduRDestPduPduRBswModulesRef = CanIf
            PduRSrcPdu_19dbfe02 (PduRSrcPdu):
              PduRSourcePduHandleId = 154
              PduRSrcPduDirection = TRANSMIT
              PduRSrcPduRef = RDR_TRACKER_OBJ_031_oPCAN_RADAR_52e6de8d_Tx
              PduRSrcPduPduRBswModulesRef = Com
          RDR_DETECTION_209_212_oPCAN_RADAR_b78ac615_Tx: PduRRoutingPathCommunicationType=COMMUNICATION_INTERFACE, PduRLockRef=PduRLock_PduRExclusiveArea
            PduRSrcPdu_1012f080 (PduRSrcPdu):
              PduRSourcePduHandleId = 71
              PduRSrcPduDirection = TRANSMIT
              PduRSrcPduRef = RDR_DETECTION_209_212_oPCAN_RADAR_b78ac615_Tx
              PduRSrcPduPduRBswModulesRef = Com
            RDR_DETECTION_209_212_oPCAN_RADAR_4c39015c_Tx (PduRDestPdu):
              PduRDestPduHandleId = 73
              PduRDestPduDirection = TRANSMIT
              PduRDestPduRoutingType = API_FORWARDING
              PduRDestPduDataProcessing = IMMEDIATE
              PduRPduLengthHandlingStrategy = IGNORE
              PduRDestPduCrossPartitionDestination = false
              PduRTransmissionConfirmation = false
              PduRDestPduDataProvision = PDUR_DIRECT
              PduRDestPduRef = RDR_DETECTION_209_212_oPCAN_RADAR_4c39015c_Tx
              PduRDestPduPduRBswModulesRef = CanIf
          RDR_DETECTION_221_224_oPCAN_RADAR_88ca180e_Tx: PduRRoutingPathCommunicationType=COMMUNICATION_INTERFACE, PduRLockRef=PduRLock_PduRExclusiveArea
            PduRSrcPdu_bcb3cc16 (PduRSrcPdu):
              PduRSourcePduHandleId = 74
              PduRSrcPduDirection = TRANSMIT
              PduRSrcPduRef = RDR_DETECTION_221_224_oPCAN_RADAR_88ca180e_Tx
              PduRSrcPduPduRBswModulesRef = Com
            RDR_DETECTION_221_224_oPCAN_RADAR_8b56c0d7_Tx (PduRDestPdu):
              PduRDestPduHandleId = 76
              PduRDestPduDirection = TRANSMIT
              PduRDestPduRoutingType = API_FORWARDING
              PduRDestPduDataProcessing = IMMEDIATE
              PduRPduLengthHandlingStrategy = IGNORE
              PduRDestPduCrossPartitionDestination = false
              PduRTransmissionConfirmation = false
              PduRDestPduDataProvision = PDUR_DIRECT
              PduRDestPduRef = RDR_DETECTION_221_224_oPCAN_RADAR_8b56c0d7_Tx
              PduRDestPduPduRBswModulesRef = CanIf
          RDR_DETECTION_325_328_oPCAN_RADAR_0f61dd8a_Tx: PduRRoutingPathCommunicationType=COMMUNICATION_INTERFACE, PduRLockRef=PduRLock_PduRExclusiveArea
            PduRSrcPdu_994ef650 (PduRSrcPdu):
              PduRSourcePduHandleId = 100
              PduRSrcPduDirection = TRANSMIT
              PduRSrcPduRef = RDR_DETECTION_325_328_oPCAN_RADAR_0f61dd8a_Tx
              PduRSrcPduPduRBswModulesRef = Com
            RDR_DETECTION_325_328_oPCAN_RADAR_d33d481c_Tx (PduRDestPdu):
              PduRDestPduHandleId = 102
              PduRDestPduDirection = TRANSMIT
              PduRDestPduRoutingType = API_FORWARDING
              PduRDestPduDataProcessing = IMMEDIATE
              PduRPduLengthHandlingStrategy = IGNORE
              PduRDestPduCrossPartitionDestination = false
              PduRTransmissionConfirmation = false
              PduRDestPduDataProvision = PDUR_DIRECT
              PduRDestPduRef = RDR_DETECTION_325_328_oPCAN_RADAR_d33d481c_Tx
              PduRDestPduPduRBswModulesRef = CanIf
          RDR_DETECTION_169_172_oPCAN_RADAR_f31fddf6_Tx: PduRRoutingPathCommunicationType=COMMUNICATION_INTERFACE, PduRLockRef=PduRLock_PduRExclusiveArea
            RDR_DETECTION_169_172_oPCAN_RADAR_54acc5c4_Tx (PduRDestPdu):
              PduRDestPduHandleId = 63
              PduRDestPduDirection = TRANSMIT
              PduRDestPduRoutingType = API_FORWARDING
              PduRDestPduDataProcessing = IMMEDIATE
              PduRPduLengthHandlingStrategy = IGNORE
              PduRDestPduCrossPartitionDestination = false
              PduRTransmissionConfirmation = false
              PduRDestPduDataProvision = PDUR_DIRECT
              PduRDestPduRef = RDR_DETECTION_169_172_oPCAN_RADAR_54acc5c4_Tx
              PduRDestPduPduRBswModulesRef = CanIf
            PduRSrcPdu_0501344c (PduRSrcPdu):
              PduRSourcePduHandleId = 61
              PduRSrcPduDirection = TRANSMIT
              PduRSrcPduRef = RDR_DETECTION_169_172_oPCAN_RADAR_f31fddf6_Tx
              PduRSrcPduPduRBswModulesRef = Com
          RDR_DETECTION_293_296_oPCAN_RADAR_8e457501_Tx: PduRRoutingPathCommunicationType=COMMUNICATION_INTERFACE, PduRLockRef=PduRLock_PduRExclusiveArea
            RDR_DETECTION_293_296_oPCAN_RADAR_544e4f14_Tx (PduRDestPdu):
              PduRDestPduHandleId = 94
              PduRDestPduDirection = TRANSMIT
              PduRDestPduRoutingType = API_FORWARDING
              PduRDestPduDataProcessing = IMMEDIATE
              PduRPduLengthHandlingStrategy = IGNORE
              PduRDestPduCrossPartitionDestination = false
              PduRTransmissionConfirmation = false
              PduRDestPduDataProvision = PDUR_DIRECT
              PduRDestPduRef = RDR_DETECTION_293_296_oPCAN_RADAR_544e4f14_Tx
              PduRDestPduPduRBswModulesRef = CanIf
            PduRSrcPdu_21e7c134 (PduRSrcPdu):
              PduRSourcePduHandleId = 92
              PduRSrcPduDirection = TRANSMIT
              PduRSrcPduRef = RDR_DETECTION_293_296_oPCAN_RADAR_8e457501_Tx
              PduRSrcPduPduRBswModulesRef = Com
          RDR_TRACKER_OBJ_034_oPCAN_RADAR_4fc96d9e_Tx: PduRRoutingPathCommunicationType=COMMUNICATION_INTERFACE, PduRLockRef=PduRLock_PduRExclusiveArea
            PduRSrcPdu_666cd3cd (PduRSrcPdu):
              PduRSourcePduHandleId = 157
              PduRSrcPduDirection = TRANSMIT
              PduRSrcPduRef = RDR_TRACKER_OBJ_034_oPCAN_RADAR_4fc96d9e_Tx
              PduRSrcPduPduRBswModulesRef = Com
            RDR_TRACKER_OBJ_034_oPCAN_RADAR_6bfb0867_Tx (PduRDestPdu):
              PduRDestPduHandleId = 159
              PduRDestPduDirection = TRANSMIT
              PduRDestPduRoutingType = API_FORWARDING
              PduRDestPduDataProcessing = IMMEDIATE
              PduRPduLengthHandlingStrategy = IGNORE
              PduRDestPduCrossPartitionDestination = false
              PduRTransmissionConfirmation = false
              PduRDestPduDataProvision = PDUR_DIRECT
              PduRDestPduRef = RDR_TRACKER_OBJ_034_oPCAN_RADAR_6bfb0867_Tx
              PduRDestPduPduRBswModulesRef = CanIf
          RDR_DETECTION_089_092_oPCAN_RADAR_4fb0c14f_Tx: PduRRoutingPathCommunicationType=COMMUNICATION_INTERFACE, PduRLockRef=PduRLock_PduRExclusiveArea
            RDR_DETECTION_089_092_oPCAN_RADAR_dd644ab8_Tx (PduRDestPdu):
              PduRDestPduHandleId = 43
              PduRDestPduDirection = TRANSMIT
              PduRDestPduRoutingType = API_FORWARDING
              PduRDestPduDataProcessing = IMMEDIATE
              PduRPduLengthHandlingStrategy = IGNORE
              PduRDestPduCrossPartitionDestination = false
              PduRTransmissionConfirmation = false
              PduRDestPduDataProvision = PDUR_DIRECT
              PduRDestPduRef = RDR_DETECTION_089_092_oPCAN_RADAR_dd644ab8_Tx
              PduRDestPduPduRBswModulesRef = CanIf
            PduRSrcPdu_09eaf938 (PduRSrcPdu):
              PduRSourcePduHandleId = 41
              PduRSrcPduDirection = TRANSMIT
              PduRSrcPduRef = RDR_DETECTION_089_092_oPCAN_RADAR_4fb0c14f_Tx
              PduRSrcPduPduRBswModulesRef = Com
          RDR_DETECTION_017_020_oPCAN_RADAR_d9f3af92_Tx: PduRRoutingPathCommunicationType=COMMUNICATION_INTERFACE, PduRLockRef=PduRLock_PduRExclusiveArea
            PduRSrcPdu_dc70d43f (PduRSrcPdu):
              PduRSourcePduHandleId = 23
              PduRSrcPduDirection = TRANSMIT
              PduRSrcPduRef = RDR_DETECTION_017_020_oPCAN_RADAR_d9f3af92_Tx
              PduRSrcPduPduRBswModulesRef = Com
            RDR_DETECTION_017_020_oPCAN_RADAR_70e9c33f_Tx (PduRDestPdu):
              PduRDestPduHandleId = 25
              PduRDestPduDirection = TRANSMIT
              PduRDestPduRoutingType = API_FORWARDING
              PduRDestPduDataProcessing = IMMEDIATE
              PduRPduLengthHandlingStrategy = IGNORE
              PduRDestPduCrossPartitionDestination = false
              PduRTransmissionConfirmation = false
              PduRDestPduDataProvision = PDUR_DIRECT
              PduRDestPduRef = RDR_DETECTION_017_020_oPCAN_RADAR_70e9c33f_Tx
              PduRDestPduPduRBswModulesRef = CanIf
          RDR_DETECTION_193_196_oPCAN_RADAR_3c6e99d1_Tx: PduRRoutingPathCommunicationType=COMMUNICATION_INTERFACE, PduRLockRef=PduRLock_PduRExclusiveArea
            RDR_DETECTION_193_196_oPCAN_RADAR_0c066df6_Tx (PduRDestPdu):
              PduRDestPduHandleId = 69
              PduRDestPduDirection = TRANSMIT
              PduRDestPduRoutingType = API_FORWARDING
              PduRDestPduDataProcessing = IMMEDIATE
              PduRPduLengthHandlingStrategy = IGNORE
              PduRDestPduCrossPartitionDestination = false
              PduRTransmissionConfirmation = false
              PduRDestPduDataProvision = PDUR_DIRECT
              PduRDestPduRef = RDR_DETECTION_193_196_oPCAN_RADAR_0c066df6_Tx
              PduRDestPduPduRBswModulesRef = CanIf
            PduRSrcPdu_3eda2bea (PduRSrcPdu):
              PduRSourcePduHandleId = 67
              PduRSrcPduDirection = TRANSMIT
              PduRSrcPduRef = RDR_DETECTION_193_196_oPCAN_RADAR_3c6e99d1_Tx
              PduRSrcPduPduRBswModulesRef = Com
          RDR_DETECTION_397_400_oPCAN_RADAR_06e626f9_Tx: PduRRoutingPathCommunicationType=COMMUNICATION_INTERFACE, PduRLockRef=PduRLock_PduRExclusiveArea
            RDR_DETECTION_397_400_oPCAN_RADAR_d58dd49c_Tx (PduRDestPdu):
              PduRDestPduHandleId = 120
              PduRDestPduDirection = TRANSMIT
              PduRDestPduRoutingType = API_FORWARDING
              PduRDestPduDataProcessing = IMMEDIATE
              PduRPduLengthHandlingStrategy = IGNORE
              PduRDestPduCrossPartitionDestination = false
              PduRTransmissionConfirmation = false
              PduRDestPduDataProvision = PDUR_DIRECT
              PduRDestPduRef = RDR_DETECTION_397_400_oPCAN_RADAR_d58dd49c_Tx
              PduRDestPduPduRBswModulesRef = CanIf
            PduRSrcPdu_b8d5302b (PduRSrcPdu):
              PduRSourcePduHandleId = 118
              PduRSrcPduDirection = TRANSMIT
              PduRSrcPduRef = RDR_DETECTION_397_400_oPCAN_RADAR_06e626f9_Tx
              PduRSrcPduPduRBswModulesRef = Com
          RDR_DETECTION_225_228_oPCAN_RADAR_6178863a_Tx: PduRRoutingPathCommunicationType=COMMUNICATION_INTERFACE, PduRLockRef=PduRLock_PduRExclusiveArea
            RDR_DETECTION_225_228_oPCAN_RADAR_522a547d_Tx (PduRDestPdu):
              PduRDestPduHandleId = 77
              PduRDestPduDirection = TRANSMIT
              PduRDestPduRoutingType = API_FORWARDING
              PduRDestPduDataProcessing = IMMEDIATE
              PduRPduLengthHandlingStrategy = IGNORE
              PduRDestPduCrossPartitionDestination = false
              PduRTransmissionConfirmation = false
              PduRDestPduDataProvision = PDUR_DIRECT
              PduRDestPduRef = RDR_DETECTION_225_228_oPCAN_RADAR_522a547d_Tx
              PduRDestPduPduRBswModulesRef = CanIf
            PduRSrcPdu_908f46f4 (PduRSrcPdu):
              PduRSourcePduHandleId = 75
              PduRSrcPduDirection = TRANSMIT
              PduRSrcPduRef = RDR_DETECTION_225_228_oPCAN_RADAR_6178863a_Tx
              PduRSrcPduPduRBswModulesRef = Com
          RDR_DETECTION_053_056_oPCAN_RADAR_647b2a46_Tx: PduRRoutingPathCommunicationType=COMMUNICATION_INTERFACE, PduRLockRef=PduRLock_PduRExclusiveArea
            PduRSrcPdu_98c6f402 (PduRSrcPdu):
              PduRSourcePduHandleId = 32
              PduRSrcPduDirection = TRANSMIT
              PduRSrcPduRef = RDR_DETECTION_053_056_oPCAN_RADAR_647b2a46_Tx
              PduRSrcPduPduRBswModulesRef = Com
            RDR_DETECTION_053_056_oPCAN_RADAR_0caabd63_Tx (PduRDestPdu):
              PduRDestPduHandleId = 34
              PduRDestPduDirection = TRANSMIT
              PduRDestPduRoutingType = API_FORWARDING
              PduRDestPduDataProcessing = IMMEDIATE
              PduRPduLengthHandlingStrategy = IGNORE
              PduRDestPduCrossPartitionDestination = false
              PduRTransmissionConfirmation = false
              PduRDestPduDataProvision = PDUR_DIRECT
              PduRDestPduRef = RDR_DETECTION_053_056_oPCAN_RADAR_0caabd63_Tx
              PduRDestPduPduRBswModulesRef = CanIf
          RDR_TRACKER_OBJ_009_oPCAN_RADAR_7484283b_Tx: PduRRoutingPathCommunicationType=COMMUNICATION_INTERFACE, PduRLockRef=PduRLock_PduRExclusiveArea
            RDR_TRACKER_OBJ_009_oPCAN_RADAR_87a0a9db_Tx (PduRDestPdu):
              PduRDestPduHandleId = 134
              PduRDestPduDirection = TRANSMIT
              PduRDestPduRoutingType = API_FORWARDING
              PduRDestPduDataProcessing = IMMEDIATE
              PduRPduLengthHandlingStrategy = IGNORE
              PduRDestPduCrossPartitionDestination = false
              PduRTransmissionConfirmation = false
              PduRDestPduDataProvision = PDUR_DIRECT
              PduRDestPduRef = RDR_TRACKER_OBJ_009_oPCAN_RADAR_87a0a9db_Tx
              PduRDestPduPduRBswModulesRef = CanIf
            PduRSrcPdu_f16341fe (PduRSrcPdu):
              PduRSourcePduHandleId = 132
              PduRSrcPduDirection = TRANSMIT
              PduRSrcPduRef = RDR_TRACKER_OBJ_009_oPCAN_RADAR_7484283b_Tx
              PduRSrcPduPduRBswModulesRef = Com
          RDR_DETECTION_061_064_oPCAN_RADAR_46fcf773_Tx: PduRRoutingPathCommunicationType=COMMUNICATION_INTERFACE, PduRLockRef=PduRLock_PduRExclusiveArea
            RDR_DETECTION_061_064_oPCAN_RADAR_9bb047c7_Tx (PduRDestPdu):
              PduRDestPduHandleId = 36
              PduRDestPduDirection = TRANSMIT
              PduRDestPduRoutingType = API_FORWARDING
              PduRDestPduDataProcessing = IMMEDIATE
              PduRPduLengthHandlingStrategy = IGNORE
              PduRDestPduCrossPartitionDestination = false
              PduRTransmissionConfirmation = false
              PduRDestPduDataProvision = PDUR_DIRECT
              PduRDestPduRef = RDR_DETECTION_061_064_oPCAN_RADAR_9bb047c7_Tx
              PduRDestPduPduRBswModulesRef = CanIf
            PduRSrcPdu_f070380c (PduRSrcPdu):
              PduRSourcePduHandleId = 34
              PduRSrcPduDirection = TRANSMIT
              PduRSrcPduRef = RDR_DETECTION_061_064_oPCAN_RADAR_46fcf773_Tx
              PduRSrcPduPduRBswModulesRef = Com
          RDR_TRACKER_OBJ_030_oPCAN_RADAR_8f700708_Tx: PduRRoutingPathCommunicationType=COMMUNICATION_INTERFACE, PduRLockRef=PduRLock_PduRExclusiveArea
            PduRSrcPdu_7a87facd (PduRSrcPdu):
              PduRSourcePduHandleId = 153
              PduRSrcPduDirection = TRANSMIT
              PduRSrcPduRef = RDR_TRACKER_OBJ_030_oPCAN_RADAR_8f700708_Tx
              PduRSrcPduPduRBswModulesRef = Com
            RDR_TRACKER_OBJ_030_oPCAN_RADAR_b0314bab_Tx (PduRDestPdu):
              PduRDestPduHandleId = 155
              PduRDestPduDirection = TRANSMIT
              PduRDestPduRoutingType = API_FORWARDING
              PduRDestPduDataProcessing = IMMEDIATE
              PduRPduLengthHandlingStrategy = IGNORE
              PduRDestPduCrossPartitionDestination = false
              PduRTransmissionConfirmation = false
              PduRDestPduDataProvision = PDUR_DIRECT
              PduRDestPduRef = RDR_TRACKER_OBJ_030_oPCAN_RADAR_b0314bab_Tx
              PduRDestPduPduRBswModulesRef = CanIf
          RDR_DETECTION_069_072_oPCAN_RADAR_9d068646_Tx: PduRRoutingPathCommunicationType=COMMUNICATION_INTERFACE, PduRLockRef=PduRLock_PduRExclusiveArea
            PduRSrcPdu_7059221e (PduRSrcPdu):
              PduRSourcePduHandleId = 36
              PduRSrcPduDirection = TRANSMIT
              PduRSrcPduRef = RDR_DETECTION_069_072_oPCAN_RADAR_9d068646_Tx
              PduRSrcPduPduRBswModulesRef = Com
            RDR_DETECTION_069_072_oPCAN_RADAR_d5bbd9a5_Tx (PduRDestPdu):
              PduRDestPduHandleId = 38
              PduRDestPduDirection = TRANSMIT
              PduRDestPduRoutingType = API_FORWARDING
              PduRDestPduDataProcessing = IMMEDIATE
              PduRPduLengthHandlingStrategy = IGNORE
              PduRDestPduCrossPartitionDestination = false
              PduRTransmissionConfirmation = false
              PduRDestPduDataProvision = PDUR_DIRECT
              PduRDestPduRef = RDR_DETECTION_069_072_oPCAN_RADAR_d5bbd9a5_Tx
              PduRDestPduPduRBswModulesRef = CanIf
          RDR_DETECTION_321_324_oPCAN_RADAR_e6d343be_Tx: PduRRoutingPathCommunicationType=COMMUNICATION_INTERFACE, PduRLockRef=PduRLock_PduRExclusiveArea
            RDR_DETECTION_321_324_oPCAN_RADAR_0a41dcb6_Tx (PduRDestPdu):
              PduRDestPduHandleId = 101
              PduRDestPduDirection = TRANSMIT
              PduRDestPduRoutingType = API_FORWARDING
              PduRDestPduDataProcessing = IMMEDIATE
              PduRPduLengthHandlingStrategy = IGNORE
              PduRDestPduCrossPartitionDestination = false
              PduRTransmissionConfirmation = false
              PduRDestPduDataProvision = PDUR_DIRECT
              PduRDestPduRef = RDR_DETECTION_321_324_oPCAN_RADAR_0a41dcb6_Tx
              PduRDestPduPduRBswModulesRef = CanIf
            PduRSrcPdu_787545ab (PduRSrcPdu):
              PduRSourcePduHandleId = 99
              PduRSrcPduDirection = TRANSMIT
              PduRSrcPduRef = RDR_DETECTION_321_324_oPCAN_RADAR_e6d343be_Tx
              PduRSrcPduPduRBswModulesRef = Com
          RDR_DETECTION_013_016_oPCAN_RADAR_767f725b_Tx: PduRRoutingPathCommunicationType=COMMUNICATION_INTERFACE, PduRLockRef=PduRLock_PduRExclusiveArea
            PduRSrcPdu_a3cd0b40 (PduRSrcPdu):
              PduRSourcePduHandleId = 22
              PduRSrcPduDirection = TRANSMIT
              PduRSrcPduRef = RDR_DETECTION_013_016_oPCAN_RADAR_767f725b_Tx
              PduRSrcPduPduRBswModulesRef = Com
            RDR_DETECTION_013_016_oPCAN_RADAR_c51304f0_Tx (PduRDestPdu):
              PduRDestPduHandleId = 24
              PduRDestPduDirection = TRANSMIT
              PduRDestPduRoutingType = API_FORWARDING
              PduRDestPduDataProcessing = IMMEDIATE
              PduRPduLengthHandlingStrategy = IGNORE
              PduRDestPduCrossPartitionDestination = false
              PduRTransmissionConfirmation = false
              PduRDestPduDataProvision = PDUR_DIRECT
              PduRDestPduRef = RDR_DETECTION_013_016_oPCAN_RADAR_c51304f0_Tx
              PduRDestPduPduRBswModulesRef = CanIf
          RDR_DETECTION_125_128_oPCAN_RADAR_d3536aea_Tx: PduRRoutingPathCommunicationType=COMMUNICATION_INTERFACE, PduRLockRef=PduRLock_PduRExclusiveArea
            PduRSrcPdu_916fab35 (PduRSrcPdu):
              PduRSourcePduHandleId = 50
              PduRSrcPduDirection = TRANSMIT
              PduRSrcPduRef = RDR_DETECTION_125_128_oPCAN_RADAR_d3536aea_Tx
              PduRSrcPduPduRBswModulesRef = Com
            RDR_DETECTION_125_128_oPCAN_RADAR_0a62769f_Tx (PduRDestPdu):
              PduRDestPduHandleId = 52
              PduRDestPduDirection = TRANSMIT
              PduRDestPduRoutingType = API_FORWARDING
              PduRDestPduDataProcessing = IMMEDIATE
              PduRPduLengthHandlingStrategy = IGNORE
              PduRDestPduCrossPartitionDestination = false
              PduRTransmissionConfirmation = false
              PduRDestPduDataProvision = PDUR_DIRECT
              PduRDestPduRef = RDR_DETECTION_125_128_oPCAN_RADAR_0a62769f_Tx
              PduRDestPduPduRBswModulesRef = CanIf
          RDR_DETECTION_185_188_oPCAN_RADAR_13e175fe_Tx: PduRRoutingPathCommunicationType=COMMUNICATION_INTERFACE, PduRLockRef=PduRLock_PduRExclusiveArea
            PduRSrcPdu_518f8e48 (PduRSrcPdu):
              PduRSourcePduHandleId = 65
              PduRSrcPduDirection = TRANSMIT
              PduRSrcPduRef = RDR_DETECTION_185_188_oPCAN_RADAR_13e175fe_Tx
              PduRSrcPduPduRBswModulesRef = Com
            RDR_DETECTION_185_188_oPCAN_RADAR_cb045c11_Tx (PduRDestPdu):
              PduRDestPduHandleId = 67
              PduRDestPduDirection = TRANSMIT
              PduRDestPduRoutingType = API_FORWARDING
              PduRDestPduDataProcessing = IMMEDIATE
              PduRPduLengthHandlingStrategy = IGNORE
              PduRDestPduCrossPartitionDestination = false
              PduRTransmissionConfirmation = false
              PduRDestPduDataProvision = PDUR_DIRECT
              PduRDestPduRef = RDR_DETECTION_185_188_oPCAN_RADAR_cb045c11_Tx
              PduRDestPduPduRBswModulesRef = CanIf
          RDR_TRACKER_OBJ_015_oPCAN_RADAR_733170b6_Tx: PduRRoutingPathCommunicationType=COMMUNICATION_INTERFACE, PduRLockRef=PduRLock_PduRExclusiveArea
            RDR_TRACKER_OBJ_015_oPCAN_RADAR_140d3af8_Tx (PduRDestPdu):
              PduRDestPduHandleId = 140
              PduRDestPduDirection = TRANSMIT
              PduRDestPduRoutingType = API_FORWARDING
              PduRDestPduDataProcessing = IMMEDIATE
              PduRPduLengthHandlingStrategy = IGNORE
              PduRDestPduCrossPartitionDestination = false
              PduRTransmissionConfirmation = false
              PduRDestPduDataProvision = PDUR_DIRECT
              PduRDestPduRef = RDR_TRACKER_OBJ_015_oPCAN_RADAR_140d3af8_Tx
              PduRDestPduPduRBswModulesRef = CanIf
            PduRSrcPdu_16d666a1 (PduRSrcPdu):
              PduRSourcePduHandleId = 138
              PduRSrcPduDirection = TRANSMIT
              PduRSrcPduRef = RDR_TRACKER_OBJ_015_oPCAN_RADAR_733170b6_Tx
              PduRSrcPduPduRBswModulesRef = Com
          RDR_DETECTION_129_132_oPCAN_RADAR_e11b85eb_Tx: PduRRoutingPathCommunicationType=COMMUNICATION_INTERFACE, PduRLockRef=PduRLock_PduRExclusiveArea
            PduRSrcPdu_e7232cc0 (PduRSrcPdu):
              PduRSourcePduHandleId = 51
              PduRSrcPduDirection = TRANSMIT
              PduRSrcPduRef = RDR_DETECTION_129_132_oPCAN_RADAR_e11b85eb_Tx
              PduRSrcPduPduRBswModulesRef = Com
            RDR_DETECTION_129_132_oPCAN_RADAR_9d157c57_Tx (PduRDestPdu):
              PduRDestPduHandleId = 53
              PduRDestPduDirection = TRANSMIT
              PduRDestPduRoutingType = API_FORWARDING
              PduRDestPduDataProcessing = IMMEDIATE
              PduRPduLengthHandlingStrategy = IGNORE
              PduRDestPduCrossPartitionDestination = false
              PduRTransmissionConfirmation = false
              PduRDestPduDataProvision = PDUR_DIRECT
              PduRDestPduRef = RDR_DETECTION_129_132_oPCAN_RADAR_9d157c57_Tx
              PduRDestPduPduRBswModulesRef = CanIf
          RDR_TRACKER_OBJ_018_oPCAN_RADAR_341d10c8_Tx: PduRRoutingPathCommunicationType=COMMUNICATION_INTERFACE, PduRLockRef=PduRLock_PduRExclusiveArea
            PduRSrcPdu_bbb1f985 (PduRSrcPdu):
              PduRSourcePduHandleId = 141
              PduRSrcPduDirection = TRANSMIT
              PduRSrcPduRef = RDR_TRACKER_OBJ_018_oPCAN_RADAR_341d10c8_Tx
              PduRSrcPduPduRBswModulesRef = Com
            RDR_TRACKER_OBJ_018_oPCAN_RADAR_95d0681e_Tx (PduRDestPdu):
              PduRDestPduHandleId = 143
              PduRDestPduDirection = TRANSMIT
              PduRDestPduRoutingType = API_FORWARDING
              PduRDestPduDataProcessing = IMMEDIATE
              PduRPduLengthHandlingStrategy = IGNORE
              PduRDestPduCrossPartitionDestination = false
              PduRTransmissionConfirmation = false
              PduRDestPduDataProvision = PDUR_DIRECT
              PduRDestPduRef = RDR_TRACKER_OBJ_018_oPCAN_RADAR_95d0681e_Tx
              PduRDestPduPduRBswModulesRef = CanIf
          RDR_DETECTION_369_372_oPCAN_RADAR_2f2d6a96_Tx: PduRRoutingPathCommunicationType=COMMUNICATION_INTERFACE, PduRLockRef=PduRLock_PduRExclusiveArea
            RDR_DETECTION_369_372_oPCAN_RADAR_8df3fb47_Tx (PduRDestPdu):
              PduRDestPduHandleId = 113
              PduRDestPduDirection = TRANSMIT
              PduRDestPduRoutingType = API_FORWARDING
              PduRDestPduDataProcessing = IMMEDIATE
              PduRPduLengthHandlingStrategy = IGNORE
              PduRDestPduCrossPartitionDestination = false
              PduRTransmissionConfirmation = false
              PduRDestPduDataProvision = PDUR_DIRECT
              PduRDestPduRef = RDR_DETECTION_369_372_oPCAN_RADAR_8df3fb47_Tx
              PduRDestPduPduRBswModulesRef = CanIf
            PduRSrcPdu_77e03a49 (PduRSrcPdu):
              PduRSourcePduHandleId = 111
              PduRSrcPduDirection = TRANSMIT
              PduRSrcPduRef = RDR_DETECTION_369_372_oPCAN_RADAR_2f2d6a96_Tx
              PduRSrcPduPduRBswModulesRef = Com
          RDR_DETECTION_117_120_oPCAN_RADAR_b7eaf422_Tx: PduRRoutingPathCommunicationType=COMMUNICATION_INTERFACE, PduRLockRef=PduRLock_PduRExclusiveArea
            PduRSrcPdu_97d8b342 (PduRSrcPdu):
              PduRSourcePduHandleId = 48
              PduRSrcPduDirection = TRANSMIT
              PduRSrcPduRef = RDR_DETECTION_117_120_oPCAN_RADAR_b7eaf422_Tx
              PduRSrcPduPduRBswModulesRef = Com
            RDR_DETECTION_117_120_oPCAN_RADAR_f1fedf5e_Tx (PduRDestPdu):
              PduRDestPduHandleId = 50
              PduRDestPduDirection = TRANSMIT
              PduRDestPduRoutingType = API_FORWARDING
              PduRDestPduDataProcessing = IMMEDIATE
              PduRPduLengthHandlingStrategy = IGNORE
              PduRDestPduCrossPartitionDestination = false
              PduRTransmissionConfirmation = false
              PduRDestPduDataProvision = PDUR_DIRECT
              PduRDestPduRef = RDR_DETECTION_117_120_oPCAN_RADAR_f1fedf5e_Tx
              PduRDestPduPduRBswModulesRef = CanIf
          RDR_STATUS_001_oPCAN_RADAR_4b6de2c5_Tx: PduRRoutingPathCommunicationType=COMMUNICATION_INTERFACE, PduRLockRef=PduRLock_PduRExclusiveArea
            RDR_STATUS_001_oPCAN_RADAR_deb478ca_Tx (PduRDestPdu):
              PduRDestPduHandleId = 124
              PduRDestPduDirection = TRANSMIT
              PduRDestPduRoutingType = API_FORWARDING
              PduRDestPduDataProcessing = IMMEDIATE
              PduRPduLengthHandlingStrategy = IGNORE
              PduRDestPduCrossPartitionDestination = false
              PduRTransmissionConfirmation = false
              PduRDestPduDataProvision = PDUR_DIRECT
              PduRDestPduRef = RDR_STATUS_001_oPCAN_RADAR_deb478ca_Tx
              PduRDestPduPduRBswModulesRef = CanIf
            PduRSrcPdu_5d7416fe (PduRSrcPdu): PduRSourcePduHandleId=122, PduRSrcPduDirection=TRANSMIT, PduRSrcPduRef=RDR_STATUS_001_oPCAN_RADAR_4b6de2c5_Tx, PduRSrcPduPduRBswModulesRef=Com
          RDR_DETECTION_065_068_oPCAN_RADAR_af4e6947_Tx: PduRRoutingPathCommunicationType=COMMUNICATION_INTERFACE, PduRLockRef=PduRLock_PduRExclusiveArea
            RDR_DETECTION_065_068_oPCAN_RADAR_42ccd36d_Tx (PduRDestPdu):
              PduRDestPduHandleId = 37
              PduRDestPduDirection = TRANSMIT
              PduRDestPduRoutingType = API_FORWARDING
              PduRDestPduDataProcessing = IMMEDIATE
              PduRPduLengthHandlingStrategy = IGNORE
              PduRDestPduCrossPartitionDestination = false
              PduRTransmissionConfirmation = false
              PduRDestPduDataProvision = PDUR_DIRECT
              PduRDestPduRef = RDR_DETECTION_065_068_oPCAN_RADAR_42ccd36d_Tx
              PduRDestPduPduRBswModulesRef = CanIf
            PduRSrcPdu_8b837188 (PduRSrcPdu):
              PduRSourcePduHandleId = 35
              PduRSrcPduDirection = TRANSMIT
              PduRSrcPduRef = RDR_DETECTION_065_068_oPCAN_RADAR_af4e6947_Tx
              PduRSrcPduPduRBswModulesRef = Com
          RDR_TRACKER_OBJ_017_oPCAN_RADAR_136dc5fd_Tx: PduRRoutingPathCommunicationType=COMMUNICATION_INTERFACE, PduRLockRef=PduRLock_PduRExclusiveArea
            RDR_TRACKER_OBJ_017_oPCAN_RADAR_79e81b1e_Tx (PduRDestPdu):
              PduRDestPduHandleId = 142
              PduRDestPduDirection = TRANSMIT
              PduRDestPduRoutingType = API_FORWARDING
              PduRDestPduDataProcessing = IMMEDIATE
              PduRPduLengthHandlingStrategy = IGNORE
              PduRDestPduCrossPartitionDestination = false
              PduRTransmissionConfirmation = false
              PduRDestPduDataProvision = PDUR_DIRECT
              PduRDestPduRef = RDR_TRACKER_OBJ_017_oPCAN_RADAR_79e81b1e_Tx
              PduRDestPduPduRBswModulesRef = CanIf
            PduRSrcPdu_2a870fac (PduRSrcPdu):
              PduRSourcePduHandleId = 140
              PduRSrcPduDirection = TRANSMIT
              PduRSrcPduRef = RDR_TRACKER_OBJ_017_oPCAN_RADAR_136dc5fd_Tx
              PduRSrcPduPduRBswModulesRef = Com
          RDR_DETECTION_113_116_oPCAN_RADAR_186629eb_Tx: PduRRoutingPathCommunicationType=COMMUNICATION_INTERFACE, PduRLockRef=PduRLock_PduRExclusiveArea
            PduRSrcPdu_776bf50a (PduRSrcPdu):
              PduRSourcePduHandleId = 47
              PduRSrcPduDirection = TRANSMIT
              PduRSrcPduRef = RDR_DETECTION_113_116_oPCAN_RADAR_186629eb_Tx
              PduRSrcPduPduRBswModulesRef = Com
            RDR_DETECTION_113_116_oPCAN_RADAR_44041891_Tx (PduRDestPdu):
              PduRDestPduHandleId = 49
              PduRDestPduDirection = TRANSMIT
              PduRDestPduRoutingType = API_FORWARDING
              PduRDestPduDataProcessing = IMMEDIATE
              PduRPduLengthHandlingStrategy = IGNORE
              PduRDestPduCrossPartitionDestination = false
              PduRTransmissionConfirmation = false
              PduRDestPduDataProvision = PDUR_DIRECT
              PduRDestPduRef = RDR_DETECTION_113_116_oPCAN_RADAR_44041891_Tx
              PduRDestPduPduRBswModulesRef = CanIf
          RDR_DETECTION_249_252_oPCAN_RADAR_a58e9e08_Tx: PduRRoutingPathCommunicationType=COMMUNICATION_INTERFACE, PduRLockRef=PduRLock_PduRExclusiveArea
            PduRSrcPdu_10ed6f75 (PduRSrcPdu):
              PduRSourcePduHandleId = 81
              PduRSrcPduDirection = TRANSMIT
              PduRSrcPduRef = RDR_DETECTION_249_252_oPCAN_RADAR_a58e9e08_Tx
              PduRSrcPduPduRBswModulesRef = Com
            RDR_DETECTION_249_252_oPCAN_RADAR_8580b8cf_Tx (PduRDestPdu):
              PduRDestPduHandleId = 83
              PduRDestPduDirection = TRANSMIT
              PduRDestPduRoutingType = API_FORWARDING
              PduRDestPduDataProcessing = IMMEDIATE
              PduRPduLengthHandlingStrategy = IGNORE
              PduRDestPduCrossPartitionDestination = false
              PduRTransmissionConfirmation = false
              PduRDestPduDataProvision = PDUR_DIRECT
              PduRDestPduRef = RDR_DETECTION_249_252_oPCAN_RADAR_8580b8cf_Tx
              PduRDestPduPduRBswModulesRef = CanIf
          RDR_TRACKER_OBJ_055_oPCAN_RADAR_6a9dffad_Tx: PduRRoutingPathCommunicationType=COMMUNICATION_INTERFACE, PduRLockRef=PduRLock_PduRExclusiveArea
            RDR_TRACKER_OBJ_055_oPCAN_RADAR_86047e20_Tx (PduRDestPdu):
              PduRDestPduHandleId = 180
              PduRDestPduDirection = TRANSMIT
              PduRDestPduRoutingType = API_FORWARDING
              PduRDestPduDataProcessing = IMMEDIATE
              PduRPduLengthHandlingStrategy = IGNORE
              PduRDestPduCrossPartitionDestination = false
              PduRTransmissionConfirmation = false
              PduRDestPduDataProvision = PDUR_DIRECT
              PduRDestPduRef = RDR_TRACKER_OBJ_055_oPCAN_RADAR_86047e20_Tx
              PduRDestPduPduRBswModulesRef = CanIf
            PduRSrcPdu_b114bae6 (PduRSrcPdu):
              PduRSourcePduHandleId = 178
              PduRSrcPduDirection = TRANSMIT
              PduRSrcPduRef = RDR_TRACKER_OBJ_055_oPCAN_RADAR_6a9dffad_Tx
              PduRSrcPduPduRBswModulesRef = Com
          RDR_ALIGNMENT_STATUS_002_oPCAN_RADAR_604bf216_Tx: PduRRoutingPathCommunicationType=COMMUNICATION_INTERFACE, PduRLockRef=PduRLock_PduRExclusiveArea
            RDR_ALIGNMENT_STATUS_002_oPCAN_RADAR_14836740_Tx (PduRDestPdu):
              PduRDestPduHandleId = 18
              PduRDestPduDirection = TRANSMIT
              PduRDestPduRoutingType = API_FORWARDING
              PduRDestPduDataProcessing = IMMEDIATE
              PduRPduLengthHandlingStrategy = IGNORE
              PduRDestPduCrossPartitionDestination = false
              PduRTransmissionConfirmation = false
              PduRDestPduDataProvision = PDUR_DIRECT
              PduRDestPduRef = RDR_ALIGNMENT_STATUS_002_oPCAN_RADAR_14836740_Tx
              PduRDestPduPduRBswModulesRef = CanIf
            PduRSrcPdu_8656e65c (PduRSrcPdu):
              PduRSourcePduHandleId = 16
              PduRSrcPduDirection = TRANSMIT
              PduRSrcPduRef = RDR_ALIGNMENT_STATUS_002_oPCAN_RADAR_604bf216_Tx
              PduRSrcPduPduRBswModulesRef = Com
          RDR_DETECTION_253_256_oPCAN_RADAR_b8499d26_Tx: PduRRoutingPathCommunicationType=COMMUNICATION_INTERFACE, PduRLockRef=PduRLock_PduRExclusiveArea
            PduRSrcPdu_6601beb6 (PduRSrcPdu):
              PduRSourcePduHandleId = 82
              PduRSrcPduDirection = TRANSMIT
              PduRSrcPduRef = RDR_DETECTION_253_256_oPCAN_RADAR_b8499d26_Tx
              PduRSrcPduPduRBswModulesRef = Com
            RDR_DETECTION_253_256_oPCAN_RADAR_d5f583e0_Tx (PduRDestPdu):
              PduRDestPduHandleId = 84
              PduRDestPduDirection = TRANSMIT
              PduRDestPduRoutingType = API_FORWARDING
              PduRDestPduDataProcessing = IMMEDIATE
              PduRPduLengthHandlingStrategy = IGNORE
              PduRDestPduCrossPartitionDestination = false
              PduRTransmissionConfirmation = false
              PduRDestPduDataProvision = PDUR_DIRECT
              PduRDestPduRef = RDR_DETECTION_253_256_oPCAN_RADAR_d5f583e0_Tx
              PduRDestPduPduRBswModulesRef = CanIf
          RDR_TRACKER_OBJ_012_oPCAN_RADAR_0e4276ee_Tx: PduRRoutingPathCommunicationType=COMMUNICATION_INTERFACE, PduRLockRef=PduRLock_PduRExclusiveArea
            PduRSrcPdu_12988cee (PduRSrcPdu):
              PduRSourcePduHandleId = 135
              PduRSrcPduDirection = TRANSMIT
              PduRSrcPduRef = RDR_TRACKER_OBJ_012_oPCAN_RADAR_0e4276ee_Tx
              PduRSrcPduPduRBswModulesRef = Com
            RDR_TRACKER_OBJ_012_oPCAN_RADAR_94d0c821_Tx (PduRDestPdu):
              PduRDestPduHandleId = 137
              PduRDestPduDirection = TRANSMIT
              PduRDestPduRoutingType = API_FORWARDING
              PduRDestPduDataProcessing = IMMEDIATE
              PduRPduLengthHandlingStrategy = IGNORE
              PduRDestPduCrossPartitionDestination = false
              PduRTransmissionConfirmation = false
              PduRDestPduDataProvision = PDUR_DIRECT
              PduRDestPduRef = RDR_TRACKER_OBJ_012_oPCAN_RADAR_94d0c821_Tx
              PduRDestPduPduRBswModulesRef = CanIf
          RDR_DETECTION_309_312_oPCAN_RADAR_d9939da5_Tx: PduRRoutingPathCommunicationType=COMMUNICATION_INTERFACE, PduRLockRef=PduRLock_PduRExclusiveArea
            PduRSrcPdu_788dc9d6 (PduRSrcPdu):
              PduRSourcePduHandleId = 96
              PduRSrcPduDirection = TRANSMIT
              PduRSrcPduRef = RDR_DETECTION_309_312_oPCAN_RADAR_d9939da5_Tx
              PduRSrcPduPduRBswModulesRef = Com
            RDR_DETECTION_309_312_oPCAN_RADAR_cd2e1d3d_Tx (PduRDestPdu):
              PduRDestPduHandleId = 98
              PduRDestPduDirection = TRANSMIT
              PduRDestPduRoutingType = API_FORWARDING
              PduRDestPduDataProcessing = IMMEDIATE
              PduRPduLengthHandlingStrategy = IGNORE
              PduRDestPduCrossPartitionDestination = false
              PduRTransmissionConfirmation = false
              PduRDestPduDataProvision = PDUR_DIRECT
              PduRDestPduRef = RDR_DETECTION_309_312_oPCAN_RADAR_cd2e1d3d_Tx
              PduRDestPduPduRBswModulesRef = CanIf
          RDR_OBJ_HEADER_002_oPCAN_RADAR_1ea433e3_Tx: PduRRoutingPathCommunicationType=COMMUNICATION_INTERFACE, PduRLockRef=PduRLock_PduRExclusiveArea
            PduRSrcPdu_0bea2fee (PduRSrcPdu): PduRSourcePduHandleId=120, PduRSrcPduDirection=TRANSMIT, PduRSrcPduRef=RDR_OBJ_HEADER_002_oPCAN_RADAR_1ea433e3_Tx, PduRSrcPduPduRBswModulesRef=Com
            RDR_OBJ_HEADER_002_oPCAN_RADAR_018ea437_Tx (PduRDestPdu):
              PduRDestPduHandleId = 122
              PduRDestPduDirection = TRANSMIT
              PduRDestPduRoutingType = API_FORWARDING
              PduRDestPduDataProcessing = IMMEDIATE
              PduRPduLengthHandlingStrategy = IGNORE
              PduRDestPduCrossPartitionDestination = false
              PduRTransmissionConfirmation = false
              PduRDestPduDataProvision = PDUR_DIRECT
              PduRDestPduRef = RDR_OBJ_HEADER_002_oPCAN_RADAR_018ea437_Tx
              PduRDestPduPduRBswModulesRef = CanIf
          RDR_DETECTION_385_388_oPCAN_RADAR_cfd3c29e_Tx: PduRRoutingPathCommunicationType=COMMUNICATION_INTERFACE, PduRLockRef=PduRLock_PduRExclusiveArea
            RDR_DETECTION_385_388_oPCAN_RADAR_125b6292_Tx (PduRDestPdu):
              PduRDestPduHandleId = 117
              PduRDestPduDirection = TRANSMIT
              PduRDestPduRoutingType = API_FORWARDING
              PduRDestPduDataProcessing = IMMEDIATE
              PduRPduLengthHandlingStrategy = IGNORE
              PduRDestPduCrossPartitionDestination = false
              PduRTransmissionConfirmation = false
              PduRDestPduDataProvision = PDUR_DIRECT
              PduRDestPduRef = RDR_DETECTION_385_388_oPCAN_RADAR_125b6292_Tx
              PduRDestPduPduRBswModulesRef = CanIf
            PduRSrcPdu_cb35f6b9 (PduRSrcPdu):
              PduRSourcePduHandleId = 115
              PduRSrcPduDirection = TRANSMIT
              PduRSrcPduRef = RDR_DETECTION_385_388_oPCAN_RADAR_cfd3c29e_Tx
              PduRSrcPduPduRBswModulesRef = Com
          RDR_DETECTION_141_144_oPCAN_RADAR_cc5f03ed_Tx: PduRRoutingPathCommunicationType=COMMUNICATION_INTERFACE, PduRLockRef=PduRLock_PduRExclusiveArea
            RDR_DETECTION_141_144_oPCAN_RADAR_93c3044f_Tx (PduRDestPdu):
              PduRDestPduHandleId = 56
              PduRDestPduDirection = TRANSMIT
              PduRDestPduRoutingType = API_FORWARDING
              PduRDestPduDataProcessing = IMMEDIATE
              PduRPduLengthHandlingStrategy = IGNORE
              PduRDestPduCrossPartitionDestination = false
              PduRTransmissionConfirmation = false
              PduRDestPduDataProvision = PDUR_DIRECT
              PduRDestPduRef = RDR_DETECTION_141_144_oPCAN_RADAR_93c3044f_Tx
              PduRDestPduPduRBswModulesRef = CanIf
            PduRSrcPdu_3f8a85b4 (PduRSrcPdu):
              PduRSourcePduHandleId = 54
              PduRSrcPduDirection = TRANSMIT
              PduRSrcPduRef = RDR_DETECTION_141_144_oPCAN_RADAR_cc5f03ed_Tx
              PduRSrcPduPduRBswModulesRef = Com
          RDR_DETECTION_153_156_oPCAN_RADAR_0a6271f6_Tx: PduRRoutingPathCommunicationType=COMMUNICATION_INTERFACE, PduRLockRef=PduRLock_PduRExclusiveArea
            PduRSrcPdu_111ddca3 (PduRSrcPdu):
              PduRSourcePduHandleId = 57
              PduRSrcPduDirection = TRANSMIT
              PduRSrcPduRef = RDR_DETECTION_153_156_oPCAN_RADAR_0a6271f6_Tx
              PduRSrcPduPduRBswModulesRef = Com
            RDR_DETECTION_153_156_oPCAN_RADAR_8dbda102_Tx (PduRDestPdu):
              PduRDestPduHandleId = 59
              PduRDestPduDirection = TRANSMIT
              PduRDestPduRoutingType = API_FORWARDING
              PduRDestPduDataProcessing = IMMEDIATE
              PduRPduLengthHandlingStrategy = IGNORE
              PduRDestPduCrossPartitionDestination = false
              PduRTransmissionConfirmation = false
              PduRDestPduDataProvision = PDUR_DIRECT
              PduRDestPduRef = RDR_DETECTION_153_156_oPCAN_RADAR_8dbda102_Tx
              PduRDestPduPduRBswModulesRef = CanIf
          RDR_TRACKER_OBJ_056_oPCAN_RADAR_d7579363_Tx: PduRRoutingPathCommunicationType=COMMUNICATION_INTERFACE, PduRLockRef=PduRLock_PduRExclusiveArea
            PduRSrcPdu_788bbdb4 (PduRSrcPdu):
              PduRSourcePduHandleId = 179
              PduRSrcPduDirection = TRANSMIT
              PduRSrcPduRef = RDR_TRACKER_OBJ_056_oPCAN_RADAR_d7579363_Tx
              PduRSrcPduPduRBswModulesRef = Com
            RDR_TRACKER_OBJ_056_oPCAN_RADAR_dd13cf35_Tx (PduRDestPdu):
              PduRDestPduHandleId = 181
              PduRDestPduDirection = TRANSMIT
              PduRDestPduRoutingType = API_FORWARDING
              PduRDestPduDataProcessing = IMMEDIATE
              PduRPduLengthHandlingStrategy = IGNORE
              PduRDestPduCrossPartitionDestination = false
              PduRTransmissionConfirmation = false
              PduRDestPduDataProvision = PDUR_DIRECT
              PduRDestPduRef = RDR_TRACKER_OBJ_056_oPCAN_RADAR_dd13cf35_Tx
              PduRDestPduPduRBswModulesRef = CanIf
          RDR_TRACKER_OBJ_041_oPCAN_RADAR_372b744d_Tx: PduRRoutingPathCommunicationType=COMMUNICATION_INTERFACE, PduRLockRef=PduRLock_PduRExclusiveArea
            PduRSrcPdu_18c490d9 (PduRSrcPdu):
              PduRSourcePduHandleId = 164
              PduRSrcPduDirection = TRANSMIT
              PduRSrcPduRef = RDR_TRACKER_OBJ_041_oPCAN_RADAR_372b744d_Tx
              PduRSrcPduPduRBswModulesRef = Com
            RDR_TRACKER_OBJ_041_oPCAN_RADAR_794c6cda_Tx (PduRDestPdu):
              PduRDestPduHandleId = 166
              PduRDestPduDirection = TRANSMIT
              PduRDestPduRoutingType = API_FORWARDING
              PduRDestPduDataProcessing = IMMEDIATE
              PduRPduLengthHandlingStrategy = IGNORE
              PduRDestPduCrossPartitionDestination = false
              PduRTransmissionConfirmation = false
              PduRDestPduDataProvision = PDUR_DIRECT
              PduRDestPduRef = RDR_TRACKER_OBJ_041_oPCAN_RADAR_794c6cda_Tx
              PduRDestPduPduRBswModulesRef = CanIf
          RDR_DETECTION_333_336_oPCAN_RADAR_20ee31a5_Tx: PduRRoutingPathCommunicationType=COMMUNICATION_INTERFACE, PduRLockRef=PduRLock_PduRExclusiveArea
            PduRSrcPdu_290a2834 (PduRSrcPdu):
              PduRSourcePduHandleId = 102
              PduRSrcPduDirection = TRANSMIT
              PduRSrcPduRef = RDR_DETECTION_333_336_oPCAN_RADAR_20ee31a5_Tx
              PduRSrcPduPduRBswModulesRef = Com
            RDR_DETECTION_333_336_oPCAN_RADAR_143f79fb_Tx (PduRDestPdu):
              PduRDestPduHandleId = 104
              PduRDestPduDirection = TRANSMIT
              PduRDestPduRoutingType = API_FORWARDING
              PduRDestPduDataProcessing = IMMEDIATE
              PduRPduLengthHandlingStrategy = IGNORE
              PduRDestPduCrossPartitionDestination = false
              PduRTransmissionConfirmation = false
              PduRDestPduDataProvision = PDUR_DIRECT
              PduRDestPduRef = RDR_DETECTION_333_336_oPCAN_RADAR_143f79fb_Tx
              PduRDestPduPduRBswModulesRef = CanIf
          RDR_TRACKER_OBJ_064_oPCAN_RADAR_cb6a03f3_Tx: PduRRoutingPathCommunicationType=COMMUNICATION_INTERFACE, PduRLockRef=PduRLock_PduRExclusiveArea
            PduRSrcPdu_6bf36202 (PduRSrcPdu):
              PduRSourcePduHandleId = 187
              PduRSrcPduDirection = TRANSMIT
              PduRSrcPduRef = RDR_TRACKER_OBJ_064_oPCAN_RADAR_cb6a03f3_Tx
              PduRSrcPduPduRBswModulesRef = Com
            RDR_TRACKER_OBJ_064_oPCAN_RADAR_dd701d89_Tx (PduRDestPdu):
              PduRDestPduHandleId = 189
              PduRDestPduDirection = TRANSMIT
              PduRDestPduRoutingType = API_FORWARDING
              PduRDestPduDataProcessing = IMMEDIATE
              PduRPduLengthHandlingStrategy = IGNORE
              PduRDestPduCrossPartitionDestination = false
              PduRTransmissionConfirmation = false
              PduRDestPduDataProvision = PDUR_DIRECT
              PduRDestPduRef = RDR_TRACKER_OBJ_064_oPCAN_RADAR_dd701d89_Tx
              PduRDestPduPduRBswModulesRef = CanIf
          RDR_DETECTION_297_300_oPCAN_RADAR_4a05a9bb_Tx: PduRRoutingPathCommunicationType=COMMUNICATION_INTERFACE, PduRLockRef=PduRLock_PduRExclusiveArea
            PduRSrcPdu_335b1c89 (PduRSrcPdu):
              PduRSourcePduHandleId = 93
              PduRSrcPduDirection = TRANSMIT
              PduRSrcPduRef = RDR_DETECTION_297_300_oPCAN_RADAR_4a05a9bb_Tx
              PduRSrcPduPduRBswModulesRef = Com
            RDR_DETECTION_297_300_oPCAN_RADAR_984db28e_Tx (PduRDestPdu):
              PduRDestPduHandleId = 95
              PduRDestPduDirection = TRANSMIT
              PduRDestPduRoutingType = API_FORWARDING
              PduRDestPduDataProcessing = IMMEDIATE
              PduRPduLengthHandlingStrategy = IGNORE
              PduRDestPduCrossPartitionDestination = false
              PduRTransmissionConfirmation = false
              PduRDestPduDataProvision = PDUR_DIRECT
              PduRDestPduRef = RDR_DETECTION_297_300_oPCAN_RADAR_984db28e_Tx
              PduRDestPduPduRBswModulesRef = CanIf
          RDR_DETECTION_037_040_oPCAN_RADAR_24e58fa7_Tx: PduRRoutingPathCommunicationType=COMMUNICATION_INTERFACE, PduRLockRef=PduRLock_PduRExclusiveArea
            PduRSrcPdu_8888be57 (PduRSrcPdu):
              PduRSourcePduHandleId = 28
              PduRSrcPduDirection = TRANSMIT
              PduRSrcPduRef = RDR_DETECTION_037_040_oPCAN_RADAR_24e58fa7_Tx
              PduRSrcPduPduRBswModulesRef = Com
            RDR_DETECTION_037_040_oPCAN_RADAR_6b84d80e_Tx (PduRDestPdu):
              PduRDestPduHandleId = 30
              PduRDestPduDirection = TRANSMIT
              PduRDestPduRoutingType = API_FORWARDING
              PduRDestPduDataProcessing = IMMEDIATE
              PduRPduLengthHandlingStrategy = IGNORE
              PduRDestPduCrossPartitionDestination = false
              PduRTransmissionConfirmation = false
              PduRDestPduDataProvision = PDUR_DIRECT
              PduRDestPduRef = RDR_DETECTION_037_040_oPCAN_RADAR_6b84d80e_Tx
              PduRDestPduPduRBswModulesRef = CanIf
          RDR_DETECTION_165_168_oPCAN_RADAR_c15732f7_Tx: PduRRoutingPathCommunicationType=COMMUNICATION_INTERFACE, PduRLockRef=PduRLock_PduRExclusiveArea
            RDR_DETECTION_165_168_oPCAN_RADAR_c3dbcf0c_Tx (PduRDestPdu):
              PduRDestPduHandleId = 62
              PduRDestPduDirection = TRANSMIT
              PduRDestPduRoutingType = API_FORWARDING
              PduRDestPduDataProcessing = IMMEDIATE
              PduRPduLengthHandlingStrategy = IGNORE
              PduRDestPduCrossPartitionDestination = false
              PduRTransmissionConfirmation = false
              PduRDestPduDataProvision = PDUR_DIRECT
              PduRDestPduRef = RDR_DETECTION_165_168_oPCAN_RADAR_c3dbcf0c_Tx
              PduRDestPduPduRBswModulesRef = CanIf
            PduRSrcPdu_921805df (PduRSrcPdu):
              PduRSourcePduHandleId = 60
              PduRSrcPduDirection = TRANSMIT
              PduRSrcPduRef = RDR_DETECTION_165_168_oPCAN_RADAR_c15732f7_Tx
              PduRSrcPduPduRBswModulesRef = Com
          RDR_DETECTION_149_152_oPCAN_RADAR_17a572d8_Tx: PduRRoutingPathCommunicationType=COMMUNICATION_INTERFACE, PduRLockRef=PduRLock_PduRExclusiveArea
            PduRSrcPdu_cbea582e (PduRSrcPdu):
              PduRSourcePduHandleId = 56
              PduRSrcPduDirection = TRANSMIT
              PduRSrcPduRef = RDR_DETECTION_149_152_oPCAN_RADAR_17a572d8_Tx
              PduRSrcPduPduRBswModulesRef = Com
            RDR_DETECTION_149_152_oPCAN_RADAR_ddc89a2d_Tx (PduRDestPdu):
              PduRDestPduHandleId = 58
              PduRDestPduDirection = TRANSMIT
              PduRDestPduRoutingType = API_FORWARDING
              PduRDestPduDataProcessing = IMMEDIATE
              PduRPduLengthHandlingStrategy = IGNORE
              PduRDestPduCrossPartitionDestination = false
              PduRTransmissionConfirmation = false
              PduRDestPduDataProvision = PDUR_DIRECT
              PduRDestPduRef = RDR_DETECTION_149_152_oPCAN_RADAR_ddc89a2d_Tx
              PduRDestPduPduRBswModulesRef = CanIf
          RDR_STATUS_002_oPCAN_RADAR_f6a78e0b_Tx: PduRRoutingPathCommunicationType=COMMUNICATION_INTERFACE, PduRLockRef=PduRLock_PduRExclusiveArea
            RDR_STATUS_002_oPCAN_RADAR_85a3c9df_Tx (PduRDestPdu):
              PduRDestPduHandleId = 125
              PduRDestPduDirection = TRANSMIT
              PduRDestPduRoutingType = API_FORWARDING
              PduRDestPduDataProcessing = IMMEDIATE
              PduRPduLengthHandlingStrategy = IGNORE
              PduRDestPduCrossPartitionDestination = false
              PduRTransmissionConfirmation = false
              PduRDestPduDataProvision = PDUR_DIRECT
              PduRDestPduRef = RDR_STATUS_002_oPCAN_RADAR_85a3c9df_Tx
              PduRDestPduPduRBswModulesRef = CanIf
            PduRSrcPdu_4fce08d8 (PduRSrcPdu): PduRSourcePduHandleId=123, PduRSrcPduDirection=TRANSMIT, PduRSrcPduRef=RDR_STATUS_002_oPCAN_RADAR_f6a78e0b_Tx, PduRSrcPduPduRBswModulesRef=Com
          RDR_TRACKER_OBJ_023_oPCAN_RADAR_afb58ab0_Tx: PduRRoutingPathCommunicationType=COMMUNICATION_INTERFACE, PduRLockRef=PduRLock_PduRExclusiveArea
            PduRSrcPdu_b5fe123c (PduRSrcPdu):
              PduRSourcePduHandleId = 146
              PduRSrcPduDirection = TRANSMIT
              PduRSrcPduRef = RDR_TRACKER_OBJ_023_oPCAN_RADAR_afb58ab0_Tx
              PduRSrcPduPduRBswModulesRef = Com
            RDR_TRACKER_OBJ_023_oPCAN_RADAR_cfa4ab88_Tx (PduRDestPdu):
              PduRDestPduHandleId = 148
              PduRDestPduDirection = TRANSMIT
              PduRDestPduRoutingType = API_FORWARDING
              PduRDestPduDataProcessing = IMMEDIATE
              PduRPduLengthHandlingStrategy = IGNORE
              PduRDestPduCrossPartitionDestination = false
              PduRTransmissionConfirmation = false
              PduRDestPduDataProvision = PDUR_DIRECT
              PduRDestPduRef = RDR_TRACKER_OBJ_023_oPCAN_RADAR_cfa4ab88_Tx
              PduRDestPduPduRBswModulesRef = CanIf
          RDR_TRACKER_OBJ_029_oPCAN_RADAR_95eaec96_Tx: PduRRoutingPathCommunicationType=COMMUNICATION_INTERFACE, PduRLockRef=PduRLock_PduRExclusiveArea
            RDR_TRACKER_OBJ_029_oPCAN_RADAR_cea40bb7_Tx (PduRDestPdu):
              PduRDestPduHandleId = 154
              PduRDestPduDirection = TRANSMIT
              PduRDestPduRoutingType = API_FORWARDING
              PduRDestPduDataProcessing = IMMEDIATE
              PduRPduLengthHandlingStrategy = IGNORE
              PduRDestPduCrossPartitionDestination = false
              PduRTransmissionConfirmation = false
              PduRDestPduDataProvision = PDUR_DIRECT
              PduRDestPduRef = RDR_TRACKER_OBJ_029_oPCAN_RADAR_cea40bb7_Tx
              PduRDestPduPduRBswModulesRef = CanIf
            PduRSrcPdu_49a2be73 (PduRSrcPdu):
              PduRSourcePduHandleId = 152
              PduRSrcPduDirection = TRANSMIT
              PduRSrcPduRef = RDR_TRACKER_OBJ_029_oPCAN_RADAR_95eaec96_Tx
              PduRSrcPduPduRBswModulesRef = Com
          RDR_TRACKER_OBJ_054_oPCAN_RADAR_b70b2628_Tx: PduRRoutingPathCommunicationType=COMMUNICATION_INTERFACE, PduRLockRef=PduRLock_PduRExclusiveArea
            RDR_TRACKER_OBJ_054_oPCAN_RADAR_b0f6eed3_Tx (PduRDestPdu):
              PduRDestPduHandleId = 179
              PduRDestPduDirection = TRANSMIT
              PduRDestPduRoutingType = API_FORWARDING
              PduRDestPduDataProcessing = IMMEDIATE
              PduRPduLengthHandlingStrategy = IGNORE
              PduRDestPduCrossPartitionDestination = false
              PduRTransmissionConfirmation = false
              PduRDestPduDataProvision = PDUR_DIRECT
              PduRDestPduRef = RDR_TRACKER_OBJ_054_oPCAN_RADAR_b0f6eed3_Tx
              PduRDestPduPduRBswModulesRef = CanIf
            PduRSrcPdu_27420dcf (PduRSrcPdu):
              PduRSourcePduHandleId = 177
              PduRSrcPduDirection = TRANSMIT
              PduRSrcPduRef = RDR_TRACKER_OBJ_054_oPCAN_RADAR_b70b2628_Tx
              PduRSrcPduPduRBswModulesRef = Com
          RDR_DETECTION_313_316_oPCAN_RADAR_c4549e8b_Tx: PduRRoutingPathCommunicationType=COMMUNICATION_INTERFACE, PduRLockRef=PduRLock_PduRExclusiveArea
            RDR_DETECTION_313_316_oPCAN_RADAR_9d5b2612_Tx (PduRDestPdu):
              PduRDestPduHandleId = 99
              PduRDestPduDirection = TRANSMIT
              PduRDestPduRoutingType = API_FORWARDING
              PduRDestPduDataProcessing = IMMEDIATE
              PduRPduLengthHandlingStrategy = IGNORE
              PduRDestPduCrossPartitionDestination = false
              PduRTransmissionConfirmation = false
              PduRDestPduDataProvision = PDUR_DIRECT
              PduRDestPduRef = RDR_DETECTION_313_316_oPCAN_RADAR_9d5b2612_Tx
              PduRDestPduPduRBswModulesRef = CanIf
            PduRSrcPdu_4f323af5 (PduRSrcPdu):
              PduRSourcePduHandleId = 97
              PduRSrcPduDirection = TRANSMIT
              PduRSrcPduRef = RDR_DETECTION_313_316_oPCAN_RADAR_c4549e8b_Tx
              PduRSrcPduPduRBswModulesRef = Com
          RDR_DETECTION_353_356_oPCAN_RADAR_d650c696_Tx: PduRRoutingPathCommunicationType=COMMUNICATION_INTERFACE, PduRLockRef=PduRLock_PduRExclusiveArea
            RDR_DETECTION_353_356_oPCAN_RADAR_54e29f81_Tx (PduRDestPdu):
              PduRDestPduHandleId = 109
              PduRDestPduDirection = TRANSMIT
              PduRDestPduRoutingType = API_FORWARDING
              PduRDestPduDataProcessing = IMMEDIATE
              PduRPduLengthHandlingStrategy = IGNORE
              PduRDestPduCrossPartitionDestination = false
              PduRTransmissionConfirmation = false
              PduRDestPduDataProvision = PDUR_DIRECT
              PduRDestPduRef = RDR_DETECTION_353_356_oPCAN_RADAR_54e29f81_Tx
              PduRDestPduPduRBswModulesRef = CanIf
            PduRSrcPdu_491196aa (PduRSrcPdu):
              PduRSourcePduHandleId = 107
              PduRSrcPduDirection = TRANSMIT
              PduRSrcPduRef = RDR_DETECTION_353_356_oPCAN_RADAR_d650c696_Tx
              PduRSrcPduPduRBswModulesRef = Com
          RDR_TRACKER_OBJ_038_oPCAN_RADAR_d573d465_Tx: PduRRoutingPathCommunicationType=COMMUNICATION_INTERFACE, PduRLockRef=PduRLock_PduRExclusiveArea
            RDR_TRACKER_OBJ_038_oPCAN_RADAR_dcd4ca72_Tx (PduRDestPdu):
              PduRDestPduHandleId = 163
              PduRDestPduDirection = TRANSMIT
              PduRDestPduRoutingType = API_FORWARDING
              PduRDestPduDataProcessing = IMMEDIATE
              PduRPduLengthHandlingStrategy = IGNORE
              PduRDestPduCrossPartitionDestination = false
              PduRTransmissionConfirmation = false
              PduRDestPduDataProvision = PDUR_DIRECT
              PduRDestPduRef = RDR_TRACKER_OBJ_038_oPCAN_RADAR_dcd4ca72_Tx
              PduRDestPduPduRBswModulesRef = CanIf
            PduRSrcPdu_d4a08e46 (PduRSrcPdu):
              PduRSourcePduHandleId = 161
              PduRSrcPduDirection = TRANSMIT
              PduRSrcPduRef = RDR_TRACKER_OBJ_038_oPCAN_RADAR_d573d465_Tx
              PduRSrcPduPduRBswModulesRef = Com
          RDR_DETECTION_157_160_oPCAN_RADAR_a5eeac3f_Tx: PduRRoutingPathCommunicationType=COMMUNICATION_INTERFACE, PduRLockRef=PduRLock_PduRExclusiveArea
            RDR_DETECTION_157_160_oPCAN_RADAR_384766cd_Tx (PduRDestPdu):
              PduRDestPduHandleId = 60
              PduRDestPduDirection = TRANSMIT
              PduRDestPduRoutingType = API_FORWARDING
              PduRDestPduDataProcessing = IMMEDIATE
              PduRPduLengthHandlingStrategy = IGNORE
              PduRDestPduCrossPartitionDestination = false
              PduRTransmissionConfirmation = false
              PduRDestPduDataProvision = PDUR_DIRECT
              PduRDestPduRef = RDR_DETECTION_157_160_oPCAN_RADAR_384766cd_Tx
              PduRDestPduPduRBswModulesRef = CanIf
            PduRSrcPdu_f8b1a6fe (PduRSrcPdu):
              PduRSourcePduHandleId = 58
              PduRSrcPduDirection = TRANSMIT
              PduRSrcPduRef = RDR_DETECTION_157_160_oPCAN_RADAR_a5eeac3f_Tx
              PduRSrcPduPduRBswModulesRef = Com
          RDR_TRACKER_OBJ_014_oPCAN_RADAR_aea7a933_Tx: PduRRoutingPathCommunicationType=COMMUNICATION_INTERFACE, PduRLockRef=PduRLock_PduRExclusiveArea
            PduRSrcPdu_5830ecbc (PduRSrcPdu):
              PduRSourcePduHandleId = 137
              PduRSrcPduDirection = TRANSMIT
              PduRSrcPduRef = RDR_TRACKER_OBJ_014_oPCAN_RADAR_aea7a933_Tx
              PduRSrcPduPduRBswModulesRef = Com
            RDR_TRACKER_OBJ_014_oPCAN_RADAR_22ffaa0b_Tx (PduRDestPdu):
              PduRDestPduHandleId = 139
              PduRDestPduDirection = TRANSMIT
              PduRDestPduRoutingType = API_FORWARDING
              PduRDestPduDataProcessing = IMMEDIATE
              PduRPduLengthHandlingStrategy = IGNORE
              PduRDestPduCrossPartitionDestination = false
              PduRTransmissionConfirmation = false
              PduRDestPduDataProvision = PDUR_DIRECT
              PduRDestPduRef = RDR_TRACKER_OBJ_014_oPCAN_RADAR_22ffaa0b_Tx
              PduRDestPduPduRBswModulesRef = CanIf
          RDR_DETECTION_057_060_oPCAN_RADAR_cbf7f78f_Tx: PduRRoutingPathCommunicationType=COMMUNICATION_INTERFACE, PduRLockRef=PduRLock_PduRExclusiveArea
            PduRSrcPdu_9098fc9e (PduRSrcPdu):
              PduRSourcePduHandleId = 33
              PduRSrcPduDirection = TRANSMIT
              PduRSrcPduRef = RDR_DETECTION_057_060_oPCAN_RADAR_cbf7f78f_Tx
              PduRSrcPduPduRBswModulesRef = Com
            RDR_DETECTION_057_060_oPCAN_RADAR_b9507aac_Tx (PduRDestPdu):
              PduRDestPduHandleId = 35
              PduRDestPduDirection = TRANSMIT
              PduRDestPduRoutingType = API_FORWARDING
              PduRDestPduDataProcessing = IMMEDIATE
              PduRPduLengthHandlingStrategy = IGNORE
              PduRDestPduCrossPartitionDestination = false
              PduRTransmissionConfirmation = false
              PduRDestPduDataProvision = PDUR_DIRECT
              PduRDestPduRef = RDR_DETECTION_057_060_oPCAN_RADAR_b9507aac_Tx
              PduRDestPduPduRBswModulesRef = CanIf
          RDR_DETECTION_341_344_oPCAN_RADAR_106db48d_Tx: PduRRoutingPathCommunicationType=COMMUNICATION_INTERFACE, PduRLockRef=PduRLock_PduRExclusiveArea
            RDR_DETECTION_341_344_oPCAN_RADAR_4a9c3acc_Tx (PduRDestPdu):
              PduRDestPduHandleId = 106
              PduRDestPduDirection = TRANSMIT
              PduRDestPduRoutingType = API_FORWARDING
              PduRDestPduDataProcessing = IMMEDIATE
              PduRPduLengthHandlingStrategy = IGNORE
              PduRDestPduCrossPartitionDestination = false
              PduRTransmissionConfirmation = false
              PduRDestPduDataProvision = PDUR_DIRECT
              PduRDestPduRef = RDR_DETECTION_341_344_oPCAN_RADAR_4a9c3acc_Tx
              PduRDestPduPduRBswModulesRef = CanIf
            PduRSrcPdu_9fc8c3de (PduRSrcPdu):
              PduRSourcePduHandleId = 104
              PduRSrcPduDirection = TRANSMIT
              PduRSrcPduRef = RDR_DETECTION_341_344_oPCAN_RADAR_106db48d_Tx
              PduRSrcPduPduRBswModulesRef = Com
          RDR_DETECTION_337_340_oPCAN_RADAR_96ce6377_Tx: PduRRoutingPathCommunicationType=COMMUNICATION_INTERFACE, PduRLockRef=PduRLock_PduRExclusiveArea
            RDR_DETECTION_337_340_oPCAN_RADAR_33ccfaec_Tx (PduRDestPdu):
              PduRDestPduHandleId = 105
              PduRDestPduDirection = TRANSMIT
              PduRDestPduRoutingType = API_FORWARDING
              PduRDestPduDataProcessing = IMMEDIATE
              PduRPduLengthHandlingStrategy = IGNORE
              PduRDestPduCrossPartitionDestination = false
              PduRTransmissionConfirmation = false
              PduRDestPduDataProvision = PDUR_DIRECT
              PduRDestPduRef = RDR_DETECTION_337_340_oPCAN_RADAR_33ccfaec_Tx
              PduRDestPduPduRBswModulesRef = CanIf
            PduRSrcPdu_92f3afa0 (PduRSrcPdu):
              PduRSourcePduHandleId = 103
              PduRSrcPduDirection = TRANSMIT
              PduRSrcPduRef = RDR_DETECTION_337_340_oPCAN_RADAR_96ce6377_Tx
              PduRSrcPduPduRBswModulesRef = Com
          RDR_TRACKER_OBJ_053_oPCAN_RADAR_ca782070_Tx: PduRRoutingPathCommunicationType=COMMUNICATION_INTERFACE, PduRLockRef=PduRLock_PduRExclusiveArea
            PduRSrcPdu_e71c1eed (PduRSrcPdu):
              PduRSourcePduHandleId = 176
              PduRSrcPduDirection = TRANSMIT
              PduRSrcPduRef = RDR_TRACKER_OBJ_053_oPCAN_RADAR_ca782070_Tx
              PduRSrcPduPduRBswModulesRef = Com
            RDR_TRACKER_OBJ_053_oPCAN_RADAR_302b1c0a_Tx (PduRDestPdu):
              PduRDestPduHandleId = 178
              PduRDestPduDirection = TRANSMIT
              PduRDestPduRoutingType = API_FORWARDING
              PduRDestPduDataProcessing = IMMEDIATE
              PduRPduLengthHandlingStrategy = IGNORE
              PduRDestPduCrossPartitionDestination = false
              PduRTransmissionConfirmation = false
              PduRDestPduDataProvision = PDUR_DIRECT
              PduRDestPduRef = RDR_TRACKER_OBJ_053_oPCAN_RADAR_302b1c0a_Tx
              PduRDestPduPduRBswModulesRef = CanIf
          RDR_DETECTION_025_028_oPCAN_RADAR_bd4a315a_Tx: PduRRoutingPathCommunicationType=COMMUNICATION_INTERFACE, PduRLockRef=PduRLock_PduRExclusiveArea
            RDR_DETECTION_025_028_oPCAN_RADAR_8b756afe_Tx (PduRDestPdu):
              PduRDestPduHandleId = 27
              PduRDestPduDirection = TRANSMIT
              PduRDestPduRoutingType = API_FORWARDING
              PduRDestPduDataProcessing = IMMEDIATE
              PduRPduLengthHandlingStrategy = IGNORE
              PduRDestPduCrossPartitionDestination = false
              PduRTransmissionConfirmation = false
              PduRDestPduDataProvision = PDUR_DIRECT
              PduRDestPduRef = RDR_DETECTION_025_028_oPCAN_RADAR_8b756afe_Tx
              PduRDestPduPduRBswModulesRef = CanIf
            PduRSrcPdu_24a407b4 (PduRSrcPdu):
              PduRSourcePduHandleId = 25
              PduRSrcPduDirection = TRANSMIT
              PduRSrcPduRef = RDR_DETECTION_025_028_oPCAN_RADAR_bd4a315a_Tx
              PduRSrcPduPduRBswModulesRef = Com
          RDR_DETECTION_105_108_oPCAN_RADAR_37e9c5c4_Tx: PduRRoutingPathCommunicationType=COMMUNICATION_INTERFACE, PduRLockRef=PduRLock_PduRExclusiveArea
            PduRSrcPdu_d27995e8 (PduRSrcPdu):
              PduRSourcePduHandleId = 45
              PduRSrcPduDirection = TRANSMIT
              PduRSrcPduRef = RDR_DETECTION_105_108_oPCAN_RADAR_37e9c5c4_Tx
              PduRSrcPduPduRBswModulesRef = Com
            RDR_DETECTION_105_108_oPCAN_RADAR_83062976_Tx (PduRDestPdu):
              PduRDestPduHandleId = 47
              PduRDestPduDirection = TRANSMIT
              PduRDestPduRoutingType = API_FORWARDING
              PduRDestPduDataProcessing = IMMEDIATE
              PduRPduLengthHandlingStrategy = IGNORE
              PduRDestPduCrossPartitionDestination = false
              PduRTransmissionConfirmation = false
              PduRDestPduDataProvision = PDUR_DIRECT
              PduRDestPduRef = RDR_DETECTION_105_108_oPCAN_RADAR_83062976_Tx
              PduRDestPduPduRBswModulesRef = CanIf
          RDR_TRACKER_OBJ_010_oPCAN_RADAR_6e1ec3a5_Tx: PduRRoutingPathCommunicationType=COMMUNICATION_INTERFACE, PduRLockRef=PduRLock_PduRExclusiveArea
            RDR_TRACKER_OBJ_010_oPCAN_RADAR_f935e9c7_Tx (PduRDestPdu):
              PduRDestPduHandleId = 135
              PduRDestPduDirection = TRANSMIT
              PduRDestPduRoutingType = API_FORWARDING
              PduRDestPduDataProcessing = IMMEDIATE
              PduRPduLengthHandlingStrategy = IGNORE
              PduRDestPduCrossPartitionDestination = false
              PduRTransmissionConfirmation = false
              PduRDestPduDataProvision = PDUR_DIRECT
              PduRDestPduRef = RDR_TRACKER_OBJ_010_oPCAN_RADAR_f935e9c7_Tx
              PduRDestPduPduRBswModulesRef = CanIf
            PduRSrcPdu_c6e52a15 (PduRSrcPdu):
              PduRSourcePduHandleId = 133
              PduRSrcPduDirection = TRANSMIT
              PduRSrcPduRef = RDR_TRACKER_OBJ_010_oPCAN_RADAR_6e1ec3a5_Tx
              PduRSrcPduPduRBswModulesRef = Com
          RDR_DETECTION_049_052_oPCAN_RADAR_79bc2968_Tx: PduRRoutingPathCommunicationType=COMMUNICATION_INTERFACE, PduRLockRef=PduRLock_PduRExclusiveArea
            RDR_DETECTION_049_052_oPCAN_RADAR_5cdf864c_Tx (PduRDestPdu):
              PduRDestPduHandleId = 33
              PduRDestPduDirection = TRANSMIT
              PduRDestPduRoutingType = API_FORWARDING
              PduRDestPduDataProcessing = IMMEDIATE
              PduRPduLengthHandlingStrategy = IGNORE
              PduRDestPduCrossPartitionDestination = false
              PduRTransmissionConfirmation = false
              PduRDestPduDataProvision = PDUR_DIRECT
              PduRDestPduRef = RDR_DETECTION_049_052_oPCAN_RADAR_5cdf864c_Tx
              PduRDestPduPduRBswModulesRef = CanIf
            PduRSrcPdu_8d15d405 (PduRSrcPdu):
              PduRSourcePduHandleId = 31
              PduRSrcPduDirection = TRANSMIT
              PduRSrcPduRef = RDR_DETECTION_049_052_oPCAN_RADAR_79bc2968_Tx
              PduRSrcPduPduRBswModulesRef = Com
          RDR_TRACKER_OBJ_044_oPCAN_RADAR_2a04c75e_Tx: PduRRoutingPathCommunicationType=COMMUNICATION_INTERFACE, PduRLockRef=PduRLock_PduRExclusiveArea
            RDR_TRACKER_OBJ_044_oPCAN_RADAR_9474bfe5_Tx (PduRDestPdu):
              PduRDestPduHandleId = 169
              PduRDestPduDirection = TRANSMIT
              PduRDestPduRoutingType = API_FORWARDING
              PduRDestPduDataProcessing = IMMEDIATE
              PduRPduLengthHandlingStrategy = IGNORE
              PduRDestPduCrossPartitionDestination = false
              PduRTransmissionConfirmation = false
              PduRDestPduDataProvision = PDUR_DIRECT
              PduRDestPduRef = RDR_TRACKER_OBJ_044_oPCAN_RADAR_9474bfe5_Tx
              PduRDestPduPduRBswModulesRef = CanIf
            PduRSrcPdu_5a1b40fb (PduRSrcPdu):
              PduRSourcePduHandleId = 167
              PduRSrcPduDirection = TRANSMIT
              PduRSrcPduRef = RDR_TRACKER_OBJ_044_oPCAN_RADAR_2a04c75e_Tx
              PduRSrcPduPduRBswModulesRef = Com
          RDR_DETECTION_277_280_oPCAN_RADAR_d98a7eec_Tx: PduRRoutingPathCommunicationType=COMMUNICATION_INTERFACE, PduRLockRef=PduRLock_PduRExclusiveArea
            RDR_DETECTION_277_280_oPCAN_RADAR_8401d0ef_Tx (PduRDestPdu):
              PduRDestPduHandleId = 90
              PduRDestPduDirection = TRANSMIT
              PduRDestPduRoutingType = API_FORWARDING
              PduRDestPduDataProcessing = IMMEDIATE
              PduRPduLengthHandlingStrategy = IGNORE
              PduRDestPduCrossPartitionDestination = false
              PduRTransmissionConfirmation = false
              PduRDestPduDataProvision = PDUR_DIRECT
              PduRDestPduRef = RDR_DETECTION_277_280_oPCAN_RADAR_8401d0ef_Tx
              PduRDestPduPduRBswModulesRef = CanIf
            PduRSrcPdu_30d6958d (PduRSrcPdu):
              PduRSourcePduHandleId = 88
              PduRSrcPduDirection = TRANSMIT
              PduRSrcPduRef = RDR_DETECTION_277_280_oPCAN_RADAR_d98a7eec_Tx
              PduRSrcPduPduRBswModulesRef = Com
          RDR_TRACKER_OBJ_016_oPCAN_RADAR_cefb1c78_Tx: PduRRoutingPathCommunicationType=COMMUNICATION_INTERFACE, PduRLockRef=PduRLock_PduRExclusiveArea
            PduRSrcPdu_45dc00ac (PduRSrcPdu):
              PduRSourcePduHandleId = 139
              PduRSrcPduDirection = TRANSMIT
              PduRSrcPduRef = RDR_TRACKER_OBJ_016_oPCAN_RADAR_cefb1c78_Tx
              PduRSrcPduPduRBswModulesRef = Com
            RDR_TRACKER_OBJ_016_oPCAN_RADAR_4f1a8bed_Tx (PduRDestPdu):
              PduRDestPduHandleId = 141
              PduRDestPduDirection = TRANSMIT
              PduRDestPduRoutingType = API_FORWARDING
              PduRDestPduDataProcessing = IMMEDIATE
              PduRPduLengthHandlingStrategy = IGNORE
              PduRDestPduCrossPartitionDestination = false
              PduRTransmissionConfirmation = false
              PduRDestPduDataProvision = PDUR_DIRECT
              PduRDestPduRef = RDR_TRACKER_OBJ_016_oPCAN_RADAR_4f1a8bed_Tx
              PduRDestPduPduRBswModulesRef = CanIf
          RDR_DETECTION_261_264_oPCAN_RADAR_9ace4013_Tx: PduRRoutingPathCommunicationType=COMMUNICATION_INTERFACE, PduRLockRef=PduRLock_PduRExclusiveArea
            RDR_DETECTION_261_264_oPCAN_RADAR_42ef7944_Tx (PduRDestPdu):
              PduRDestPduHandleId = 86
              PduRDestPduDirection = TRANSMIT
              PduRDestPduRoutingType = API_FORWARDING
              PduRDestPduDataProcessing = IMMEDIATE
              PduRPduLengthHandlingStrategy = IGNORE
              PduRDestPduCrossPartitionDestination = false
              PduRTransmissionConfirmation = false
              PduRDestPduDataProvision = PDUR_DIRECT
              PduRDestPduRef = RDR_DETECTION_261_264_oPCAN_RADAR_42ef7944_Tx
              PduRDestPduPduRBswModulesRef = CanIf
            PduRSrcPdu_0a0c7e54 (PduRSrcPdu):
              PduRSourcePduHandleId = 84
              PduRSrcPduDirection = TRANSMIT
              PduRSrcPduRef = RDR_DETECTION_261_264_oPCAN_RADAR_9ace4013_Tx
              PduRSrcPduPduRBswModulesRef = Com
          RDR_TRACKER_OBJ_045_oPCAN_RADAR_f7921edb_Tx: PduRRoutingPathCommunicationType=COMMUNICATION_INTERFACE, PduRLockRef=PduRLock_PduRExclusiveArea
            RDR_TRACKER_OBJ_045_oPCAN_RADAR_a2862f16_Tx (PduRDestPdu):
              PduRDestPduHandleId = 170
              PduRDestPduDirection = TRANSMIT
              PduRDestPduRoutingType = API_FORWARDING
              PduRDestPduDataProcessing = IMMEDIATE
              PduRPduLengthHandlingStrategy = IGNORE
              PduRDestPduCrossPartitionDestination = false
              PduRTransmissionConfirmation = false
              PduRDestPduDataProvision = PDUR_DIRECT
              PduRDestPduRef = RDR_TRACKER_OBJ_045_oPCAN_RADAR_a2862f16_Tx
              PduRDestPduPduRBswModulesRef = CanIf
            PduRSrcPdu_8499b820 (PduRSrcPdu):
              PduRSourcePduHandleId = 168
              PduRSrcPduDirection = TRANSMIT
              PduRSrcPduRef = RDR_TRACKER_OBJ_045_oPCAN_RADAR_f7921edb_Tx
              PduRSrcPduPduRBswModulesRef = Com
          RDR_DETECTION_197_200_oPCAN_RADAR_50a8f4fa_Tx: PduRRoutingPathCommunicationType=COMMUNICATION_INTERFACE, PduRLockRef=PduRLock_PduRExclusiveArea
            RDR_DETECTION_197_200_oPCAN_RADAR_8448b9bd_Tx (PduRDestPdu):
              PduRDestPduHandleId = 70
              PduRDestPduDirection = TRANSMIT
              PduRDestPduRoutingType = API_FORWARDING
              PduRDestPduDataProcessing = IMMEDIATE
              PduRPduLengthHandlingStrategy = IGNORE
              PduRDestPduCrossPartitionDestination = false
              PduRTransmissionConfirmation = false
              PduRDestPduDataProvision = PDUR_DIRECT
              PduRDestPduRef = RDR_DETECTION_197_200_oPCAN_RADAR_8448b9bd_Tx
              PduRDestPduPduRBswModulesRef = CanIf
            PduRSrcPdu_b9876897 (PduRSrcPdu):
              PduRSourcePduHandleId = 68
              PduRSrcPduDirection = TRANSMIT
              PduRSrcPduRef = RDR_DETECTION_197_200_oPCAN_RADAR_50a8f4fa_Tx
              PduRSrcPduPduRBswModulesRef = Com
          RDR_DETECTION_233_236_oPCAN_RADAR_4ef76a15_Tx: PduRRoutingPathCommunicationType=COMMUNICATION_INTERFACE, PduRLockRef=PduRLock_PduRExclusiveArea
            RDR_DETECTION_233_236_oPCAN_RADAR_9528659a_Tx (PduRDestPdu):
              PduRDestPduHandleId = 79
              PduRDestPduDirection = TRANSMIT
              PduRDestPduRoutingType = API_FORWARDING
              PduRDestPduDataProcessing = IMMEDIATE
              PduRPduLengthHandlingStrategy = IGNORE
              PduRDestPduCrossPartitionDestination = false
              PduRTransmissionConfirmation = false
              PduRDestPduDataProvision = PDUR_DIRECT
              PduRDestPduRef = RDR_DETECTION_233_236_oPCAN_RADAR_9528659a_Tx
              PduRDestPduPduRBswModulesRef = CanIf
            PduRSrcPdu_b6c27c0e (PduRSrcPdu):
              PduRSourcePduHandleId = 77
              PduRSrcPduDirection = TRANSMIT
              PduRSrcPduRef = RDR_DETECTION_233_236_oPCAN_RADAR_4ef76a15_Tx
              PduRSrcPduPduRBswModulesRef = Com
          RDR_DETECTION_305_308_oPCAN_RADAR_ebdb72a4_Tx: PduRRoutingPathCommunicationType=COMMUNICATION_INTERFACE, PduRLockRef=PduRLock_PduRExclusiveArea
            RDR_DETECTION_305_308_oPCAN_RADAR_5a5917f5_Tx (PduRDestPdu):
              PduRDestPduHandleId = 97
              PduRDestPduDirection = TRANSMIT
              PduRDestPduRoutingType = API_FORWARDING
              PduRDestPduDataProcessing = IMMEDIATE
              PduRPduLengthHandlingStrategy = IGNORE
              PduRDestPduCrossPartitionDestination = false
              PduRTransmissionConfirmation = false
              PduRDestPduDataProvision = PDUR_DIRECT
              PduRDestPduRef = RDR_DETECTION_305_308_oPCAN_RADAR_5a5917f5_Tx
              PduRDestPduPduRBswModulesRef = CanIf
            PduRSrcPdu_72f07d0c (PduRSrcPdu):
              PduRSourcePduHandleId = 95
              PduRSrcPduDirection = TRANSMIT
              PduRSrcPduRef = RDR_DETECTION_305_308_oPCAN_RADAR_ebdb72a4_Tx
              PduRSrcPduPduRBswModulesRef = Com
          RDR_HEADER_001_oPCAN_RADAR_0cd81ee7_Tx: PduRRoutingPathCommunicationType=COMMUNICATION_INTERFACE, PduRLockRef=PduRLock_PduRExclusiveArea
            PduRSrcPdu_1ae5d784 (PduRSrcPdu): PduRSourcePduHandleId=119, PduRSrcPduDirection=TRANSMIT, PduRSrcPduRef=RDR_HEADER_001_oPCAN_RADAR_0cd81ee7_Tx, PduRSrcPduPduRBswModulesRef=Com
            RDR_HEADER_001_oPCAN_RADAR_48304dbd_Tx (PduRDestPdu):
              PduRDestPduHandleId = 121
              PduRDestPduDirection = TRANSMIT
              PduRDestPduRoutingType = API_FORWARDING
              PduRDestPduDataProcessing = IMMEDIATE
              PduRPduLengthHandlingStrategy = IGNORE
              PduRDestPduCrossPartitionDestination = false
              PduRTransmissionConfirmation = false
              PduRDestPduDataProvision = PDUR_DIRECT
              PduRDestPduRef = RDR_HEADER_001_oPCAN_RADAR_48304dbd_Tx
              PduRDestPduPduRBswModulesRef = CanIf
          RDR_TRACKER_OBJ_051_oPCAN_RADAR_aa24953b_Tx: PduRRoutingPathCommunicationType=COMMUNICATION_INTERFACE, PduRLockRef=PduRLock_PduRExclusiveArea
            PduRSrcPdu_f46075d1 (PduRSrcPdu):
              PduRSourcePduHandleId = 174
              PduRSrcPduDirection = TRANSMIT
              PduRSrcPduRef = RDR_TRACKER_OBJ_051_oPCAN_RADAR_aa24953b_Tx
              PduRSrcPduPduRBswModulesRef = Com
            RDR_TRACKER_OBJ_051_oPCAN_RADAR_5dce3dec_Tx (PduRDestPdu):
              PduRDestPduHandleId = 176
              PduRDestPduDirection = TRANSMIT
              PduRDestPduRoutingType = API_FORWARDING
              PduRDestPduDataProcessing = IMMEDIATE
              PduRPduLengthHandlingStrategy = IGNORE
              PduRDestPduCrossPartitionDestination = false
              PduRTransmissionConfirmation = false
              PduRDestPduDataProvision = PDUR_DIRECT
              PduRDestPduRef = RDR_TRACKER_OBJ_051_oPCAN_RADAR_5dce3dec_Tx
              PduRDestPduPduRBswModulesRef = CanIf
          RDR_DETECTION_073_076_oPCAN_RADAR_80c18568_Tx: PduRRoutingPathCommunicationType=COMMUNICATION_INTERFACE, PduRLockRef=PduRLock_PduRExclusiveArea
            RDR_DETECTION_073_076_oPCAN_RADAR_85cee28a_Tx (PduRDestPdu):
              PduRDestPduHandleId = 39
              PduRDestPduDirection = TRANSMIT
              PduRDestPduRoutingType = API_FORWARDING
              PduRDestPduDataProcessing = IMMEDIATE
              PduRPduLengthHandlingStrategy = IGNORE
              PduRDestPduCrossPartitionDestination = false
              PduRTransmissionConfirmation = false
              PduRDestPduDataProvision = PDUR_DIRECT
              PduRDestPduRef = RDR_DETECTION_073_076_oPCAN_RADAR_85cee28a_Tx
              PduRDestPduPduRBswModulesRef = CanIf
            PduRSrcPdu_f3b727a2 (PduRSrcPdu):
              PduRSourcePduHandleId = 37
              PduRSrcPduDirection = TRANSMIT
              PduRSrcPduRef = RDR_DETECTION_073_076_oPCAN_RADAR_80c18568_Tx
              PduRSrcPduPduRBswModulesRef = Com
          RDR_DETECTION_093_096_oPCAN_RADAR_5277c261_Tx: PduRRoutingPathCommunicationType=COMMUNICATION_INTERFACE, PduRLockRef=PduRLock_PduRExclusiveArea
            PduRSrcPdu_4f1bc526 (PduRSrcPdu):
              PduRSourcePduHandleId = 42
              PduRSrcPduDirection = TRANSMIT
              PduRSrcPduRef = RDR_DETECTION_093_096_oPCAN_RADAR_5277c261_Tx
              PduRSrcPduPduRBswModulesRef = Com
            RDR_DETECTION_093_096_oPCAN_RADAR_8d117197_Tx (PduRDestPdu):
              PduRDestPduHandleId = 44
              PduRDestPduDirection = TRANSMIT
              PduRDestPduRoutingType = API_FORWARDING
              PduRDestPduDataProcessing = IMMEDIATE
              PduRPduLengthHandlingStrategy = IGNORE
              PduRDestPduCrossPartitionDestination = false
              PduRTransmissionConfirmation = false
              PduRDestPduDataProvision = PDUR_DIRECT
              PduRDestPduRef = RDR_DETECTION_093_096_oPCAN_RADAR_8d117197_Tx
              PduRDestPduPduRBswModulesRef = CanIf
          RDR_TRACKER_OBJ_019_oPCAN_RADAR_e98bc94d_Tx: PduRRoutingPathCommunicationType=COMMUNICATION_INTERFACE, PduRLockRef=PduRLock_PduRExclusiveArea
            RDR_TRACKER_OBJ_019_oPCAN_RADAR_a322f8ed_Tx (PduRDestPdu):
              PduRDestPduHandleId = 144
              PduRDestPduDirection = TRANSMIT
              PduRDestPduRoutingType = API_FORWARDING
              PduRDestPduDataProcessing = IMMEDIATE
              PduRPduLengthHandlingStrategy = IGNORE
              PduRDestPduCrossPartitionDestination = false
              PduRTransmissionConfirmation = false
              PduRDestPduDataProvision = PDUR_DIRECT
              PduRDestPduRef = RDR_TRACKER_OBJ_019_oPCAN_RADAR_a322f8ed_Tx
              PduRDestPduPduRBswModulesRef = CanIf
            PduRSrcPdu_89ae4017 (PduRSrcPdu):
              PduRSourcePduHandleId = 142
              PduRSrcPduDirection = TRANSMIT
              PduRSrcPduRef = RDR_TRACKER_OBJ_019_oPCAN_RADAR_e98bc94d_Tx
              PduRSrcPduPduRBswModulesRef = Com
          RDR_DETECTION_077_080_oPCAN_RADAR_05b8c98c_Tx: PduRRoutingPathCommunicationType=COMMUNICATION_INTERFACE, PduRLockRef=PduRLock_PduRExclusiveArea
            RDR_DETECTION_077_080_oPCAN_RADAR_5d5eee6c_Tx (PduRDestPdu):
              PduRDestPduHandleId = 40
              PduRDestPduDirection = TRANSMIT
              PduRDestPduRoutingType = API_FORWARDING
              PduRDestPduDataProcessing = IMMEDIATE
              PduRPduLengthHandlingStrategy = IGNORE
              PduRDestPduCrossPartitionDestination = false
              PduRTransmissionConfirmation = false
              PduRDestPduDataProvision = PDUR_DIRECT
              PduRDestPduRef = RDR_DETECTION_077_080_oPCAN_RADAR_5d5eee6c_Tx
              PduRDestPduPduRBswModulesRef = CanIf
            PduRSrcPdu_e31a11d2 (PduRSrcPdu):
              PduRSourcePduHandleId = 38
              PduRSrcPduDirection = TRANSMIT
              PduRSrcPduRef = RDR_DETECTION_077_080_oPCAN_RADAR_05b8c98c_Tx
              PduRSrcPduPduRBswModulesRef = Com
          RDR_DETECTION_033_036_oPCAN_RADAR_92c5dd75_Tx: PduRRoutingPathCommunicationType=COMMUNICATION_INTERFACE, PduRLockRef=PduRLock_PduRExclusiveArea
            PduRSrcPdu_853c95a7 (PduRSrcPdu):
              PduRSourcePduHandleId = 27
              PduRSrcPduDirection = TRANSMIT
              PduRSrcPduRef = RDR_DETECTION_033_036_oPCAN_RADAR_92c5dd75_Tx
              PduRSrcPduPduRBswModulesRef = Com
            RDR_DETECTION_033_036_oPCAN_RADAR_4c775b19_Tx (PduRDestPdu):
              PduRDestPduHandleId = 29
              PduRDestPduDirection = TRANSMIT
              PduRDestPduRoutingType = API_FORWARDING
              PduRDestPduDataProcessing = IMMEDIATE
              PduRPduLengthHandlingStrategy = IGNORE
              PduRDestPduCrossPartitionDestination = false
              PduRTransmissionConfirmation = false
              PduRDestPduDataProvision = PDUR_DIRECT
              PduRDestPduRef = RDR_DETECTION_033_036_oPCAN_RADAR_4c775b19_Tx
              PduRDestPduPduRBswModulesRef = CanIf
          RDR_TRACKER_OBJ_022_oPCAN_RADAR_72235335_Tx: PduRRoutingPathCommunicationType=COMMUNICATION_INTERFACE, PduRLockRef=PduRLock_PduRExclusiveArea
            RDR_TRACKER_OBJ_022_oPCAN_RADAR_f9563b7b_Tx (PduRDestPdu):
              PduRDestPduHandleId = 147
              PduRDestPduDirection = TRANSMIT
              PduRDestPduRoutingType = API_FORWARDING
              PduRDestPduDataProcessing = IMMEDIATE
              PduRPduLengthHandlingStrategy = IGNORE
              PduRDestPduCrossPartitionDestination = false
              PduRTransmissionConfirmation = false
              PduRDestPduDataProvision = PDUR_DIRECT
              PduRDestPduRef = RDR_TRACKER_OBJ_022_oPCAN_RADAR_f9563b7b_Tx
              PduRDestPduPduRBswModulesRef = CanIf
            PduRSrcPdu_968025e3 (PduRSrcPdu):
              PduRSourcePduHandleId = 145
              PduRSrcPduDirection = TRANSMIT
              PduRSrcPduRef = RDR_TRACKER_OBJ_022_oPCAN_RADAR_72235335_Tx
              PduRSrcPduPduRBswModulesRef = Com
          RDR_TRACKER_OBJ_060_oPCAN_RADAR_0bd36965_Tx: PduRRoutingPathCommunicationType=COMMUNICATION_INTERFACE, PduRLockRef=PduRLock_PduRExclusiveArea
            PduRSrcPdu_e58688dc (PduRSrcPdu):
              PduRSourcePduHandleId = 183
              PduRSrcPduDirection = TRANSMIT
              PduRSrcPduRef = RDR_TRACKER_OBJ_060_oPCAN_RADAR_0bd36965_Tx
              PduRSrcPduPduRBswModulesRef = Com
            RDR_TRACKER_OBJ_060_oPCAN_RADAR_06ba5e45_Tx (PduRDestPdu):
              PduRDestPduHandleId = 185
              PduRDestPduDirection = TRANSMIT
              PduRDestPduRoutingType = API_FORWARDING
              PduRDestPduDataProcessing = IMMEDIATE
              PduRPduLengthHandlingStrategy = IGNORE
              PduRDestPduCrossPartitionDestination = false
              PduRTransmissionConfirmation = false
              PduRDestPduDataProvision = PDUR_DIRECT
              PduRDestPduRef = RDR_TRACKER_OBJ_060_oPCAN_RADAR_06ba5e45_Tx
              PduRDestPduPduRBswModulesRef = CanIf
          RDR_TRACKER_OBJ_013_oPCAN_RADAR_d3d4af6b_Tx: PduRRoutingPathCommunicationType=COMMUNICATION_INTERFACE, PduRLockRef=PduRLock_PduRExclusiveArea
            RDR_TRACKER_OBJ_013_oPCAN_RADAR_a22258d2_Tx (PduRDestPdu):
              PduRDestPduHandleId = 138
              PduRDestPduDirection = TRANSMIT
              PduRDestPduRoutingType = API_FORWARDING
              PduRDestPduDataProcessing = IMMEDIATE
              PduRPduLengthHandlingStrategy = IGNORE
              PduRDestPduCrossPartitionDestination = false
              PduRTransmissionConfirmation = false
              PduRDestPduDataProvision = PDUR_DIRECT
              PduRDestPduRef = RDR_TRACKER_OBJ_013_oPCAN_RADAR_a22258d2_Tx
              PduRDestPduPduRBswModulesRef = CanIf
            PduRSrcPdu_d1ac5560 (PduRSrcPdu):
              PduRSourcePduHandleId = 136
              PduRSrcPduDirection = TRANSMIT
              PduRSrcPduRef = RDR_TRACKER_OBJ_013_oPCAN_RADAR_d3d4af6b_Tx
              PduRSrcPduPduRBswModulesRef = Com
          RDR_DETECTION_345_348_oPCAN_RADAR_f9df2ab9_Tx: PduRRoutingPathCommunicationType=COMMUNICATION_INTERFACE, PduRLockRef=PduRLock_PduRExclusiveArea
            PduRSrcPdu_98538545 (PduRSrcPdu):
              PduRSourcePduHandleId = 105
              PduRSrcPduDirection = TRANSMIT
              PduRSrcPduRef = RDR_DETECTION_345_348_oPCAN_RADAR_f9df2ab9_Tx
              PduRSrcPduPduRBswModulesRef = Com
            RDR_DETECTION_345_348_oPCAN_RADAR_93e0ae66_Tx (PduRDestPdu):
              PduRDestPduHandleId = 107
              PduRDestPduDirection = TRANSMIT
              PduRDestPduRoutingType = API_FORWARDING
              PduRDestPduDataProcessing = IMMEDIATE
              PduRPduLengthHandlingStrategy = IGNORE
              PduRDestPduCrossPartitionDestination = false
              PduRTransmissionConfirmation = false
              PduRDestPduDataProvision = PDUR_DIRECT
              PduRDestPduRef = RDR_DETECTION_345_348_oPCAN_RADAR_93e0ae66_Tx
              PduRDestPduPduRBswModulesRef = CanIf
          RDR_TRACKER_OBJ_062_oPCAN_RADAR_6b8fdc2e_Tx: PduRRoutingPathCommunicationType=COMMUNICATION_INTERFACE, PduRLockRef=PduRLock_PduRExclusiveArea
            RDR_TRACKER_OBJ_062_oPCAN_RADAR_6b5f7fa3_Tx (PduRDestPdu):
              PduRDestPduHandleId = 187
              PduRDestPduDirection = TRANSMIT
              PduRDestPduRoutingType = API_FORWARDING
              PduRDestPduDataProcessing = IMMEDIATE
              PduRPduLengthHandlingStrategy = IGNORE
              PduRDestPduCrossPartitionDestination = false
              PduRTransmissionConfirmation = false
              PduRDestPduDataProvision = PDUR_DIRECT
              PduRDestPduRef = RDR_TRACKER_OBJ_062_oPCAN_RADAR_6b5f7fa3_Tx
              PduRDestPduPduRBswModulesRef = CanIf
            PduRSrcPdu_3327516f (PduRSrcPdu):
              PduRSourcePduHandleId = 185
              PduRSrcPduDirection = TRANSMIT
              PduRSrcPduRef = RDR_TRACKER_OBJ_062_oPCAN_RADAR_6b8fdc2e_Tx
              PduRSrcPduPduRBswModulesRef = Com
          RDR_DETECTION_005_008_oPCAN_RADAR_59f09e74_Tx: PduRRoutingPathCommunicationType=COMMUNICATION_INTERFACE, PduRLockRef=PduRLock_PduRExclusiveArea
            PduRSrcPdu_24146c63 (PduRSrcPdu):
              PduRSourcePduHandleId = 20
              PduRSrcPduDirection = TRANSMIT
              PduRSrcPduRef = RDR_DETECTION_005_008_oPCAN_RADAR_59f09e74_Tx
              PduRSrcPduPduRBswModulesRef = Com
            RDR_DETECTION_005_008_oPCAN_RADAR_02113517_Tx (PduRDestPdu):
              PduRDestPduHandleId = 22
              PduRDestPduDirection = TRANSMIT
              PduRDestPduRoutingType = API_FORWARDING
              PduRDestPduDataProcessing = IMMEDIATE
              PduRPduLengthHandlingStrategy = IGNORE
              PduRDestPduCrossPartitionDestination = false
              PduRTransmissionConfirmation = false
              PduRDestPduDataProvision = PDUR_DIRECT
              PduRDestPduRef = RDR_DETECTION_005_008_oPCAN_RADAR_02113517_Tx
              PduRDestPduPduRBswModulesRef = CanIf
          RDR_DETECTION_101_104_oPCAN_RADAR_de5b5bf0_Tx: PduRRoutingPathCommunicationType=COMMUNICATION_INTERFACE, PduRLockRef=PduRLock_PduRExclusiveArea
            PduRSrcPdu_d2d7e2a4 (PduRSrcPdu):
              PduRSourcePduHandleId = 44
              PduRSrcPduDirection = TRANSMIT
              PduRSrcPduRef = RDR_DETECTION_101_104_oPCAN_RADAR_de5b5bf0_Tx
              PduRSrcPduPduRBswModulesRef = Com
            RDR_DETECTION_101_104_oPCAN_RADAR_5a7abddc_Tx (PduRDestPdu):
              PduRDestPduHandleId = 46
              PduRDestPduDirection = TRANSMIT
              PduRDestPduRoutingType = API_FORWARDING
              PduRDestPduDataProcessing = IMMEDIATE
              PduRPduLengthHandlingStrategy = IGNORE
              PduRDestPduCrossPartitionDestination = false
              PduRTransmissionConfirmation = false
              PduRDestPduDataProvision = PDUR_DIRECT
              PduRDestPduRef = RDR_DETECTION_101_104_oPCAN_RADAR_5a7abddc_Tx
              PduRDestPduPduRBswModulesRef = CanIf
          RDR_TRACKER_OBJ_039_oPCAN_RADAR_08e50de0_Tx: PduRRoutingPathCommunicationType=COMMUNICATION_INTERFACE, PduRLockRef=PduRLock_PduRExclusiveArea
            RDR_TRACKER_OBJ_039_oPCAN_RADAR_ea265a81_Tx (PduRDestPdu):
              PduRDestPduHandleId = 164
              PduRDestPduDirection = TRANSMIT
              PduRDestPduRoutingType = API_FORWARDING
              PduRDestPduDataProcessing = IMMEDIATE
              PduRPduLengthHandlingStrategy = IGNORE
              PduRDestPduCrossPartitionDestination = false
              PduRTransmissionConfirmation = false
              PduRDestPduDataProvision = PDUR_DIRECT
              PduRDestPduRef = RDR_TRACKER_OBJ_039_oPCAN_RADAR_ea265a81_Tx
              PduRDestPduPduRBswModulesRef = CanIf
            PduRSrcPdu_4500db53 (PduRSrcPdu):
              PduRSourcePduHandleId = 162
              PduRSrcPduDirection = TRANSMIT
              PduRSrcPduRef = RDR_TRACKER_OBJ_039_oPCAN_RADAR_08e50de0_Tx
              PduRSrcPduPduRBswModulesRef = Com
          RDR_DETECTION_133_136_oPCAN_RADAR_fcdc86c5_Tx: PduRRoutingPathCommunicationType=COMMUNICATION_INTERFACE, PduRLockRef=PduRLock_PduRExclusiveArea
            PduRSrcPdu_c74f761f (PduRSrcPdu):
              PduRSourcePduHandleId = 52
              PduRSrcPduDirection = TRANSMIT
              PduRSrcPduRef = RDR_DETECTION_133_136_oPCAN_RADAR_fcdc86c5_Tx
              PduRSrcPduPduRBswModulesRef = Com
            RDR_DETECTION_133_136_oPCAN_RADAR_cd604778_Tx (PduRDestPdu):
              PduRDestPduHandleId = 54
              PduRDestPduDirection = TRANSMIT
              PduRDestPduRoutingType = API_FORWARDING
              PduRDestPduDataProcessing = IMMEDIATE
              PduRPduLengthHandlingStrategy = IGNORE
              PduRDestPduCrossPartitionDestination = false
              PduRTransmissionConfirmation = false
              PduRDestPduDataProvision = PDUR_DIRECT
              PduRDestPduRef = RDR_DETECTION_133_136_oPCAN_RADAR_cd604778_Tx
              PduRDestPduPduRBswModulesRef = CanIf
          RDR_DETECTION_301_304_oPCAN_RADAR_0269ec90_Tx: PduRRoutingPathCommunicationType=COMMUNICATION_INTERFACE, PduRLockRef=PduRLock_PduRExclusiveArea
            RDR_DETECTION_301_304_oPCAN_RADAR_8325835f_Tx (PduRDestPdu):
              PduRDestPduHandleId = 96
              PduRDestPduDirection = TRANSMIT
              PduRDestPduRoutingType = API_FORWARDING
              PduRDestPduDataProcessing = IMMEDIATE
              PduRPduLengthHandlingStrategy = IGNORE
              PduRDestPduCrossPartitionDestination = false
              PduRTransmissionConfirmation = false
              PduRDestPduDataProvision = PDUR_DIRECT
              PduRDestPduRef = RDR_DETECTION_301_304_oPCAN_RADAR_8325835f_Tx
              PduRDestPduPduRBswModulesRef = CanIf
            PduRSrcPdu_e2a4874e (PduRSrcPdu):
              PduRSourcePduHandleId = 94
              PduRSrcPduDirection = TRANSMIT
              PduRSrcPduRef = RDR_DETECTION_301_304_oPCAN_RADAR_0269ec90_Tx
              PduRSrcPduPduRBswModulesRef = Com
          RDR_DETECTION_041_044_oPCAN_RADAR_a246585d_Tx: PduRRoutingPathCommunicationType=COMMUNICATION_INTERFACE, PduRLockRef=PduRLock_PduRExclusiveArea
            RDR_DETECTION_041_044_oPCAN_RADAR_12d4182e_Tx (PduRDestPdu):
              PduRDestPduHandleId = 31
              PduRDestPduDirection = TRANSMIT
              PduRDestPduRoutingType = API_FORWARDING
              PduRDestPduDataProcessing = IMMEDIATE
              PduRPduLengthHandlingStrategy = IGNORE
              PduRDestPduCrossPartitionDestination = false
              PduRTransmissionConfirmation = false
              PduRDestPduDataProvision = PDUR_DIRECT
              PduRDestPduRef = RDR_DETECTION_041_044_oPCAN_RADAR_12d4182e_Tx
              PduRDestPduPduRBswModulesRef = CanIf
            PduRSrcPdu_13ead5b9 (PduRSrcPdu):
              PduRSourcePduHandleId = 29
              PduRSrcPduDirection = TRANSMIT
              PduRSrcPduRef = RDR_DETECTION_041_044_oPCAN_RADAR_a246585d_Tx
              PduRSrcPduPduRBswModulesRef = Com
          RDR_TRACKER_OBJ_005_oPCAN_RADAR_ee3e91c0_Tx: PduRRoutingPathCommunicationType=COMMUNICATION_INTERFACE, PduRLockRef=PduRLock_PduRExclusiveArea
            PduRSrcPdu_37177174 (PduRSrcPdu):
              PduRSourcePduHandleId = 128
              PduRSrcPduDirection = TRANSMIT
              PduRSrcPduRef = RDR_TRACKER_OBJ_005_oPCAN_RADAR_ee3e91c0_Tx
              PduRSrcPduPduRBswModulesRef = Com
            RDR_TRACKER_OBJ_005_oPCAN_RADAR_308f6bce_Tx (PduRDestPdu):
              PduRDestPduHandleId = 130
              PduRDestPduDirection = TRANSMIT
              PduRDestPduRoutingType = API_FORWARDING
              PduRDestPduDataProcessing = IMMEDIATE
              PduRPduLengthHandlingStrategy = IGNORE
              PduRDestPduCrossPartitionDestination = false
              PduRTransmissionConfirmation = false
              PduRDestPduDataProvision = PDUR_DIRECT
              PduRDestPduRef = RDR_TRACKER_OBJ_005_oPCAN_RADAR_308f6bce_Tx
              PduRDestPduPduRBswModulesRef = CanIf
          signalPdu_RDR_1_Status_9d482741_Tx: PduRRoutingPathCommunicationType=COMMUNICATION_INTERFACE, PduRLockRef=PduRLock_PduRExclusiveArea
            signalPdu_RDR_1_Status_67c6fd21_Tx (PduRDestPdu):
              PduRDestPduHandleId = 214
              PduRDestPduDirection = TRANSMIT
              PduRDestPduRoutingType = API_FORWARDING
              PduRDestPduDataProcessing = IMMEDIATE
              PduRPduLengthHandlingStrategy = IGNORE
              PduRDestPduCrossPartitionDestination = false
              PduRDestPduDataProvision = PDUR_DIRECT
              PduRTransmissionConfirmation = false
              PduRDestPduRef = signalPdu_RDR_1_Status_67c6fd21_Tx
              PduRDestPduPduRBswModulesRef = SoAd
            PduRSrcPdu_c2fc0504 (PduRSrcPdu): PduRSourcePduHandleId=192, PduRSrcPduDirection=TRANSMIT, PduRSrcPduRef=signalPdu_RDR_1_Status_9d482741_Tx, PduRSrcPduPduRBswModulesRef=LdCom
          signalPdu_ADAS_Vehicle_Status_71b7c213_Rx: PduRRoutingPathCommunicationType=COMMUNICATION_INTERFACE, PduRLockRef=PduRLock_PduRExclusiveArea
            signalPdu_ADAS_Vehicle_Status_71b7c213_Rx_18053073_Rx (PduRDestPdu):
              PduRDestPduHandleId = 63
              PduRDestPduDirection = RECEIVE
              PduRDestPduRoutingType = API_FORWARDING
              PduRDestPduDataProcessing = IMMEDIATE
              PduRPduLengthHandlingStrategy = IGNORE
              PduRDestPduCrossPartitionDestination = false
              PduRTransmissionConfirmation = false
              PduRDestPduRef = signalPdu_ADAS_Vehicle_Status_638dcd82_Rx
              PduRDestPduPduRBswModulesRef = LdCom
            PduRSrcPdu_18053073 (PduRSrcPdu): PduRSourcePduHandleId=87, PduRSrcPduDirection=RECEIVE, PduRSrcPduRef=signalPdu_ADAS_Vehicle_Status_71b7c213_Rx, PduRSrcPduPduRBswModulesRef=SoAd
          signalPdu_RDR_1_Detections_Transport_d322aa23_Tx: PduRRoutingPathCommunicationType=COMMUNICATION_INTERFACE, PduRLockRef=PduRLock_PduRExclusiveArea
            PduRSrcPdu_f4b7358b (PduRSrcPdu):
              PduRSourcePduHandleId = 190
              PduRSrcPduDirection = TRANSMIT
              PduRSrcPduRef = signalPdu_RDR_1_Detections_Transport_d322aa23_Tx
              PduRSrcPduPduRBswModulesRef = SomeIpTp
            signalPdu_RDR_1_Detections_Transport_d322aa23_Tx_f4b7358b_Tx (PduRDestPdu):
              PduRDestPduHandleId = 212
              PduRDestPduDirection = TRANSMIT
              PduRDestPduRoutingType = API_FORWARDING
              PduRDestPduDataProcessing = IMMEDIATE
              PduRPduLengthHandlingStrategy = IGNORE
              PduRDestPduCrossPartitionDestination = false
              PduRDestPduDataProvision = PDUR_TRIGGERTRANSMIT
              PduRTransmissionConfirmation = true
              PduRDestPduRef = signalPdu_RDR_1_Detections_Transport_d322aa23_Tx
              PduRDestPduPduRBswModulesRef = SoAd
          signalPdu_RDR_1_SW_Info_b4e751e3_Tx: PduRRoutingPathCommunicationType=COMMUNICATION_INTERFACE, PduRLockRef=PduRLock_PduRExclusiveArea
            PduRSrcPdu_69bb1772 (PduRSrcPdu): PduRSourcePduHandleId=191, PduRSrcPduDirection=TRANSMIT, PduRSrcPduRef=signalPdu_RDR_1_SW_Info_b4e751e3_Tx, PduRSrcPduPduRBswModulesRef=LdCom
            signalPdu_RDR_1_SW_Info_14232baa_Tx (PduRDestPdu):
              PduRDestPduHandleId = 213
              PduRDestPduDirection = TRANSMIT
              PduRDestPduRoutingType = API_FORWARDING
              PduRDestPduDataProcessing = IMMEDIATE
              PduRPduLengthHandlingStrategy = IGNORE
              PduRDestPduCrossPartitionDestination = false
              PduRDestPduDataProvision = PDUR_DIRECT
              PduRTransmissionConfirmation = false
              PduRDestPduRef = signalPdu_RDR_1_SW_Info_14232baa_Tx
              PduRDestPduPduRBswModulesRef = SoAd
          signalPdu_RDR_1_Detections_52b391ee_Tx: PduRRoutingPathCommunicationType=TRANSPORT_PROTOCOL, PduRLockRef=PduRLock_PduRExclusiveArea
            PduRSrcPdu_7d97b0c9 (PduRSrcPdu): PduRSourcePduHandleId=189, PduRSrcPduDirection=TRANSMIT, PduRSrcPduRef=signalPdu_RDR_1_Detections_52b391ee_Tx, PduRSrcPduPduRBswModulesRef=LdCom
            signalPdu_RDR_1_Detections_52b391ee_Tx (PduRDestPdu):
              PduRDestPduHandleId = 13
              PduRDestPduDirection = TRANSMIT
              PduRDestPduRoutingType = API_FORWARDING
              PduRDestPduDataProcessing = IMMEDIATE
              PduRPduLengthHandlingStrategy = UNUSED
              PduRDestPduCrossPartitionDestination = false
              PduRDestPduRef = signalPdu_RDR_1_Detections_52b391ee_Tx
              PduRDestPduPduRBswModulesRef = SomeIpTp
          RDR_FUSION_DET_065_068_oPCAN_RADAR_40089964_Rx: PduRRoutingPathCommunicationType=COMMUNICATION_INTERFACE, PduRLockRef=PduRLock_PduRExclusiveArea
            PduRSrcPdu_798630bc (PduRSrcPdu):
              PduRSourcePduHandleId = 45
              PduRSrcPduDirection = RECEIVE
              PduRSrcPduRef = RDR_FUSION_DET_065_068_oPCAN_RADAR_40089964_Rx
              PduRSrcPduPduRBswModulesRef = CanIf
            RDR_FUSION_DET_065_068_oPCAN_RADAR_40089964_Rx_798630bc_Rx (PduRDestPdu):
              PduRDestPduHandleId = 38
              PduRDestPduDirection = RECEIVE
              PduRDestPduRoutingType = API_FORWARDING
              PduRDestPduDataProcessing = IMMEDIATE
              PduRPduLengthHandlingStrategy = IGNORE
              PduRDestPduCrossPartitionDestination = false
              PduRTransmissionConfirmation = false
              PduRDestPduRef = RDR_FUSION_DET_065_068_oPCAN_RADAR_cc92c4b2_Rx
              PduRDestPduPduRBswModulesRef = Com
