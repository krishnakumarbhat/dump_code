[part 2 of 4: package /ActiveEcuC]
AUTOSAR XML (schema 00053)
package /ActiveEcuC  (continued)
  module config PduR: implementation-config-variant=VARIANT-POST-BUILD-SELECTABLE, module-description=PduR_Impl  (continued)
    PduRRoutingTables: PduRConfigurationId=0  (continued)
      PduRRoutingTable  (continued)
        305 x PduRRoutingPath, all with PduRMulticoreRoutingPath=false:  (continued)
          RDR_FUSION_DET_073_076_oPCAN_RADAR_870aa883_Rx: PduRRoutingPathCommunicationType=COMMUNICATION_INTERFACE, PduRLockRef=PduRLock_PduRExclusiveArea
            RDR_FUSION_DET_073_076_oPCAN_RADAR_870aa883_Rx_2f64c955_Rx (PduRDestPdu):
              PduRDestPduHandleId = 40
              PduRDestPduDirection = RECEIVE
              PduRDestPduRoutingType = API_FORWARDING
              PduRDestPduDataProcessing = IMMEDIATE
              PduRPduLengthHandlingStrategy = IGNORE
              PduRDestPduCrossPartitionDestination = false
              PduRTransmissionConfirmation = false
              PduRDestPduRef = RDR_FUSION_DET_073_076_oPCAN_RADAR_e31d289d_Rx
              PduRDestPduPduRBswModulesRef = Com
            PduRSrcPdu_2f64c955 (PduRSrcPdu):
              PduRSourcePduHandleId = 47
              PduRSrcPduDirection = RECEIVE
              PduRSrcPduRef = RDR_FUSION_DET_073_076_oPCAN_RADAR_870aa883_Rx
              PduRSrcPduPduRBswModulesRef = CanIf
          RDR_FUSION_DET_025_028_oPCAN_RADAR_89b120f7_Rx: PduRRoutingPathCommunicationType=COMMUNICATION_INTERFACE, PduRLockRef=PduRLock_PduRExclusiveArea
            RDR_FUSION_DET_025_028_oPCAN_RADAR_89b120f7_Rx_18db8483_Rx (PduRDestPdu):
              PduRDestPduHandleId = 28
              PduRDestPduDirection = RECEIVE
              PduRDestPduRoutingType = API_FORWARDING
              PduRDestPduDataProcessing = IMMEDIATE
              PduRPduLengthHandlingStrategy = IGNORE
              PduRDestPduCrossPartitionDestination = false
              PduRTransmissionConfirmation = false
              PduRDestPduRef = RDR_FUSION_DET_025_028_oPCAN_RADAR_de969caf_Rx
              PduRDestPduPduRBswModulesRef = Com
            PduRSrcPdu_18db8483 (PduRSrcPdu):
              PduRSourcePduHandleId = 35
              PduRSrcPduDirection = RECEIVE
              PduRSrcPduRef = RDR_FUSION_DET_025_028_oPCAN_RADAR_89b120f7_Rx
              PduRSrcPduPduRBswModulesRef = CanIf
          RDR_FUSION_DET_049_052_oPCAN_RADAR_5e1bcc45_Rx: PduRRoutingPathCommunicationType=COMMUNICATION_INTERFACE, PduRLockRef=PduRLock_PduRExclusiveArea
            PduRSrcPdu_132dc921 (PduRSrcPdu):
              PduRSourcePduHandleId = 41
              PduRSrcPduDirection = RECEIVE
              PduRSrcPduRef = RDR_FUSION_DET_049_052_oPCAN_RADAR_5e1bcc45_Rx
              PduRSrcPduPduRBswModulesRef = CanIf
            RDR_FUSION_DET_049_052_oPCAN_RADAR_5e1bcc45_Rx_132dc921_Rx (PduRDestPdu):
              PduRDestPduHandleId = 34
              PduRDestPduDirection = RECEIVE
              PduRDestPduRoutingType = API_FORWARDING
              PduRDestPduDataProcessing = IMMEDIATE
              PduRPduLengthHandlingStrategy = IGNORE
              PduRDestPduCrossPartitionDestination = false
              PduRTransmissionConfirmation = false
              PduRDestPduRef = RDR_FUSION_DET_049_052_oPCAN_RADAR_1a60849d_Rx
              PduRDestPduPduRBswModulesRef = Com
          RDR_FUSION_DET_005_008_oPCAN_RADAR_00d57f1e_Rx: PduRRoutingPathCommunicationType=COMMUNICATION_INTERFACE, PduRLockRef=PduRLock_PduRExclusiveArea
            PduRSrcPdu_a70ea4bc (PduRSrcPdu):
              PduRSourcePduHandleId = 30
              PduRSrcPduDirection = RECEIVE
              PduRSrcPduRef = RDR_FUSION_DET_005_008_oPCAN_RADAR_00d57f1e_Rx
              PduRSrcPduPduRBswModulesRef = CanIf
            RDR_FUSION_DET_005_008_oPCAN_RADAR_00d57f1e_Rx_a70ea4bc_Rx (PduRDestPdu):
              PduRDestPduHandleId = 23
              PduRDestPduDirection = RECEIVE
              PduRDestPduRoutingType = API_FORWARDING
              PduRDestPduDataProcessing = IMMEDIATE
              PduRPduLengthHandlingStrategy = IGNORE
              PduRDestPduCrossPartitionDestination = false
              PduRTransmissionConfirmation = false
              PduRDestPduRef = RDR_FUSION_DET_005_008_oPCAN_RADAR_3a2c3381_Rx
              PduRDestPduPduRBswModulesRef = Com
          RDR_FUSION_DET_041_044_oPCAN_RADAR_10105227_Rx: PduRRoutingPathCommunicationType=COMMUNICATION_INTERFACE, PduRLockRef=PduRLock_PduRExclusiveArea
            RDR_FUSION_DET_041_044_oPCAN_RADAR_10105227_Rx_6b4e3673_Rx (PduRDestPdu):
              PduRDestPduHandleId = 32
              PduRDestPduDirection = RECEIVE
              PduRDestPduRoutingType = API_FORWARDING
              PduRDestPduDataProcessing = IMMEDIATE
              PduRPduLengthHandlingStrategy = IGNORE
              PduRDestPduCrossPartitionDestination = false
              PduRTransmissionConfirmation = false
              PduRDestPduRef = RDR_FUSION_DET_041_044_oPCAN_RADAR_c19af5a8_Rx
              PduRDestPduPduRBswModulesRef = Com
            PduRSrcPdu_6b4e3673 (PduRSrcPdu):
              PduRSourcePduHandleId = 39
              PduRSrcPduDirection = RECEIVE
              PduRSrcPduRef = RDR_FUSION_DET_041_044_oPCAN_RADAR_10105227_Rx
              PduRSrcPduPduRBswModulesRef = CanIf
          RDR_FUSION_DET_109_112_oPCAN_RADAR_16b569b7_Rx: PduRRoutingPathCommunicationType=COMMUNICATION_INTERFACE, PduRLockRef=PduRLock_PduRExclusiveArea
            PduRSrcPdu_9f35f68b (PduRSrcPdu):
              PduRSourcePduHandleId = 56
              PduRSrcPduDirection = RECEIVE
              PduRSrcPduRef = RDR_FUSION_DET_109_112_oPCAN_RADAR_16b569b7_Rx
              PduRSrcPduPduRBswModulesRef = CanIf
            RDR_FUSION_DET_109_112_oPCAN_RADAR_16b569b7_Rx_9f35f68b_Rx (PduRDestPdu):
              PduRDestPduHandleId = 49
              PduRDestPduDirection = RECEIVE
              PduRDestPduRoutingType = API_FORWARDING
              PduRDestPduDataProcessing = IMMEDIATE
              PduRPduLengthHandlingStrategy = IGNORE
              PduRDestPduCrossPartitionDestination = false
              PduRTransmissionConfirmation = false
              PduRDestPduRef = RDR_FUSION_DET_109_112_oPCAN_RADAR_667d8730_Rx
              PduRDestPduPduRBswModulesRef = Com
          RDR_FUSION_DET_093_096_oPCAN_RADAR_8fd53b9e_Rx: PduRRoutingPathCommunicationType=COMMUNICATION_INTERFACE, PduRLockRef=PduRLock_PduRExclusiveArea
            RDR_FUSION_DET_093_096_oPCAN_RADAR_8fd53b9e_Rx_96fac798_Rx (PduRDestPdu):
              PduRDestPduHandleId = 45
              PduRDestPduDirection = RECEIVE
              PduRDestPduRoutingType = API_FORWARDING
              PduRDestPduDataProcessing = IMMEDIATE
              PduRPduLengthHandlingStrategy = IGNORE
              PduRDestPduCrossPartitionDestination = false
              PduRTransmissionConfirmation = false
              PduRDestPduRef = RDR_FUSION_DET_093_096_oPCAN_RADAR_31ab6f94_Rx
              PduRDestPduPduRBswModulesRef = Com
            PduRSrcPdu_96fac798 (PduRSrcPdu):
              PduRSourcePduHandleId = 52
              PduRSrcPduDirection = RECEIVE
              PduRSrcPduRef = RDR_FUSION_DET_093_096_oPCAN_RADAR_8fd53b9e_Rx
              PduRSrcPduPduRBswModulesRef = CanIf
          RDR_FUSION_DET_045_048_oPCAN_RADAR_c96cc68d_Rx: PduRRoutingPathCommunicationType=COMMUNICATION_INTERFACE, PduRLockRef=PduRLock_PduRExclusiveArea
            PduRSrcPdu_c0057d5b (PduRSrcPdu):
              PduRSourcePduHandleId = 40
              PduRSrcPduDirection = RECEIVE
              PduRSrcPduRef = RDR_FUSION_DET_045_048_oPCAN_RADAR_c96cc68d_Rx
              PduRSrcPduPduRBswModulesRef = CanIf
            RDR_FUSION_DET_045_048_oPCAN_RADAR_c96cc68d_Rx_c0057d5b_Rx (PduRDestPdu):
              PduRDestPduHandleId = 33
              PduRDestPduDirection = RECEIVE
              PduRDestPduRoutingType = API_FORWARDING
              PduRDestPduDataProcessing = IMMEDIATE
              PduRPduLengthHandlingStrategy = IGNORE
              PduRDestPduCrossPartitionDestination = false
              PduRTransmissionConfirmation = false
              PduRDestPduRef = RDR_FUSION_DET_045_048_oPCAN_RADAR_28286b9c_Rx
              PduRDestPduPduRBswModulesRef = Com
          RDR_FUSION_DET_033_036_oPCAN_RADAR_4eb31110_Rx: PduRRoutingPathCommunicationType=COMMUNICATION_INTERFACE, PduRLockRef=PduRLock_PduRExclusiveArea
            RDR_FUSION_DET_033_036_oPCAN_RADAR_4eb31110_Rx_1350ffb2_Rx (PduRDestPdu):
              PduRDestPduHandleId = 30
              PduRDestPduDirection = RECEIVE
              PduRDestPduRoutingType = API_FORWARDING
              PduRDestPduDataProcessing = IMMEDIATE
              PduRPduLengthHandlingStrategy = IGNORE
              PduRDestPduCrossPartitionDestination = false
              PduRTransmissionConfirmation = false
              PduRDestPduRef = RDR_FUSION_DET_033_036_oPCAN_RADAR_f1197080_Rx
              PduRDestPduPduRBswModulesRef = Com
            PduRSrcPdu_1350ffb2 (PduRSrcPdu):
              PduRSourcePduHandleId = 37
              PduRSrcPduDirection = RECEIVE
              PduRSrcPduRef = RDR_FUSION_DET_033_036_oPCAN_RADAR_4eb31110_Rx
              PduRSrcPduPduRBswModulesRef = CanIf
          RDR_FUSION_DET_077_080_oPCAN_RADAR_5f9aa465_Rx: PduRRoutingPathCommunicationType=COMMUNICATION_INTERFACE, PduRLockRef=PduRLock_PduRExclusiveArea
            RDR_FUSION_DET_077_080_oPCAN_RADAR_5f9aa465_Rx_4243a654_Rx (PduRDestPdu):
              PduRDestPduHandleId = 41
              PduRDestPduDirection = RECEIVE
              PduRDestPduRoutingType = API_FORWARDING
              PduRDestPduDataProcessing = IMMEDIATE
              PduRPduLengthHandlingStrategy = IGNORE
              PduRDestPduCrossPartitionDestination = false
              PduRTransmissionConfirmation = false
              PduRDestPduRef = RDR_FUSION_DET_077_080_oPCAN_RADAR_66646479_Rx
              PduRDestPduPduRBswModulesRef = Com
            PduRSrcPdu_4243a654 (PduRSrcPdu):
              PduRSourcePduHandleId = 48
              PduRSrcPduDirection = RECEIVE
              PduRSrcPduRef = RDR_FUSION_DET_077_080_oPCAN_RADAR_5f9aa465_Rx
              PduRSrcPduPduRBswModulesRef = CanIf
          RDR_FUSION_HEADER_001_oPCAN_RADAR_204bf532_Rx: PduRRoutingPathCommunicationType=COMMUNICATION_INTERFACE, PduRLockRef=PduRLock_PduRExclusiveArea
            PduRSrcPdu_a89b9b48 (PduRSrcPdu):
              PduRSourcePduHandleId = 61
              PduRSrcPduDirection = RECEIVE
              PduRSrcPduRef = RDR_FUSION_HEADER_001_oPCAN_RADAR_204bf532_Rx
              PduRSrcPduPduRBswModulesRef = CanIf
            RDR_FUSION_HEADER_001_oPCAN_RADAR_204bf532_Rx_a89b9b48_Rx (PduRDestPdu):
              PduRDestPduHandleId = 54
              PduRDestPduDirection = RECEIVE
              PduRDestPduRoutingType = API_FORWARDING
              PduRDestPduDataProcessing = IMMEDIATE
              PduRPduLengthHandlingStrategy = IGNORE
              PduRDestPduCrossPartitionDestination = false
              PduRTransmissionConfirmation = false
              PduRDestPduRef = RDR_FUSION_HEADER_001_oPCAN_RADAR_cc468fbf_Rx
              PduRDestPduPduRBswModulesRef = Com
          RDR_FUSION_DET_117_120_oPCAN_RADAR_f33a9557_Rx: PduRRoutingPathCommunicationType=COMMUNICATION_INTERFACE, PduRLockRef=PduRLock_PduRExclusiveArea
            PduRSrcPdu_f689c3be (PduRSrcPdu):
              PduRSourcePduHandleId = 58
              PduRSrcPduDirection = RECEIVE
              PduRSrcPduRef = RDR_FUSION_DET_117_120_oPCAN_RADAR_f33a9557_Rx
              PduRSrcPduPduRBswModulesRef = CanIf
            RDR_FUSION_DET_117_120_oPCAN_RADAR_f33a9557_Rx_f689c3be_Rx (PduRDestPdu):
              PduRDestPduHandleId = 51
              PduRDestPduDirection = RECEIVE
              PduRDestPduRoutingType = API_FORWARDING
              PduRDestPduDataProcessing = IMMEDIATE
              PduRPduLengthHandlingStrategy = IGNORE
              PduRDestPduCrossPartitionDestination = false
              PduRTransmissionConfirmation = false
              PduRDestPduRef = RDR_FUSION_DET_117_120_oPCAN_RADAR_d43659d7_Rx
              PduRDestPduPduRBswModulesRef = Com
          RDR_FUSION_DET_113_116_oPCAN_RADAR_46c05298_Rx: PduRRoutingPathCommunicationType=COMMUNICATION_INTERFACE, PduRLockRef=PduRLock_PduRExclusiveArea
            RDR_FUSION_DET_113_116_oPCAN_RADAR_46c05298_Rx_52789a25_Rx (PduRDestPdu):
              PduRDestPduHandleId = 50
              PduRDestPduDirection = RECEIVE
              PduRDestPduRoutingType = API_FORWARDING
              PduRDestPduDataProcessing = IMMEDIATE
              PduRPduLengthHandlingStrategy = IGNORE
              PduRDestPduCrossPartitionDestination = false
              PduRTransmissionConfirmation = false
              PduRDestPduRef = RDR_FUSION_DET_113_116_oPCAN_RADAR_7bba841e_Rx
              PduRDestPduPduRBswModulesRef = Com
            PduRSrcPdu_52789a25 (PduRSrcPdu):
              PduRSourcePduHandleId = 57
              PduRSrcPduDirection = RECEIVE
              PduRSrcPduRef = RDR_FUSION_DET_113_116_oPCAN_RADAR_46c05298_Rx
              PduRSrcPduPduRBswModulesRef = CanIf
          RDR_FUSION_DET_053_056_oPCAN_RADAR_0e6ef76a_Rx: PduRRoutingPathCommunicationType=COMMUNICATION_INTERFACE, PduRLockRef=PduRLock_PduRExclusiveArea
            RDR_FUSION_DET_053_056_oPCAN_RADAR_0e6ef76a_Rx_58587179_Rx (PduRDestPdu):
              PduRDestPduHandleId = 35
              PduRDestPduDirection = RECEIVE
              PduRDestPduRoutingType = API_FORWARDING
              PduRDestPduDataProcessing = IMMEDIATE
              PduRPduLengthHandlingStrategy = IGNORE
              PduRDestPduCrossPartitionDestination = false
              PduRTransmissionConfirmation = false
              PduRDestPduRef = RDR_FUSION_DET_053_056_oPCAN_RADAR_07a787b3_Rx
              PduRDestPduPduRBswModulesRef = Com
            PduRSrcPdu_58587179 (PduRSrcPdu):
              PduRSourcePduHandleId = 42
              PduRSrcPduDirection = RECEIVE
              PduRSrcPduRef = RDR_FUSION_DET_053_056_oPCAN_RADAR_0e6ef76a_Rx
              PduRSrcPduPduRBswModulesRef = CanIf
          RDR_FUSION_DET_021_024_oPCAN_RADAR_50cdb45d_Rx: PduRRoutingPathCommunicationType=COMMUNICATION_INTERFACE, PduRLockRef=PduRLock_PduRExclusiveArea
            PduRSrcPdu_bb700ec4 (PduRSrcPdu):
              PduRSourcePduHandleId = 34
              PduRSrcPduDirection = RECEIVE
              PduRSrcPduRef = RDR_FUSION_DET_021_024_oPCAN_RADAR_50cdb45d_Rx
              PduRSrcPduPduRBswModulesRef = CanIf
            RDR_FUSION_DET_021_024_oPCAN_RADAR_50cdb45d_Rx_bb700ec4_Rx (PduRDestPdu):
              PduRDestPduHandleId = 27
              PduRDestPduDirection = RECEIVE
              PduRDestPduRoutingType = API_FORWARDING
              PduRDestPduDataProcessing = IMMEDIATE
              PduRPduLengthHandlingStrategy = IGNORE
              PduRDestPduCrossPartitionDestination = false
              PduRTransmissionConfirmation = false
              PduRDestPduRef = RDR_FUSION_DET_021_024_oPCAN_RADAR_3724029b_Rx
              PduRDestPduPduRBswModulesRef = Com
          RDR_FUSION_DET_105_108_oPCAN_RADAR_81c2637f_Rx: PduRRoutingPathCommunicationType=COMMUNICATION_INTERFACE, PduRLockRef=PduRLock_PduRExclusiveArea
            PduRSrcPdu_9b017139 (PduRSrcPdu):
              PduRSourcePduHandleId = 55
              PduRSrcPduDirection = RECEIVE
              PduRSrcPduRef = RDR_FUSION_DET_105_108_oPCAN_RADAR_81c2637f_Rx
              PduRSrcPduPduRBswModulesRef = CanIf
            RDR_FUSION_DET_105_108_oPCAN_RADAR_81c2637f_Rx_9b017139_Rx (PduRDestPdu):
              PduRDestPduHandleId = 48
              PduRDestPduDirection = RECEIVE
              PduRDestPduRoutingType = API_FORWARDING
              PduRDestPduDataProcessing = IMMEDIATE
              PduRPduLengthHandlingStrategy = IGNORE
              PduRDestPduCrossPartitionDestination = false
              PduRTransmissionConfirmation = false
              PduRDestPduRef = RDR_FUSION_DET_105_108_oPCAN_RADAR_54356831_Rx
              PduRDestPduPduRBswModulesRef = Com
          RDR_FUSION_DET_069_072_oPCAN_RADAR_d77f93ac_Rx: PduRRoutingPathCommunicationType=COMMUNICATION_INTERFACE, PduRLockRef=PduRLock_PduRExclusiveArea
            RDR_FUSION_DET_069_072_oPCAN_RADAR_d77f93ac_Rx_1899c974_Rx (PduRDestPdu):
              PduRDestPduHandleId = 39
              PduRDestPduDirection = RECEIVE
              PduRDestPduRoutingType = API_FORWARDING
              PduRDestPduDataProcessing = IMMEDIATE
              PduRPduLengthHandlingStrategy = IGNORE
              PduRDestPduCrossPartitionDestination = false
              PduRTransmissionConfirmation = false
              PduRDestPduRef = RDR_FUSION_DET_069_072_oPCAN_RADAR_feda2bb3_Rx
              PduRDestPduPduRBswModulesRef = Com
            PduRSrcPdu_1899c974 (PduRSrcPdu):
              PduRSourcePduHandleId = 46
              PduRSrcPduDirection = RECEIVE
              PduRSrcPduRef = RDR_FUSION_DET_069_072_oPCAN_RADAR_d77f93ac_Rx
              PduRSrcPduPduRBswModulesRef = CanIf
          RDR_FUSION_DET_037_040_oPCAN_RADAR_69409207_Rx: PduRRoutingPathCommunicationType=COMMUNICATION_INTERFACE, PduRLockRef=PduRLock_PduRExclusiveArea
            PduRSrcPdu_9669473b (PduRSrcPdu):
              PduRSourcePduHandleId = 38
              PduRSrcPduDirection = RECEIVE
              PduRSrcPduRef = RDR_FUSION_DET_037_040_oPCAN_RADAR_69409207_Rx
              PduRSrcPduPduRBswModulesRef = CanIf
            RDR_FUSION_DET_037_040_oPCAN_RADAR_69409207_Rx_9669473b_Rx (PduRDestPdu):
              PduRDestPduHandleId = 31
              PduRDestPduDirection = RECEIVE
              PduRDestPduRoutingType = API_FORWARDING
              PduRDestPduDataProcessing = IMMEDIATE
              PduRPduLengthHandlingStrategy = IGNORE
              PduRDestPduCrossPartitionDestination = false
              PduRTransmissionConfirmation = false
              PduRDestPduRef = RDR_FUSION_DET_037_040_oPCAN_RADAR_47392252_Rx
              PduRDestPduPduRBswModulesRef = Com
          RDR_FUSION_DET_029_032_oPCAN_RADAR_1ec62a3f_Rx: PduRRoutingPathCommunicationType=COMMUNICATION_INTERFACE, PduRLockRef=PduRLock_PduRExclusiveArea
            PduRSrcPdu_3b5286ba (PduRSrcPdu):
              PduRSourcePduHandleId = 36
              PduRSrcPduDirection = RECEIVE
              PduRSrcPduRef = RDR_FUSION_DET_029_032_oPCAN_RADAR_1ec62a3f_Rx
              PduRSrcPduPduRBswModulesRef = CanIf
            RDR_FUSION_DET_029_032_oPCAN_RADAR_1ec62a3f_Rx_3b5286ba_Rx (PduRDestPdu):
              PduRDestPduHandleId = 29
              PduRDestPduDirection = RECEIVE
              PduRDestPduRoutingType = API_FORWARDING
              PduRDestPduDataProcessing = IMMEDIATE
              PduRPduLengthHandlingStrategy = IGNORE
              PduRDestPduCrossPartitionDestination = false
              PduRTransmissionConfirmation = false
              PduRDestPduRef = RDR_FUSION_DET_029_032_oPCAN_RADAR_ecde73ae_Rx
              PduRDestPduPduRBswModulesRef = Com
          RDR_FUSION_STATUS_001_oPCAN_RADAR_b6cfc045_Rx: PduRRoutingPathCommunicationType=COMMUNICATION_INTERFACE, PduRLockRef=PduRLock_PduRExclusiveArea
            RDR_FUSION_STATUS_001_oPCAN_RADAR_b6cfc045_Rx_c7bfd0ac_Rx (PduRDestPdu):
              PduRDestPduHandleId = 55
              PduRDestPduDirection = RECEIVE
              PduRDestPduRoutingType = API_FORWARDING
              PduRDestPduDataProcessing = IMMEDIATE
              PduRPduLengthHandlingStrategy = IGNORE
              PduRDestPduCrossPartitionDestination = false
              PduRTransmissionConfirmation = false
              PduRDestPduRef = RDR_FUSION_STATUS_001_oPCAN_RADAR_8bf3739d_Rx
              PduRDestPduPduRBswModulesRef = Com
            PduRSrcPdu_c7bfd0ac (PduRSrcPdu):
              PduRSourcePduHandleId = 62
              PduRSrcPduDirection = RECEIVE
              PduRSrcPduRef = RDR_FUSION_STATUS_001_oPCAN_RADAR_b6cfc045_Rx
              PduRSrcPduPduRBswModulesRef = CanIf
          RDR_FUSION_DET_057_060_oPCAN_RADAR_bb9430a5_Rx: PduRRoutingPathCommunicationType=COMMUNICATION_INTERFACE, PduRLockRef=PduRLock_PduRExclusiveArea
            RDR_FUSION_DET_057_060_oPCAN_RADAR_bb9430a5_Rx_b035ac65_Rx (PduRDestPdu):
              PduRDestPduHandleId = 36
              PduRDestPduDirection = RECEIVE
              PduRDestPduRoutingType = API_FORWARDING
              PduRDestPduDataProcessing = IMMEDIATE
              PduRPduLengthHandlingStrategy = IGNORE
              PduRDestPduCrossPartitionDestination = false
              PduRTransmissionConfirmation = false
              PduRDestPduRef = RDR_FUSION_DET_057_060_oPCAN_RADAR_a82b5a7a_Rx
              PduRDestPduPduRBswModulesRef = Com
            PduRSrcPdu_b035ac65 (PduRSrcPdu):
              PduRSourcePduHandleId = 43
              PduRSrcPduDirection = RECEIVE
              PduRSrcPduRef = RDR_FUSION_DET_057_060_oPCAN_RADAR_bb9430a5_Rx
              PduRSrcPduPduRBswModulesRef = CanIf
          RDR_FUSION_DET_081_084_oPCAN_RADAR_91ab9ed3_Rx: PduRRoutingPathCommunicationType=COMMUNICATION_INTERFACE, PduRLockRef=PduRLock_PduRExclusiveArea
            PduRSrcPdu_034cdf81 (PduRSrcPdu):
              PduRSourcePduHandleId = 49
              PduRSrcPduDirection = RECEIVE
              PduRSrcPduRef = RDR_FUSION_DET_081_084_oPCAN_RADAR_91ab9ed3_Rx
              PduRSrcPduPduRBswModulesRef = CanIf
            RDR_FUSION_DET_081_084_oPCAN_RADAR_91ab9ed3_Rx_034cdf81_Rx (PduRDestPdu):
              PduRDestPduHandleId = 42
              PduRDestPduDirection = RECEIVE
              PduRDestPduRoutingType = API_FORWARDING
              PduRDestPduDataProcessing = IMMEDIATE
              PduRPduLengthHandlingStrategy = IGNORE
              PduRDestPduCrossPartitionDestination = false
              PduRTransmissionConfirmation = false
              PduRDestPduRef = RDR_FUSION_DET_081_084_oPCAN_RADAR_f7961d8f_Rx
              PduRDestPduPduRBswModulesRef = Com
          RDR_FUSION_DET_061_064_oPCAN_RADAR_99740dce_Rx: PduRRoutingPathCommunicationType=COMMUNICATION_INTERFACE, PduRLockRef=PduRLock_PduRExclusiveArea
            RDR_FUSION_DET_061_064_oPCAN_RADAR_99740dce_Rx_5bdbe3ec_Rx (PduRDestPdu):
              PduRDestPduHandleId = 37
              PduRDestPduDirection = RECEIVE
              PduRDestPduRoutingType = API_FORWARDING
              PduRDestPduDataProcessing = IMMEDIATE
              PduRPduLengthHandlingStrategy = IGNORE
              PduRDestPduCrossPartitionDestination = false
              PduRTransmissionConfirmation = false
              PduRDestPduRef = RDR_FUSION_DET_061_064_oPCAN_RADAR_25205a86_Rx
              PduRDestPduPduRBswModulesRef = Com
            PduRSrcPdu_5bdbe3ec (PduRSrcPdu):
              PduRSourcePduHandleId = 44
              PduRSrcPduDirection = RECEIVE
              PduRSrcPduRef = RDR_FUSION_DET_061_064_oPCAN_RADAR_99740dce_Rx
              PduRSrcPduPduRBswModulesRef = CanIf
          RDR_FUSION_DET_125_128_oPCAN_RADAR_08a63c96_Rx: PduRRoutingPathCommunicationType=COMMUNICATION_INTERFACE, PduRLockRef=PduRLock_PduRExclusiveArea
            RDR_FUSION_DET_125_128_oPCAN_RADAR_08a63c96_Rx_306b8626_Rx (PduRDestPdu):
              PduRDestPduHandleId = 53
              PduRDestPduDirection = RECEIVE
              PduRDestPduRoutingType = API_FORWARDING
              PduRDestPduDataProcessing = IMMEDIATE
              PduRPduLengthHandlingStrategy = IGNORE
              PduRDestPduCrossPartitionDestination = false
              PduRTransmissionConfirmation = false
              PduRDestPduRef = RDR_FUSION_DET_125_128_oPCAN_RADAR_b08fc71f_Rx
              PduRDestPduPduRBswModulesRef = Com
            PduRSrcPdu_306b8626 (PduRSrcPdu):
              PduRSourcePduHandleId = 60
              PduRSrcPduDirection = RECEIVE
              PduRSrcPduRef = RDR_FUSION_DET_125_128_oPCAN_RADAR_08a63c96_Rx
              PduRSrcPduPduRBswModulesRef = CanIf
          RDR_FUSION_DET_001_004_oPCAN_RADAR_d9a9ebb4_Rx: PduRRoutingPathCommunicationType=COMMUNICATION_INTERFACE, PduRLockRef=PduRLock_PduRExclusiveArea
            RDR_FUSION_DET_001_004_oPCAN_RADAR_d9a9ebb4_Rx_2d45ad19_Rx (PduRDestPdu):
              PduRDestPduHandleId = 22
              PduRDestPduDirection = RECEIVE
              PduRDestPduRoutingType = API_FORWARDING
              PduRDestPduDataProcessing = IMMEDIATE
              PduRPduLengthHandlingStrategy = IGNORE
              PduRDestPduCrossPartitionDestination = false
              PduRTransmissionConfirmation = false
              PduRDestPduRef = RDR_FUSION_DET_001_004_oPCAN_RADAR_d39eadb5_Rx
              PduRDestPduPduRBswModulesRef = Com
            PduRSrcPdu_2d45ad19 (PduRSrcPdu):
              PduRSourcePduHandleId = 29
              PduRSrcPduDirection = RECEIVE
              PduRSrcPduRef = RDR_FUSION_DET_001_004_oPCAN_RADAR_d9a9ebb4_Rx
              PduRSrcPduPduRBswModulesRef = CanIf
          RDR_FUSION_DET_017_020_oPCAN_RADAR_722d8936_Rx: PduRRoutingPathCommunicationType=COMMUNICATION_INTERFACE, PduRLockRef=PduRLock_PduRExclusiveArea
            PduRSrcPdu_79c21ad9 (PduRSrcPdu):
              PduRSourcePduHandleId = 33
              PduRSrcPduDirection = RECEIVE
              PduRSrcPduRef = RDR_FUSION_DET_017_020_oPCAN_RADAR_722d8936_Rx
              PduRSrcPduPduRBswModulesRef = CanIf
            RDR_FUSION_DET_017_020_oPCAN_RADAR_722d8936_Rx_79c21ad9_Rx (PduRDestPdu):
              PduRDestPduHandleId = 26
              PduRDestPduDirection = RECEIVE
              PduRDestPduRoutingType = API_FORWARDING
              PduRDestPduDataProcessing = IMMEDIATE
              PduRPduLengthHandlingStrategy = IGNORE
              PduRDestPduCrossPartitionDestination = false
              PduRTransmissionConfirmation = false
              PduRDestPduRef = RDR_FUSION_DET_017_020_oPCAN_RADAR_ba2f0267_Rx
              PduRDestPduPduRBswModulesRef = Com
          RDR_FUSION_DET_101_104_oPCAN_RADAR_58bef7d5_Rx: PduRRoutingPathCommunicationType=COMMUNICATION_INTERFACE, PduRLockRef=PduRLock_PduRExclusiveArea
            PduRSrcPdu_7a8ffc03 (PduRSrcPdu):
              PduRSourcePduHandleId = 54
              PduRSrcPduDirection = RECEIVE
              PduRSrcPduRef = RDR_FUSION_DET_101_104_oPCAN_RADAR_58bef7d5_Rx
              PduRSrcPduPduRBswModulesRef = CanIf
            RDR_FUSION_DET_101_104_oPCAN_RADAR_58bef7d5_Rx_7a8ffc03_Rx (PduRDestPdu):
              PduRDestPduHandleId = 47
              PduRDestPduDirection = RECEIVE
              PduRDestPduRoutingType = API_FORWARDING
              PduRDestPduDataProcessing = IMMEDIATE
              PduRPduLengthHandlingStrategy = IGNORE
              PduRDestPduCrossPartitionDestination = false
              PduRTransmissionConfirmation = false
              PduRDestPduRef = RDR_FUSION_DET_101_104_oPCAN_RADAR_bd87f605_Rx
              PduRDestPduPduRBswModulesRef = Com
          RDR_FUSION_DET_013_016_oPCAN_RADAR_c7d74ef9_Rx: PduRRoutingPathCommunicationType=COMMUNICATION_INTERFACE, PduRLockRef=PduRLock_PduRExclusiveArea
            RDR_FUSION_DET_013_016_oPCAN_RADAR_c7d74ef9_Rx_57f3a278_Rx (PduRDestPdu):
              PduRDestPduHandleId = 25
              PduRDestPduDirection = RECEIVE
              PduRDestPduRoutingType = API_FORWARDING
              PduRDestPduDataProcessing = IMMEDIATE
              PduRPduLengthHandlingStrategy = IGNORE
              PduRDestPduCrossPartitionDestination = false
              PduRTransmissionConfirmation = false
              PduRDestPduRef = RDR_FUSION_DET_013_016_oPCAN_RADAR_15a3dfae_Rx
              PduRDestPduPduRBswModulesRef = Com
            PduRSrcPdu_57f3a278 (PduRSrcPdu):
              PduRSourcePduHandleId = 32
              PduRSrcPduDirection = RECEIVE
              PduRSrcPduRef = RDR_FUSION_DET_013_016_oPCAN_RADAR_c7d74ef9_Rx
              PduRSrcPduPduRBswModulesRef = CanIf
          RDR_FUSION_DET_089_092_oPCAN_RADAR_dfa000b1_Rx: PduRRoutingPathCommunicationType=COMMUNICATION_INTERFACE, PduRLockRef=PduRLock_PduRExclusiveArea
            RDR_FUSION_DET_089_092_oPCAN_RADAR_dfa000b1_Rx_3225c807_Rx (PduRDestPdu):
              PduRDestPduHandleId = 44
              PduRDestPduDirection = RECEIVE
              PduRDestPduRoutingType = API_FORWARDING
              PduRDestPduDataProcessing = IMMEDIATE
              PduRPduLengthHandlingStrategy = IGNORE
              PduRDestPduCrossPartitionDestination = false
              PduRTransmissionConfirmation = false
              PduRDestPduRef = RDR_FUSION_DET_089_092_oPCAN_RADAR_2c6c6cba_Rx
              PduRDestPduPduRBswModulesRef = Com
            PduRSrcPdu_3225c807 (PduRSrcPdu):
              PduRSourcePduHandleId = 51
              PduRSrcPduDirection = RECEIVE
              PduRSrcPduRef = RDR_FUSION_DET_089_092_oPCAN_RADAR_dfa000b1_Rx
              PduRSrcPduPduRBswModulesRef = CanIf
          RDR_FUSION_DET_121_124_oPCAN_RADAR_d1daa83c_Rx: PduRRoutingPathCommunicationType=COMMUNICATION_INTERFACE, PduRLockRef=PduRLock_PduRExclusiveArea
            RDR_FUSION_DET_121_124_oPCAN_RADAR_d1daa83c_Rx_f5d5e0dc_Rx (PduRDestPdu):
              PduRDestPduHandleId = 52
              PduRDestPduDirection = RECEIVE
              PduRDestPduRoutingType = API_FORWARDING
              PduRDestPduDataProcessing = IMMEDIATE
              PduRPduLengthHandlingStrategy = IGNORE
              PduRDestPduCrossPartitionDestination = false
              PduRTransmissionConfirmation = false
              PduRDestPduRef = RDR_FUSION_DET_121_124_oPCAN_RADAR_593d592b_Rx
              PduRDestPduPduRBswModulesRef = Com
            PduRSrcPdu_f5d5e0dc (PduRSrcPdu):
              PduRSourcePduHandleId = 59
              PduRSrcPduDirection = RECEIVE
              PduRSrcPduRef = RDR_FUSION_DET_121_124_oPCAN_RADAR_d1daa83c_Rx
              PduRSrcPduPduRBswModulesRef = CanIf
          RDR_FUSION_DET_097_100_oPCAN_RADAR_43d6c604_Rx: PduRRoutingPathCommunicationType=COMMUNICATION_INTERFACE, PduRLockRef=PduRLock_PduRExclusiveArea
            RDR_FUSION_DET_097_100_oPCAN_RADAR_43d6c604_Rx_6734284d_Rx (PduRDestPdu):
              PduRDestPduHandleId = 46
              PduRDestPduDirection = RECEIVE
              PduRDestPduRoutingType = API_FORWARDING
              PduRDestPduDataProcessing = IMMEDIATE
              PduRPduLengthHandlingStrategy = IGNORE
              PduRDestPduCrossPartitionDestination = false
              PduRTransmissionConfirmation = false
              PduRDestPduRef = RDR_FUSION_DET_097_100_oPCAN_RADAR_f5ebb32e_Rx
              PduRDestPduPduRBswModulesRef = Com
            PduRSrcPdu_6734284d (PduRSrcPdu):
              PduRSourcePduHandleId = 53
              PduRSrcPduDirection = RECEIVE
              PduRSrcPduRef = RDR_FUSION_DET_097_100_oPCAN_RADAR_43d6c604_Rx
              PduRSrcPduPduRBswModulesRef = CanIf
          RDR_FUSION_DET_009_012_oPCAN_RADAR_97a275d6_Rx: PduRRoutingPathCommunicationType=COMMUNICATION_INTERFACE, PduRLockRef=PduRLock_PduRExclusiveArea
            RDR_FUSION_DET_009_012_oPCAN_RADAR_97a275d6_Rx_7f5ee3b6_Rx (PduRDestPdu):
              PduRDestPduHandleId = 24
              PduRDestPduDirection = RECEIVE
              PduRDestPduRoutingType = API_FORWARDING
              PduRDestPduDataProcessing = IMMEDIATE
              PduRPduLengthHandlingStrategy = IGNORE
              PduRDestPduCrossPartitionDestination = false
              PduRTransmissionConfirmation = false
              PduRDestPduRef = RDR_FUSION_DET_009_012_oPCAN_RADAR_0864dc80_Rx
              PduRDestPduPduRBswModulesRef = Com
            PduRSrcPdu_7f5ee3b6 (PduRSrcPdu):
              PduRSourcePduHandleId = 31
              PduRSrcPduDirection = RECEIVE
              PduRSrcPduRef = RDR_FUSION_DET_009_012_oPCAN_RADAR_97a275d6_Rx
              PduRSrcPduPduRBswModulesRef = CanIf
          RDR_FUSION_DET_085_088_oPCAN_RADAR_48d70a79_Rx: PduRRoutingPathCommunicationType=COMMUNICATION_INTERFACE, PduRLockRef=PduRLock_PduRExclusiveArea
            PduRSrcPdu_fd43e886 (PduRSrcPdu):
              PduRSourcePduHandleId = 50
              PduRSrcPduDirection = RECEIVE
              PduRSrcPduRef = RDR_FUSION_DET_085_088_oPCAN_RADAR_48d70a79_Rx
              PduRSrcPduPduRBswModulesRef = CanIf
            RDR_FUSION_DET_085_088_oPCAN_RADAR_48d70a79_Rx_fd43e886_Rx (PduRDestPdu):
              PduRDestPduHandleId = 43
              PduRDestPduDirection = RECEIVE
              PduRDestPduRoutingType = API_FORWARDING
              PduRDestPduDataProcessing = IMMEDIATE
              PduRPduLengthHandlingStrategy = IGNORE
              PduRDestPduCrossPartitionDestination = false
              PduRTransmissionConfirmation = false
              PduRDestPduRef = RDR_FUSION_DET_085_088_oPCAN_RADAR_1e2483bb_Rx
              PduRDestPduPduRBswModulesRef = Com
          ETC2_03_oVCAN_RADAR_a69b4dc5_Rx: PduRRoutingPathCommunicationType=COMMUNICATION_INTERFACE, PduRLockRef=PduRLock_PduRExclusiveArea
            ETC2_03_oVCAN_RADAR_a69b4dc5_Rx_03929d1b_Rx (PduRDestPdu):
              PduRDestPduHandleId = 5
              PduRDestPduDirection = RECEIVE
              PduRDestPduRoutingType = API_FORWARDING
              PduRDestPduDataProcessing = IMMEDIATE
              PduRPduLengthHandlingStrategy = IGNORE
              PduRDestPduCrossPartitionDestination = false
              PduRTransmissionConfirmation = false
              PduRDestPduRef = ETC2_03_oVCAN_RADAR_8fe61e94_Rx
              PduRDestPduPduRBswModulesRef = Com
            PduRSrcPdu_03929d1b (PduRSrcPdu): PduRSourcePduHandleId=7, PduRSrcPduDirection=RECEIVE, PduRSrcPduRef=ETC2_03_oVCAN_RADAR_a69b4dc5_Rx, PduRSrcPduPduRBswModulesRef=CanIf
            GW_ETC2_03_Tx_oPCAN_RADAR_07adbeb0_Tx (PduRDestPdu):
              PduRDestPduHandleId = 7
              PduRDestPduDirection = TRANSMIT if post-build-variant-condition{matching-criterion=RDR_POS, value=3}
              PduRDestPduDirection = TRANSMIT if post-build-variant-condition{matching-criterion=RDR_POS, value=0}
              PduRDestPduDirection = TRANSMIT if post-build-variant-condition{matching-criterion=RDR_POS, value=7}
              PduRDestPduDirection = TRANSMIT if post-build-variant-condition{matching-criterion=RDR_POS, value=6}
              PduRDestPduDirection = TRANSMIT if post-build-variant-condition{matching-criterion=RDR_POS, value=4}
              PduRDestPduDirection = TRANSMIT if post-build-variant-condition{matching-criterion=RDR_POS, value=1}
              PduRDestPduDirection = TRANSMIT if post-build-variant-condition{matching-criterion=RDR_POS, value=2}
              PduRDestPduDirection = TRANSMIT if post-build-variant-condition{matching-criterion=RDR_POS, value=5}
              PduRDestPduRoutingType = GATEWAY_ROUTING if post-build-variant-condition{matching-criterion=RDR_POS, value=3}
              PduRDestPduRoutingType = GATEWAY_ROUTING if post-build-variant-condition{matching-criterion=RDR_POS, value=0}
              PduRDestPduRoutingType = GATEWAY_ROUTING if post-build-variant-condition{matching-criterion=RDR_POS, value=7}
              PduRDestPduRoutingType = GATEWAY_ROUTING if post-build-variant-condition{matching-criterion=RDR_POS, value=6}
              PduRDestPduRoutingType = GATEWAY_ROUTING if post-build-variant-condition{matching-criterion=RDR_POS, value=4}
              PduRDestPduRoutingType = GATEWAY_ROUTING if post-build-variant-condition{matching-criterion=RDR_POS, value=1}
              PduRDestPduRoutingType = GATEWAY_ROUTING if post-build-variant-condition{matching-criterion=RDR_POS, value=2}
              PduRDestPduRoutingType = GATEWAY_ROUTING if post-build-variant-condition{matching-criterion=RDR_POS, value=5}
              PduRDestPduDataProcessing = IMMEDIATE
              PduRPduLengthHandlingStrategy = IGNORE
              PduRDestPduCrossPartitionDestination = false
              PduRTransmissionConfirmation = false
              PduRDestPduDataProvision = PDUR_DIRECT
              PduRDestPduRef = GW_ETC2_03_Tx_oPCAN_RADAR_07adbeb0_Tx
              PduRDestPduPduRBswModulesRef = CanIf if post-build-variant-condition{matching-criterion=RDR_POS, value=6}
              PduRDestPduPduRBswModulesRef = CanIf if post-build-variant-condition{matching-criterion=RDR_POS, value=5}
              PduRDestPduPduRBswModulesRef = CanIf if post-build-variant-condition{matching-criterion=RDR_POS, value=4}
              PduRDestPduPduRBswModulesRef = CanIf if post-build-variant-condition{matching-criterion=RDR_POS, value=1}
              PduRDestPduPduRBswModulesRef = CanIf if post-build-variant-condition{matching-criterion=RDR_POS, value=2}
              PduRDestPduPduRBswModulesRef = CanIf if post-build-variant-condition{matching-criterion=RDR_POS, value=7}
              PduRDestPduPduRBswModulesRef = CanIf if post-build-variant-condition{matching-criterion=RDR_POS, value=3}
              PduRDestPduPduRBswModulesRef = CanIf if post-build-variant-condition{matching-criterion=RDR_POS, value=0}
          ETC2_00_oVCAN_RADAR_fd8cfcd0_Rx: PduRRoutingPathCommunicationType=COMMUNICATION_INTERFACE, PduRLockRef=PduRLock_PduRExclusiveArea
            ETC2_00_oVCAN_RADAR_fd8cfcd0_Rx_55c59867_Rx (PduRDestPdu):
              PduRDestPduHandleId = 4
              PduRDestPduDirection = RECEIVE
              PduRDestPduRoutingType = API_FORWARDING
              PduRDestPduDataProcessing = IMMEDIATE
              PduRPduLengthHandlingStrategy = IGNORE
              PduRDestPduCrossPartitionDestination = false
              PduRTransmissionConfirmation = false
              PduRDestPduRef = ETC2_00_oVCAN_RADAR_322c725a_Rx
              PduRDestPduPduRBswModulesRef = Com
            PduRSrcPdu_55c59867 (PduRSrcPdu): PduRSourcePduHandleId=6, PduRSrcPduDirection=RECEIVE, PduRSrcPduRef=ETC2_00_oVCAN_RADAR_fd8cfcd0_Rx, PduRSrcPduPduRBswModulesRef=CanIf
            GW_ETC2_Tx_oPCAN_RADAR_dfec0354_Tx (PduRDestPdu):
              PduRDestPduHandleId = 8
              PduRDestPduDirection = TRANSMIT
              PduRDestPduRoutingType = GATEWAY_ROUTING
              PduRDestPduDataProcessing = IMMEDIATE
              PduRPduLengthHandlingStrategy = IGNORE
              PduRDestPduCrossPartitionDestination = false
              PduRDestPduDataProvision = PDUR_DIRECT
              PduRTransmissionConfirmation = false
              PduRDestPduRef = GW_ETC2_Tx_oPCAN_RADAR_dfec0354_Tx
              PduRDestPduPduRBswModulesRef = CanIf
          ADAS_FN_Enable_disable_sts_oVCAN_RADAR_3f57de57_Rx: PduRRoutingPathCommunicationType=COMMUNICATION_INTERFACE, PduRLockRef=PduRLock_PduRExclusiveArea
            PduRSrcPdu_afaa1f7b (PduRSrcPdu):
              PduRSourcePduHandleId = 0
              PduRSrcPduDirection = RECEIVE
              PduRSrcPduRef = ADAS_FN_Enable_disable_sts_oVCAN_RADAR_3f57de57_Rx
              PduRSrcPduPduRBswModulesRef = CanIf
            ADAS_FN_Enable_disable_sts_oVCAN_RADAR_3f57de57_Rx_afaa1f7b_Rx (PduRDestPdu):
              PduRDestPduHandleId = 0
              PduRDestPduDirection = RECEIVE
              PduRDestPduRoutingType = API_FORWARDING
              PduRDestPduDataProcessing = IMMEDIATE
              PduRPduLengthHandlingStrategy = IGNORE
              PduRDestPduCrossPartitionDestination = false
              PduRTransmissionConfirmation = false
              PduRDestPduRef = ADAS_FN_Enable_disable_sts_oVCAN_RADAR_dbe1c88d_Rx
              PduRDestPduPduRBswModulesRef = Com
            GW_ADAS_FN_Enable_disable_sts_Tx_oPCAN_RADAR_27a639a3_Tx (PduRDestPdu):
              PduRDestPduHandleId = 3
              PduRDestPduDirection = TRANSMIT
              PduRDestPduRoutingType = GATEWAY_ROUTING
              PduRDestPduDataProcessing = IMMEDIATE
              PduRPduLengthHandlingStrategy = IGNORE
              PduRDestPduCrossPartitionDestination = false
              PduRTransmissionConfirmation = false
              PduRDestPduDataProvision = PDUR_DIRECT
              PduRDestPduRef = GW_ADAS_FN_Enable_disable_sts_Tx_oPCAN_RADAR_27a639a3_Tx
              PduRDestPduPduRBswModulesRef = CanIf
          VD_oVCAN_RADAR_36e033f5_Rx: PduRRoutingPathCommunicationType=COMMUNICATION_INTERFACE, PduRLockRef=PduRLock_PduRExclusiveArea
            PduRSrcPdu_33254787 (PduRSrcPdu): PduRSourcePduHandleId=84, PduRSrcPduDirection=RECEIVE, PduRSrcPduRef=VD_oVCAN_RADAR_36e033f5_Rx, PduRSrcPduPduRBswModulesRef=CanIf
            VD_oVCAN_RADAR_36e033f5_Rx_33254787_Rx (PduRDestPdu):
              PduRDestPduHandleId = 61
              PduRDestPduDirection = RECEIVE
              PduRDestPduRoutingType = API_FORWARDING
              PduRDestPduDataProcessing = IMMEDIATE
              PduRPduLengthHandlingStrategy = IGNORE
              PduRDestPduCrossPartitionDestination = false
              PduRTransmissionConfirmation = false
              PduRDestPduRef = VD_oVCAN_RADAR_612104d9_Rx
              PduRDestPduPduRBswModulesRef = Com
            GW_VD_Tx_oPCAN_RADAR_70a8f6f0_Tx (PduRDestPdu):
              PduRDestPduHandleId = 13
              PduRDestPduDirection = TRANSMIT
              PduRDestPduRoutingType = GATEWAY_ROUTING
              PduRDestPduDataProcessing = IMMEDIATE
              PduRPduLengthHandlingStrategy = IGNORE
              PduRDestPduCrossPartitionDestination = false
              PduRDestPduDataProvision = PDUR_DIRECT
              PduRTransmissionConfirmation = false
              PduRDestPduRef = GW_VD_Tx_oPCAN_RADAR_70a8f6f0_Tx
              PduRDestPduPduRBswModulesRef = CanIf
          VDC2_oVCAN_RADAR_9b73b1bc_Rx: PduRRoutingPathCommunicationType=COMMUNICATION_INTERFACE, PduRLockRef=PduRLock_PduRExclusiveArea
            PduRSrcPdu_8bed2445 (PduRSrcPdu): PduRSourcePduHandleId=83, PduRSrcPduDirection=RECEIVE, PduRSrcPduRef=VDC2_oVCAN_RADAR_9b73b1bc_Rx, PduRSrcPduPduRBswModulesRef=CanIf
            VDC2_oVCAN_RADAR_9b73b1bc_Rx_8bed2445_Rx (PduRDestPdu):
              PduRDestPduHandleId = 60
              PduRDestPduDirection = RECEIVE
              PduRDestPduRoutingType = API_FORWARDING
              PduRDestPduDataProcessing = IMMEDIATE
              PduRPduLengthHandlingStrategy = IGNORE
              PduRDestPduCrossPartitionDestination = false
              PduRTransmissionConfirmation = false
              PduRDestPduRef = VDC2_oVCAN_RADAR_5a222cac_Rx
              PduRDestPduPduRBswModulesRef = Com
            GW_VDC2_Tx_oPCAN_RADAR_8a7343d4_Tx (PduRDestPdu):
              PduRDestPduHandleId = 12
              PduRDestPduDirection = TRANSMIT
              PduRDestPduRoutingType = GATEWAY_ROUTING
              PduRDestPduDataProcessing = IMMEDIATE
              PduRPduLengthHandlingStrategy = IGNORE
              PduRDestPduCrossPartitionDestination = false
              PduRDestPduDataProvision = PDUR_DIRECT
              PduRTransmissionConfirmation = false
              PduRDestPduRef = GW_VDC2_Tx_oPCAN_RADAR_8a7343d4_Tx
              PduRDestPduPduRBswModulesRef = CanIf
          CLS_Tx_16_oVCAN_RADAR_afa2b499_Rx: PduRRoutingPathCommunicationType=COMMUNICATION_INTERFACE, PduRLockRef=PduRLock_PduRExclusiveArea
            CLS_Tx_16_oVCAN_RADAR_afa2b499_Rx_314b6b6e_Rx (PduRDestPdu):
              PduRDestPduHandleId = 3
              PduRDestPduDirection = RECEIVE
              PduRDestPduRoutingType = API_FORWARDING
              PduRDestPduDataProcessing = IMMEDIATE
              PduRPduLengthHandlingStrategy = IGNORE
              PduRDestPduCrossPartitionDestination = false
              PduRTransmissionConfirmation = false
              PduRDestPduRef = CLS_Tx_16_oVCAN_RADAR_4a01c26f_Rx
              PduRDestPduPduRBswModulesRef = Com
            PduRSrcPdu_314b6b6e (PduRSrcPdu): PduRSourcePduHandleId=3, PduRSrcPduDirection=RECEIVE, PduRSrcPduRef=CLS_Tx_16_oVCAN_RADAR_afa2b499_Rx, PduRSrcPduPduRBswModulesRef=CanIf
            GW_CLS_Tx_16_Tx_oPCAN_RADAR_b30c42cc_Tx (PduRDestPdu):
              PduRDestPduHandleId = 6
              PduRDestPduDirection = TRANSMIT
              PduRDestPduRoutingType = GATEWAY_ROUTING
              PduRDestPduDataProcessing = IMMEDIATE
              PduRPduLengthHandlingStrategy = IGNORE
              PduRDestPduCrossPartitionDestination = false
              PduRDestPduDataProvision = PDUR_DIRECT
              PduRTransmissionConfirmation = false
              PduRDestPduRef = GW_CLS_Tx_16_Tx_oPCAN_RADAR_b30c42cc_Tx
              PduRDestPduPduRBswModulesRef = CanIf
          TD_oVCAN_RADAR_7fe49199_Rx: PduRRoutingPathCommunicationType=COMMUNICATION_INTERFACE, PduRLockRef=PduRLock_PduRExclusiveArea
            TD_oVCAN_RADAR_7fe49199_Rx_b2c5ee3f_Rx (PduRDestPdu):
              PduRDestPduHandleId = 59
              PduRDestPduDirection = RECEIVE
              PduRDestPduRoutingType = API_FORWARDING
              PduRDestPduDataProcessing = IMMEDIATE
              PduRPduLengthHandlingStrategy = IGNORE
              PduRDestPduCrossPartitionDestination = false
              PduRTransmissionConfirmation = false
              PduRDestPduRef = TD_oVCAN_RADAR_804fc074_Rx
              PduRDestPduPduRBswModulesRef = Com
            PduRSrcPdu_b2c5ee3f (PduRSrcPdu): PduRSourcePduHandleId=82, PduRSrcPduDirection=RECEIVE, PduRSrcPduRef=TD_oVCAN_RADAR_7fe49199_Rx, PduRSrcPduPduRBswModulesRef=CanIf
            GW_TD_Tx_oPCAN_RADAR_aa39de8f_Tx (PduRDestPdu):
              PduRDestPduHandleId = 11
              PduRDestPduDirection = TRANSMIT
              PduRDestPduRoutingType = GATEWAY_ROUTING
              PduRDestPduDataProcessing = IMMEDIATE
              PduRPduLengthHandlingStrategy = IGNORE
              PduRDestPduCrossPartitionDestination = false
              PduRDestPduDataProvision = PDUR_DIRECT
              PduRTransmissionConfirmation = false
              PduRDestPduRef = GW_TD_Tx_oPCAN_RADAR_aa39de8f_Tx
              PduRDestPduPduRBswModulesRef = CanIf
          OEL_oVCAN_RADAR_45092dcb_Rx: PduRRoutingPathCommunicationType=COMMUNICATION_INTERFACE, PduRLockRef=PduRLock_PduRExclusiveArea
            PduRSrcPdu_e7745bc0 (PduRSrcPdu): PduRSourcePduHandleId=20, PduRSrcPduDirection=RECEIVE, PduRSrcPduRef=OEL_oVCAN_RADAR_45092dcb_Rx, PduRSrcPduPduRBswModulesRef=CanIf
            OEL_oVCAN_RADAR_45092dcb_Rx_e7745bc0_Rx (PduRDestPdu):
              PduRDestPduHandleId = 18
              PduRDestPduDirection = RECEIVE
              PduRDestPduRoutingType = API_FORWARDING
              PduRDestPduDataProcessing = IMMEDIATE
              PduRPduLengthHandlingStrategy = IGNORE
              PduRDestPduCrossPartitionDestination = false
              PduRTransmissionConfirmation = false
              PduRDestPduRef = OEL_oVCAN_RADAR_75091ec5_Rx
              PduRDestPduPduRBswModulesRef = Com
            GW_OEL_Tx_oPCAN_RADAR_96436c6f_Tx (PduRDestPdu):
              PduRDestPduHandleId = 9
              PduRDestPduDirection = TRANSMIT
              PduRDestPduRoutingType = GATEWAY_ROUTING
              PduRDestPduDataProcessing = IMMEDIATE
              PduRPduLengthHandlingStrategy = IGNORE
              PduRDestPduCrossPartitionDestination = false
              PduRDestPduDataProvision = PDUR_DIRECT
              PduRTransmissionConfirmation = false
              PduRDestPduRef = GW_OEL_Tx_oPCAN_RADAR_96436c6f_Tx
              PduRDestPduPduRBswModulesRef = CanIf
          CLS_Tx_4_oVCAN_RADAR_e4fced07_Rx: PduRRoutingPathCommunicationType=COMMUNICATION_INTERFACE, PduRLockRef=PduRLock_PduRExclusiveArea
            CLS_Tx_4_oVCAN_RADAR_e4fced07_Rx_d09977e2_Rx (PduRDestPdu):
              PduRDestPduHandleId = 2
              PduRDestPduDirection = RECEIVE
              PduRDestPduRoutingType = API_FORWARDING
              PduRDestPduDataProcessing = IMMEDIATE
              PduRPduLengthHandlingStrategy = IGNORE
              PduRDestPduCrossPartitionDestination = false
              PduRTransmissionConfirmation = false
              PduRDestPduRef = CLS_Tx_4_oVCAN_RADAR_1adbb350_Rx
              PduRDestPduPduRBswModulesRef = Com
            PduRSrcPdu_d09977e2 (PduRSrcPdu): PduRSourcePduHandleId=2, PduRSrcPduDirection=RECEIVE, PduRSrcPduRef=CLS_Tx_4_oVCAN_RADAR_e4fced07_Rx, PduRSrcPduPduRBswModulesRef=CanIf
            GW_CLS_Tx_4_Tx_oPCAN_RADAR_ecf0186d_Tx (PduRDestPdu):
              PduRDestPduHandleId = 5
              PduRDestPduDirection = TRANSMIT
              PduRDestPduRoutingType = GATEWAY_ROUTING
              PduRDestPduDataProcessing = IMMEDIATE
              PduRPduLengthHandlingStrategy = IGNORE
              PduRDestPduCrossPartitionDestination = false
              PduRDestPduDataProvision = PDUR_DIRECT
              PduRTransmissionConfirmation = false
              PduRDestPduRef = GW_CLS_Tx_4_Tx_oPCAN_RADAR_ecf0186d_Tx
              PduRDestPduPduRBswModulesRef = CanIf
          SAS_oVCAN_RADAR_efd6af4d_Rx: PduRRoutingPathCommunicationType=COMMUNICATION_INTERFACE, PduRLockRef=PduRLock_PduRExclusiveArea
            SAS_oVCAN_RADAR_efd6af4d_Rx_673bb0aa_Rx (PduRDestPdu):
              PduRDestPduHandleId = 57
              PduRDestPduDirection = RECEIVE
              PduRDestPduRoutingType = API_FORWARDING
              PduRDestPduDataProcessing = IMMEDIATE
              PduRPduLengthHandlingStrategy = IGNORE
              PduRDestPduCrossPartitionDestination = false
              PduRTransmissionConfirmation = false
              PduRDestPduRef = SAS_oVCAN_RADAR_fe45d49a_Rx
              PduRDestPduPduRBswModulesRef = Com
            PduRSrcPdu_673bb0aa (PduRSrcPdu): PduRSourcePduHandleId=64, PduRSrcPduDirection=RECEIVE, PduRSrcPduRef=SAS_oVCAN_RADAR_efd6af4d_Rx, PduRSrcPduPduRBswModulesRef=CanIf
            GW_SAS_Tx_oPCAN_RADAR_6c223e7b_Tx (PduRDestPdu):
              PduRDestPduHandleId = 10
              PduRDestPduDirection = TRANSMIT
              PduRDestPduRoutingType = GATEWAY_ROUTING
              PduRDestPduDataProcessing = IMMEDIATE
              PduRPduLengthHandlingStrategy = IGNORE
              PduRDestPduCrossPartitionDestination = false
              PduRTransmissionConfirmation = false
              PduRDestPduDataProvision = PDUR_DIRECT
              PduRDestPduRef = GW_SAS_Tx_oPCAN_RADAR_6c223e7b_Tx
              PduRDestPduPduRBswModulesRef = CanIf
          DM1_D0_oVCAN_RADAR_94793fbe_Tx: PduRRoutingPathCommunicationType=TRANSPORT_PROTOCOL, PduRLockRef=PduRLock_PduRExclusiveArea
            DM1_D0_oVCAN_RADAR_ce78d82a_Tx (PduRDestPdu):
              PduRDestPduHandleId = 0
              PduRDestPduDirection = TRANSMIT
              PduRDestPduRoutingType = API_FORWARDING
              PduRDestPduDataProcessing = IMMEDIATE
              PduRPduLengthHandlingStrategy = UNUSED
              PduRDestPduCrossPartitionDestination = false
              PduRDestPduRef = DM1_D0_oVCAN_RADAR_ce78d82a_Tx
              PduRDestPduPduRBswModulesRef = J1939Tp
            PduRSrcPdu_beb9bba4 (PduRSrcPdu): PduRSourcePduHandleId=0, PduRSrcPduDirection=TRANSMIT, PduRSrcPduRef=DM1_D0_oVCAN_RADAR_94793fbe_Tx, PduRSrcPduPduRBswModulesRef=J1939Dcm
          CCVS1_oVCAN_RADAR_e4df8c5f_Rx: PduRRoutingPathCommunicationType=COMMUNICATION_INTERFACE, PduRLockRef=PduRLock_PduRExclusiveArea
            PduRSrcPdu_1d08c8b3 (PduRSrcPdu): PduRSourcePduHandleId=1, PduRSrcPduDirection=RECEIVE, PduRSrcPduRef=CCVS1_oVCAN_RADAR_e4df8c5f_Rx, PduRSrcPduPduRBswModulesRef=CanIf
            CCVS1_oVCAN_RADAR_e4df8c5f_Rx_1d08c8b3_Rx (PduRDestPdu):
              PduRDestPduHandleId = 1
              PduRDestPduDirection = RECEIVE
              PduRDestPduRoutingType = API_FORWARDING
              PduRDestPduDataProcessing = IMMEDIATE
              PduRPduLengthHandlingStrategy = IGNORE
              PduRDestPduCrossPartitionDestination = false
              PduRTransmissionConfirmation = false
              PduRDestPduRef = CCVS1_oVCAN_RADAR_7fab2fed_Rx
              PduRDestPduPduRBswModulesRef = Com
            GW_CCVS1_Tx_oPCAN_RADAR_7eaa671a_Tx (PduRDestPdu):
              PduRDestPduHandleId = 4
              PduRDestPduDirection = TRANSMIT
              PduRDestPduRoutingType = GATEWAY_ROUTING
              PduRDestPduDataProcessing = IMMEDIATE
              PduRPduLengthHandlingStrategy = IGNORE
              PduRDestPduCrossPartitionDestination = false
              PduRTransmissionConfirmation = false
              PduRDestPduDataProvision = PDUR_DIRECT
              PduRDestPduRef = GW_CCVS1_Tx_oPCAN_RADAR_7eaa671a_Tx
              PduRDestPduPduRBswModulesRef = CanIf
          VI_oVCAN_RADAR_b73d6113_Rx: PduRRoutingPathCommunicationType=COMMUNICATION_INTERFACE, PduRLockRef=PduRLock_PduRExclusiveArea
            VI_oVCAN_RADAR_b73d6113_Rx_77666074_Rx (PduRDestPdu):
              PduRDestPduHandleId = 62
              PduRDestPduDirection = RECEIVE
              PduRDestPduRoutingType = API_FORWARDING
              PduRDestPduDataProcessing = IMMEDIATE
              PduRPduLengthHandlingStrategy = IGNORE
              PduRDestPduCrossPartitionDestination = false
              PduRTransmissionConfirmation = false
              PduRDestPduRef = VI_oVCAN_RADAR_260d64a7_Rx
              PduRDestPduPduRBswModulesRef = Com
            PduRSrcPdu_77666074 (PduRSrcPdu): PduRSourcePduHandleId=85, PduRSrcPduDirection=RECEIVE, PduRSrcPduRef=VI_oVCAN_RADAR_b73d6113_Rx, PduRSrcPduPduRBswModulesRef=CanIf
            GW_VI_Tx_oPCAN_RADAR_ad28cbdc_Tx (PduRDestPdu):
              PduRDestPduHandleId = 14
              PduRDestPduDirection = TRANSMIT
              PduRDestPduRoutingType = GATEWAY_ROUTING
              PduRDestPduDataProcessing = IMMEDIATE
              PduRPduLengthHandlingStrategy = IGNORE
              PduRDestPduCrossPartitionDestination = false
              PduRDestPduDataProvision = PDUR_DIRECT
              PduRTransmissionConfirmation = false
              PduRDestPduRef = GW_VI_Tx_oPCAN_RADAR_ad28cbdc_Tx
              PduRDestPduPduRBswModulesRef = CanIf
          MOIS_oVCAN_RADAR_39784631_Tx: PduRRoutingPathCommunicationType=COMMUNICATION_INTERFACE, PduRLockRef=PduRLock_PduRExclusiveArea
            PduRSrcPdu_91229167 (PduRSrcPdu): PduRSourcePduHandleId=6, PduRSrcPduDirection=TRANSMIT, PduRSrcPduRef=MOIS_oVCAN_RADAR_39784631_Tx, PduRSrcPduPduRBswModulesRef=Com
            MOIS_oVCAN_RADAR_1658382d_Tx (PduRDestPdu):
              PduRDestPduHandleId = 16
              PduRDestPduDirection = TRANSMIT
              PduRDestPduRoutingType = API_FORWARDING
              PduRDestPduDataProcessing = IMMEDIATE
              PduRPduLengthHandlingStrategy = IGNORE
              PduRDestPduCrossPartitionDestination = false
              PduRTransmissionConfirmation = false
              PduRDestPduDataProvision = PDUR_DIRECT
              PduRDestPduRef = MOIS_oVCAN_RADAR_1658382d_Tx
              PduRDestPduPduRBswModulesRef = CanIf
          GW_CCVS1_oPCAN_RADAR_d10adaab_Rx: PduRRoutingPathCommunicationType=COMMUNICATION_INTERFACE, PduRLockRef=PduRLock_PduRExclusiveArea
            PduRSrcPdu_783b4bee (PduRSrcPdu): PduRSourcePduHandleId=9, PduRSrcPduDirection=RECEIVE, PduRSrcPduRef=GW_CCVS1_oPCAN_RADAR_d10adaab_Rx, PduRSrcPduPduRBswModulesRef=CanIf
            GW_CCVS1_oPCAN_RADAR_d10adaab_Rx_783b4bee_Rx (PduRDestPdu):
              PduRDestPduHandleId = 7
              PduRDestPduDirection = RECEIVE
              PduRDestPduRoutingType = API_FORWARDING
              PduRDestPduDataProcessing = IMMEDIATE
              PduRPduLengthHandlingStrategy = IGNORE
              PduRDestPduCrossPartitionDestination = false
              PduRTransmissionConfirmation = false
              PduRDestPduRef = GW_CCVS1_oPCAN_RADAR_379fc270_Rx
              PduRDestPduPduRBswModulesRef = Com
          GW_OEL_oPCAN_RADAR_4c06edea_Rx: PduRRoutingPathCommunicationType=COMMUNICATION_INTERFACE, PduRLockRef=PduRLock_PduRExclusiveArea
            PduRSrcPdu_43222444 (PduRSrcPdu): PduRSourcePduHandleId=14, PduRSrcPduDirection=RECEIVE, PduRSrcPduRef=GW_OEL_oPCAN_RADAR_4c06edea_Rx, PduRSrcPduPduRBswModulesRef=CanIf
            GW_OEL_oPCAN_RADAR_4c06edea_Rx_43222444_Rx (PduRDestPdu):
              PduRDestPduHandleId = 12
              PduRDestPduDirection = RECEIVE
              PduRDestPduRoutingType = API_FORWARDING
              PduRDestPduDataProcessing = IMMEDIATE
              PduRPduLengthHandlingStrategy = IGNORE
              PduRDestPduCrossPartitionDestination = false
              PduRTransmissionConfirmation = false
              PduRDestPduRef = GW_OEL_oPCAN_RADAR_b67c14d5_Rx
              PduRDestPduPduRBswModulesRef = Com
          GW_CLS_Tx_4_oPCAN_RADAR_deff6d37_Rx: PduRRoutingPathCommunicationType=COMMUNICATION_INTERFACE, PduRLockRef=PduRLock_PduRExclusiveArea
            PduRSrcPdu_b617520e (PduRSrcPdu): PduRSourcePduHandleId=10, PduRSrcPduDirection=RECEIVE, PduRSrcPduRef=GW_CLS_Tx_4_oPCAN_RADAR_deff6d37_Rx, PduRSrcPduPduRBswModulesRef=CanIf
            GW_CLS_Tx_4_oPCAN_RADAR_deff6d37_Rx_b617520e_Rx (PduRDestPdu):
              PduRDestPduHandleId = 8
              PduRDestPduDirection = RECEIVE
              PduRDestPduRoutingType = API_FORWARDING
              PduRDestPduDataProcessing = IMMEDIATE
              PduRPduLengthHandlingStrategy = IGNORE
              PduRDestPduCrossPartitionDestination = false
              PduRTransmissionConfirmation = false
              PduRDestPduRef = GW_CLS_Tx_4_oPCAN_RADAR_888f4e35_Rx
              PduRDestPduPduRBswModulesRef = Com
          GW_ADAS_FN_Enable_disable_sts_oPCAN_RADAR_781ac753_Rx: PduRRoutingPathCommunicationType=COMMUNICATION_INTERFACE, PduRLockRef=PduRLock_PduRExclusiveArea
            GW_ADAS_FN_Enable_disable_sts_oPCAN_RADAR_781ac753_Rx_b0c6f800_Rx (PduRDestPdu):
              PduRDestPduHandleId = 6
              PduRDestPduDirection = RECEIVE
              PduRDestPduRoutingType = API_FORWARDING
              PduRDestPduDataProcessing = IMMEDIATE
              PduRPduLengthHandlingStrategy = IGNORE
              PduRDestPduCrossPartitionDestination = false
              PduRTransmissionConfirmation = false
              PduRDestPduRef = GW_ADAS_FN_Enable_disable_sts_oPCAN_RADAR_a2ffe33c_Rx
              PduRDestPduPduRBswModulesRef = Com
            PduRSrcPdu_b0c6f800 (PduRSrcPdu):
              PduRSourcePduHandleId = 8
              PduRSrcPduDirection = RECEIVE
              PduRSrcPduRef = GW_ADAS_FN_Enable_disable_sts_oPCAN_RADAR_781ac753_Rx
              PduRSrcPduPduRBswModulesRef = CanIf
          RDR_BSD1_oPCAN_RADAR_03d8d8bd_Rx: PduRRoutingPathCommunicationType=COMMUNICATION_INTERFACE, PduRLockRef=PduRLock_PduRExclusiveArea
            PduRSrcPdu_0e6d82c3 (PduRSrcPdu): PduRSourcePduHandleId=21, PduRSrcPduDirection=RECEIVE, PduRSrcPduRef=RDR_BSD1_oPCAN_RADAR_03d8d8bd_Rx, PduRSrcPduPduRBswModulesRef=CanIf
            BSD1_oVCAN_RADAR_aa49a410_Tx (PduRDestPdu):
              PduRDestPduHandleId = 0
              PduRDestPduDirection = TRANSMIT
              PduRDestPduRoutingType = GATEWAY_ROUTING
              PduRDestPduDataProcessing = IMMEDIATE
              PduRPduLengthHandlingStrategy = IGNORE
              PduRDestPduCrossPartitionDestination = false
              PduRTransmissionConfirmation = false
              PduRDestPduDataProvision = PDUR_DIRECT
              PduRDestPduRef = BSD1_oVCAN_RADAR_aa49a410_Tx
              PduRDestPduPduRBswModulesRef = CanIf
          GW_VDC2_oPCAN_RADAR_9daa2cf0_Rx: PduRRoutingPathCommunicationType=COMMUNICATION_INTERFACE, PduRLockRef=PduRLock_PduRExclusiveArea
            PduRSrcPdu_2af15c9a (PduRSrcPdu): PduRSourcePduHandleId=17, PduRSrcPduDirection=RECEIVE, PduRSrcPduRef=GW_VDC2_oPCAN_RADAR_9daa2cf0_Rx, PduRSrcPduPduRBswModulesRef=CanIf
            GW_VDC2_oPCAN_RADAR_9daa2cf0_Rx_2af15c9a_Rx (PduRDestPdu):
              PduRDestPduHandleId = 15
              PduRDestPduDirection = RECEIVE
              PduRDestPduRoutingType = API_FORWARDING
              PduRDestPduDataProcessing = IMMEDIATE
              PduRPduLengthHandlingStrategy = IGNORE
              PduRDestPduCrossPartitionDestination = false
              PduRTransmissionConfirmation = false
              PduRDestPduRef = GW_VDC2_oPCAN_RADAR_a2fdf3c6_Rx
              PduRDestPduPduRBswModulesRef = Com
          RDR_BSD1_Tx_oPCAN_RADAR_170995fb_Tx: PduRRoutingPathCommunicationType=COMMUNICATION_INTERFACE, PduRLockRef=PduRLock_PduRExclusiveArea
            RDR_BSD1_Tx_oPCAN_RADAR_3cea6970_Tx (PduRDestPdu):
              PduRDestPduHandleId = 19
              PduRDestPduDirection = TRANSMIT
              PduRDestPduRoutingType = API_FORWARDING
              PduRDestPduDataProcessing = IMMEDIATE
              PduRPduLengthHandlingStrategy = IGNORE
              PduRDestPduCrossPartitionDestination = false
              PduRTransmissionConfirmation = false
              PduRDestPduDataProvision = PDUR_DIRECT
              PduRDestPduRef = RDR_BSD1_Tx_oPCAN_RADAR_3cea6970_Tx
              PduRDestPduPduRBswModulesRef = CanIf
            PduRSrcPdu_8f6d8fc5 (PduRSrcPdu): PduRSourcePduHandleId=17, PduRSrcPduDirection=TRANSMIT, PduRSrcPduRef=RDR_BSD1_Tx_oPCAN_RADAR_170995fb_Tx, PduRSrcPduPduRBswModulesRef=Com
          GW_CLS_Tx_16_oPCAN_RADAR_c3f80567_Rx: PduRRoutingPathCommunicationType=COMMUNICATION_INTERFACE, PduRLockRef=PduRLock_PduRExclusiveArea
            GW_CLS_Tx_16_oPCAN_RADAR_c3f80567_Rx_ddfca0b8_Rx (PduRDestPdu):
              PduRDestPduHandleId = 9
              PduRDestPduDirection = RECEIVE
              PduRDestPduRoutingType = API_FORWARDING
              PduRDestPduDataProcessing = IMMEDIATE
              PduRPduLengthHandlingStrategy = IGNORE
              PduRDestPduCrossPartitionDestination = false
              PduRTransmissionConfirmation = false
              PduRDestPduRef = GW_CLS_Tx_16_oPCAN_RADAR_92e0b941_Rx
              PduRDestPduPduRBswModulesRef = Com
            PduRSrcPdu_ddfca0b8 (PduRSrcPdu): PduRSourcePduHandleId=11, PduRSrcPduDirection=RECEIVE, PduRSrcPduRef=GW_CLS_Tx_16_oPCAN_RADAR_c3f80567_Rx, PduRSrcPduPduRBswModulesRef=CanIf
          GW_VI_oPCAN_RADAR_6896f87b_Rx: PduRRoutingPathCommunicationType=COMMUNICATION_INTERFACE, PduRLockRef=PduRLock_PduRExclusiveArea
            GW_VI_oPCAN_RADAR_6896f87b_Rx_f6dde99d_Rx (PduRDestPdu):
              PduRDestPduHandleId = 17
              PduRDestPduDirection = RECEIVE
              PduRDestPduRoutingType = API_FORWARDING
              PduRDestPduDataProcessing = IMMEDIATE
              PduRPduLengthHandlingStrategy = IGNORE
              PduRDestPduCrossPartitionDestination = false
              PduRTransmissionConfirmation = false
              PduRDestPduRef = GW_VI_oPCAN_RADAR_218ddc97_Rx
              PduRDestPduPduRBswModulesRef = Com
            PduRSrcPdu_f6dde99d (PduRSrcPdu): PduRSourcePduHandleId=19, PduRSrcPduDirection=RECEIVE, PduRSrcPduRef=GW_VI_oPCAN_RADAR_6896f87b_Rx, PduRSrcPduPduRBswModulesRef=CanIf
          GW_TD_oPCAN_RADAR_a04f08f1_Rx: PduRRoutingPathCommunicationType=COMMUNICATION_INTERFACE, PduRLockRef=PduRLock_PduRExclusiveArea
            PduRSrcPdu_eb5fedc8 (PduRSrcPdu): PduRSourcePduHandleId=16, PduRSrcPduDirection=RECEIVE, PduRSrcPduRef=GW_TD_oPCAN_RADAR_a04f08f1_Rx, PduRSrcPduPduRBswModulesRef=CanIf
            GW_TD_oPCAN_RADAR_a04f08f1_Rx_eb5fedc8_Rx (PduRDestPdu):
              PduRDestPduHandleId = 14
              PduRDestPduDirection = RECEIVE
              PduRDestPduRoutingType = API_FORWARDING
              PduRDestPduDataProcessing = IMMEDIATE
              PduRPduLengthHandlingStrategy = IGNORE
              PduRDestPduCrossPartitionDestination = false
              PduRTransmissionConfirmation = false
              PduRDestPduRef = GW_TD_oPCAN_RADAR_87cf7844_Rx
              PduRDestPduPduRBswModulesRef = Com
          GW_VD_oPCAN_RADAR_e94baa9d_Rx: PduRRoutingPathCommunicationType=COMMUNICATION_INTERFACE, PduRLockRef=PduRLock_PduRExclusiveArea
            GW_VD_oPCAN_RADAR_e94baa9d_Rx_de20eca3_Rx (PduRDestPdu):
              PduRDestPduHandleId = 16
              PduRDestPduDirection = RECEIVE
              PduRDestPduRoutingType = API_FORWARDING
              PduRDestPduDataProcessing = IMMEDIATE
              PduRPduLengthHandlingStrategy = IGNORE
              PduRDestPduCrossPartitionDestination = false
              PduRTransmissionConfirmation = false
              PduRDestPduRef = GW_VD_oPCAN_RADAR_66a1bce9_Rx
              PduRDestPduPduRBswModulesRef = Com
            PduRSrcPdu_de20eca3 (PduRSrcPdu): PduRSourcePduHandleId=18, PduRSrcPduDirection=RECEIVE, PduRSrcPduRef=GW_VD_oPCAN_RADAR_e94baa9d_Rx, PduRSrcPduPduRBswModulesRef=CanIf
          GW_ETC2_oPCAN_RADAR_57f17119_Rx: PduRRoutingPathCommunicationType=COMMUNICATION_INTERFACE, PduRLockRef=PduRLock_PduRExclusiveArea
            PduRSrcPdu_e03fcab1 (PduRSrcPdu): PduRSourcePduHandleId=13, PduRSrcPduDirection=RECEIVE, PduRSrcPduRef=GW_ETC2_oPCAN_RADAR_57f17119_Rx, PduRSrcPduPduRBswModulesRef=CanIf
            GW_ETC2_oPCAN_RADAR_57f17119_Rx_e03fcab1_Rx (PduRDestPdu):
              PduRDestPduHandleId = 11
              PduRDestPduDirection = RECEIVE
              PduRDestPduRoutingType = API_FORWARDING
              PduRDestPduDataProcessing = IMMEDIATE
              PduRPduLengthHandlingStrategy = IGNORE
              PduRDestPduCrossPartitionDestination = false
              PduRTransmissionConfirmation = false
              PduRDestPduRef = GW_ETC2_oPCAN_RADAR_2970e6e5_Rx
              PduRDestPduPduRBswModulesRef = Com
          GW_SAS_oPCAN_RADAR_e6d96f6c_Rx: PduRRoutingPathCommunicationType=COMMUNICATION_INTERFACE, PduRLockRef=PduRLock_PduRExclusiveArea
            PduRSrcPdu_b4918efe (PduRSrcPdu): PduRSourcePduHandleId=15, PduRSrcPduDirection=RECEIVE, PduRSrcPduRef=GW_SAS_oPCAN_RADAR_e6d96f6c_Rx, PduRSrcPduPduRBswModulesRef=CanIf
            GW_SAS_oPCAN_RADAR_e6d96f6c_Rx_b4918efe_Rx (PduRDestPdu):
              PduRDestPduHandleId = 13
              PduRDestPduDirection = RECEIVE
              PduRDestPduRoutingType = API_FORWARDING
              PduRDestPduDataProcessing = IMMEDIATE
              PduRPduLengthHandlingStrategy = IGNORE
              PduRDestPduCrossPartitionDestination = false
              PduRTransmissionConfirmation = false
              PduRDestPduRef = GW_SAS_oPCAN_RADAR_3d30de8a_Rx
              PduRDestPduPduRBswModulesRef = Com
          RDR_DT_B1_Rx_oPCAN_RADAR_3eed4299_Rx: PduRRoutingPathCommunicationType=COMMUNICATION_INTERFACE if post-build-variant-condition{matching-criterion=RDR_POS, value=6}, PduRRoutingPathCommunicationType=COMMUNICATION_INTERFACE if post-build-variant-condition{matching-criterion=RDR_POS, value=1}, PduRRoutingPathCommunicationType=COMMUNICATION_INTERFACE if post-build-variant-condition{matching-criterion=RDR_POS, value=3}, PduRRoutingPathCommunicationType=COMMUNICATION_INTERFACE if post-build-variant-condition{matching-criterion=RDR_POS, value=0}, PduRRoutingPathCommunicationType=COMMUNICATION_INTERFACE if post-build-variant-condition{matching-criterion=RDR_POS, value=7}, PduRRoutingPathCommunicationType=COMMUNICATION_INTERFACE if post-build-variant-condition{matching-criterion=RDR_POS, value=5}, PduRRoutingPathCommunicationType=COMMUNICATION_INTERFACE if post-build-variant-condition{matching-criterion=RDR_POS, value=2}, PduRRoutingPathCommunicationType=COMMUNICATION_INTERFACE if post-build-variant-condition{matching-criterion=RDR_POS, value=4}, PduRLockRef=PduRLock_PduRExclusiveArea if post-build-variant-condition{matching-criterion=RDR_POS, value=0}, PduRLockRef=PduRLock_PduRExclusiveArea if post-build-variant-condition{matching-criterion=RDR_POS, value=7}, PduRLockRef=PduRLock_PduRExclusiveArea if post-build-variant-condition{matching-criterion=RDR_POS, value=6}, PduRLockRef=PduRLock_PduRExclusiveArea if post-build-variant-condition{matching-criterion=RDR_POS, value=4}, PduRLockRef=PduRLock_PduRExclusiveArea if post-build-variant-condition{matching-criterion=RDR_POS, value=1}, PduRLockRef=PduRLock_PduRExclusiveArea if post-build-variant-condition{matching-criterion=RDR_POS, value=3}, PduRLockRef=PduRLock_PduRExclusiveArea if post-build-variant-condition{matching-criterion=RDR_POS, value=2}, PduRLockRef=PduRLock_PduRExclusiveArea if post-build-variant-condition{matching-criterion=RDR_POS, value=5}
            PduRSrcPdu_f60795ea (PduRSrcPdu):
              PduRSourcePduHandleId = 25
              PduRSrcPduDirection = RECEIVE if post-build-variant-condition{matching-criterion=RDR_POS, value=3}
              PduRSrcPduDirection = RECEIVE if post-build-variant-condition{matching-criterion=RDR_POS, value=1}
              PduRSrcPduDirection = RECEIVE if post-build-variant-condition{matching-criterion=RDR_POS, value=0}
              PduRSrcPduDirection = RECEIVE if post-build-variant-condition{matching-criterion=RDR_POS, value=7}
              PduRSrcPduDirection = RECEIVE if post-build-variant-condition{matching-criterion=RDR_POS, value=5}
              PduRSrcPduDirection = RECEIVE if post-build-variant-condition{matching-criterion=RDR_POS, value=2}
              PduRSrcPduDirection = RECEIVE if post-build-variant-condition{matching-criterion=RDR_POS, value=4}
              PduRSrcPduDirection = RECEIVE if post-build-variant-condition{matching-criterion=RDR_POS, value=6}
              PduRSrcPduRef = RDR_DT_B1_Rx_oPCAN_RADAR_3eed4299_Rx
              PduRSrcPduPduRBswModulesRef = CanIf if post-build-variant-condition{matching-criterion=RDR_POS, value=3}
              PduRSrcPduPduRBswModulesRef = CanIf if post-build-variant-condition{matching-criterion=RDR_POS, value=2}
              PduRSrcPduPduRBswModulesRef = CanIf if post-build-variant-condition{matching-criterion=RDR_POS, value=7}
              PduRSrcPduPduRBswModulesRef = CanIf if post-build-variant-condition{matching-criterion=RDR_POS, value=4}
              PduRSrcPduPduRBswModulesRef = CanIf if post-build-variant-condition{matching-criterion=RDR_POS, value=0}
              PduRSrcPduPduRBswModulesRef = CanIf if post-build-variant-condition{matching-criterion=RDR_POS, value=5}
              PduRSrcPduPduRBswModulesRef = CanIf if post-build-variant-condition{matching-criterion=RDR_POS, value=6}
              PduRSrcPduPduRBswModulesRef = CanIf if post-build-variant-condition{matching-criterion=RDR_POS, value=1}
            TPDT_B1_oVCAN_RADAR_8b1102fa_Tx (PduRDestPdu):
              PduRDestPduHandleId = 209
              PduRDestPduDirection = TRANSMIT if post-build-variant-condition{matching-criterion=RDR_POS, value=3}
              PduRDestPduDirection = TRANSMIT if post-build-variant-condition{matching-criterion=RDR_POS, value=0}
              PduRDestPduDirection = TRANSMIT if post-build-variant-condition{matching-criterion=RDR_POS, value=7}
              PduRDestPduDirection = TRANSMIT if post-build-variant-condition{matching-criterion=RDR_POS, value=6}
              PduRDestPduDirection = TRANSMIT if post-build-variant-condition{matching-criterion=RDR_POS, value=4}
              PduRDestPduDirection = TRANSMIT if post-build-variant-condition{matching-criterion=RDR_POS, value=1}
              PduRDestPduDirection = TRANSMIT if post-build-variant-condition{matching-criterion=RDR_POS, value=2}
              PduRDestPduDirection = TRANSMIT if post-build-variant-condition{matching-criterion=RDR_POS, value=5}
              PduRDestPduRoutingType = GATEWAY_ROUTING if post-build-variant-condition{matching-criterion=RDR_POS, value=3}
              PduRDestPduRoutingType = GATEWAY_ROUTING if post-build-variant-condition{matching-criterion=RDR_POS, value=0}
              PduRDestPduRoutingType = GATEWAY_ROUTING if post-build-variant-condition{matching-criterion=RDR_POS, value=7}
              PduRDestPduRoutingType = GATEWAY_ROUTING if post-build-variant-condition{matching-criterion=RDR_POS, value=6}
              PduRDestPduRoutingType = GATEWAY_ROUTING if post-build-variant-condition{matching-criterion=RDR_POS, value=4}
              PduRDestPduRoutingType = GATEWAY_ROUTING if post-build-variant-condition{matching-criterion=RDR_POS, value=1}
              PduRDestPduRoutingType = GATEWAY_ROUTING if post-build-variant-condition{matching-criterion=RDR_POS, value=2}
              PduRDestPduRoutingType = GATEWAY_ROUTING if post-build-variant-condition{matching-criterion=RDR_POS, value=5}
              PduRDestPduDataProcessing = IMMEDIATE
              PduRPduLengthHandlingStrategy = IGNORE
              PduRDestPduCrossPartitionDestination = false
              PduRDestPduDataProvision = PDUR_DIRECT
              PduRTransmissionConfirmation = false
              PduRDestPduRef = TPDT_B1_oVCAN_RADAR_8b1102fa_Tx
              PduRDestPduPduRBswModulesRef = CanIf if post-build-variant-condition{matching-criterion=RDR_POS, value=5}
              PduRDestPduPduRBswModulesRef = CanIf if post-build-variant-condition{matching-criterion=RDR_POS, value=7}
              PduRDestPduPduRBswModulesRef = CanIf if post-build-variant-condition{matching-criterion=RDR_POS, value=1}
              PduRDestPduPduRBswModulesRef = CanIf if post-build-variant-condition{matching-criterion=RDR_POS, value=3}
              PduRDestPduPduRBswModulesRef = CanIf if post-build-variant-condition{matching-criterion=RDR_POS, value=0}
              PduRDestPduPduRBswModulesRef = CanIf if post-build-variant-condition{matching-criterion=RDR_POS, value=2}
              PduRDestPduPduRBswModulesRef = CanIf if post-build-variant-condition{matching-criterion=RDR_POS, value=6}
              PduRDestPduPduRBswModulesRef = CanIf if post-build-variant-condition{matching-criterion=RDR_POS, value=4}
          RDR_DT_B0_Rx_oPCAN_RADAR_ab9d960c_Rx: PduRRoutingPathCommunicationType=COMMUNICATION_INTERFACE if post-build-variant-condition{matching-criterion=RDR_POS, value=6}, PduRRoutingPathCommunicationType=COMMUNICATION_INTERFACE if post-build-variant-condition{matching-criterion=RDR_POS, value=1}, PduRRoutingPathCommunicationType=COMMUNICATION_INTERFACE if post-build-variant-condition{matching-criterion=RDR_POS, value=3}, PduRRoutingPathCommunicationType=COMMUNICATION_INTERFACE if post-build-variant-condition{matching-criterion=RDR_POS, value=0}, PduRRoutingPathCommunicationType=COMMUNICATION_INTERFACE if post-build-variant-condition{matching-criterion=RDR_POS, value=7}, PduRRoutingPathCommunicationType=COMMUNICATION_INTERFACE if post-build-variant-condition{matching-criterion=RDR_POS, value=5}, PduRRoutingPathCommunicationType=COMMUNICATION_INTERFACE if post-build-variant-condition{matching-criterion=RDR_POS, value=2}, PduRRoutingPathCommunicationType=COMMUNICATION_INTERFACE if post-build-variant-condition{matching-criterion=RDR_POS, value=4}, PduRLockRef=PduRLock_PduRExclusiveArea if post-build-variant-condition{matching-criterion=RDR_POS, value=2}, PduRLockRef=PduRLock_PduRExclusiveArea if post-build-variant-condition{matching-criterion=RDR_POS, value=0}, PduRLockRef=PduRLock_PduRExclusiveArea if post-build-variant-condition{matching-criterion=RDR_POS, value=7}, PduRLockRef=PduRLock_PduRExclusiveArea if post-build-variant-condition{matching-criterion=RDR_POS, value=6}, PduRLockRef=PduRLock_PduRExclusiveArea if post-build-variant-condition{matching-criterion=RDR_POS, value=4}, PduRLockRef=PduRLock_PduRExclusiveArea if post-build-variant-condition{matching-criterion=RDR_POS, value=1}, PduRLockRef=PduRLock_PduRExclusiveArea if post-build-variant-condition{matching-criterion=RDR_POS, value=3}, PduRLockRef=PduRLock_PduRExclusiveArea if post-build-variant-condition{matching-criterion=RDR_POS, value=5}
            PduRSrcPdu_f23c0b68 (PduRSrcPdu):
              PduRSourcePduHandleId = 24
              PduRSrcPduDirection = RECEIVE if post-build-variant-condition{matching-criterion=RDR_POS, value=7}
              PduRSrcPduDirection = RECEIVE if post-build-variant-condition{matching-criterion=RDR_POS, value=1}
              PduRSrcPduDirection = RECEIVE if post-build-variant-condition{matching-criterion=RDR_POS, value=3}
              PduRSrcPduDirection = RECEIVE if post-build-variant-condition{matching-criterion=RDR_POS, value=0}
              PduRSrcPduDirection = RECEIVE if post-build-variant-condition{matching-criterion=RDR_POS, value=5}
              PduRSrcPduDirection = RECEIVE if post-build-variant-condition{matching-criterion=RDR_POS, value=2}
              PduRSrcPduDirection = RECEIVE if post-build-variant-condition{matching-criterion=RDR_POS, value=4}
              PduRSrcPduDirection = RECEIVE if post-build-variant-condition{matching-criterion=RDR_POS, value=6}
              PduRSrcPduRef = RDR_DT_B0_Rx_oPCAN_RADAR_ab9d960c_Rx
              PduRSrcPduPduRBswModulesRef = CanIf if post-build-variant-condition{matching-criterion=RDR_POS, value=7}
              PduRSrcPduPduRBswModulesRef = CanIf if post-build-variant-condition{matching-criterion=RDR_POS, value=3}
              PduRSrcPduPduRBswModulesRef = CanIf if post-build-variant-condition{matching-criterion=RDR_POS, value=2}
              PduRSrcPduPduRBswModulesRef = CanIf if post-build-variant-condition{matching-criterion=RDR_POS, value=5}
              PduRSrcPduPduRBswModulesRef = CanIf if post-build-variant-condition{matching-criterion=RDR_POS, value=1}
              PduRSrcPduPduRBswModulesRef = CanIf if post-build-variant-condition{matching-criterion=RDR_POS, value=6}
              PduRSrcPduPduRBswModulesRef = CanIf if post-build-variant-condition{matching-criterion=RDR_POS, value=0}
              PduRSrcPduPduRBswModulesRef = CanIf if post-build-variant-condition{matching-criterion=RDR_POS, value=4}
            TPDT_B0_oVCAN_RADAR_bde39209_Tx (PduRDestPdu):
              PduRDestPduHandleId = 208
              PduRDestPduDirection = TRANSMIT if post-build-variant-condition{matching-criterion=RDR_POS, value=4}
              PduRDestPduDirection = TRANSMIT if post-build-variant-condition{matching-criterion=RDR_POS, value=0}
              PduRDestPduDirection = TRANSMIT if post-build-variant-condition{matching-criterion=RDR_POS, value=7}
              PduRDestPduDirection = TRANSMIT if post-build-variant-condition{matching-criterion=RDR_POS, value=6}
              PduRDestPduDirection = TRANSMIT if post-build-variant-condition{matching-criterion=RDR_POS, value=1}
              PduRDestPduDirection = TRANSMIT if post-build-variant-condition{matching-criterion=RDR_POS, value=3}
              PduRDestPduDirection = TRANSMIT if post-build-variant-condition{matching-criterion=RDR_POS, value=2}
              PduRDestPduDirection = TRANSMIT if post-build-variant-condition{matching-criterion=RDR_POS, value=5}
              PduRDestPduRoutingType = GATEWAY_ROUTING if post-build-variant-condition{matching-criterion=RDR_POS, value=4}
              PduRDestPduRoutingType = GATEWAY_ROUTING if post-build-variant-condition{matching-criterion=RDR_POS, value=0}
              PduRDestPduRoutingType = GATEWAY_ROUTING if post-build-variant-condition{matching-criterion=RDR_POS, value=7}
              PduRDestPduRoutingType = GATEWAY_ROUTING if post-build-variant-condition{matching-criterion=RDR_POS, value=6}
              PduRDestPduRoutingType = GATEWAY_ROUTING if post-build-variant-condition{matching-criterion=RDR_POS, value=1}
              PduRDestPduRoutingType = GATEWAY_ROUTING if post-build-variant-condition{matching-criterion=RDR_POS, value=3}
              PduRDestPduRoutingType = GATEWAY_ROUTING if post-build-variant-condition{matching-criterion=RDR_POS, value=2}
              PduRDestPduRoutingType = GATEWAY_ROUTING if post-build-variant-condition{matching-criterion=RDR_POS, value=5}
              PduRDestPduDataProcessing = IMMEDIATE
              PduRPduLengthHandlingStrategy = IGNORE
              PduRDestPduCrossPartitionDestination = false
              PduRTransmissionConfirmation = false
              PduRDestPduDataProvision = PDUR_DIRECT
              PduRDestPduRef = TPDT_B0_oVCAN_RADAR_bde39209_Tx
              PduRDestPduPduRBswModulesRef = CanIf if post-build-variant-condition{matching-criterion=RDR_POS, value=4}
              PduRDestPduPduRBswModulesRef = CanIf if post-build-variant-condition{matching-criterion=RDR_POS, value=0}
              PduRDestPduPduRBswModulesRef = CanIf if post-build-variant-condition{matching-criterion=RDR_POS, value=7}
              PduRDestPduPduRBswModulesRef = CanIf if post-build-variant-condition{matching-criterion=RDR_POS, value=6}
              PduRDestPduPduRBswModulesRef = CanIf if post-build-variant-condition{matching-criterion=RDR_POS, value=3}
              PduRDestPduPduRBswModulesRef = CanIf if post-build-variant-condition{matching-criterion=RDR_POS, value=1}
              PduRDestPduPduRBswModulesRef = CanIf if post-build-variant-condition{matching-criterion=RDR_POS, value=2}
              PduRDestPduPduRBswModulesRef = CanIf if post-build-variant-condition{matching-criterion=RDR_POS, value=5}
          SR2_DIAG_REQ_PHY_OBD1_oVCAN_RADAR_7a08c544_Rx: PduRRoutingPathCommunicationType=COMMUNICATION_INTERFACE if post-build-variant-condition{matching-criterion=RDR_POS, value=5}, PduRRoutingPathCommunicationType=COMMUNICATION_INTERFACE if post-build-variant-condition{matching-criterion=RDR_POS, value=1}, PduRRoutingPathCommunicationType=COMMUNICATION_INTERFACE if post-build-variant-condition{matching-criterion=RDR_POS, value=3}, PduRRoutingPathCommunicationType=COMMUNICATION_INTERFACE if post-build-variant-condition{matching-criterion=RDR_POS, value=0}, PduRRoutingPathCommunicationType=COMMUNICATION_INTERFACE if post-build-variant-condition{matching-criterion=RDR_POS, value=7}, PduRRoutingPathCommunicationType=COMMUNICATION_INTERFACE if post-build-variant-condition{matching-criterion=RDR_POS, value=2}, PduRRoutingPathCommunicationType=COMMUNICATION_INTERFACE if post-build-variant-condition{matching-criterion=RDR_POS, value=4}, PduRRoutingPathCommunicationType=COMMUNICATION_INTERFACE if post-build-variant-condition{matching-criterion=RDR_POS, value=6}, PduRLockRef=PduRLock_PduRExclusiveArea if post-build-variant-condition{matching-criterion=RDR_POS, value=5}, PduRLockRef=PduRLock_PduRExclusiveArea if post-build-variant-condition{matching-criterion=RDR_POS, value=0}, PduRLockRef=PduRLock_PduRExclusiveArea if post-build-variant-condition{matching-criterion=RDR_POS, value=7}, PduRLockRef=PduRLock_PduRExclusiveArea if post-build-variant-condition{matching-criterion=RDR_POS, value=6}, PduRLockRef=PduRLock_PduRExclusiveArea if post-build-variant-condition{matching-criterion=RDR_POS, value=4}, PduRLockRef=PduRLock_PduRExclusiveArea if post-build-variant-condition{matching-criterion=RDR_POS, value=1}, PduRLockRef=PduRLock_PduRExclusiveArea if post-build-variant-condition{matching-criterion=RDR_POS, value=3}, PduRLockRef=PduRLock_PduRExclusiveArea if post-build-variant-condition{matching-criterion=RDR_POS, value=2}
            PduRSrcPdu_4ed399d8 (PduRSrcPdu):
              PduRSourcePduHandleId = 73
              PduRSrcPduDirection = RECEIVE if post-build-variant-condition{matching-criterion=RDR_POS, value=4}
              PduRSrcPduDirection = RECEIVE if post-build-variant-condition{matching-criterion=RDR_POS, value=1}
              PduRSrcPduDirection = RECEIVE if post-build-variant-condition{matching-criterion=RDR_POS, value=3}
              PduRSrcPduDirection = RECEIVE if post-build-variant-condition{matching-criterion=RDR_POS, value=0}
              PduRSrcPduDirection = RECEIVE if post-build-variant-condition{matching-criterion=RDR_POS, value=7}
              PduRSrcPduDirection = RECEIVE if post-build-variant-condition{matching-criterion=RDR_POS, value=5}
              PduRSrcPduDirection = RECEIVE if post-build-variant-condition{matching-criterion=RDR_POS, value=2}
              PduRSrcPduDirection = RECEIVE if post-build-variant-condition{matching-criterion=RDR_POS, value=6}
              PduRSrcPduRef = SR2_DIAG_REQ_PHY_OBD1_oVCAN_RADAR_7a08c544_Rx
              PduRSrcPduPduRBswModulesRef = CanIf if post-build-variant-condition{matching-criterion=RDR_POS, value=4}
              PduRSrcPduPduRBswModulesRef = CanIf if post-build-variant-condition{matching-criterion=RDR_POS, value=3}
              PduRSrcPduPduRBswModulesRef = CanIf if post-build-variant-condition{matching-criterion=RDR_POS, value=5}
              PduRSrcPduPduRBswModulesRef = CanIf if post-build-variant-condition{matching-criterion=RDR_POS, value=1}
              PduRSrcPduPduRBswModulesRef = CanIf if post-build-variant-condition{matching-criterion=RDR_POS, value=2}
              PduRSrcPduPduRBswModulesRef = CanIf if post-build-variant-condition{matching-criterion=RDR_POS, value=0}
              PduRSrcPduPduRBswModulesRef = CanIf if post-build-variant-condition{matching-criterion=RDR_POS, value=7}
              PduRSrcPduPduRBswModulesRef = CanIf if post-build-variant-condition{matching-criterion=RDR_POS, value=6}
            SRR_RL_DIAG_REQ_PHYS_OBD1_Tx_oPCAN_RADAR_697bc1d9_Tx (PduRDestPdu):
              PduRDestPduHandleId = 202
              PduRDestPduDirection = TRANSMIT if post-build-variant-condition{matching-criterion=RDR_POS, value=7}
              PduRDestPduDirection = TRANSMIT if post-build-variant-condition{matching-criterion=RDR_POS, value=0}
              PduRDestPduDirection = TRANSMIT if post-build-variant-condition{matching-criterion=RDR_POS, value=6}
              PduRDestPduDirection = TRANSMIT if post-build-variant-condition{matching-criterion=RDR_POS, value=4}
              PduRDestPduDirection = TRANSMIT if post-build-variant-condition{matching-criterion=RDR_POS, value=1}
              PduRDestPduDirection = TRANSMIT if post-build-variant-condition{matching-criterion=RDR_POS, value=3}
              PduRDestPduDirection = TRANSMIT if post-build-variant-condition{matching-criterion=RDR_POS, value=2}
              PduRDestPduDirection = TRANSMIT if post-build-variant-condition{matching-criterion=RDR_POS, value=5}
              PduRDestPduRoutingType = GATEWAY_ROUTING if post-build-variant-condition{matching-criterion=RDR_POS, value=7}
              PduRDestPduRoutingType = GATEWAY_ROUTING if post-build-variant-condition{matching-criterion=RDR_POS, value=0}
              PduRDestPduRoutingType = GATEWAY_ROUTING if post-build-variant-condition{matching-criterion=RDR_POS, value=6}
              PduRDestPduRoutingType = GATEWAY_ROUTING if post-build-variant-condition{matching-criterion=RDR_POS, value=4}
              PduRDestPduRoutingType = GATEWAY_ROUTING if post-build-variant-condition{matching-criterion=RDR_POS, value=1}
              PduRDestPduRoutingType = GATEWAY_ROUTING if post-build-variant-condition{matching-criterion=RDR_POS, value=3}
              PduRDestPduRoutingType = GATEWAY_ROUTING if post-build-variant-condition{matching-criterion=RDR_POS, value=2}
              PduRDestPduRoutingType = GATEWAY_ROUTING if post-build-variant-condition{matching-criterion=RDR_POS, value=5}
              PduRDestPduDataProcessing = IMMEDIATE
              PduRPduLengthHandlingStrategy = IGNORE
              PduRDestPduCrossPartitionDestination = false
              PduRTransmissionConfirmation = false
              PduRDestPduDataProvision = PDUR_DIRECT
              PduRDestPduRef = SRR_RL_DIAG_REQ_PHYS_OBD1_Tx_oPCAN_RADAR_697bc1d9_Tx
              PduRDestPduPduRBswModulesRef = CanIf if post-build-variant-condition{matching-criterion=RDR_POS, value=5}
              PduRDestPduPduRBswModulesRef = CanIf if post-build-variant-condition{matching-criterion=RDR_POS, value=7}
              PduRDestPduPduRBswModulesRef = CanIf if post-build-variant-condition{matching-criterion=RDR_POS, value=0}
              PduRDestPduPduRBswModulesRef = CanIf if post-build-variant-condition{matching-criterion=RDR_POS, value=2}
              PduRDestPduPduRBswModulesRef = CanIf if post-build-variant-condition{matching-criterion=RDR_POS, value=6}
              PduRDestPduPduRBswModulesRef = CanIf if post-build-variant-condition{matching-criterion=RDR_POS, value=1}
              PduRDestPduPduRBswModulesRef = CanIf if post-build-variant-condition{matching-criterion=RDR_POS, value=4}
              PduRDestPduPduRBswModulesRef = CanIf if post-build-variant-condition{matching-criterion=RDR_POS, value=3}
          SR2_DIAG_RES_PHY_OTA_oVCAN_RADAR_55f88417_Tx: PduRRoutingPathCommunicationType=COMMUNICATION_INTERFACE if post-build-variant-condition{matching-criterion=RDR_POS, value=1}, PduRRoutingPathCommunicationType=COMMUNICATION_INTERFACE if post-build-variant-condition{matching-criterion=RDR_POS, value=3}, PduRRoutingPathCommunicationType=COMMUNICATION_INTERFACE if post-build-variant-condition{matching-criterion=RDR_POS, value=0}, PduRRoutingPathCommunicationType=COMMUNICATION_INTERFACE if post-build-variant-condition{matching-criterion=RDR_POS, value=7}, PduRRoutingPathCommunicationType=COMMUNICATION_INTERFACE if post-build-variant-condition{matching-criterion=RDR_POS, value=5}, PduRRoutingPathCommunicationType=COMMUNICATION_INTERFACE if post-build-variant-condition{matching-criterion=RDR_POS, value=2}, PduRRoutingPathCommunicationType=COMMUNICATION_INTERFACE if post-build-variant-condition{matching-criterion=RDR_POS, value=4}, PduRRoutingPathCommunicationType=COMMUNICATION_INTERFACE if post-build-variant-condition{matching-criterion=RDR_POS, value=6}, PduRLockRef=PduRLock_PduRExclusiveArea if post-build-variant-condition{matching-criterion=RDR_POS, value=6}, PduRLockRef=PduRLock_PduRExclusiveArea if post-build-variant-condition{matching-criterion=RDR_POS, value=0}, PduRLockRef=PduRLock_PduRExclusiveArea if post-build-variant-condition{matching-criterion=RDR_POS, value=7}, PduRLockRef=PduRLock_PduRExclusiveArea if post-build-variant-condition{matching-criterion=RDR_POS, value=4}, PduRLockRef=PduRLock_PduRExclusiveArea if post-build-variant-condition{matching-criterion=RDR_POS, value=1}, PduRLockRef=PduRLock_PduRExclusiveArea if post-build-variant-condition{matching-criterion=RDR_POS, value=3}, PduRLockRef=PduRLock_PduRExclusiveArea if post-build-variant-condition{matching-criterion=RDR_POS, value=2}, PduRLockRef=PduRLock_PduRExclusiveArea if post-build-variant-condition{matching-criterion=RDR_POS, value=5}
            SR2_DIAG_RES_PHY_OTA_oVCAN_RADAR_63bc1ea4_Tx (PduRDestPdu):
              PduRDestPduHandleId = 196
              PduRDestPduDirection = TRANSMIT if post-build-variant-condition{matching-criterion=RDR_POS, value=6}
              PduRDestPduDirection = TRANSMIT if post-build-variant-condition{matching-criterion=RDR_POS, value=1}
              PduRDestPduDirection = TRANSMIT if post-build-variant-condition{matching-criterion=RDR_POS, value=3}
              PduRDestPduDirection = TRANSMIT if post-build-variant-condition{matching-criterion=RDR_POS, value=0}
              PduRDestPduDirection = TRANSMIT if post-build-variant-condition{matching-criterion=RDR_POS, value=7}
              PduRDestPduDirection = TRANSMIT if post-build-variant-condition{matching-criterion=RDR_POS, value=5}
              PduRDestPduDirection = TRANSMIT if post-build-variant-condition{matching-criterion=RDR_POS, value=2}
              PduRDestPduDirection = TRANSMIT if post-build-variant-condition{matching-criterion=RDR_POS, value=4}
              PduRDestPduRoutingType = GATEWAY_ROUTING if post-build-variant-condition{matching-criterion=RDR_POS, value=2}
              PduRDestPduRoutingType = GATEWAY_ROUTING if post-build-variant-condition{matching-criterion=RDR_POS, value=0}
              PduRDestPduRoutingType = GATEWAY_ROUTING if post-build-variant-condition{matching-criterion=RDR_POS, value=7}
              PduRDestPduRoutingType = GATEWAY_ROUTING if post-build-variant-condition{matching-criterion=RDR_POS, value=6}
              PduRDestPduRoutingType = GATEWAY_ROUTING if post-build-variant-condition{matching-criterion=RDR_POS, value=4}
              PduRDestPduRoutingType = GATEWAY_ROUTING if post-build-variant-condition{matching-criterion=RDR_POS, value=1}
              PduRDestPduRoutingType = GATEWAY_ROUTING if post-build-variant-condition{matching-criterion=RDR_POS, value=3}
              PduRDestPduRoutingType = GATEWAY_ROUTING if post-build-variant-condition{matching-criterion=RDR_POS, value=5}
              PduRDestPduDataProcessing = IMMEDIATE
              PduRPduLengthHandlingStrategy = IGNORE
              PduRDestPduCrossPartitionDestination = false
              PduRDestPduDataProvision = PDUR_DIRECT
              PduRTransmissionConfirmation = false
              PduRDestPduRef = SR2_DIAG_RES_PHY_OTA_oVCAN_RADAR_63bc1ea4_Tx
              PduRDestPduPduRBswModulesRef = CanIf if post-build-variant-condition{matching-criterion=RDR_POS, value=0}
              PduRDestPduPduRBswModulesRef = CanIf if post-build-variant-condition{matching-criterion=RDR_POS, value=4}
              PduRDestPduPduRBswModulesRef = CanIf if post-build-variant-condition{matching-criterion=RDR_POS, value=3}
              PduRDestPduPduRBswModulesRef = CanIf if post-build-variant-condition{matching-criterion=RDR_POS, value=6}
              PduRDestPduPduRBswModulesRef = CanIf if post-build-variant-condition{matching-criterion=RDR_POS, value=7}
              PduRDestPduPduRBswModulesRef = CanIf if post-build-variant-condition{matching-criterion=RDR_POS, value=2}
              PduRDestPduPduRBswModulesRef = CanIf if post-build-variant-condition{matching-criterion=RDR_POS, value=1}
              PduRDestPduPduRBswModulesRef = CanIf if post-build-variant-condition{matching-criterion=RDR_POS, value=5}
            PduRSrcPdu_b0883b81_001 (PduRSrcPdu):
              PduRSourcePduHandleId = 79
              PduRSrcPduDirection = RECEIVE if post-build-variant-condition{matching-criterion=RDR_POS, value=2}
              PduRSrcPduDirection = RECEIVE if post-build-variant-condition{matching-criterion=RDR_POS, value=0}
              PduRSrcPduDirection = RECEIVE if post-build-variant-condition{matching-criterion=RDR_POS, value=7}
              PduRSrcPduDirection = RECEIVE if post-build-variant-condition{matching-criterion=RDR_POS, value=6}
              PduRSrcPduDirection = RECEIVE if post-build-variant-condition{matching-criterion=RDR_POS, value=4}
              PduRSrcPduDirection = RECEIVE if post-build-variant-condition{matching-criterion=RDR_POS, value=1}
              PduRSrcPduDirection = RECEIVE if post-build-variant-condition{matching-criterion=RDR_POS, value=3}
              PduRSrcPduDirection = RECEIVE if post-build-variant-condition{matching-criterion=RDR_POS, value=5}
              PduRSrcPduRef = SRR_RL_DIAG_RESP_PHYS_OTA_Rx_oPCAN_RADAR_eba387b4_Rx
              PduRSrcPduPduRBswModulesRef = CanIf if post-build-variant-condition{matching-criterion=RDR_POS, value=1}
              PduRSrcPduPduRBswModulesRef = CanIf if post-build-variant-condition{matching-criterion=RDR_POS, value=2}
              PduRSrcPduPduRBswModulesRef = CanIf if post-build-variant-condition{matching-criterion=RDR_POS, value=4}
              PduRSrcPduPduRBswModulesRef = CanIf if post-build-variant-condition{matching-criterion=RDR_POS, value=0}
              PduRSrcPduPduRBswModulesRef = CanIf if post-build-variant-condition{matching-criterion=RDR_POS, value=6}
              PduRSrcPduPduRBswModulesRef = CanIf if post-build-variant-condition{matching-criterion=RDR_POS, value=3}
              PduRSrcPduPduRBswModulesRef = CanIf if post-build-variant-condition{matching-criterion=RDR_POS, value=7}
              PduRSrcPduPduRBswModulesRef = CanIf if post-build-variant-condition{matching-criterion=RDR_POS, value=5}
          FR_DIAG_REQ_PHY_OTA_oVCAN_RADAR_9187f4da_Rx: PduRRoutingPathCommunicationType=TRANSPORT_PROTOCOL if post-build-variant-condition{matching-criterion=RDR_POS, value=6}, PduRRoutingPathCommunicationType=TRANSPORT_PROTOCOL if post-build-variant-condition{matching-criterion=RDR_POS, value=1}, PduRRoutingPathCommunicationType=TRANSPORT_PROTOCOL if post-build-variant-condition{matching-criterion=RDR_POS, value=3}, PduRRoutingPathCommunicationType=TRANSPORT_PROTOCOL if post-build-variant-condition{matching-criterion=RDR_POS, value=0}, PduRRoutingPathCommunicationType=TRANSPORT_PROTOCOL if post-build-variant-condition{matching-criterion=RDR_POS, value=7}, PduRRoutingPathCommunicationType=TRANSPORT_PROTOCOL if post-build-variant-condition{matching-criterion=RDR_POS, value=5}, PduRRoutingPathCommunicationType=TRANSPORT_PROTOCOL if post-build-variant-condition{matching-criterion=RDR_POS, value=2}, PduRRoutingPathCommunicationType=TRANSPORT_PROTOCOL if post-build-variant-condition{matching-criterion=RDR_POS, value=4}, PduRLockRef=PduRLock_PduRExclusiveArea if post-build-variant-condition{matching-criterion=RDR_POS, value=6}, PduRLockRef=PduRLock_PduRExclusiveArea if post-build-variant-condition{matching-criterion=RDR_POS, value=1}, PduRLockRef=PduRLock_PduRExclusiveArea if post-build-variant-condition{matching-criterion=RDR_POS, value=3}, PduRLockRef=PduRLock_PduRExclusiveArea if post-build-variant-condition{matching-criterion=RDR_POS, value=0}, PduRLockRef=PduRLock_PduRExclusiveArea if post-build-variant-condition{matching-criterion=RDR_POS, value=7}, PduRLockRef=PduRLock_PduRExclusiveArea if post-build-variant-condition{matching-criterion=RDR_POS, value=5}, PduRLockRef=PduRLock_PduRExclusiveArea if post-build-variant-condition{matching-criterion=RDR_POS, value=2}, PduRLockRef=PduRLock_PduRExclusiveArea if post-build-variant-condition{matching-criterion=RDR_POS, value=4}
            PduRSrcPdu_4399556e (PduRSrcPdu):
              PduRSourcePduHandleId = 6
              PduRSrcPduDirection = RECEIVE if post-build-variant-condition{matching-criterion=RDR_POS, value=6}
              PduRSrcPduDirection = RECEIVE if post-build-variant-condition{matching-criterion=RDR_POS, value=1}
              PduRSrcPduDirection = RECEIVE if post-build-variant-condition{matching-criterion=RDR_POS, value=3}
              PduRSrcPduDirection = RECEIVE if post-build-variant-condition{matching-criterion=RDR_POS, value=0}
              PduRSrcPduDirection = RECEIVE if post-build-variant-condition{matching-criterion=RDR_POS, value=7}
              PduRSrcPduDirection = RECEIVE if post-build-variant-condition{matching-criterion=RDR_POS, value=5}
              PduRSrcPduDirection = RECEIVE if post-build-variant-condition{matching-criterion=RDR_POS, value=2}
              PduRSrcPduDirection = RECEIVE if post-build-variant-condition{matching-criterion=RDR_POS, value=4}
              PduRSrcPduRef = FR_DIAG_REQ_PHY_OTA_oVCAN_RADAR_9187f4da_Rx
              PduRSrcPduPduRBswModulesRef = CanTp if post-build-variant-condition{matching-criterion=RDR_POS, value=0}
              PduRSrcPduPduRBswModulesRef = CanTp if post-build-variant-condition{matching-criterion=RDR_POS, value=1}
              PduRSrcPduPduRBswModulesRef = CanTp if post-build-variant-condition{matching-criterion=RDR_POS, value=5}
              PduRSrcPduPduRBswModulesRef = CanTp if post-build-variant-condition{matching-criterion=RDR_POS, value=3}
              PduRSrcPduPduRBswModulesRef = CanTp if post-build-variant-condition{matching-criterion=RDR_POS, value=2}
              PduRSrcPduPduRBswModulesRef = CanTp if post-build-variant-condition{matching-criterion=RDR_POS, value=6}
              PduRSrcPduPduRBswModulesRef = CanTp if post-build-variant-condition{matching-criterion=RDR_POS, value=7}
              PduRSrcPduPduRBswModulesRef = CanTp if post-build-variant-condition{matching-criterion=RDR_POS, value=4}
            FR_DIAG_REQ_PHY_OTA_oVCAN_RADAR_9187f4da_Rx_4399556e_Rx (PduRDestPdu):
              PduRDestPduHandleId = 6
              PduRDestPduDirection = RECEIVE if post-build-variant-condition{matching-criterion=RDR_POS, value=1}
              PduRDestPduDirection = RECEIVE if post-build-variant-condition{matching-criterion=RDR_POS, value=3}
              PduRDestPduDirection = RECEIVE if post-build-variant-condition{matching-criterion=RDR_POS, value=0}
              PduRDestPduDirection = RECEIVE if post-build-variant-condition{matching-criterion=RDR_POS, value=7}
              PduRDestPduDirection = RECEIVE if post-build-variant-condition{matching-criterion=RDR_POS, value=5}
              PduRDestPduDirection = RECEIVE if post-build-variant-condition{matching-criterion=RDR_POS, value=2}
              PduRDestPduDirection = RECEIVE if post-build-variant-condition{matching-criterion=RDR_POS, value=4}
              PduRDestPduDirection = RECEIVE if post-build-variant-condition{matching-criterion=RDR_POS, value=6}
              PduRDestPduRoutingType = API_FORWARDING if post-build-variant-condition{matching-criterion=RDR_POS, value=3}
              PduRDestPduRoutingType = API_FORWARDING if post-build-variant-condition{matching-criterion=RDR_POS, value=1}
              PduRDestPduRoutingType = API_FORWARDING if post-build-variant-condition{matching-criterion=RDR_POS, value=0}
              PduRDestPduRoutingType = API_FORWARDING if post-build-variant-condition{matching-criterion=RDR_POS, value=7}
              PduRDestPduRoutingType = API_FORWARDING if post-build-variant-condition{matching-criterion=RDR_POS, value=5}
              PduRDestPduRoutingType = API_FORWARDING if post-build-variant-condition{matching-criterion=RDR_POS, value=2}
              PduRDestPduRoutingType = API_FORWARDING if post-build-variant-condition{matching-criterion=RDR_POS, value=4}
              PduRDestPduRoutingType = API_FORWARDING if post-build-variant-condition{matching-criterion=RDR_POS, value=6}
              PduRDestPduDataProcessing = IMMEDIATE
              PduRPduLengthHandlingStrategy = UNUSED
              PduRDestPduCrossPartitionDestination = false
              PduRDestPduRef = FR_DIAG_REQ_PHY_OTA_oVCAN_RADAR_7facfb76_Rx
              PduRDestPduPduRBswModulesRef = Dcm if post-build-variant-condition{matching-criterion=RDR_POS, value=6}
              PduRDestPduPduRBswModulesRef = Dcm if post-build-variant-condition{matching-criterion=RDR_POS, value=4}
              PduRDestPduPduRBswModulesRef = Dcm if post-build-variant-condition{matching-criterion=RDR_POS, value=0}
              PduRDestPduPduRBswModulesRef = Dcm if post-build-variant-condition{matching-criterion=RDR_POS, value=5}
              PduRDestPduPduRBswModulesRef = Dcm if post-build-variant-condition{matching-criterion=RDR_POS, value=3}
              PduRDestPduPduRBswModulesRef = Dcm if post-build-variant-condition{matching-criterion=RDR_POS, value=2}
              PduRDestPduPduRBswModulesRef = Dcm if post-build-variant-condition{matching-criterion=RDR_POS, value=7}
              PduRDestPduPduRBswModulesRef = Dcm if post-build-variant-condition{matching-criterion=RDR_POS, value=1}
          DIAG_REQ_FNC_OBD2_oVCAN_RADAR_254b3790_Rx: PduRRoutingPathCommunicationType=TRANSPORT_PROTOCOL if post-build-variant-condition{matching-criterion=RDR_POS, value=1}, PduRRoutingPathCommunicationType=TRANSPORT_PROTOCOL if post-build-variant-condition{matching-criterion=RDR_POS, value=3}, PduRRoutingPathCommunicationType=TRANSPORT_PROTOCOL if post-build-variant-condition{matching-criterion=RDR_POS, value=0}, PduRRoutingPathCommunicationType=TRANSPORT_PROTOCOL if post-build-variant-condition{matching-criterion=RDR_POS, value=7}, PduRRoutingPathCommunicationType=TRANSPORT_PROTOCOL if post-build-variant-condition{matching-criterion=RDR_POS, value=5}, PduRRoutingPathCommunicationType=TRANSPORT_PROTOCOL if post-build-variant-condition{matching-criterion=RDR_POS, value=2}, PduRRoutingPathCommunicationType=TRANSPORT_PROTOCOL if post-build-variant-condition{matching-criterion=RDR_POS, value=4}, PduRRoutingPathCommunicationType=TRANSPORT_PROTOCOL if post-build-variant-condition{matching-criterion=RDR_POS, value=6}, PduRLockRef=PduRLock_PduRExclusiveArea if post-build-variant-condition{matching-criterion=RDR_POS, value=6}, PduRLockRef=PduRLock_PduRExclusiveArea if post-build-variant-condition{matching-criterion=RDR_POS, value=1}, PduRLockRef=PduRLock_PduRExclusiveArea if post-build-variant-condition{matching-criterion=RDR_POS, value=3}, PduRLockRef=PduRLock_PduRExclusiveArea if post-build-variant-condition{matching-criterion=RDR_POS, value=0}, PduRLockRef=PduRLock_PduRExclusiveArea if post-build-variant-condition{matching-criterion=RDR_POS, value=7}, PduRLockRef=PduRLock_PduRExclusiveArea if post-build-variant-condition{matching-criterion=RDR_POS, value=5}, PduRLockRef=PduRLock_PduRExclusiveArea if post-build-variant-condition{matching-criterion=RDR_POS, value=2}, PduRLockRef=PduRLock_PduRExclusiveArea if post-build-variant-condition{matching-criterion=RDR_POS, value=4}
            DIAG_REQ_FNC_OBD2_oVCAN_RADAR_254b3790_Rx_017e0121_Rx (PduRDestPdu):
              PduRDestPduHandleId = 1
              PduRDestPduDirection = RECEIVE if post-build-variant-condition{matching-criterion=RDR_POS, value=0}
              PduRDestPduDirection = RECEIVE if post-build-variant-condition{matching-criterion=RDR_POS, value=1}
              PduRDestPduDirection = RECEIVE if post-build-variant-condition{matching-criterion=RDR_POS, value=3}
              PduRDestPduDirection = RECEIVE if post-build-variant-condition{matching-criterion=RDR_POS, value=7}
              PduRDestPduDirection = RECEIVE if post-build-variant-condition{matching-criterion=RDR_POS, value=5}
              PduRDestPduDirection = RECEIVE if post-build-variant-condition{matching-criterion=RDR_POS, value=2}
              PduRDestPduDirection = RECEIVE if post-build-variant-condition{matching-criterion=RDR_POS, value=4}
              PduRDestPduDirection = RECEIVE if post-build-variant-condition{matching-criterion=RDR_POS, value=6}
              PduRDestPduRoutingType = API_FORWARDING if post-build-variant-condition{matching-criterion=RDR_POS, value=1}
              PduRDestPduRoutingType = API_FORWARDING if post-build-variant-condition{matching-criterion=RDR_POS, value=3}
              PduRDestPduRoutingType = API_FORWARDING if post-build-variant-condition{matching-criterion=RDR_POS, value=0}
              PduRDestPduRoutingType = API_FORWARDING if post-build-variant-condition{matching-criterion=RDR_POS, value=7}
              PduRDestPduRoutingType = API_FORWARDING if post-build-variant-condition{matching-criterion=RDR_POS, value=5}
              PduRDestPduRoutingType = API_FORWARDING if post-build-variant-condition{matching-criterion=RDR_POS, value=2}
              PduRDestPduRoutingType = API_FORWARDING if post-build-variant-condition{matching-criterion=RDR_POS, value=4}
              PduRDestPduRoutingType = API_FORWARDING if post-build-variant-condition{matching-criterion=RDR_POS, value=6}
              PduRDestPduDataProcessing = IMMEDIATE
              PduRPduLengthHandlingStrategy = UNUSED
              PduRDestPduCrossPartitionDestination = false
              PduRDestPduRef = DIAG_REQ_FNC_OBD2_oVCAN_RADAR_57874f35_Rx
              PduRDestPduPduRBswModulesRef = Dcm if post-build-variant-condition{matching-criterion=RDR_POS, value=0}
              PduRDestPduPduRBswModulesRef = Dcm if post-build-variant-condition{matching-criterion=RDR_POS, value=6}
              PduRDestPduPduRBswModulesRef = Dcm if post-build-variant-condition{matching-criterion=RDR_POS, value=2}
              PduRDestPduPduRBswModulesRef = Dcm if post-build-variant-condition{matching-criterion=RDR_POS, value=4}
              PduRDestPduPduRBswModulesRef = Dcm if post-build-variant-condition{matching-criterion=RDR_POS, value=1}
              PduRDestPduPduRBswModulesRef = Dcm if post-build-variant-condition{matching-criterion=RDR_POS, value=7}
              PduRDestPduPduRBswModulesRef = Dcm if post-build-variant-condition{matching-criterion=RDR_POS, value=3}
              PduRDestPduPduRBswModulesRef = Dcm if post-build-variant-condition{matching-criterion=RDR_POS, value=5}
            PduRSrcPdu_017e0121 (PduRSrcPdu):
              PduRSourcePduHandleId = 1
              PduRSrcPduDirection = RECEIVE if post-build-variant-condition{matching-criterion=RDR_POS, value=0}
              PduRSrcPduDirection = RECEIVE if post-build-variant-condition{matching-criterion=RDR_POS, value=1}
              PduRSrcPduDirection = RECEIVE if post-build-variant-condition{matching-criterion=RDR_POS, value=3}
              PduRSrcPduDirection = RECEIVE if post-build-variant-condition{matching-criterion=RDR_POS, value=7}
              PduRSrcPduDirection = RECEIVE if post-build-variant-condition{matching-criterion=RDR_POS, value=5}
              PduRSrcPduDirection = RECEIVE if post-build-variant-condition{matching-criterion=RDR_POS, value=2}
              PduRSrcPduDirection = RECEIVE if post-build-variant-condition{matching-criterion=RDR_POS, value=4}
              PduRSrcPduDirection = RECEIVE if post-build-variant-condition{matching-criterion=RDR_POS, value=6}
              PduRSrcPduRef = DIAG_REQ_FNC_OBD2_oVCAN_RADAR_254b3790_Rx
              PduRSrcPduPduRBswModulesRef = CanTp if post-build-variant-condition{matching-criterion=RDR_POS, value=2}
              PduRSrcPduPduRBswModulesRef = CanTp if post-build-variant-condition{matching-criterion=RDR_POS, value=0}
              PduRSrcPduPduRBswModulesRef = CanTp if post-build-variant-condition{matching-criterion=RDR_POS, value=7}
              PduRSrcPduPduRBswModulesRef = CanTp if post-build-variant-condition{matching-criterion=RDR_POS, value=5}
              PduRSrcPduPduRBswModulesRef = CanTp if post-build-variant-condition{matching-criterion=RDR_POS, value=6}
              PduRSrcPduPduRBswModulesRef = CanTp if post-build-variant-condition{matching-criterion=RDR_POS, value=4}
              PduRSrcPduPduRBswModulesRef = CanTp if post-build-variant-condition{matching-criterion=RDR_POS, value=1}
              PduRSrcPduPduRBswModulesRef = CanTp if post-build-variant-condition{matching-criterion=RDR_POS, value=3}
          RDR_FUSION_STATUS_002_oPCAN_RADAR_edd87150_Rx: PduRRoutingPathCommunicationType=COMMUNICATION_INTERFACE if post-build-variant-condition{matching-criterion=RDR_POS, value=7}, PduRRoutingPathCommunicationType=COMMUNICATION_INTERFACE if post-build-variant-condition{matching-criterion=RDR_POS, value=1}, PduRRoutingPathCommunicationType=COMMUNICATION_INTERFACE if post-build-variant-condition{matching-criterion=RDR_POS, value=3}, PduRRoutingPathCommunicationType=COMMUNICATION_INTERFACE if post-build-variant-condition{matching-criterion=RDR_POS, value=0}, PduRRoutingPathCommunicationType=COMMUNICATION_INTERFACE if post-build-variant-condition{matching-criterion=RDR_POS, value=5}, PduRRoutingPathCommunicationType=COMMUNICATION_INTERFACE if post-build-variant-condition{matching-criterion=RDR_POS, value=2}, PduRRoutingPathCommunicationType=COMMUNICATION_INTERFACE if post-build-variant-condition{matching-criterion=RDR_POS, value=4}, PduRRoutingPathCommunicationType=COMMUNICATION_INTERFACE if post-build-variant-condition{matching-criterion=RDR_POS, value=6}, PduRLockRef=PduRLock_PduRExclusiveArea if post-build-variant-condition{matching-criterion=RDR_POS, value=6}, PduRLockRef=PduRLock_PduRExclusiveArea if post-build-variant-condition{matching-criterion=RDR_POS, value=1}, PduRLockRef=PduRLock_PduRExclusiveArea if post-build-variant-condition{matching-criterion=RDR_POS, value=3}, PduRLockRef=PduRLock_PduRExclusiveArea if post-build-variant-condition{matching-criterion=RDR_POS, value=0}, PduRLockRef=PduRLock_PduRExclusiveArea if post-build-variant-condition{matching-criterion=RDR_POS, value=7}, PduRLockRef=PduRLock_PduRExclusiveArea if post-build-variant-condition{matching-criterion=RDR_POS, value=5}, PduRLockRef=PduRLock_PduRExclusiveArea if post-build-variant-condition{matching-criterion=RDR_POS, value=2}, PduRLockRef=PduRLock_PduRExclusiveArea if post-build-variant-condition{matching-criterion=RDR_POS, value=4}
            RDR_FUSION_STATUS_002_oPCAN_RADAR_edd87150_Rx_543d6eb7_Rx (PduRDestPdu):
              PduRDestPduHandleId = 56
              PduRDestPduDirection = RECEIVE if post-build-variant-condition{matching-criterion=RDR_POS, value=1}
              PduRDestPduDirection = RECEIVE if post-build-variant-condition{matching-criterion=RDR_POS, value=3}
              PduRDestPduDirection = RECEIVE if post-build-variant-condition{matching-criterion=RDR_POS, value=0}
              PduRDestPduDirection = RECEIVE if post-build-variant-condition{matching-criterion=RDR_POS, value=7}
              PduRDestPduDirection = RECEIVE if post-build-variant-condition{matching-criterion=RDR_POS, value=5}
              PduRDestPduDirection = RECEIVE if post-build-variant-condition{matching-criterion=RDR_POS, value=2}
              PduRDestPduDirection = RECEIVE if post-build-variant-condition{matching-criterion=RDR_POS, value=4}
              PduRDestPduDirection = RECEIVE if post-build-variant-condition{matching-criterion=RDR_POS, value=6}
              PduRDestPduRoutingType = API_FORWARDING if post-build-variant-condition{matching-criterion=RDR_POS, value=2}
              PduRDestPduRoutingType = API_FORWARDING if post-build-variant-condition{matching-criterion=RDR_POS, value=1}
              PduRDestPduRoutingType = API_FORWARDING if post-build-variant-condition{matching-criterion=RDR_POS, value=3}
              PduRDestPduRoutingType = API_FORWARDING if post-build-variant-condition{matching-criterion=RDR_POS, value=0}
              PduRDestPduRoutingType = API_FORWARDING if post-build-variant-condition{matching-criterion=RDR_POS, value=5}
              PduRDestPduRoutingType = API_FORWARDING if post-build-variant-condition{matching-criterion=RDR_POS, value=7}
              PduRDestPduRoutingType = API_FORWARDING if post-build-variant-condition{matching-criterion=RDR_POS, value=4}
              PduRDestPduRoutingType = API_FORWARDING if post-build-variant-condition{matching-criterion=RDR_POS, value=6}
              PduRDestPduDataProcessing = IMMEDIATE
              PduRPduLengthHandlingStrategy = IGNORE
              PduRDestPduCrossPartitionDestination = false
              PduRTransmissionConfirmation = false
              PduRDestPduRef = RDR_FUSION_STATUS_002_oPCAN_RADAR_36391f53_Rx
              PduRDestPduPduRBswModulesRef = Com if post-build-variant-condition{matching-criterion=RDR_POS, value=1}
              PduRDestPduPduRBswModulesRef = Com if post-build-variant-condition{matching-criterion=RDR_POS, value=0}
              PduRDestPduPduRBswModulesRef = Com if post-build-variant-condition{matching-criterion=RDR_POS, value=5}
              PduRDestPduPduRBswModulesRef = Com if post-build-variant-condition{matching-criterion=RDR_POS, value=4}
              PduRDestPduPduRBswModulesRef = Com if post-build-variant-condition{matching-criterion=RDR_POS, value=2}
              PduRDestPduPduRBswModulesRef = Com if post-build-variant-condition{matching-criterion=RDR_POS, value=6}
              PduRDestPduPduRBswModulesRef = Com if post-build-variant-condition{matching-criterion=RDR_POS, value=3}
              PduRDestPduPduRBswModulesRef = Com if post-build-variant-condition{matching-criterion=RDR_POS, value=7}
            PduRSrcPdu_543d6eb7 (PduRSrcPdu):
              PduRSourcePduHandleId = 63
              PduRSrcPduDirection = RECEIVE if post-build-variant-condition{matching-criterion=RDR_POS, value=6}
              PduRSrcPduDirection = RECEIVE if post-build-variant-condition{matching-criterion=RDR_POS, value=1}
              PduRSrcPduDirection = RECEIVE if post-build-variant-condition{matching-criterion=RDR_POS, value=3}
              PduRSrcPduDirection = RECEIVE if post-build-variant-condition{matching-criterion=RDR_POS, value=0}
              PduRSrcPduDirection = RECEIVE if post-build-variant-condition{matching-criterion=RDR_POS, value=7}
              PduRSrcPduDirection = RECEIVE if post-build-variant-condition{matching-criterion=RDR_POS, value=5}
              PduRSrcPduDirection = RECEIVE if post-build-variant-condition{matching-criterion=RDR_POS, value=2}
              PduRSrcPduDirection = RECEIVE if post-build-variant-condition{matching-criterion=RDR_POS, value=4}
              PduRSrcPduRef = RDR_FUSION_STATUS_002_oPCAN_RADAR_edd87150_Rx
              PduRSrcPduPduRBswModulesRef = CanIf if post-build-variant-condition{matching-criterion=RDR_POS, value=5}
              PduRSrcPduPduRBswModulesRef = CanIf if post-build-variant-condition{matching-criterion=RDR_POS, value=6}
              PduRSrcPduPduRBswModulesRef = CanIf if post-build-variant-condition{matching-criterion=RDR_POS, value=0}
              PduRSrcPduPduRBswModulesRef = CanIf if post-build-variant-condition{matching-criterion=RDR_POS, value=7}
              PduRSrcPduPduRBswModulesRef = CanIf if post-build-variant-condition{matching-criterion=RDR_POS, value=1}
              PduRSrcPduPduRBswModulesRef = CanIf if post-build-variant-condition{matching-criterion=RDR_POS, value=4}
              PduRSrcPduPduRBswModulesRef = CanIf if post-build-variant-condition{matching-criterion=RDR_POS, value=3}
              PduRSrcPduPduRBswModulesRef = CanIf if post-build-variant-condition{matching-criterion=RDR_POS, value=2}
          SR1_DIAG_RES_PHY_OTA_oVCAN_RADAR_1159a10f_Tx: PduRRoutingPathCommunicationType=COMMUNICATION_INTERFACE if post-build-variant-condition{matching-criterion=RDR_POS, value=1}, PduRRoutingPathCommunicationType=COMMUNICATION_INTERFACE if post-build-variant-condition{matching-criterion=RDR_POS, value=3}, PduRRoutingPathCommunicationType=COMMUNICATION_INTERFACE if post-build-variant-condition{matching-criterion=RDR_POS, value=0}, PduRRoutingPathCommunicationType=COMMUNICATION_INTERFACE if post-build-variant-condition{matching-criterion=RDR_POS, value=7}, PduRRoutingPathCommunicationType=COMMUNICATION_INTERFACE if post-build-variant-condition{matching-criterion=RDR_POS, value=5}, PduRRoutingPathCommunicationType=COMMUNICATION_INTERFACE if post-build-variant-condition{matching-criterion=RDR_POS, value=2}, PduRRoutingPathCommunicationType=COMMUNICATION_INTERFACE if post-build-variant-condition{matching-criterion=RDR_POS, value=4}, PduRRoutingPathCommunicationType=COMMUNICATION_INTERFACE if post-build-variant-condition{matching-criterion=RDR_POS, value=6}, PduRLockRef=PduRLock_PduRExclusiveArea if post-build-variant-condition{matching-criterion=RDR_POS, value=1}, PduRLockRef=PduRLock_PduRExclusiveArea if post-build-variant-condition{matching-criterion=RDR_POS, value=0}, PduRLockRef=PduRLock_PduRExclusiveArea if post-build-variant-condition{matching-criterion=RDR_POS, value=7}, PduRLockRef=PduRLock_PduRExclusiveArea if post-build-variant-condition{matching-criterion=RDR_POS, value=6}, PduRLockRef=PduRLock_PduRExclusiveArea if post-build-variant-condition{matching-criterion=RDR_POS, value=4}, PduRLockRef=PduRLock_PduRExclusiveArea if post-build-variant-condition{matching-criterion=RDR_POS, value=3}, PduRLockRef=PduRLock_PduRExclusiveArea if post-build-variant-condition{matching-criterion=RDR_POS, value=2}, PduRLockRef=PduRLock_PduRExclusiveArea if post-build-variant-condition{matching-criterion=RDR_POS, value=5}
            SR1_DIAG_RES_PHY_OTA_oVCAN_RADAR_349e32f6_Tx (PduRDestPdu):
              PduRDestPduHandleId = 192
              PduRDestPduDirection = TRANSMIT if post-build-variant-condition{matching-criterion=RDR_POS, value=2}
              PduRDestPduDirection = TRANSMIT if post-build-variant-condition{matching-criterion=RDR_POS, value=1}
              PduRDestPduDirection = TRANSMIT if post-build-variant-condition{matching-criterion=RDR_POS, value=3}
              PduRDestPduDirection = TRANSMIT if post-build-variant-condition{matching-criterion=RDR_POS, value=0}
              PduRDestPduDirection = TRANSMIT if post-build-variant-condition{matching-criterion=RDR_POS, value=5}
              PduRDestPduDirection = TRANSMIT if post-build-variant-condition{matching-criterion=RDR_POS, value=7}
              PduRDestPduDirection = TRANSMIT if post-build-variant-condition{matching-criterion=RDR_POS, value=4}
              PduRDestPduDirection = TRANSMIT if post-build-variant-condition{matching-criterion=RDR_POS, value=6}
              PduRDestPduRoutingType = GATEWAY_ROUTING if post-build-variant-condition{matching-criterion=RDR_POS, value=5}
              PduRDestPduRoutingType = GATEWAY_ROUTING if post-build-variant-condition{matching-criterion=RDR_POS, value=0}
              PduRDestPduRoutingType = GATEWAY_ROUTING if post-build-variant-condition{matching-criterion=RDR_POS, value=7}
              PduRDestPduRoutingType = GATEWAY_ROUTING if post-build-variant-condition{matching-criterion=RDR_POS, value=6}
              PduRDestPduRoutingType = GATEWAY_ROUTING if post-build-variant-condition{matching-criterion=RDR_POS, value=4}
              PduRDestPduRoutingType = GATEWAY_ROUTING if post-build-variant-condition{matching-criterion=RDR_POS, value=1}
              PduRDestPduRoutingType = GATEWAY_ROUTING if post-build-variant-condition{matching-criterion=RDR_POS, value=3}
              PduRDestPduRoutingType = GATEWAY_ROUTING if post-build-variant-condition{matching-criterion=RDR_POS, value=2}
              PduRDestPduDataProcessing = IMMEDIATE
              PduRPduLengthHandlingStrategy = IGNORE
              PduRDestPduCrossPartitionDestination = false
              PduRDestPduDataProvision = PDUR_DIRECT
              PduRTransmissionConfirmation = false
              PduRDestPduRef = SR1_DIAG_RES_PHY_OTA_oVCAN_RADAR_349e32f6_Tx
              PduRDestPduPduRBswModulesRef = CanIf if post-build-variant-condition{matching-criterion=RDR_POS, value=0}
              PduRDestPduPduRBswModulesRef = CanIf if post-build-variant-condition{matching-criterion=RDR_POS, value=4}
              PduRDestPduPduRBswModulesRef = CanIf if post-build-variant-condition{matching-criterion=RDR_POS, value=6}
              PduRDestPduPduRBswModulesRef = CanIf if post-build-variant-condition{matching-criterion=RDR_POS, value=5}
              PduRDestPduPduRBswModulesRef = CanIf if post-build-variant-condition{matching-criterion=RDR_POS, value=1}
              PduRDestPduPduRBswModulesRef = CanIf if post-build-variant-condition{matching-criterion=RDR_POS, value=3}
              PduRDestPduPduRBswModulesRef = CanIf if post-build-variant-condition{matching-criterion=RDR_POS, value=7}
              PduRDestPduPduRBswModulesRef = CanIf if post-build-variant-condition{matching-criterion=RDR_POS, value=2}
            PduRSrcPdu_1ea56287_001 (PduRSrcPdu):
              PduRSourcePduHandleId = 71
              PduRSrcPduDirection = RECEIVE if post-build-variant-condition{matching-criterion=RDR_POS, value=5}
              PduRSrcPduDirection = RECEIVE if post-build-variant-condition{matching-criterion=RDR_POS, value=0}
              PduRSrcPduDirection = RECEIVE if post-build-variant-condition{matching-criterion=RDR_POS, value=7}
              PduRSrcPduDirection = RECEIVE if post-build-variant-condition{matching-criterion=RDR_POS, value=6}
              PduRSrcPduDirection = RECEIVE if post-build-variant-condition{matching-criterion=RDR_POS, value=4}
              PduRSrcPduDirection = RECEIVE if post-build-variant-condition{matching-criterion=RDR_POS, value=1}
              PduRSrcPduDirection = RECEIVE if post-build-variant-condition{matching-criterion=RDR_POS, value=3}
              PduRSrcPduDirection = RECEIVE if post-build-variant-condition{matching-criterion=RDR_POS, value=2}
              PduRSrcPduRef = SRR_FL_DIAG_RESP_PHYS_OTA_Rx_oPCAN_RADAR_9fd7f3d9_Rx
              PduRSrcPduPduRBswModulesRef = CanIf if post-build-variant-condition{matching-criterion=RDR_POS, value=0}
              PduRSrcPduPduRBswModulesRef = CanIf if post-build-variant-condition{matching-criterion=RDR_POS, value=5}
              PduRSrcPduPduRBswModulesRef = CanIf if post-build-variant-condition{matching-criterion=RDR_POS, value=3}
              PduRSrcPduPduRBswModulesRef = CanIf if post-build-variant-condition{matching-criterion=RDR_POS, value=6}
              PduRSrcPduPduRBswModulesRef = CanIf if post-build-variant-condition{matching-criterion=RDR_POS, value=4}
              PduRSrcPduPduRBswModulesRef = CanIf if post-build-variant-condition{matching-criterion=RDR_POS, value=2}
              PduRSrcPduPduRBswModulesRef = CanIf if post-build-variant-condition{matching-criterion=RDR_POS, value=7}
              PduRSrcPduPduRBswModulesRef = CanIf if post-build-variant-condition{matching-criterion=RDR_POS, value=1}
          RDR_CM_B1_Rx_oPCAN_RADAR_a03442fa_Rx: PduRRoutingPathCommunicationType=COMMUNICATION_INTERFACE if post-build-variant-condition{matching-criterion=RDR_POS, value=4}, PduRRoutingPathCommunicationType=COMMUNICATION_INTERFACE if post-build-variant-condition{matching-criterion=RDR_POS, value=1}, PduRRoutingPathCommunicationType=COMMUNICATION_INTERFACE if post-build-variant-condition{matching-criterion=RDR_POS, value=3}, PduRRoutingPathCommunicationType=COMMUNICATION_INTERFACE if post-build-variant-condition{matching-criterion=RDR_POS, value=0}, PduRRoutingPathCommunicationType=COMMUNICATION_INTERFACE if post-build-variant-condition{matching-criterion=RDR_POS, value=7}, PduRRoutingPathCommunicationType=COMMUNICATION_INTERFACE if post-build-variant-condition{matching-criterion=RDR_POS, value=5}, PduRRoutingPathCommunicationType=COMMUNICATION_INTERFACE if post-build-variant-condition{matching-criterion=RDR_POS, value=2}, PduRRoutingPathCommunicationType=COMMUNICATION_INTERFACE if post-build-variant-condition{matching-criterion=RDR_POS, value=6}, PduRLockRef=PduRLock_PduRExclusiveArea if post-build-variant-condition{matching-criterion=RDR_POS, value=6}, PduRLockRef=PduRLock_PduRExclusiveArea if post-build-variant-condition{matching-criterion=RDR_POS, value=0}, PduRLockRef=PduRLock_PduRExclusiveArea if post-build-variant-condition{matching-criterion=RDR_POS, value=7}, PduRLockRef=PduRLock_PduRExclusiveArea if post-build-variant-condition{matching-criterion=RDR_POS, value=4}, PduRLockRef=PduRLock_PduRExclusiveArea if post-build-variant-condition{matching-criterion=RDR_POS, value=1}, PduRLockRef=PduRLock_PduRExclusiveArea if post-build-variant-condition{matching-criterion=RDR_POS, value=3}, PduRLockRef=PduRLock_PduRExclusiveArea if post-build-variant-condition{matching-criterion=RDR_POS, value=2}, PduRLockRef=PduRLock_PduRExclusiveArea if post-build-variant-condition{matching-criterion=RDR_POS, value=5}
            PduRSrcPdu_464f39b2 (PduRSrcPdu):
              PduRSourcePduHandleId = 23
              PduRSrcPduDirection = RECEIVE if post-build-variant-condition{matching-criterion=RDR_POS, value=7}
              PduRSrcPduDirection = RECEIVE if post-build-variant-condition{matching-criterion=RDR_POS, value=1}
              PduRSrcPduDirection = RECEIVE if post-build-variant-condition{matching-criterion=RDR_POS, value=3}
              PduRSrcPduDirection = RECEIVE if post-build-variant-condition{matching-criterion=RDR_POS, value=0}
              PduRSrcPduDirection = RECEIVE if post-build-variant-condition{matching-criterion=RDR_POS, value=5}
              PduRSrcPduDirection = RECEIVE if post-build-variant-condition{matching-criterion=RDR_POS, value=2}
              PduRSrcPduDirection = RECEIVE if post-build-variant-condition{matching-criterion=RDR_POS, value=4}
              PduRSrcPduDirection = RECEIVE if post-build-variant-condition{matching-criterion=RDR_POS, value=6}
              PduRSrcPduRef = RDR_CM_B1_Rx_oPCAN_RADAR_a03442fa_Rx
              PduRSrcPduPduRBswModulesRef = CanIf if post-build-variant-condition{matching-criterion=RDR_POS, value=5}
              PduRSrcPduPduRBswModulesRef = CanIf if post-build-variant-condition{matching-criterion=RDR_POS, value=7}
              PduRSrcPduPduRBswModulesRef = CanIf if post-build-variant-condition{matching-criterion=RDR_POS, value=2}
              PduRSrcPduPduRBswModulesRef = CanIf if post-build-variant-condition{matching-criterion=RDR_POS, value=4}
              PduRSrcPduPduRBswModulesRef = CanIf if post-build-variant-condition{matching-criterion=RDR_POS, value=0}
              PduRSrcPduPduRBswModulesRef = CanIf if post-build-variant-condition{matching-criterion=RDR_POS, value=6}
              PduRSrcPduPduRBswModulesRef = CanIf if post-build-variant-condition{matching-criterion=RDR_POS, value=3}
              PduRSrcPduPduRBswModulesRef = CanIf if post-build-variant-condition{matching-criterion=RDR_POS, value=1}
            TPCM_SR2_oVCAN_RADAR_19e46f16_Tx (PduRDestPdu):
              PduRDestPduHandleId = 207
              PduRDestPduDirection = TRANSMIT if post-build-variant-condition{matching-criterion=RDR_POS, value=7}
              PduRDestPduDirection = TRANSMIT if post-build-variant-condition{matching-criterion=RDR_POS, value=0}
              PduRDestPduDirection = TRANSMIT if post-build-variant-condition{matching-criterion=RDR_POS, value=6}
              PduRDestPduDirection = TRANSMIT if post-build-variant-condition{matching-criterion=RDR_POS, value=4}
              PduRDestPduDirection = TRANSMIT if post-build-variant-condition{matching-criterion=RDR_POS, value=1}
              PduRDestPduDirection = TRANSMIT if post-build-variant-condition{matching-criterion=RDR_POS, value=3}
              PduRDestPduDirection = TRANSMIT if post-build-variant-condition{matching-criterion=RDR_POS, value=2}
              PduRDestPduDirection = TRANSMIT if post-build-variant-condition{matching-criterion=RDR_POS, value=5}
              PduRDestPduRoutingType = GATEWAY_ROUTING if post-build-variant-condition{matching-criterion=RDR_POS, value=7}
              PduRDestPduRoutingType = GATEWAY_ROUTING if post-build-variant-condition{matching-criterion=RDR_POS, value=0}
              PduRDestPduRoutingType = GATEWAY_ROUTING if post-build-variant-condition{matching-criterion=RDR_POS, value=6}
              PduRDestPduRoutingType = GATEWAY_ROUTING if post-build-variant-condition{matching-criterion=RDR_POS, value=4}
              PduRDestPduRoutingType = GATEWAY_ROUTING if post-build-variant-condition{matching-criterion=RDR_POS, value=1}
              PduRDestPduRoutingType = GATEWAY_ROUTING if post-build-variant-condition{matching-criterion=RDR_POS, value=3}
              PduRDestPduRoutingType = GATEWAY_ROUTING if post-build-variant-condition{matching-criterion=RDR_POS, value=2}
              PduRDestPduRoutingType = GATEWAY_ROUTING if post-build-variant-condition{matching-criterion=RDR_POS, value=5}
              PduRDestPduDataProcessing = IMMEDIATE
              PduRPduLengthHandlingStrategy = IGNORE
              PduRDestPduCrossPartitionDestination = false
              PduRTransmissionConfirmation = false
              PduRDestPduDataProvision = PDUR_DIRECT
              PduRDestPduRef = TPCM_SR2_oVCAN_RADAR_19e46f16_Tx
              PduRDestPduPduRBswModulesRef = CanIf if post-build-variant-condition{matching-criterion=RDR_POS, value=1}
              PduRDestPduPduRBswModulesRef = CanIf if post-build-variant-condition{matching-criterion=RDR_POS, value=3}
              PduRDestPduPduRBswModulesRef = CanIf if post-build-variant-condition{matching-criterion=RDR_POS, value=0}
              PduRDestPduPduRBswModulesRef = CanIf if post-build-variant-condition{matching-criterion=RDR_POS, value=2}
              PduRDestPduPduRBswModulesRef = CanIf if post-build-variant-condition{matching-criterion=RDR_POS, value=4}
              PduRDestPduPduRBswModulesRef = CanIf if post-build-variant-condition{matching-criterion=RDR_POS, value=5}
              PduRDestPduPduRBswModulesRef = CanIf if post-build-variant-condition{matching-criterion=RDR_POS, value=7}
              PduRDestPduPduRBswModulesRef = CanIf if post-build-variant-condition{matching-criterion=RDR_POS, value=6}
          PCAN_DIAG_REQ_PHYS_PLANT_oPCAN_RADAR_214e1a1c_Rx: PduRRoutingPathCommunicationType=TRANSPORT_PROTOCOL if post-build-variant-condition{matching-criterion=RDR_POS, value=2}, PduRRoutingPathCommunicationType=TRANSPORT_PROTOCOL if post-build-variant-condition{matching-criterion=RDR_POS, value=1}, PduRRoutingPathCommunicationType=TRANSPORT_PROTOCOL if post-build-variant-condition{matching-criterion=RDR_POS, value=3}, PduRRoutingPathCommunicationType=TRANSPORT_PROTOCOL if post-build-variant-condition{matching-criterion=RDR_POS, value=0}, PduRRoutingPathCommunicationType=TRANSPORT_PROTOCOL if post-build-variant-condition{matching-criterion=RDR_POS, value=5}, PduRRoutingPathCommunicationType=TRANSPORT_PROTOCOL if post-build-variant-condition{matching-criterion=RDR_POS, value=7}, PduRRoutingPathCommunicationType=TRANSPORT_PROTOCOL if post-build-variant-condition{matching-criterion=RDR_POS, value=4}, PduRRoutingPathCommunicationType=TRANSPORT_PROTOCOL if post-build-variant-condition{matching-criterion=RDR_POS, value=6}, PduRLockRef=PduRLock_PduRExclusiveArea if post-build-variant-condition{matching-criterion=RDR_POS, value=6}, PduRLockRef=PduRLock_PduRExclusiveArea if post-build-variant-condition{matching-criterion=RDR_POS, value=1}, PduRLockRef=PduRLock_PduRExclusiveArea if post-build-variant-condition{matching-criterion=RDR_POS, value=3}, PduRLockRef=PduRLock_PduRExclusiveArea if post-build-variant-condition{matching-criterion=RDR_POS, value=0}, PduRLockRef=PduRLock_PduRExclusiveArea if post-build-variant-condition{matching-criterion=RDR_POS, value=7}, PduRLockRef=PduRLock_PduRExclusiveArea if post-build-variant-condition{matching-criterion=RDR_POS, value=5}, PduRLockRef=PduRLock_PduRExclusiveArea if post-build-variant-condition{matching-criterion=RDR_POS, value=2}, PduRLockRef=PduRLock_PduRExclusiveArea if post-build-variant-condition{matching-criterion=RDR_POS, value=4}
            PduRSrcPdu_ce8fc2bd (PduRSrcPdu):
              PduRSourcePduHandleId = 23
              PduRSrcPduDirection = RECEIVE if post-build-variant-condition{matching-criterion=RDR_POS, value=1}
              PduRSrcPduDirection = RECEIVE if post-build-variant-condition{matching-criterion=RDR_POS, value=3}
              PduRSrcPduDirection = RECEIVE if post-build-variant-condition{matching-criterion=RDR_POS, value=0}
              PduRSrcPduDirection = RECEIVE if post-build-variant-condition{matching-criterion=RDR_POS, value=7}
              PduRSrcPduDirection = RECEIVE if post-build-variant-condition{matching-criterion=RDR_POS, value=5}
              PduRSrcPduDirection = RECEIVE if post-build-variant-condition{matching-criterion=RDR_POS, value=2}
              PduRSrcPduDirection = RECEIVE if post-build-variant-condition{matching-criterion=RDR_POS, value=4}
              PduRSrcPduDirection = RECEIVE if post-build-variant-condition{matching-criterion=RDR_POS, value=6}
              PduRSrcPduRef = PCAN_DIAG_REQ_PHYS_PLANT_oPCAN_RADAR_214e1a1c_Rx
              PduRSrcPduPduRBswModulesRef = CanTp if post-build-variant-condition{matching-criterion=RDR_POS, value=6}
              PduRSrcPduPduRBswModulesRef = CanTp if post-build-variant-condition{matching-criterion=RDR_POS, value=3}
              PduRSrcPduPduRBswModulesRef = CanTp if post-build-variant-condition{matching-criterion=RDR_POS, value=2}
              PduRSrcPduPduRBswModulesRef = CanTp if post-build-variant-condition{matching-criterion=RDR_POS, value=0}
              PduRSrcPduPduRBswModulesRef = CanTp if post-build-variant-condition{matching-criterion=RDR_POS, value=4}
              PduRSrcPduPduRBswModulesRef = CanTp if post-build-variant-condition{matching-criterion=RDR_POS, value=5}
              PduRSrcPduPduRBswModulesRef = CanTp if post-build-variant-condition{matching-criterion=RDR_POS, value=7}
              PduRSrcPduPduRBswModulesRef = CanTp if post-build-variant-condition{matching-criterion=RDR_POS, value=1}
            PCAN_DIAG_REQ_PHYS_PLANT_oPCAN_RADAR_214e1a1c_Rx_ce8fc2bd_Rx (PduRDestPdu):
              PduRDestPduHandleId = 23
              PduRDestPduDirection = RECEIVE if post-build-variant-condition{matching-criterion=RDR_POS, value=0}
              PduRDestPduDirection = RECEIVE if post-build-variant-condition{matching-criterion=RDR_POS, value=1}
              PduRDestPduDirection = RECEIVE if post-build-variant-condition{matching-criterion=RDR_POS, value=3}
              PduRDestPduDirection = RECEIVE if post-build-variant-condition{matching-criterion=RDR_POS, value=7}
              PduRDestPduDirection = RECEIVE if post-build-variant-condition{matching-criterion=RDR_POS, value=5}
              PduRDestPduDirection = RECEIVE if post-build-variant-condition{matching-criterion=RDR_POS, value=2}
              PduRDestPduDirection = RECEIVE if post-build-variant-condition{matching-criterion=RDR_POS, value=4}
              PduRDestPduDirection = RECEIVE if post-build-variant-condition{matching-criterion=RDR_POS, value=6}
              PduRDestPduRoutingType = API_FORWARDING if post-build-variant-condition{matching-criterion=RDR_POS, value=2}
              PduRDestPduRoutingType = API_FORWARDING if post-build-variant-condition{matching-criterion=RDR_POS, value=1}
              PduRDestPduRoutingType = API_FORWARDING if post-build-variant-condition{matching-criterion=RDR_POS, value=3}
              PduRDestPduRoutingType = API_FORWARDING if post-build-variant-condition{matching-criterion=RDR_POS, value=0}
              PduRDestPduRoutingType = API_FORWARDING if post-build-variant-condition{matching-criterion=RDR_POS, value=5}
              PduRDestPduRoutingType = API_FORWARDING if post-build-variant-condition{matching-criterion=RDR_POS, value=7}
              PduRDestPduRoutingType = API_FORWARDING if post-build-variant-condition{matching-criterion=RDR_POS, value=4}
              PduRDestPduRoutingType = API_FORWARDING if post-build-variant-condition{matching-criterion=RDR_POS, value=6}
              PduRDestPduDataProcessing = IMMEDIATE
              PduRPduLengthHandlingStrategy = UNUSED
              PduRDestPduCrossPartitionDestination = false
              PduRDestPduRef = PCAN_DIAG_REQ_PHYS_PLANT_oPCAN_RADAR_a4e456d5_Rx
              PduRDestPduPduRBswModulesRef = Dcm if post-build-variant-condition{matching-criterion=RDR_POS, value=6}
              PduRDestPduPduRBswModulesRef = Dcm if post-build-variant-condition{matching-criterion=RDR_POS, value=0}
              PduRDestPduPduRBswModulesRef = Dcm if post-build-variant-condition{matching-criterion=RDR_POS, value=7}
              PduRDestPduPduRBswModulesRef = Dcm if post-build-variant-condition{matching-criterion=RDR_POS, value=3}
              PduRDestPduPduRBswModulesRef = Dcm if post-build-variant-condition{matching-criterion=RDR_POS, value=2}
              PduRDestPduPduRBswModulesRef = Dcm if post-build-variant-condition{matching-criterion=RDR_POS, value=1}
              PduRDestPduPduRBswModulesRef = Dcm if post-build-variant-condition{matching-criterion=RDR_POS, value=4}
              PduRDestPduPduRBswModulesRef = Dcm if post-build-variant-condition{matching-criterion=RDR_POS, value=5}
          PCAN_DIAG_REQ_FUNC_PLANT_oPCAN_RADAR_20_c17463fa_Rx: PduRRoutingPathCommunicationType=TRANSPORT_PROTOCOL if post-build-variant-condition{matching-criterion=RDR_POS, value=0}, PduRRoutingPathCommunicationType=TRANSPORT_PROTOCOL if post-build-variant-condition{matching-criterion=RDR_POS, value=1}, PduRRoutingPathCommunicationType=TRANSPORT_PROTOCOL if post-build-variant-condition{matching-criterion=RDR_POS, value=3}, PduRRoutingPathCommunicationType=TRANSPORT_PROTOCOL if post-build-variant-condition{matching-criterion=RDR_POS, value=7}, PduRRoutingPathCommunicationType=TRANSPORT_PROTOCOL if post-build-variant-condition{matching-criterion=RDR_POS, value=5}, PduRRoutingPathCommunicationType=TRANSPORT_PROTOCOL if post-build-variant-condition{matching-criterion=RDR_POS, value=2}, PduRRoutingPathCommunicationType=TRANSPORT_PROTOCOL if post-build-variant-condition{matching-criterion=RDR_POS, value=4}, PduRRoutingPathCommunicationType=TRANSPORT_PROTOCOL if post-build-variant-condition{matching-criterion=RDR_POS, value=6}, PduRLockRef=PduRLock_PduRExclusiveArea if post-build-variant-condition{matching-criterion=RDR_POS, value=6}, PduRLockRef=PduRLock_PduRExclusiveArea if post-build-variant-condition{matching-criterion=RDR_POS, value=1}, PduRLockRef=PduRLock_PduRExclusiveArea if post-build-variant-condition{matching-criterion=RDR_POS, value=3}, PduRLockRef=PduRLock_PduRExclusiveArea if post-build-variant-condition{matching-criterion=RDR_POS, value=0}, PduRLockRef=PduRLock_PduRExclusiveArea if post-build-variant-condition{matching-criterion=RDR_POS, value=7}, PduRLockRef=PduRLock_PduRExclusiveArea if post-build-variant-condition{matching-criterion=RDR_POS, value=5}, PduRLockRef=PduRLock_PduRExclusiveArea if post-build-variant-condition{matching-criterion=RDR_POS, value=2}, PduRLockRef=PduRLock_PduRExclusiveArea if post-build-variant-condition{matching-criterion=RDR_POS, value=4}
            PCAN_DIAG_REQ_FUNC_PLANT_oPCAN_RADAR_20_c17463fa_Rx_d6a59fd3_Rx (PduRDestPdu):
              PduRDestPduHandleId = 15
              PduRDestPduDirection = RECEIVE if post-build-variant-condition{matching-criterion=RDR_POS, value=0}
              PduRDestPduDirection = RECEIVE if post-build-variant-condition{matching-criterion=RDR_POS, value=1}
              PduRDestPduDirection = RECEIVE if post-build-variant-condition{matching-criterion=RDR_POS, value=3}
              PduRDestPduDirection = RECEIVE if post-build-variant-condition{matching-criterion=RDR_POS, value=7}
              PduRDestPduDirection = RECEIVE if post-build-variant-condition{matching-criterion=RDR_POS, value=5}
              PduRDestPduDirection = RECEIVE if post-build-variant-condition{matching-criterion=RDR_POS, value=2}
              PduRDestPduDirection = RECEIVE if post-build-variant-condition{matching-criterion=RDR_POS, value=4}
              PduRDestPduDirection = RECEIVE if post-build-variant-condition{matching-criterion=RDR_POS, value=6}
              PduRDestPduRoutingType = API_FORWARDING if post-build-variant-condition{matching-criterion=RDR_POS, value=3}
              PduRDestPduRoutingType = API_FORWARDING if post-build-variant-condition{matching-criterion=RDR_POS, value=1}
              PduRDestPduRoutingType = API_FORWARDING if post-build-variant-condition{matching-criterion=RDR_POS, value=0}
              PduRDestPduRoutingType = API_FORWARDING if post-build-variant-condition{matching-criterion=RDR_POS, value=7}
              PduRDestPduRoutingType = API_FORWARDING if post-build-variant-condition{matching-criterion=RDR_POS, value=5}
              PduRDestPduRoutingType = API_FORWARDING if post-build-variant-condition{matching-criterion=RDR_POS, value=2}
              PduRDestPduRoutingType = API_FORWARDING if post-build-variant-condition{matching-criterion=RDR_POS, value=4}
              PduRDestPduRoutingType = API_FORWARDING if post-build-variant-condition{matching-criterion=RDR_POS, value=6}
              PduRDestPduDataProcessing = IMMEDIATE
              PduRPduLengthHandlingStrategy = UNUSED
              PduRDestPduCrossPartitionDestination = false
              PduRDestPduRef = PCAN_DIAG_REQ_FUNC_PLANT_oPCAN_RADAR_20_3b79581e_Rx
              PduRDestPduPduRBswModulesRef = Dcm if post-build-variant-condition{matching-criterion=RDR_POS, value=1}
              PduRDestPduPduRBswModulesRef = Dcm if post-build-variant-condition{matching-criterion=RDR_POS, value=5}
              PduRDestPduPduRBswModulesRef = Dcm if post-build-variant-condition{matching-criterion=RDR_POS, value=7}
              PduRDestPduPduRBswModulesRef = Dcm if post-build-variant-condition{matching-criterion=RDR_POS, value=2}
              PduRDestPduPduRBswModulesRef = Dcm if post-build-variant-condition{matching-criterion=RDR_POS, value=4}
              PduRDestPduPduRBswModulesRef = Dcm if post-build-variant-condition{matching-criterion=RDR_POS, value=6}
              PduRDestPduPduRBswModulesRef = Dcm if post-build-variant-condition{matching-criterion=RDR_POS, value=0}
              PduRDestPduPduRBswModulesRef = Dcm if post-build-variant-condition{matching-criterion=RDR_POS, value=3}
            PduRSrcPdu_d6a59fd3 (PduRSrcPdu):
              PduRSourcePduHandleId = 14
              PduRSrcPduDirection = RECEIVE if post-build-variant-condition{matching-criterion=RDR_POS, value=5}
              PduRSrcPduDirection = RECEIVE if post-build-variant-condition{matching-criterion=RDR_POS, value=1}
              PduRSrcPduDirection = RECEIVE if post-build-variant-condition{matching-criterion=RDR_POS, value=3}
              PduRSrcPduDirection = RECEIVE if post-build-variant-condition{matching-criterion=RDR_POS, value=0}
              PduRSrcPduDirection = RECEIVE if post-build-variant-condition{matching-criterion=RDR_POS, value=7}
              PduRSrcPduDirection = RECEIVE if post-build-variant-condition{matching-criterion=RDR_POS, value=2}
              PduRSrcPduDirection = RECEIVE if post-build-variant-condition{matching-criterion=RDR_POS, value=4}
              PduRSrcPduDirection = RECEIVE if post-build-variant-condition{matching-criterion=RDR_POS, value=6}
              PduRSrcPduRef = PCAN_DIAG_REQ_FUNC_PLANT_oPCAN_RADAR_20_c17463fa_Rx
              PduRSrcPduPduRBswModulesRef = CanTp if post-build-variant-condition{matching-criterion=RDR_POS, value=1}
              PduRSrcPduPduRBswModulesRef = CanTp if post-build-variant-condition{matching-criterion=RDR_POS, value=5}
              PduRSrcPduPduRBswModulesRef = CanTp if post-build-variant-condition{matching-criterion=RDR_POS, value=2}
              PduRSrcPduPduRBswModulesRef = CanTp if post-build-variant-condition{matching-criterion=RDR_POS, value=4}
              PduRSrcPduPduRBswModulesRef = CanTp if post-build-variant-condition{matching-criterion=RDR_POS, value=7}
              PduRSrcPduPduRBswModulesRef = CanTp if post-build-variant-condition{matching-criterion=RDR_POS, value=0}
              PduRSrcPduPduRBswModulesRef = CanTp if post-build-variant-condition{matching-criterion=RDR_POS, value=3}
              PduRSrcPduPduRBswModulesRef = CanTp if post-build-variant-condition{matching-criterion=RDR_POS, value=6}
          FR_DIAG_REQ_PHY_OBD1_oVCAN_RADAR_5445ad08_Rx: PduRRoutingPathCommunicationType=TRANSPORT_PROTOCOL if post-build-variant-condition{matching-criterion=RDR_POS, value=3}, PduRRoutingPathCommunicationType=TRANSPORT_PROTOCOL if post-build-variant-condition{matching-criterion=RDR_POS, value=1}, PduRRoutingPathCommunicationType=TRANSPORT_PROTOCOL if post-build-variant-condition{matching-criterion=RDR_POS, value=0}, PduRRoutingPathCommunicationType=TRANSPORT_PROTOCOL if post-build-variant-condition{matching-criterion=RDR_POS, value=7}, PduRRoutingPathCommunicationType=TRANSPORT_PROTOCOL if post-build-variant-condition{matching-criterion=RDR_POS, value=5}, PduRRoutingPathCommunicationType=TRANSPORT_PROTOCOL if post-build-variant-condition{matching-criterion=RDR_POS, value=2}, PduRRoutingPathCommunicationType=TRANSPORT_PROTOCOL if post-build-variant-condition{matching-criterion=RDR_POS, value=4}, PduRRoutingPathCommunicationType=TRANSPORT_PROTOCOL if post-build-variant-condition{matching-criterion=RDR_POS, value=6}, PduRLockRef=PduRLock_PduRExclusiveArea if post-build-variant-condition{matching-criterion=RDR_POS, value=6}, PduRLockRef=PduRLock_PduRExclusiveArea if post-build-variant-condition{matching-criterion=RDR_POS, value=1}, PduRLockRef=PduRLock_PduRExclusiveArea if post-build-variant-condition{matching-criterion=RDR_POS, value=3}, PduRLockRef=PduRLock_PduRExclusiveArea if post-build-variant-condition{matching-criterion=RDR_POS, value=0}, PduRLockRef=PduRLock_PduRExclusiveArea if post-build-variant-condition{matching-criterion=RDR_POS, value=7}, PduRLockRef=PduRLock_PduRExclusiveArea if post-build-variant-condition{matching-criterion=RDR_POS, value=5}, PduRLockRef=PduRLock_PduRExclusiveArea if post-build-variant-condition{matching-criterion=RDR_POS, value=2}, PduRLockRef=PduRLock_PduRExclusiveArea if post-build-variant-condition{matching-criterion=RDR_POS, value=4}
            FR_DIAG_REQ_PHY_OBD1_oVCAN_RADAR_5445ad08_Rx_7bb4cf60_Rx (PduRDestPdu):
              PduRDestPduHandleId = 4
              PduRDestPduDirection = RECEIVE if post-build-variant-condition{matching-criterion=RDR_POS, value=5}
              PduRDestPduDirection = RECEIVE if post-build-variant-condition{matching-criterion=RDR_POS, value=1}
              PduRDestPduDirection = RECEIVE if post-build-variant-condition{matching-criterion=RDR_POS, value=3}
              PduRDestPduDirection = RECEIVE if post-build-variant-condition{matching-criterion=RDR_POS, value=0}
              PduRDestPduDirection = RECEIVE if post-build-variant-condition{matching-criterion=RDR_POS, value=7}
              PduRDestPduDirection = RECEIVE if post-build-variant-condition{matching-criterion=RDR_POS, value=2}
              PduRDestPduDirection = RECEIVE if post-build-variant-condition{matching-criterion=RDR_POS, value=4}
              PduRDestPduDirection = RECEIVE if post-build-variant-condition{matching-criterion=RDR_POS, value=6}
              PduRDestPduRoutingType = API_FORWARDING if post-build-variant-condition{matching-criterion=RDR_POS, value=4}
              PduRDestPduRoutingType = API_FORWARDING if post-build-variant-condition{matching-criterion=RDR_POS, value=1}
              PduRDestPduRoutingType = API_FORWARDING if post-build-variant-condition{matching-criterion=RDR_POS, value=3}
              PduRDestPduRoutingType = API_FORWARDING if post-build-variant-condition{matching-criterion=RDR_POS, value=0}
              PduRDestPduRoutingType = API_FORWARDING if post-build-variant-condition{matching-criterion=RDR_POS, value=7}
              PduRDestPduRoutingType = API_FORWARDING if post-build-variant-condition{matching-criterion=RDR_POS, value=5}
              PduRDestPduRoutingType = API_FORWARDING if post-build-variant-condition{matching-criterion=RDR_POS, value=2}
              PduRDestPduRoutingType = API_FORWARDING if post-build-variant-condition{matching-criterion=RDR_POS, value=6}
              PduRDestPduDataProcessing = IMMEDIATE
              PduRPduLengthHandlingStrategy = UNUSED
              PduRDestPduCrossPartitionDestination = false
              PduRDestPduRef = FR_DIAG_REQ_PHY_OBD1_oVCAN_RADAR_83827d3f_Rx
              PduRDestPduPduRBswModulesRef = Dcm if post-build-variant-condition{matching-criterion=RDR_POS, value=5}
              PduRDestPduPduRBswModulesRef = Dcm if post-build-variant-condition{matching-criterion=RDR_POS, value=4}
              PduRDestPduPduRBswModulesRef = Dcm if post-build-variant-condition{matching-criterion=RDR_POS, value=6}
              PduRDestPduPduRBswModulesRef = Dcm if post-build-variant-condition{matching-criterion=RDR_POS, value=2}
              PduRDestPduPduRBswModulesRef = Dcm if post-build-variant-condition{matching-criterion=RDR_POS, value=7}
              PduRDestPduPduRBswModulesRef = Dcm if post-build-variant-condition{matching-criterion=RDR_POS, value=1}
              PduRDestPduPduRBswModulesRef = Dcm if post-build-variant-condition{matching-criterion=RDR_POS, value=0}
              PduRDestPduPduRBswModulesRef = Dcm if post-build-variant-condition{matching-criterion=RDR_POS, value=3}
            PduRSrcPdu_7bb4cf60 (PduRSrcPdu):
              PduRSourcePduHandleId = 4
              PduRSrcPduDirection = RECEIVE if post-build-variant-condition{matching-criterion=RDR_POS, value=2}
              PduRSrcPduDirection = RECEIVE if post-build-variant-condition{matching-criterion=RDR_POS, value=1}
              PduRSrcPduDirection = RECEIVE if post-build-variant-condition{matching-criterion=RDR_POS, value=3}
              PduRSrcPduDirection = RECEIVE if post-build-variant-condition{matching-criterion=RDR_POS, value=0}
              PduRSrcPduDirection = RECEIVE if post-build-variant-condition{matching-criterion=RDR_POS, value=5}
              PduRSrcPduDirection = RECEIVE if post-build-variant-condition{matching-criterion=RDR_POS, value=7}
              PduRSrcPduDirection = RECEIVE if post-build-variant-condition{matching-criterion=RDR_POS, value=4}
              PduRSrcPduDirection = RECEIVE if post-build-variant-condition{matching-criterion=RDR_POS, value=6}
              PduRSrcPduRef = FR_DIAG_REQ_PHY_OBD1_oVCAN_RADAR_5445ad08_Rx
              PduRSrcPduPduRBswModulesRef = CanTp if post-build-variant-condition{matching-criterion=RDR_POS, value=5}
              PduRSrcPduPduRBswModulesRef = CanTp if post-build-variant-condition{matching-criterion=RDR_POS, value=6}
              PduRSrcPduPduRBswModulesRef = CanTp if post-build-variant-condition{matching-criterion=RDR_POS, value=0}
              PduRSrcPduPduRBswModulesRef = CanTp if post-build-variant-condition{matching-criterion=RDR_POS, value=1}
              PduRSrcPduPduRBswModulesRef = CanTp if post-build-variant-condition{matching-criterion=RDR_POS, value=7}
              PduRSrcPduPduRBswModulesRef = CanTp if post-build-variant-condition{matching-criterion=RDR_POS, value=4}
              PduRSrcPduPduRBswModulesRef = CanTp if post-build-variant-condition{matching-criterion=RDR_POS, value=3}
              PduRSrcPduPduRBswModulesRef = CanTp if post-build-variant-condition{matching-criterion=RDR_POS, value=2}
          SR1_DIAG_RES_PHY_OBD1_oVCAN_RADAR_aa3541fd_Tx: PduRRoutingPathCommunicationType=COMMUNICATION_INTERFACE if post-build-variant-condition{matching-criterion=RDR_POS, value=6}, PduRRoutingPathCommunicationType=COMMUNICATION_INTERFACE if post-build-variant-condition{matching-criterion=RDR_POS, value=1}, PduRRoutingPathCommunicationType=COMMUNICATION_INTERFACE if post-build-variant-condition{matching-criterion=RDR_POS, value=3}, PduRRoutingPathCommunicationType=COMMUNICATION_INTERFACE if post-build-variant-condition{matching-criterion=RDR_POS, value=0}, PduRRoutingPathCommunicationType=COMMUNICATION_INTERFACE if post-build-variant-condition{matching-criterion=RDR_POS, value=7}, PduRRoutingPathCommunicationType=COMMUNICATION_INTERFACE if post-build-variant-condition{matching-criterion=RDR_POS, value=5}, PduRRoutingPathCommunicationType=COMMUNICATION_INTERFACE if post-build-variant-condition{matching-criterion=RDR_POS, value=2}, PduRRoutingPathCommunicationType=COMMUNICATION_INTERFACE if post-build-variant-condition{matching-criterion=RDR_POS, value=4}, PduRLockRef=PduRLock_PduRExclusiveArea if post-build-variant-condition{matching-criterion=RDR_POS, value=5}, PduRLockRef=PduRLock_PduRExclusiveArea if post-build-variant-condition{matching-criterion=RDR_POS, value=0}, PduRLockRef=PduRLock_PduRExclusiveArea if post-build-variant-condition{matching-criterion=RDR_POS, value=7}, PduRLockRef=PduRLock_PduRExclusiveArea if post-build-variant-condition{matching-criterion=RDR_POS, value=6}, PduRLockRef=PduRLock_PduRExclusiveArea if post-build-variant-condition{matching-criterion=RDR_POS, value=4}, PduRLockRef=PduRLock_PduRExclusiveArea if post-build-variant-condition{matching-criterion=RDR_POS, value=1}, PduRLockRef=PduRLock_PduRExclusiveArea if post-build-variant-condition{matching-criterion=RDR_POS, value=3}, PduRLockRef=PduRLock_PduRExclusiveArea if post-build-variant-condition{matching-criterion=RDR_POS, value=2}
            SR1_DIAG_RES_PHY_OBD1_oVCAN_RADAR_6638d82d_Tx (PduRDestPdu):
              PduRDestPduHandleId = 190
              PduRDestPduDirection = TRANSMIT if post-build-variant-condition{matching-criterion=RDR_POS, value=6}
              PduRDestPduDirection = TRANSMIT if post-build-variant-condition{matching-criterion=RDR_POS, value=1}
              PduRDestPduDirection = TRANSMIT if post-build-variant-condition{matching-criterion=RDR_POS, value=3}
              PduRDestPduDirection = TRANSMIT if post-build-variant-condition{matching-criterion=RDR_POS, value=0}
              PduRDestPduDirection = TRANSMIT if post-build-variant-condition{matching-criterion=RDR_POS, value=7}
              PduRDestPduDirection = TRANSMIT if post-build-variant-condition{matching-criterion=RDR_POS, value=5}
              PduRDestPduDirection = TRANSMIT if post-build-variant-condition{matching-criterion=RDR_POS, value=2}
              PduRDestPduDirection = TRANSMIT if post-build-variant-condition{matching-criterion=RDR_POS, value=4}
              PduRDestPduRoutingType = GATEWAY_ROUTING if post-build-variant-condition{matching-criterion=RDR_POS, value=5}
              PduRDestPduRoutingType = GATEWAY_ROUTING if post-build-variant-condition{matching-criterion=RDR_POS, value=0}
              PduRDestPduRoutingType = GATEWAY_ROUTING if post-build-variant-condition{matching-criterion=RDR_POS, value=7}
              PduRDestPduRoutingType = GATEWAY_ROUTING if post-build-variant-condition{matching-criterion=RDR_POS, value=6}
              PduRDestPduRoutingType = GATEWAY_ROUTING if post-build-variant-condition{matching-criterion=RDR_POS, value=4}
              PduRDestPduRoutingType = GATEWAY_ROUTING if post-build-variant-condition{matching-criterion=RDR_POS, value=1}
              PduRDestPduRoutingType = GATEWAY_ROUTING if post-build-variant-condition{matching-criterion=RDR_POS, value=3}
              PduRDestPduRoutingType = GATEWAY_ROUTING if post-build-variant-condition{matching-criterion=RDR_POS, value=2}
              PduRDestPduDataProcessing = IMMEDIATE
              PduRPduLengthHandlingStrategy = IGNORE
              PduRDestPduCrossPartitionDestination = false
              PduRTransmissionConfirmation = false
              PduRDestPduDataProvision = PDUR_DIRECT
              PduRDestPduRef = SR1_DIAG_RES_PHY_OBD1_oVCAN_RADAR_6638d82d_Tx
              PduRDestPduPduRBswModulesRef = CanIf if post-build-variant-condition{matching-criterion=RDR_POS, value=3}
              PduRDestPduPduRBswModulesRef = CanIf if post-build-variant-condition{matching-criterion=RDR_POS, value=4}
              PduRDestPduPduRBswModulesRef = CanIf if post-build-variant-condition{matching-criterion=RDR_POS, value=2}
              PduRDestPduPduRBswModulesRef = CanIf if post-build-variant-condition{matching-criterion=RDR_POS, value=7}
              PduRDestPduPduRBswModulesRef = CanIf if post-build-variant-condition{matching-criterion=RDR_POS, value=0}
              PduRDestPduPduRBswModulesRef = CanIf if post-build-variant-condition{matching-criterion=RDR_POS, value=6}
              PduRDestPduPduRBswModulesRef = CanIf if post-build-variant-condition{matching-criterion=RDR_POS, value=5}
              PduRDestPduPduRBswModulesRef = CanIf if post-build-variant-condition{matching-criterion=RDR_POS, value=1}
            PduRSrcPdu_5e07bf6a_001 (PduRSrcPdu):
              PduRSourcePduHandleId = 69
              PduRSrcPduDirection = RECEIVE if post-build-variant-condition{matching-criterion=RDR_POS, value=5}
              PduRSrcPduDirection = RECEIVE if post-build-variant-condition{matching-criterion=RDR_POS, value=0}
              PduRSrcPduDirection = RECEIVE if post-build-variant-condition{matching-criterion=RDR_POS, value=7}
              PduRSrcPduDirection = RECEIVE if post-build-variant-condition{matching-criterion=RDR_POS, value=6}
              PduRSrcPduDirection = RECEIVE if post-build-variant-condition{matching-criterion=RDR_POS, value=4}
              PduRSrcPduDirection = RECEIVE if post-build-variant-condition{matching-criterion=RDR_POS, value=1}
              PduRSrcPduDirection = RECEIVE if post-build-variant-condition{matching-criterion=RDR_POS, value=3}
              PduRSrcPduDirection = RECEIVE if post-build-variant-condition{matching-criterion=RDR_POS, value=2}
              PduRSrcPduRef = SRR_FL_DIAG_RESP_PHYS_OBD1_Rx_oPCAN_RADAR_1a7b5ebf_Rx
              PduRSrcPduPduRBswModulesRef = CanIf if post-build-variant-condition{matching-criterion=RDR_POS, value=6}
              PduRSrcPduPduRBswModulesRef = CanIf if post-build-variant-condition{matching-criterion=RDR_POS, value=1}
              PduRSrcPduPduRBswModulesRef = CanIf if post-build-variant-condition{matching-criterion=RDR_POS, value=2}
              PduRSrcPduPduRBswModulesRef = CanIf if post-build-variant-condition{matching-criterion=RDR_POS, value=0}
              PduRSrcPduPduRBswModulesRef = CanIf if post-build-variant-condition{matching-criterion=RDR_POS, value=7}
              PduRSrcPduPduRBswModulesRef = CanIf if post-build-variant-condition{matching-criterion=RDR_POS, value=4}
              PduRSrcPduPduRBswModulesRef = CanIf if post-build-variant-condition{matching-criterion=RDR_POS, value=3}
              PduRSrcPduPduRBswModulesRef = CanIf if post-build-variant-condition{matching-criterion=RDR_POS, value=5}
          PCAN_DIAG_RESP_PHYS_OTA_oPCAN_RADAR_4fa3c8f0_Tx: PduRRoutingPathCommunicationType=TRANSPORT_PROTOCOL if post-build-variant-condition{matching-criterion=RDR_POS, value=7}, PduRRoutingPathCommunicationType=TRANSPORT_PROTOCOL if post-build-variant-condition{matching-criterion=RDR_POS, value=1}, PduRRoutingPathCommunicationType=TRANSPORT_PROTOCOL if post-build-variant-condition{matching-criterion=RDR_POS, value=3}, PduRRoutingPathCommunicationType=TRANSPORT_PROTOCOL if post-build-variant-condition{matching-criterion=RDR_POS, value=0}, PduRRoutingPathCommunicationType=TRANSPORT_PROTOCOL if post-build-variant-condition{matching-criterion=RDR_POS, value=5}, PduRRoutingPathCommunicationType=TRANSPORT_PROTOCOL if post-build-variant-condition{matching-criterion=RDR_POS, value=2}, PduRRoutingPathCommunicationType=TRANSPORT_PROTOCOL if post-build-variant-condition{matching-criterion=RDR_POS, value=4}, PduRRoutingPathCommunicationType=TRANSPORT_PROTOCOL if post-build-variant-condition{matching-criterion=RDR_POS, value=6}, PduRLockRef=PduRLock_PduRExclusiveArea if post-build-variant-condition{matching-criterion=RDR_POS, value=6}, PduRLockRef=PduRLock_PduRExclusiveArea if post-build-variant-condition{matching-criterion=RDR_POS, value=1}, PduRLockRef=PduRLock_PduRExclusiveArea if post-build-variant-condition{matching-criterion=RDR_POS, value=3}, PduRLockRef=PduRLock_PduRExclusiveArea if post-build-variant-condition{matching-criterion=RDR_POS, value=0}, PduRLockRef=PduRLock_PduRExclusiveArea if post-build-variant-condition{matching-criterion=RDR_POS, value=7}, PduRLockRef=PduRLock_PduRExclusiveArea if post-build-variant-condition{matching-criterion=RDR_POS, value=5}, PduRLockRef=PduRLock_PduRExclusiveArea if post-build-variant-condition{matching-criterion=RDR_POS, value=2}, PduRLockRef=PduRLock_PduRExclusiveArea if post-build-variant-condition{matching-criterion=RDR_POS, value=4}
            PCAN_DIAG_RESP_PHYS_OTA_oPCAN_RADAR_2a569d3c_Tx (PduRDestPdu):
              PduRDestPduHandleId = 9
              PduRDestPduDirection = TRANSMIT if post-build-variant-condition{matching-criterion=RDR_POS, value=4}
              PduRDestPduDirection = TRANSMIT if post-build-variant-condition{matching-criterion=RDR_POS, value=1}
              PduRDestPduDirection = TRANSMIT if post-build-variant-condition{matching-criterion=RDR_POS, value=3}
              PduRDestPduDirection = TRANSMIT if post-build-variant-condition{matching-criterion=RDR_POS, value=0}
              PduRDestPduDirection = TRANSMIT if post-build-variant-condition{matching-criterion=RDR_POS, value=7}
              PduRDestPduDirection = TRANSMIT if post-build-variant-condition{matching-criterion=RDR_POS, value=5}
              PduRDestPduDirection = TRANSMIT if post-build-variant-condition{matching-criterion=RDR_POS, value=2}
              PduRDestPduDirection = TRANSMIT if post-build-variant-condition{matching-criterion=RDR_POS, value=6}
              PduRDestPduRoutingType = API_FORWARDING if post-build-variant-condition{matching-criterion=RDR_POS, value=1}
              PduRDestPduRoutingType = API_FORWARDING if post-build-variant-condition{matching-criterion=RDR_POS, value=3}
              PduRDestPduRoutingType = API_FORWARDING if post-build-variant-condition{matching-criterion=RDR_POS, value=0}
              PduRDestPduRoutingType = API_FORWARDING if post-build-variant-condition{matching-criterion=RDR_POS, value=7}
              PduRDestPduRoutingType = API_FORWARDING if post-build-variant-condition{matching-criterion=RDR_POS, value=5}
              PduRDestPduRoutingType = API_FORWARDING if post-build-variant-condition{matching-criterion=RDR_POS, value=2}
              PduRDestPduRoutingType = API_FORWARDING if post-build-variant-condition{matching-criterion=RDR_POS, value=4}
              PduRDestPduRoutingType = API_FORWARDING if post-build-variant-condition{matching-criterion=RDR_POS, value=6}
              PduRDestPduDataProcessing = IMMEDIATE
              PduRPduLengthHandlingStrategy = UNUSED
              PduRDestPduCrossPartitionDestination = false
              PduRDestPduRef = PCAN_DIAG_RESP_PHYS_OTA_oPCAN_RADAR_2a569d3c_Tx
              PduRDestPduPduRBswModulesRef = CanTp if post-build-variant-condition{matching-criterion=RDR_POS, value=7}
              PduRDestPduPduRBswModulesRef = CanTp if post-build-variant-condition{matching-criterion=RDR_POS, value=3}
              PduRDestPduPduRBswModulesRef = CanTp if post-build-variant-condition{matching-criterion=RDR_POS, value=0}
              PduRDestPduPduRBswModulesRef = CanTp if post-build-variant-condition{matching-criterion=RDR_POS, value=4}
              PduRDestPduPduRBswModulesRef = CanTp if post-build-variant-condition{matching-criterion=RDR_POS, value=6}
              PduRDestPduPduRBswModulesRef = CanTp if post-build-variant-condition{matching-criterion=RDR_POS, value=2}
              PduRDestPduPduRBswModulesRef = CanTp if post-build-variant-condition{matching-criterion=RDR_POS, value=5}
              PduRDestPduPduRBswModulesRef = CanTp if post-build-variant-condition{matching-criterion=RDR_POS, value=1}
            PduRSrcPdu_c06d99da (PduRSrcPdu):
              PduRSourcePduHandleId = 11
              PduRSrcPduDirection = TRANSMIT if post-build-variant-condition{matching-criterion=RDR_POS, value=0}
              PduRSrcPduDirection = TRANSMIT if post-build-variant-condition{matching-criterion=RDR_POS, value=1}
              PduRSrcPduDirection = TRANSMIT if post-build-variant-condition{matching-criterion=RDR_POS, value=3}
              PduRSrcPduDirection = TRANSMIT if post-build-variant-condition{matching-criterion=RDR_POS, value=7}
              PduRSrcPduDirection = TRANSMIT if post-build-variant-condition{matching-criterion=RDR_POS, value=5}
              PduRSrcPduDirection = TRANSMIT if post-build-variant-condition{matching-criterion=RDR_POS, value=2}
              PduRSrcPduDirection = TRANSMIT if post-build-variant-condition{matching-criterion=RDR_POS, value=4}
              PduRSrcPduDirection = TRANSMIT if post-build-variant-condition{matching-criterion=RDR_POS, value=6}
              PduRSrcPduRef = PCAN_DIAG_RESP_PHYS_OTA_oPCAN_RADAR_4fa3c8f0_Tx
              PduRSrcPduPduRBswModulesRef = Dcm if post-build-variant-condition{matching-criterion=RDR_POS, value=6}
              PduRSrcPduPduRBswModulesRef = Dcm if post-build-variant-condition{matching-criterion=RDR_POS, value=3}
              PduRSrcPduPduRBswModulesRef = Dcm if post-build-variant-condition{matching-criterion=RDR_POS, value=5}
              PduRSrcPduPduRBswModulesRef = Dcm if post-build-variant-condition{matching-criterion=RDR_POS, value=7}
              PduRSrcPduPduRBswModulesRef = Dcm if post-build-variant-condition{matching-criterion=RDR_POS, value=2}
              PduRSrcPduPduRBswModulesRef = Dcm if post-build-variant-condition{matching-criterion=RDR_POS, value=0}
              PduRSrcPduPduRBswModulesRef = Dcm if post-build-variant-condition{matching-criterion=RDR_POS, value=4}
              PduRSrcPduPduRBswModulesRef = Dcm if post-build-variant-condition{matching-criterion=RDR_POS, value=1}
          RDR_FUSION_ALIGNMENT_STATUS_002_oPCAN_RADAR_b952d80d_Rx: PduRRoutingPathCommunicationType=COMMUNICATION_INTERFACE if post-build-variant-condition{matching-criterion=RDR_POS, value=6}, PduRRoutingPathCommunicationType=COMMUNICATION_INTERFACE if post-build-variant-condition{matching-criterion=RDR_POS, value=1}, PduRRoutingPathCommunicationType=COMMUNICATION_INTERFACE if post-build-variant-condition{matching-criterion=RDR_POS, value=3}, PduRRoutingPathCommunicationType=COMMUNICATION_INTERFACE if post-build-variant-condition{matching-criterion=RDR_POS, value=0}, PduRRoutingPathCommunicationType=COMMUNICATION_INTERFACE if post-build-variant-condition{matching-criterion=RDR_POS, value=7}, PduRRoutingPathCommunicationType=COMMUNICATION_INTERFACE if post-build-variant-condition{matching-criterion=RDR_POS, value=5}, PduRRoutingPathCommunicationType=COMMUNICATION_INTERFACE if post-build-variant-condition{matching-criterion=RDR_POS, value=2}, PduRRoutingPathCommunicationType=COMMUNICATION_INTERFACE if post-build-variant-condition{matching-criterion=RDR_POS, value=4}, PduRLockRef=PduRLock_PduRExclusiveArea if post-build-variant-condition{matching-criterion=RDR_POS, value=6}, PduRLockRef=PduRLock_PduRExclusiveArea if post-build-variant-condition{matching-criterion=RDR_POS, value=1}, PduRLockRef=PduRLock_PduRExclusiveArea if post-build-variant-condition{matching-criterion=RDR_POS, value=3}, PduRLockRef=PduRLock_PduRExclusiveArea if post-build-variant-condition{matching-criterion=RDR_POS, value=0}, PduRLockRef=PduRLock_PduRExclusiveArea if post-build-variant-condition{matching-criterion=RDR_POS, value=7}, PduRLockRef=PduRLock_PduRExclusiveArea if post-build-variant-condition{matching-criterion=RDR_POS, value=5}, PduRLockRef=PduRLock_PduRExclusiveArea if post-build-variant-condition{matching-criterion=RDR_POS, value=2}, PduRLockRef=PduRLock_PduRExclusiveArea if post-build-variant-condition{matching-criterion=RDR_POS, value=4}
            PduRSrcPdu_bbc5f648 (PduRSrcPdu):
              PduRSourcePduHandleId = 27
              PduRSrcPduDirection = RECEIVE if post-build-variant-condition{matching-criterion=RDR_POS, value=4}
              PduRSrcPduDirection = RECEIVE if post-build-variant-condition{matching-criterion=RDR_POS, value=1}
              PduRSrcPduDirection = RECEIVE if post-build-variant-condition{matching-criterion=RDR_POS, value=3}
              PduRSrcPduDirection = RECEIVE if post-build-variant-condition{matching-criterion=RDR_POS, value=0}
              PduRSrcPduDirection = RECEIVE if post-build-variant-condition{matching-criterion=RDR_POS, value=7}
              PduRSrcPduDirection = RECEIVE if post-build-variant-condition{matching-criterion=RDR_POS, value=5}
              PduRSrcPduDirection = RECEIVE if post-build-variant-condition{matching-criterion=RDR_POS, value=2}
              PduRSrcPduDirection = RECEIVE if post-build-variant-condition{matching-criterion=RDR_POS, value=6}
              PduRSrcPduRef = RDR_FUSION_ALIGNMENT_STATUS_002_oPCAN_RADAR_b952d80d_Rx
              PduRSrcPduPduRBswModulesRef = CanIf if post-build-variant-condition{matching-criterion=RDR_POS, value=4}
              PduRSrcPduPduRBswModulesRef = CanIf if post-build-variant-condition{matching-criterion=RDR_POS, value=6}
              PduRSrcPduPduRBswModulesRef = CanIf if post-build-variant-condition{matching-criterion=RDR_POS, value=5}
              PduRSrcPduPduRBswModulesRef = CanIf if post-build-variant-condition{matching-criterion=RDR_POS, value=1}
              PduRSrcPduPduRBswModulesRef = CanIf if post-build-variant-condition{matching-criterion=RDR_POS, value=0}
              PduRSrcPduPduRBswModulesRef = CanIf if post-build-variant-condition{matching-criterion=RDR_POS, value=3}
              PduRSrcPduPduRBswModulesRef = CanIf if post-build-variant-condition{matching-criterion=RDR_POS, value=2}
              PduRSrcPduPduRBswModulesRef = CanIf if post-build-variant-condition{matching-criterion=RDR_POS, value=7}
            RDR_FUSION_ALIGNMENT_STATUS_002_oPCAN_RADAR_b952d80d_Rx_bbc5f648_Rx (PduRDestPdu):
              PduRDestPduHandleId = 20
              PduRDestPduDirection = RECEIVE if post-build-variant-condition{matching-criterion=RDR_POS, value=3}
              PduRDestPduDirection = RECEIVE if post-build-variant-condition{matching-criterion=RDR_POS, value=1}
              PduRDestPduDirection = RECEIVE if post-build-variant-condition{matching-criterion=RDR_POS, value=0}
              PduRDestPduDirection = RECEIVE if post-build-variant-condition{matching-criterion=RDR_POS, value=7}
              PduRDestPduDirection = RECEIVE if post-build-variant-condition{matching-criterion=RDR_POS, value=5}
              PduRDestPduDirection = RECEIVE if post-build-variant-condition{matching-criterion=RDR_POS, value=2}
              PduRDestPduDirection = RECEIVE if post-build-variant-condition{matching-criterion=RDR_POS, value=4}
              PduRDestPduDirection = RECEIVE if post-build-variant-condition{matching-criterion=RDR_POS, value=6}
              PduRDestPduRoutingType = API_FORWARDING if post-build-variant-condition{matching-criterion=RDR_POS, value=0}
              PduRDestPduRoutingType = API_FORWARDING if post-build-variant-condition{matching-criterion=RDR_POS, value=1}
              PduRDestPduRoutingType = API_FORWARDING if post-build-variant-condition{matching-criterion=RDR_POS, value=3}
              PduRDestPduRoutingType = API_FORWARDING if post-build-variant-condition{matching-criterion=RDR_POS, value=7}
              PduRDestPduRoutingType = API_FORWARDING if post-build-variant-condition{matching-criterion=RDR_POS, value=5}
              PduRDestPduRoutingType = API_FORWARDING if post-build-variant-condition{matching-criterion=RDR_POS, value=2}
              PduRDestPduRoutingType = API_FORWARDING if post-build-variant-condition{matching-criterion=RDR_POS, value=4}
              PduRDestPduRoutingType = API_FORWARDING if post-build-variant-condition{matching-criterion=RDR_POS, value=6}
              PduRDestPduDataProcessing = IMMEDIATE
              PduRPduLengthHandlingStrategy = IGNORE
              PduRDestPduCrossPartitionDestination = false
              PduRTransmissionConfirmation = false
              PduRDestPduRef = RDR_FUSION_ALIGNMENT_STATUS_002_oPCAN_RADAR_e1715b9f_Rx
              PduRDestPduPduRBswModulesRef = Com if post-build-variant-condition{matching-criterion=RDR_POS, value=6}
              PduRDestPduPduRBswModulesRef = Com if post-build-variant-condition{matching-criterion=RDR_POS, value=2}
              PduRDestPduPduRBswModulesRef = Com if post-build-variant-condition{matching-criterion=RDR_POS, value=5}
              PduRDestPduPduRBswModulesRef = Com if post-build-variant-condition{matching-criterion=RDR_POS, value=1}
              PduRDestPduPduRBswModulesRef = Com if post-build-variant-condition{matching-criterion=RDR_POS, value=0}
              PduRDestPduPduRBswModulesRef = Com if post-build-variant-condition{matching-criterion=RDR_POS, value=7}
              PduRDestPduPduRBswModulesRef = Com if post-build-variant-condition{matching-criterion=RDR_POS, value=4}
              PduRDestPduPduRBswModulesRef = Com if post-build-variant-condition{matching-criterion=RDR_POS, value=3}
          SR2_DIAG_REQ_PHY_PLANT_oVCAN_RADAR_ae8c8942_Rx: PduRRoutingPathCommunicationType=COMMUNICATION_INTERFACE if post-build-variant-condition{matching-criterion=RDR_POS, value=3}, PduRRoutingPathCommunicationType=COMMUNICATION_INTERFACE if post-build-variant-condition{matching-criterion=RDR_POS, value=1}, PduRRoutingPathCommunicationType=COMMUNICATION_INTERFACE if post-build-variant-condition{matching-criterion=RDR_POS, value=0}, PduRRoutingPathCommunicationType=COMMUNICATION_INTERFACE if post-build-variant-condition{matching-criterion=RDR_POS, value=7}, PduRRoutingPathCommunicationType=COMMUNICATION_INTERFACE if post-build-variant-condition{matching-criterion=RDR_POS, value=5}, PduRRoutingPathCommunicationType=COMMUNICATION_INTERFACE if post-build-variant-condition{matching-criterion=RDR_POS, value=2}, PduRRoutingPathCommunicationType=COMMUNICATION_INTERFACE if post-build-variant-condition{matching-criterion=RDR_POS, value=4}, PduRRoutingPathCommunicationType=COMMUNICATION_INTERFACE if post-build-variant-condition{matching-criterion=RDR_POS, value=6}, PduRLockRef=PduRLock_PduRExclusiveArea if post-build-variant-condition{matching-criterion=RDR_POS, value=4}, PduRLockRef=PduRLock_PduRExclusiveArea if post-build-variant-condition{matching-criterion=RDR_POS, value=0}, PduRLockRef=PduRLock_PduRExclusiveArea if post-build-variant-condition{matching-criterion=RDR_POS, value=7}, PduRLockRef=PduRLock_PduRExclusiveArea if post-build-variant-condition{matching-criterion=RDR_POS, value=6}, PduRLockRef=PduRLock_PduRExclusiveArea if post-build-variant-condition{matching-criterion=RDR_POS, value=1}, PduRLockRef=PduRLock_PduRExclusiveArea if post-build-variant-condition{matching-criterion=RDR_POS, value=3}, PduRLockRef=PduRLock_PduRExclusiveArea if post-build-variant-condition{matching-criterion=RDR_POS, value=2}, PduRLockRef=PduRLock_PduRExclusiveArea if post-build-variant-condition{matching-criterion=RDR_POS, value=5}
            PduRSrcPdu_aa962039 (PduRSrcPdu):
              PduRSourcePduHandleId = 76
              PduRSrcPduDirection = RECEIVE if post-build-variant-condition{matching-criterion=RDR_POS, value=6}
              PduRSrcPduDirection = RECEIVE if post-build-variant-condition{matching-criterion=RDR_POS, value=1}
              PduRSrcPduDirection = RECEIVE if post-build-variant-condition{matching-criterion=RDR_POS, value=3}
              PduRSrcPduDirection = RECEIVE if post-build-variant-condition{matching-criterion=RDR_POS, value=0}
              PduRSrcPduDirection = RECEIVE if post-build-variant-condition{matching-criterion=RDR_POS, value=7}
              PduRSrcPduDirection = RECEIVE if post-build-variant-condition{matching-criterion=RDR_POS, value=5}
              PduRSrcPduDirection = RECEIVE if post-build-variant-condition{matching-criterion=RDR_POS, value=2}
              PduRSrcPduDirection = RECEIVE if post-build-variant-condition{matching-criterion=RDR_POS, value=4}
              PduRSrcPduRef = SR2_DIAG_REQ_PHY_PLANT_oVCAN_RADAR_ae8c8942_Rx
              PduRSrcPduPduRBswModulesRef = CanIf if post-build-variant-condition{matching-criterion=RDR_POS, value=5}
              PduRSrcPduPduRBswModulesRef = CanIf if post-build-variant-condition{matching-criterion=RDR_POS, value=6}
              PduRSrcPduPduRBswModulesRef = CanIf if post-build-variant-condition{matching-criterion=RDR_POS, value=2}
              PduRSrcPduPduRBswModulesRef = CanIf if post-build-variant-condition{matching-criterion=RDR_POS, value=3}
              PduRSrcPduPduRBswModulesRef = CanIf if post-build-variant-condition{matching-criterion=RDR_POS, value=1}
              PduRSrcPduPduRBswModulesRef = CanIf if post-build-variant-condition{matching-criterion=RDR_POS, value=7}
              PduRSrcPduPduRBswModulesRef = CanIf if post-build-variant-condition{matching-criterion=RDR_POS, value=0}
              PduRSrcPduPduRBswModulesRef = CanIf if post-build-variant-condition{matching-criterion=RDR_POS, value=4}
            SRR_RL_DIAG_REQ_PHYS_PLANT_Tx_oPCAN_RADAR_90ff5b50_Tx (PduRDestPdu):
              PduRDestPduHandleId = 205
              PduRDestPduDirection = TRANSMIT if post-build-variant-condition{matching-criterion=RDR_POS, value=4}
              PduRDestPduDirection = TRANSMIT if post-build-variant-condition{matching-criterion=RDR_POS, value=0}
              PduRDestPduDirection = TRANSMIT if post-build-variant-condition{matching-criterion=RDR_POS, value=7}
              PduRDestPduDirection = TRANSMIT if post-build-variant-condition{matching-criterion=RDR_POS, value=6}
              PduRDestPduDirection = TRANSMIT if post-build-variant-condition{matching-criterion=RDR_POS, value=1}
              PduRDestPduDirection = TRANSMIT if post-build-variant-condition{matching-criterion=RDR_POS, value=3}
              PduRDestPduDirection = TRANSMIT if post-build-variant-condition{matching-criterion=RDR_POS, value=2}
              PduRDestPduDirection = TRANSMIT if post-build-variant-condition{matching-criterion=RDR_POS, value=5}
              PduRDestPduRoutingType = GATEWAY_ROUTING if post-build-variant-condition{matching-criterion=RDR_POS, value=4}
              PduRDestPduRoutingType = GATEWAY_ROUTING if post-build-variant-condition{matching-criterion=RDR_POS, value=0}
              PduRDestPduRoutingType = GATEWAY_ROUTING if post-build-variant-condition{matching-criterion=RDR_POS, value=7}
              PduRDestPduRoutingType = GATEWAY_ROUTING if post-build-variant-condition{matching-criterion=RDR_POS, value=6}
              PduRDestPduRoutingType = GATEWAY_ROUTING if post-build-variant-condition{matching-criterion=RDR_POS, value=1}
              PduRDestPduRoutingType = GATEWAY_ROUTING if post-build-variant-condition{matching-criterion=RDR_POS, value=3}
              PduRDestPduRoutingType = GATEWAY_ROUTING if post-build-variant-condition{matching-criterion=RDR_POS, value=2}
              PduRDestPduRoutingType = GATEWAY_ROUTING if post-build-variant-condition{matching-criterion=RDR_POS, value=5}
              PduRDestPduDataProcessing = IMMEDIATE
              PduRPduLengthHandlingStrategy = IGNORE
              PduRDestPduCrossPartitionDestination = false
              PduRTransmissionConfirmation = false
              PduRDestPduDataProvision = PDUR_DIRECT
              PduRDestPduRef = SRR_RL_DIAG_REQ_PHYS_PLANT_Tx_oPCAN_RADAR_90ff5b50_Tx
              PduRDestPduPduRBswModulesRef = CanIf if post-build-variant-condition{matching-criterion=RDR_POS, value=6}
              PduRDestPduPduRBswModulesRef = CanIf if post-build-variant-condition{matching-criterion=RDR_POS, value=3}
              PduRDestPduPduRBswModulesRef = CanIf if post-build-variant-condition{matching-criterion=RDR_POS, value=7}
              PduRDestPduPduRBswModulesRef = CanIf if post-build-variant-condition{matching-criterion=RDR_POS, value=4}
              PduRDestPduPduRBswModulesRef = CanIf if post-build-variant-condition{matching-criterion=RDR_POS, value=5}
              PduRDestPduPduRBswModulesRef = CanIf if post-build-variant-condition{matching-criterion=RDR_POS, value={0..2}}
