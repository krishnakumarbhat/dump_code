[part 4 of 4: package /ActiveEcuC]
AUTOSAR XML (schema 00053)
package /ActiveEcuC  (continued)
  module config PduR: implementation-config-variant=VARIANT-POST-BUILD-SELECTABLE, module-description=PduR_Impl  (continued)
    PduRRoutingTables: PduRConfigurationId=0  (continued)
      PduRRoutingTable  (continued)
        305 x PduRRoutingPath, all with PduRMulticoreRoutingPath=false:  (continued)
          SR2_DIAG_RES_PHY_PLANT_oVCAN_RADAR_bfe81f34_Tx: PduRRoutingPathCommunicationType=COMMUNICATION_INTERFACE if post-build-variant-condition{matching-criterion=RDR_POS, value=5}, PduRRoutingPathCommunicationType=COMMUNICATION_INTERFACE if post-build-variant-condition{matching-criterion=RDR_POS, value=1}, PduRRoutingPathCommunicationType=COMMUNICATION_INTERFACE if post-build-variant-condition{matching-criterion=RDR_POS, value=3}, PduRRoutingPathCommunicationType=COMMUNICATION_INTERFACE if post-build-variant-condition{matching-criterion=RDR_POS, value=0}, PduRRoutingPathCommunicationType=COMMUNICATION_INTERFACE if post-build-variant-condition{matching-criterion=RDR_POS, value=7}, PduRRoutingPathCommunicationType=COMMUNICATION_INTERFACE if post-build-variant-condition{matching-criterion=RDR_POS, value=2}, PduRRoutingPathCommunicationType=COMMUNICATION_INTERFACE if post-build-variant-condition{matching-criterion=RDR_POS, value=4}, PduRRoutingPathCommunicationType=COMMUNICATION_INTERFACE if post-build-variant-condition{matching-criterion=RDR_POS, value=6}, PduRLockRef=PduRLock_PduRExclusiveArea if post-build-variant-condition{matching-criterion=RDR_POS, value=0}, PduRLockRef=PduRLock_PduRExclusiveArea if post-build-variant-condition{matching-criterion=RDR_POS, value=7}, PduRLockRef=PduRLock_PduRExclusiveArea if post-build-variant-condition{matching-criterion=RDR_POS, value=6}, PduRLockRef=PduRLock_PduRExclusiveArea if post-build-variant-condition{matching-criterion=RDR_POS, value=4}, PduRLockRef=PduRLock_PduRExclusiveArea if post-build-variant-condition{matching-criterion=RDR_POS, value=1}, PduRLockRef=PduRLock_PduRExclusiveArea if post-build-variant-condition{matching-criterion=RDR_POS, value=3}, PduRLockRef=PduRLock_PduRExclusiveArea if post-build-variant-condition{matching-criterion=RDR_POS, value=2}, PduRLockRef=PduRLock_PduRExclusiveArea if post-build-variant-condition{matching-criterion=RDR_POS, value=5}
            SR2_DIAG_RES_PHY_PLANT_oVCAN_RADAR_20ab64b4_Tx (PduRDestPdu):
              PduRDestPduHandleId = 197
              PduRDestPduDirection = TRANSMIT if post-build-variant-condition{matching-criterion=RDR_POS, value=7}
              PduRDestPduDirection = TRANSMIT if post-build-variant-condition{matching-criterion=RDR_POS, value=1}
              PduRDestPduDirection = TRANSMIT if post-build-variant-condition{matching-criterion=RDR_POS, value=3}
              PduRDestPduDirection = TRANSMIT if post-build-variant-condition{matching-criterion=RDR_POS, value=0}
              PduRDestPduDirection = TRANSMIT if post-build-variant-condition{matching-criterion=RDR_POS, value=5}
              PduRDestPduDirection = TRANSMIT if post-build-variant-condition{matching-criterion=RDR_POS, value=2}
              PduRDestPduDirection = TRANSMIT if post-build-variant-condition{matching-criterion=RDR_POS, value=4}
              PduRDestPduDirection = TRANSMIT if post-build-variant-condition{matching-criterion=RDR_POS, value=6}
              PduRDestPduRoutingType = GATEWAY_ROUTING if post-build-variant-condition{matching-criterion=RDR_POS, value=2}
              PduRDestPduRoutingType = GATEWAY_ROUTING if post-build-variant-condition{matching-criterion=RDR_POS, value=0}
              PduRDestPduRoutingType = GATEWAY_ROUTING if post-build-variant-condition{matching-criterion=RDR_POS, value=7}
              PduRDestPduRoutingType = GATEWAY_ROUTING if post-build-variant-condition{matching-criterion=RDR_POS, value=6}
              PduRDestPduRoutingType = GATEWAY_ROUTING if post-build-variant-condition{matching-criterion=RDR_POS, value=4}
              PduRDestPduRoutingType = GATEWAY_ROUTING if post-build-variant-condition{matching-criterion=RDR_POS, value=1}
              PduRDestPduRoutingType = GATEWAY_ROUTING if post-build-variant-condition{matching-criterion=RDR_POS, value=3}
              PduRDestPduRoutingType = GATEWAY_ROUTING if post-build-variant-condition{matching-criterion=RDR_POS, value=5}
              PduRDestPduDataProcessing = IMMEDIATE
              PduRPduLengthHandlingStrategy = IGNORE
              PduRDestPduCrossPartitionDestination = false
              PduRDestPduDataProvision = PDUR_DIRECT
              PduRTransmissionConfirmation = false
              PduRDestPduRef = SR2_DIAG_RES_PHY_PLANT_oVCAN_RADAR_20ab64b4_Tx
              PduRDestPduPduRBswModulesRef = CanIf if post-build-variant-condition{matching-criterion=RDR_POS, value=0}
              PduRDestPduPduRBswModulesRef = CanIf if post-build-variant-condition{matching-criterion=RDR_POS, value=7}
              PduRDestPduPduRBswModulesRef = CanIf if post-build-variant-condition{matching-criterion=RDR_POS, value=2}
              PduRDestPduPduRBswModulesRef = CanIf if post-build-variant-condition{matching-criterion=RDR_POS, value=1}
              PduRDestPduPduRBswModulesRef = CanIf if post-build-variant-condition{matching-criterion=RDR_POS, value=5}
              PduRDestPduPduRBswModulesRef = CanIf if post-build-variant-condition{matching-criterion=RDR_POS, value=4}
              PduRDestPduPduRBswModulesRef = CanIf if post-build-variant-condition{matching-criterion=RDR_POS, value=3}
              PduRDestPduPduRBswModulesRef = CanIf if post-build-variant-condition{matching-criterion=RDR_POS, value=6}
            PduRSrcPdu_be0e46e0_001 (PduRSrcPdu):
              PduRSourcePduHandleId = 80
              PduRSrcPduDirection = RECEIVE if post-build-variant-condition{matching-criterion=RDR_POS, value=2}
              PduRSrcPduDirection = RECEIVE if post-build-variant-condition{matching-criterion=RDR_POS, value=0}
              PduRSrcPduDirection = RECEIVE if post-build-variant-condition{matching-criterion=RDR_POS, value=7}
              PduRSrcPduDirection = RECEIVE if post-build-variant-condition{matching-criterion=RDR_POS, value=6}
              PduRSrcPduDirection = RECEIVE if post-build-variant-condition{matching-criterion=RDR_POS, value=4}
              PduRSrcPduDirection = RECEIVE if post-build-variant-condition{matching-criterion=RDR_POS, value=1}
              PduRSrcPduDirection = RECEIVE if post-build-variant-condition{matching-criterion=RDR_POS, value=3}
              PduRSrcPduDirection = RECEIVE if post-build-variant-condition{matching-criterion=RDR_POS, value=5}
              PduRSrcPduRef = SRR_RL_DIAG_RESP_PHYS_PLANT_Rx_oPCAN_RADAR_a4bcd7de_Rx
              PduRSrcPduPduRBswModulesRef = CanIf if post-build-variant-condition{matching-criterion=RDR_POS, value=4}
              PduRSrcPduPduRBswModulesRef = CanIf if post-build-variant-condition{matching-criterion=RDR_POS, value=0}
              PduRSrcPduPduRBswModulesRef = CanIf if post-build-variant-condition{matching-criterion=RDR_POS, value=5}
              PduRSrcPduPduRBswModulesRef = CanIf if post-build-variant-condition{matching-criterion=RDR_POS, value=3}
              PduRSrcPduPduRBswModulesRef = CanIf if post-build-variant-condition{matching-criterion=RDR_POS, value=1}
              PduRSrcPduPduRBswModulesRef = CanIf if post-build-variant-condition{matching-criterion=RDR_POS, value=2}
              PduRSrcPduPduRBswModulesRef = CanIf if post-build-variant-condition{matching-criterion=RDR_POS, value=7}
              PduRSrcPduPduRBswModulesRef = CanIf if post-build-variant-condition{matching-criterion=RDR_POS, value=6}
          PCAN_DIAG_RESP_PHYS_OTA_oPCAN_RADAR_20_aa3008c9_Tx: PduRRoutingPathCommunicationType=TRANSPORT_PROTOCOL if post-build-variant-condition{matching-criterion=RDR_POS, value=3}, PduRRoutingPathCommunicationType=TRANSPORT_PROTOCOL if post-build-variant-condition{matching-criterion=RDR_POS, value=1}, PduRRoutingPathCommunicationType=TRANSPORT_PROTOCOL if post-build-variant-condition{matching-criterion=RDR_POS, value=0}, PduRRoutingPathCommunicationType=TRANSPORT_PROTOCOL if post-build-variant-condition{matching-criterion=RDR_POS, value=7}, PduRRoutingPathCommunicationType=TRANSPORT_PROTOCOL if post-build-variant-condition{matching-criterion=RDR_POS, value=5}, PduRRoutingPathCommunicationType=TRANSPORT_PROTOCOL if post-build-variant-condition{matching-criterion=RDR_POS, value=2}, PduRRoutingPathCommunicationType=TRANSPORT_PROTOCOL if post-build-variant-condition{matching-criterion=RDR_POS, value=4}, PduRRoutingPathCommunicationType=TRANSPORT_PROTOCOL if post-build-variant-condition{matching-criterion=RDR_POS, value=6}, PduRLockRef=PduRLock_PduRExclusiveArea if post-build-variant-condition{matching-criterion=RDR_POS, value=6}, PduRLockRef=PduRLock_PduRExclusiveArea if post-build-variant-condition{matching-criterion=RDR_POS, value=1}, PduRLockRef=PduRLock_PduRExclusiveArea if post-build-variant-condition{matching-criterion=RDR_POS, value=3}, PduRLockRef=PduRLock_PduRExclusiveArea if post-build-variant-condition{matching-criterion=RDR_POS, value=0}, PduRLockRef=PduRLock_PduRExclusiveArea if post-build-variant-condition{matching-criterion=RDR_POS, value=7}, PduRLockRef=PduRLock_PduRExclusiveArea if post-build-variant-condition{matching-criterion=RDR_POS, value=5}, PduRLockRef=PduRLock_PduRExclusiveArea if post-build-variant-condition{matching-criterion=RDR_POS, value=2}, PduRLockRef=PduRLock_PduRExclusiveArea if post-build-variant-condition{matching-criterion=RDR_POS, value=4}
            PCAN_DIAG_RESP_PHYS_OTA_oPCAN_RADAR_20_a840a80f_Tx (PduRDestPdu):
              PduRDestPduHandleId = 10
              PduRDestPduDirection = TRANSMIT if post-build-variant-condition{matching-criterion=RDR_POS, value=7}
              PduRDestPduDirection = TRANSMIT if post-build-variant-condition{matching-criterion=RDR_POS, value=1}
              PduRDestPduDirection = TRANSMIT if post-build-variant-condition{matching-criterion=RDR_POS, value=3}
              PduRDestPduDirection = TRANSMIT if post-build-variant-condition{matching-criterion=RDR_POS, value=0}
              PduRDestPduDirection = TRANSMIT if post-build-variant-condition{matching-criterion=RDR_POS, value=5}
              PduRDestPduDirection = TRANSMIT if post-build-variant-condition{matching-criterion=RDR_POS, value=2}
              PduRDestPduDirection = TRANSMIT if post-build-variant-condition{matching-criterion=RDR_POS, value=4}
              PduRDestPduDirection = TRANSMIT if post-build-variant-condition{matching-criterion=RDR_POS, value=6}
              PduRDestPduRoutingType = API_FORWARDING if post-build-variant-condition{matching-criterion=RDR_POS, value=1}
              PduRDestPduRoutingType = API_FORWARDING if post-build-variant-condition{matching-criterion=RDR_POS, value=3}
              PduRDestPduRoutingType = API_FORWARDING if post-build-variant-condition{matching-criterion=RDR_POS, value=0}
              PduRDestPduRoutingType = API_FORWARDING if post-build-variant-condition{matching-criterion=RDR_POS, value=7}
              PduRDestPduRoutingType = API_FORWARDING if post-build-variant-condition{matching-criterion=RDR_POS, value=5}
              PduRDestPduRoutingType = API_FORWARDING if post-build-variant-condition{matching-criterion=RDR_POS, value=2}
              PduRDestPduRoutingType = API_FORWARDING if post-build-variant-condition{matching-criterion=RDR_POS, value=4}
              PduRDestPduRoutingType = API_FORWARDING if post-build-variant-condition{matching-criterion=RDR_POS, value=6}
              PduRDestPduDataProcessing = IMMEDIATE
              PduRPduLengthHandlingStrategy = UNUSED
              PduRDestPduCrossPartitionDestination = false
              PduRDestPduRef = PCAN_DIAG_RESP_PHYS_OTA_oPCAN_RADAR_20_a840a80f_Tx
              PduRDestPduPduRBswModulesRef = CanTp if post-build-variant-condition{matching-criterion=RDR_POS, value=0}
              PduRDestPduPduRBswModulesRef = CanTp if post-build-variant-condition{matching-criterion=RDR_POS, value=3}
              PduRDestPduPduRBswModulesRef = CanTp if post-build-variant-condition{matching-criterion=RDR_POS, value=6}
              PduRDestPduPduRBswModulesRef = CanTp if post-build-variant-condition{matching-criterion=RDR_POS, value=2}
              PduRDestPduPduRBswModulesRef = CanTp if post-build-variant-condition{matching-criterion=RDR_POS, value=7}
              PduRDestPduPduRBswModulesRef = CanTp if post-build-variant-condition{matching-criterion=RDR_POS, value=5}
              PduRDestPduPduRBswModulesRef = CanTp if post-build-variant-condition{matching-criterion=RDR_POS, value=1}
              PduRDestPduPduRBswModulesRef = CanTp if post-build-variant-condition{matching-criterion=RDR_POS, value=4}
            PduRSrcPdu_b7e0bf39 (PduRSrcPdu):
              PduRSourcePduHandleId = 12
              PduRSrcPduDirection = TRANSMIT if post-build-variant-condition{matching-criterion=RDR_POS, value=6}
              PduRSrcPduDirection = TRANSMIT if post-build-variant-condition{matching-criterion=RDR_POS, value=1}
              PduRSrcPduDirection = TRANSMIT if post-build-variant-condition{matching-criterion=RDR_POS, value=3}
              PduRSrcPduDirection = TRANSMIT if post-build-variant-condition{matching-criterion=RDR_POS, value=0}
              PduRSrcPduDirection = TRANSMIT if post-build-variant-condition{matching-criterion=RDR_POS, value=7}
              PduRSrcPduDirection = TRANSMIT if post-build-variant-condition{matching-criterion=RDR_POS, value=5}
              PduRSrcPduDirection = TRANSMIT if post-build-variant-condition{matching-criterion=RDR_POS, value=2}
              PduRSrcPduDirection = TRANSMIT if post-build-variant-condition{matching-criterion=RDR_POS, value=4}
              PduRSrcPduRef = PCAN_DIAG_RESP_PHYS_OTA_oPCAN_RADAR_20_aa3008c9_Tx
              PduRSrcPduPduRBswModulesRef = Dcm if post-build-variant-condition{matching-criterion=RDR_POS, value=5}
              PduRSrcPduPduRBswModulesRef = Dcm if post-build-variant-condition{matching-criterion=RDR_POS, value=2}
              PduRSrcPduPduRBswModulesRef = Dcm if post-build-variant-condition{matching-criterion=RDR_POS, value=0}
              PduRSrcPduPduRBswModulesRef = Dcm if post-build-variant-condition{matching-criterion=RDR_POS, value=4}
              PduRSrcPduPduRBswModulesRef = Dcm if post-build-variant-condition{matching-criterion=RDR_POS, value=3}
              PduRSrcPduPduRBswModulesRef = Dcm if post-build-variant-condition{matching-criterion=RDR_POS, value=7}
              PduRSrcPduPduRBswModulesRef = Dcm if post-build-variant-condition{matching-criterion=RDR_POS, value=1}
              PduRSrcPduPduRBswModulesRef = Dcm if post-build-variant-condition{matching-criterion=RDR_POS, value=6}
          SR1_DIAG_REQ_PHY_OTA_oVCAN_RADAR_3fc015f5_Rx: PduRRoutingPathCommunicationType=COMMUNICATION_INTERFACE if post-build-variant-condition{matching-criterion=RDR_POS, value=1}, PduRRoutingPathCommunicationType=COMMUNICATION_INTERFACE if post-build-variant-condition{matching-criterion=RDR_POS, value=3}, PduRRoutingPathCommunicationType=COMMUNICATION_INTERFACE if post-build-variant-condition{matching-criterion=RDR_POS, value=0}, PduRRoutingPathCommunicationType=COMMUNICATION_INTERFACE if post-build-variant-condition{matching-criterion=RDR_POS, value=7}, PduRRoutingPathCommunicationType=COMMUNICATION_INTERFACE if post-build-variant-condition{matching-criterion=RDR_POS, value=5}, PduRRoutingPathCommunicationType=COMMUNICATION_INTERFACE if post-build-variant-condition{matching-criterion=RDR_POS, value=2}, PduRRoutingPathCommunicationType=COMMUNICATION_INTERFACE if post-build-variant-condition{matching-criterion=RDR_POS, value=4}, PduRRoutingPathCommunicationType=COMMUNICATION_INTERFACE if post-build-variant-condition{matching-criterion=RDR_POS, value=6}, PduRLockRef=PduRLock_PduRExclusiveArea if post-build-variant-condition{matching-criterion=RDR_POS, value=6}, PduRLockRef=PduRLock_PduRExclusiveArea if post-build-variant-condition{matching-criterion=RDR_POS, value=0}, PduRLockRef=PduRLock_PduRExclusiveArea if post-build-variant-condition{matching-criterion=RDR_POS, value=7}, PduRLockRef=PduRLock_PduRExclusiveArea if post-build-variant-condition{matching-criterion=RDR_POS, value=4}, PduRLockRef=PduRLock_PduRExclusiveArea if post-build-variant-condition{matching-criterion=RDR_POS, value=1}, PduRLockRef=PduRLock_PduRExclusiveArea if post-build-variant-condition{matching-criterion=RDR_POS, value=3}, PduRLockRef=PduRLock_PduRExclusiveArea if post-build-variant-condition{matching-criterion=RDR_POS, value=2}, PduRLockRef=PduRLock_PduRExclusiveArea if post-build-variant-condition{matching-criterion=RDR_POS, value=5}
            PduRSrcPdu_ee16d246 (PduRSrcPdu):
              PduRSourcePduHandleId = 67
              PduRSrcPduDirection = RECEIVE if post-build-variant-condition{matching-criterion=RDR_POS, value=4}
              PduRSrcPduDirection = RECEIVE if post-build-variant-condition{matching-criterion=RDR_POS, value=1}
              PduRSrcPduDirection = RECEIVE if post-build-variant-condition{matching-criterion=RDR_POS, value=3}
              PduRSrcPduDirection = RECEIVE if post-build-variant-condition{matching-criterion=RDR_POS, value=0}
              PduRSrcPduDirection = RECEIVE if post-build-variant-condition{matching-criterion=RDR_POS, value=7}
              PduRSrcPduDirection = RECEIVE if post-build-variant-condition{matching-criterion=RDR_POS, value=5}
              PduRSrcPduDirection = RECEIVE if post-build-variant-condition{matching-criterion=RDR_POS, value=2}
              PduRSrcPduDirection = RECEIVE if post-build-variant-condition{matching-criterion=RDR_POS, value=6}
              PduRSrcPduRef = SR1_DIAG_REQ_PHY_OTA_oVCAN_RADAR_3fc015f5_Rx
              PduRSrcPduPduRBswModulesRef = CanIf if post-build-variant-condition{matching-criterion=RDR_POS, value=2}
              PduRSrcPduPduRBswModulesRef = CanIf if post-build-variant-condition{matching-criterion=RDR_POS, value=0}
              PduRSrcPduPduRBswModulesRef = CanIf if post-build-variant-condition{matching-criterion=RDR_POS, value=6}
              PduRSrcPduPduRBswModulesRef = CanIf if post-build-variant-condition{matching-criterion=RDR_POS, value=4}
              PduRSrcPduPduRBswModulesRef = CanIf if post-build-variant-condition{matching-criterion=RDR_POS, value=3}
              PduRSrcPduPduRBswModulesRef = CanIf if post-build-variant-condition{matching-criterion=RDR_POS, value=5}
              PduRSrcPduPduRBswModulesRef = CanIf if post-build-variant-condition{matching-criterion=RDR_POS, value=1}
              PduRSrcPduPduRBswModulesRef = CanIf if post-build-variant-condition{matching-criterion=RDR_POS, value=7}
            SRR_FL_DIAG_REQ_PHYS_OTA_Tx_oPCAN_RADAR_ebda6543_Tx (PduRDestPdu):
              PduRDestPduHandleId = 200
              PduRDestPduDirection = TRANSMIT if post-build-variant-condition{matching-criterion=RDR_POS, value=6}
              PduRDestPduDirection = TRANSMIT if post-build-variant-condition{matching-criterion=RDR_POS, value=0}
              PduRDestPduDirection = TRANSMIT if post-build-variant-condition{matching-criterion=RDR_POS, value=7}
              PduRDestPduDirection = TRANSMIT if post-build-variant-condition{matching-criterion=RDR_POS, value=4}
              PduRDestPduDirection = TRANSMIT if post-build-variant-condition{matching-criterion=RDR_POS, value=1}
              PduRDestPduDirection = TRANSMIT if post-build-variant-condition{matching-criterion=RDR_POS, value=3}
              PduRDestPduDirection = TRANSMIT if post-build-variant-condition{matching-criterion=RDR_POS, value=2}
              PduRDestPduDirection = TRANSMIT if post-build-variant-condition{matching-criterion=RDR_POS, value=5}
              PduRDestPduRoutingType = GATEWAY_ROUTING if post-build-variant-condition{matching-criterion=RDR_POS, value=6}
              PduRDestPduRoutingType = GATEWAY_ROUTING if post-build-variant-condition{matching-criterion=RDR_POS, value=0}
              PduRDestPduRoutingType = GATEWAY_ROUTING if post-build-variant-condition{matching-criterion=RDR_POS, value=7}
              PduRDestPduRoutingType = GATEWAY_ROUTING if post-build-variant-condition{matching-criterion=RDR_POS, value=4}
              PduRDestPduRoutingType = GATEWAY_ROUTING if post-build-variant-condition{matching-criterion=RDR_POS, value=1}
              PduRDestPduRoutingType = GATEWAY_ROUTING if post-build-variant-condition{matching-criterion=RDR_POS, value=3}
              PduRDestPduRoutingType = GATEWAY_ROUTING if post-build-variant-condition{matching-criterion=RDR_POS, value=2}
              PduRDestPduRoutingType = GATEWAY_ROUTING if post-build-variant-condition{matching-criterion=RDR_POS, value=5}
              PduRDestPduDataProcessing = IMMEDIATE
              PduRPduLengthHandlingStrategy = IGNORE
              PduRDestPduCrossPartitionDestination = false
              PduRDestPduDataProvision = PDUR_DIRECT
              PduRTransmissionConfirmation = false
              PduRDestPduRef = SRR_FL_DIAG_REQ_PHYS_OTA_Tx_oPCAN_RADAR_ebda6543_Tx
              PduRDestPduPduRBswModulesRef = CanIf if post-build-variant-condition{matching-criterion=RDR_POS, value=5}
              PduRDestPduPduRBswModulesRef = CanIf if post-build-variant-condition{matching-criterion=RDR_POS, value=3}
              PduRDestPduPduRBswModulesRef = CanIf if post-build-variant-condition{matching-criterion=RDR_POS, value=4}
              PduRDestPduPduRBswModulesRef = CanIf if post-build-variant-condition{matching-criterion=RDR_POS, value=0}
              PduRDestPduPduRBswModulesRef = CanIf if post-build-variant-condition{matching-criterion=RDR_POS, value=6}
              PduRDestPduPduRBswModulesRef = CanIf if post-build-variant-condition{matching-criterion=RDR_POS, value=7}
              PduRDestPduPduRBswModulesRef = CanIf if post-build-variant-condition{matching-criterion=RDR_POS, value=2}
              PduRDestPduPduRBswModulesRef = CanIf if post-build-variant-condition{matching-criterion=RDR_POS, value=1}
          RDR_FUSION_ALIGNMENT_STATUS_001_oPCAN_RADAR_e2456918_Rx: PduRRoutingPathCommunicationType=COMMUNICATION_INTERFACE if post-build-variant-condition{matching-criterion=RDR_POS, value=0}, PduRRoutingPathCommunicationType=COMMUNICATION_INTERFACE if post-build-variant-condition{matching-criterion=RDR_POS, value=1}, PduRRoutingPathCommunicationType=COMMUNICATION_INTERFACE if post-build-variant-condition{matching-criterion=RDR_POS, value=3}, PduRRoutingPathCommunicationType=COMMUNICATION_INTERFACE if post-build-variant-condition{matching-criterion=RDR_POS, value=7}, PduRRoutingPathCommunicationType=COMMUNICATION_INTERFACE if post-build-variant-condition{matching-criterion=RDR_POS, value=5}, PduRRoutingPathCommunicationType=COMMUNICATION_INTERFACE if post-build-variant-condition{matching-criterion=RDR_POS, value=2}, PduRRoutingPathCommunicationType=COMMUNICATION_INTERFACE if post-build-variant-condition{matching-criterion=RDR_POS, value=4}, PduRRoutingPathCommunicationType=COMMUNICATION_INTERFACE if post-build-variant-condition{matching-criterion=RDR_POS, value=6}, PduRLockRef=PduRLock_PduRExclusiveArea if post-build-variant-condition{matching-criterion=RDR_POS, value=6}, PduRLockRef=PduRLock_PduRExclusiveArea if post-build-variant-condition{matching-criterion=RDR_POS, value=1}, PduRLockRef=PduRLock_PduRExclusiveArea if post-build-variant-condition{matching-criterion=RDR_POS, value=3}, PduRLockRef=PduRLock_PduRExclusiveArea if post-build-variant-condition{matching-criterion=RDR_POS, value=0}, PduRLockRef=PduRLock_PduRExclusiveArea if post-build-variant-condition{matching-criterion=RDR_POS, value=7}, PduRLockRef=PduRLock_PduRExclusiveArea if post-build-variant-condition{matching-criterion=RDR_POS, value=5}, PduRLockRef=PduRLock_PduRExclusiveArea if post-build-variant-condition{matching-criterion=RDR_POS, value=2}, PduRLockRef=PduRLock_PduRExclusiveArea if post-build-variant-condition{matching-criterion=RDR_POS, value=4}
            RDR_FUSION_ALIGNMENT_STATUS_001_oPCAN_RADAR_e2456918_Rx_81e001a4_Rx (PduRDestPdu):
              PduRDestPduHandleId = 19
              PduRDestPduDirection = RECEIVE if post-build-variant-condition{matching-criterion=RDR_POS, value=7}
              PduRDestPduDirection = RECEIVE if post-build-variant-condition{matching-criterion=RDR_POS, value=1}
              PduRDestPduDirection = RECEIVE if post-build-variant-condition{matching-criterion=RDR_POS, value=3}
              PduRDestPduDirection = RECEIVE if post-build-variant-condition{matching-criterion=RDR_POS, value=0}
              PduRDestPduDirection = RECEIVE if post-build-variant-condition{matching-criterion=RDR_POS, value=5}
              PduRDestPduDirection = RECEIVE if post-build-variant-condition{matching-criterion=RDR_POS, value=2}
              PduRDestPduDirection = RECEIVE if post-build-variant-condition{matching-criterion=RDR_POS, value=4}
              PduRDestPduDirection = RECEIVE if post-build-variant-condition{matching-criterion=RDR_POS, value=6}
              PduRDestPduRoutingType = API_FORWARDING if post-build-variant-condition{matching-criterion=RDR_POS, value=2}
              PduRDestPduRoutingType = API_FORWARDING if post-build-variant-condition{matching-criterion=RDR_POS, value=1}
              PduRDestPduRoutingType = API_FORWARDING if post-build-variant-condition{matching-criterion=RDR_POS, value=3}
              PduRDestPduRoutingType = API_FORWARDING if post-build-variant-condition{matching-criterion=RDR_POS, value=0}
              PduRDestPduRoutingType = API_FORWARDING if post-build-variant-condition{matching-criterion=RDR_POS, value=5}
              PduRDestPduRoutingType = API_FORWARDING if post-build-variant-condition{matching-criterion=RDR_POS, value=7}
              PduRDestPduRoutingType = API_FORWARDING if post-build-variant-condition{matching-criterion=RDR_POS, value=4}
              PduRDestPduRoutingType = API_FORWARDING if post-build-variant-condition{matching-criterion=RDR_POS, value=6}
              PduRDestPduDataProcessing = IMMEDIATE
              PduRPduLengthHandlingStrategy = IGNORE
              PduRDestPduCrossPartitionDestination = false
              PduRTransmissionConfirmation = false
              PduRDestPduRef = RDR_FUSION_ALIGNMENT_STATUS_001_oPCAN_RADAR_5cbb3751_Rx
              PduRDestPduPduRBswModulesRef = Com if post-build-variant-condition{matching-criterion=RDR_POS, value=6}
              PduRDestPduPduRBswModulesRef = Com if post-build-variant-condition{matching-criterion=RDR_POS, value=0}
              PduRDestPduPduRBswModulesRef = Com if post-build-variant-condition{matching-criterion=RDR_POS, value=2}
              PduRDestPduPduRBswModulesRef = Com if post-build-variant-condition{matching-criterion=RDR_POS, value=3}
              PduRDestPduPduRBswModulesRef = Com if post-build-variant-condition{matching-criterion=RDR_POS, value=1}
              PduRDestPduPduRBswModulesRef = Com if post-build-variant-condition{matching-criterion=RDR_POS, value=7}
              PduRDestPduPduRBswModulesRef = Com if post-build-variant-condition{matching-criterion=RDR_POS, value=4}
              PduRDestPduPduRBswModulesRef = Com if post-build-variant-condition{matching-criterion=RDR_POS, value=5}
            PduRSrcPdu_81e001a4 (PduRSrcPdu):
              PduRSourcePduHandleId = 26
              PduRSrcPduDirection = RECEIVE if post-build-variant-condition{matching-criterion=RDR_POS, value=2}
              PduRSrcPduDirection = RECEIVE if post-build-variant-condition{matching-criterion=RDR_POS, value=1}
              PduRSrcPduDirection = RECEIVE if post-build-variant-condition{matching-criterion=RDR_POS, value=3}
              PduRSrcPduDirection = RECEIVE if post-build-variant-condition{matching-criterion=RDR_POS, value=0}
              PduRSrcPduDirection = RECEIVE if post-build-variant-condition{matching-criterion=RDR_POS, value=5}
              PduRSrcPduDirection = RECEIVE if post-build-variant-condition{matching-criterion=RDR_POS, value=7}
              PduRSrcPduDirection = RECEIVE if post-build-variant-condition{matching-criterion=RDR_POS, value=4}
              PduRSrcPduDirection = RECEIVE if post-build-variant-condition{matching-criterion=RDR_POS, value=6}
              PduRSrcPduRef = RDR_FUSION_ALIGNMENT_STATUS_001_oPCAN_RADAR_e2456918_Rx
              PduRSrcPduPduRBswModulesRef = CanIf if post-build-variant-condition{matching-criterion=RDR_POS, value=4}
              PduRSrcPduPduRBswModulesRef = CanIf if post-build-variant-condition{matching-criterion=RDR_POS, value=5}
              PduRSrcPduPduRBswModulesRef = CanIf if post-build-variant-condition{matching-criterion=RDR_POS, value=1}
              PduRSrcPduPduRBswModulesRef = CanIf if post-build-variant-condition{matching-criterion=RDR_POS, value=2}
              PduRSrcPduPduRBswModulesRef = CanIf if post-build-variant-condition{matching-criterion=RDR_POS, value=7}
              PduRSrcPduPduRBswModulesRef = CanIf if post-build-variant-condition{matching-criterion=RDR_POS, value=6}
              PduRSrcPduPduRBswModulesRef = CanIf if post-build-variant-condition{matching-criterion=RDR_POS, value=3}
              PduRSrcPduPduRBswModulesRef = CanIf if post-build-variant-condition{matching-criterion=RDR_POS, value=0}
          FR_DIAG_RES_PHY_PLANT_oVCAN_RADAR_ee22d0c2_Tx: PduRRoutingPathCommunicationType=TRANSPORT_PROTOCOL if post-build-variant-condition{matching-criterion=RDR_POS, value=7}, PduRRoutingPathCommunicationType=TRANSPORT_PROTOCOL if post-build-variant-condition{matching-criterion=RDR_POS, value=1}, PduRRoutingPathCommunicationType=TRANSPORT_PROTOCOL if post-build-variant-condition{matching-criterion=RDR_POS, value=3}, PduRRoutingPathCommunicationType=TRANSPORT_PROTOCOL if post-build-variant-condition{matching-criterion=RDR_POS, value=0}, PduRRoutingPathCommunicationType=TRANSPORT_PROTOCOL if post-build-variant-condition{matching-criterion=RDR_POS, value=5}, PduRRoutingPathCommunicationType=TRANSPORT_PROTOCOL if post-build-variant-condition{matching-criterion=RDR_POS, value=2}, PduRRoutingPathCommunicationType=TRANSPORT_PROTOCOL if post-build-variant-condition{matching-criterion=RDR_POS, value=4}, PduRRoutingPathCommunicationType=TRANSPORT_PROTOCOL if post-build-variant-condition{matching-criterion=RDR_POS, value=6}, PduRLockRef=PduRLock_PduRExclusiveArea if post-build-variant-condition{matching-criterion=RDR_POS, value=6}, PduRLockRef=PduRLock_PduRExclusiveArea if post-build-variant-condition{matching-criterion=RDR_POS, value=1}, PduRLockRef=PduRLock_PduRExclusiveArea if post-build-variant-condition{matching-criterion=RDR_POS, value=3}, PduRLockRef=PduRLock_PduRExclusiveArea if post-build-variant-condition{matching-criterion=RDR_POS, value=0}, PduRLockRef=PduRLock_PduRExclusiveArea if post-build-variant-condition{matching-criterion=RDR_POS, value=7}, PduRLockRef=PduRLock_PduRExclusiveArea if post-build-variant-condition{matching-criterion=RDR_POS, value=5}, PduRLockRef=PduRLock_PduRExclusiveArea if post-build-variant-condition{matching-criterion=RDR_POS, value=2}, PduRLockRef=PduRLock_PduRExclusiveArea if post-build-variant-condition{matching-criterion=RDR_POS, value=4}
            PduRSrcPdu_0cacdbaf (PduRSrcPdu):
              PduRSourcePduHandleId = 4
              PduRSrcPduDirection = TRANSMIT if post-build-variant-condition{matching-criterion=RDR_POS, value=4}
              PduRSrcPduDirection = TRANSMIT if post-build-variant-condition{matching-criterion=RDR_POS, value=1}
              PduRSrcPduDirection = TRANSMIT if post-build-variant-condition{matching-criterion=RDR_POS, value=3}
              PduRSrcPduDirection = TRANSMIT if post-build-variant-condition{matching-criterion=RDR_POS, value=0}
              PduRSrcPduDirection = TRANSMIT if post-build-variant-condition{matching-criterion=RDR_POS, value=7}
              PduRSrcPduDirection = TRANSMIT if post-build-variant-condition{matching-criterion=RDR_POS, value=5}
              PduRSrcPduDirection = TRANSMIT if post-build-variant-condition{matching-criterion=RDR_POS, value=2}
              PduRSrcPduDirection = TRANSMIT if post-build-variant-condition{matching-criterion=RDR_POS, value=6}
              PduRSrcPduRef = FR_DIAG_RES_PHY_PLANT_oVCAN_RADAR_ee22d0c2_Tx
              PduRSrcPduPduRBswModulesRef = Dcm if post-build-variant-condition{matching-criterion=RDR_POS, value=5}
              PduRSrcPduPduRBswModulesRef = Dcm if post-build-variant-condition{matching-criterion=RDR_POS, value=3}
              PduRSrcPduPduRBswModulesRef = Dcm if post-build-variant-condition{matching-criterion=RDR_POS, value=4}
              PduRSrcPduPduRBswModulesRef = Dcm if post-build-variant-condition{matching-criterion=RDR_POS, value=7}
              PduRSrcPduPduRBswModulesRef = Dcm if post-build-variant-condition{matching-criterion=RDR_POS, value=1}
              PduRSrcPduPduRBswModulesRef = Dcm if post-build-variant-condition{matching-criterion=RDR_POS, value=0}
              PduRSrcPduPduRBswModulesRef = Dcm if post-build-variant-condition{matching-criterion=RDR_POS, value=2}
              PduRSrcPduPduRBswModulesRef = Dcm if post-build-variant-condition{matching-criterion=RDR_POS, value=6}
            FR_DIAG_RES_PHY_PLANT_oVCAN_RADAR_5fef2467_Tx (PduRDestPdu):
              PduRDestPduHandleId = 4
              PduRDestPduDirection = TRANSMIT if post-build-variant-condition{matching-criterion=RDR_POS, value=4}
              PduRDestPduDirection = TRANSMIT if post-build-variant-condition{matching-criterion=RDR_POS, value=1}
              PduRDestPduDirection = TRANSMIT if post-build-variant-condition{matching-criterion=RDR_POS, value=3}
              PduRDestPduDirection = TRANSMIT if post-build-variant-condition{matching-criterion=RDR_POS, value=0}
              PduRDestPduDirection = TRANSMIT if post-build-variant-condition{matching-criterion=RDR_POS, value=7}
              PduRDestPduDirection = TRANSMIT if post-build-variant-condition{matching-criterion=RDR_POS, value=5}
              PduRDestPduDirection = TRANSMIT if post-build-variant-condition{matching-criterion=RDR_POS, value=2}
              PduRDestPduDirection = TRANSMIT if post-build-variant-condition{matching-criterion=RDR_POS, value=6}
              PduRDestPduRoutingType = API_FORWARDING if post-build-variant-condition{matching-criterion=RDR_POS, value=1}
              PduRDestPduRoutingType = API_FORWARDING if post-build-variant-condition{matching-criterion=RDR_POS, value=3}
              PduRDestPduRoutingType = API_FORWARDING if post-build-variant-condition{matching-criterion=RDR_POS, value=0}
              PduRDestPduRoutingType = API_FORWARDING if post-build-variant-condition{matching-criterion=RDR_POS, value=7}
              PduRDestPduRoutingType = API_FORWARDING if post-build-variant-condition{matching-criterion=RDR_POS, value=5}
              PduRDestPduRoutingType = API_FORWARDING if post-build-variant-condition{matching-criterion=RDR_POS, value=2}
              PduRDestPduRoutingType = API_FORWARDING if post-build-variant-condition{matching-criterion=RDR_POS, value=4}
              PduRDestPduRoutingType = API_FORWARDING if post-build-variant-condition{matching-criterion=RDR_POS, value=6}
              PduRDestPduDataProcessing = IMMEDIATE
              PduRPduLengthHandlingStrategy = UNUSED
              PduRDestPduCrossPartitionDestination = false
              PduRDestPduRef = FR_DIAG_RES_PHY_PLANT_oVCAN_RADAR_5fef2467_Tx
              PduRDestPduPduRBswModulesRef = CanTp if post-build-variant-condition{matching-criterion=RDR_POS, value=5}
              PduRDestPduPduRBswModulesRef = CanTp if post-build-variant-condition{matching-criterion=RDR_POS, value=2}
              PduRDestPduPduRBswModulesRef = CanTp if post-build-variant-condition{matching-criterion=RDR_POS, value=3}
              PduRDestPduPduRBswModulesRef = CanTp if post-build-variant-condition{matching-criterion=RDR_POS, value=0}
              PduRDestPduPduRBswModulesRef = CanTp if post-build-variant-condition{matching-criterion=RDR_POS, value=1}
              PduRDestPduPduRBswModulesRef = CanTp if post-build-variant-condition{matching-criterion=RDR_POS, value=7}
              PduRDestPduPduRBswModulesRef = CanTp if post-build-variant-condition{matching-criterion=RDR_POS, value=6}
              PduRDestPduPduRBswModulesRef = CanTp if post-build-variant-condition{matching-criterion=RDR_POS, value=4}
          DIAG_REQ_FNC_PLANT_oVCAN_RADAR_42eb2f27_Rx: PduRRoutingPathCommunicationType=TRANSPORT_PROTOCOL if post-build-variant-condition{matching-criterion=RDR_POS, value=1}, PduRRoutingPathCommunicationType=TRANSPORT_PROTOCOL if post-build-variant-condition{matching-criterion=RDR_POS, value=3}, PduRRoutingPathCommunicationType=TRANSPORT_PROTOCOL if post-build-variant-condition{matching-criterion=RDR_POS, value=0}, PduRRoutingPathCommunicationType=TRANSPORT_PROTOCOL if post-build-variant-condition{matching-criterion=RDR_POS, value=7}, PduRRoutingPathCommunicationType=TRANSPORT_PROTOCOL if post-build-variant-condition{matching-criterion=RDR_POS, value=5}, PduRRoutingPathCommunicationType=TRANSPORT_PROTOCOL if post-build-variant-condition{matching-criterion=RDR_POS, value=2}, PduRRoutingPathCommunicationType=TRANSPORT_PROTOCOL if post-build-variant-condition{matching-criterion=RDR_POS, value=4}, PduRRoutingPathCommunicationType=TRANSPORT_PROTOCOL if post-build-variant-condition{matching-criterion=RDR_POS, value=6}, PduRLockRef=PduRLock_PduRExclusiveArea if post-build-variant-condition{matching-criterion=RDR_POS, value=6}, PduRLockRef=PduRLock_PduRExclusiveArea if post-build-variant-condition{matching-criterion=RDR_POS, value=1}, PduRLockRef=PduRLock_PduRExclusiveArea if post-build-variant-condition{matching-criterion=RDR_POS, value=3}, PduRLockRef=PduRLock_PduRExclusiveArea if post-build-variant-condition{matching-criterion=RDR_POS, value=0}, PduRLockRef=PduRLock_PduRExclusiveArea if post-build-variant-condition{matching-criterion=RDR_POS, value=7}, PduRLockRef=PduRLock_PduRExclusiveArea if post-build-variant-condition{matching-criterion=RDR_POS, value=5}, PduRLockRef=PduRLock_PduRExclusiveArea if post-build-variant-condition{matching-criterion=RDR_POS, value=2}, PduRLockRef=PduRLock_PduRExclusiveArea if post-build-variant-condition{matching-criterion=RDR_POS, value=4}
            DIAG_REQ_FNC_PLANT_oVCAN_RADAR_42eb2f27_Rx_55bb6522_Rx (PduRDestPdu):
              PduRDestPduHandleId = 3
              PduRDestPduDirection = RECEIVE if post-build-variant-condition{matching-criterion=RDR_POS, value=2}
              PduRDestPduDirection = RECEIVE if post-build-variant-condition{matching-criterion=RDR_POS, value=1}
              PduRDestPduDirection = RECEIVE if post-build-variant-condition{matching-criterion=RDR_POS, value=3}
              PduRDestPduDirection = RECEIVE if post-build-variant-condition{matching-criterion=RDR_POS, value=0}
              PduRDestPduDirection = RECEIVE if post-build-variant-condition{matching-criterion=RDR_POS, value=5}
              PduRDestPduDirection = RECEIVE if post-build-variant-condition{matching-criterion=RDR_POS, value=7}
              PduRDestPduDirection = RECEIVE if post-build-variant-condition{matching-criterion=RDR_POS, value=4}
              PduRDestPduDirection = RECEIVE if post-build-variant-condition{matching-criterion=RDR_POS, value=6}
              PduRDestPduRoutingType = API_FORWARDING if post-build-variant-condition{matching-criterion=RDR_POS, value=2}
              PduRDestPduRoutingType = API_FORWARDING if post-build-variant-condition{matching-criterion=RDR_POS, value=1}
              PduRDestPduRoutingType = API_FORWARDING if post-build-variant-condition{matching-criterion=RDR_POS, value=3}
              PduRDestPduRoutingType = API_FORWARDING if post-build-variant-condition{matching-criterion=RDR_POS, value=0}
              PduRDestPduRoutingType = API_FORWARDING if post-build-variant-condition{matching-criterion=RDR_POS, value=5}
              PduRDestPduRoutingType = API_FORWARDING if post-build-variant-condition{matching-criterion=RDR_POS, value=7}
              PduRDestPduRoutingType = API_FORWARDING if post-build-variant-condition{matching-criterion=RDR_POS, value=4}
              PduRDestPduRoutingType = API_FORWARDING if post-build-variant-condition{matching-criterion=RDR_POS, value=6}
              PduRDestPduDataProcessing = IMMEDIATE
              PduRPduLengthHandlingStrategy = UNUSED
              PduRDestPduCrossPartitionDestination = false
              PduRDestPduRef = DIAG_REQ_FNC_PLANT_oVCAN_RADAR_9fd4cadc_Rx
              PduRDestPduPduRBswModulesRef = Dcm if post-build-variant-condition{matching-criterion=RDR_POS, value=0}
              PduRDestPduPduRBswModulesRef = Dcm if post-build-variant-condition{matching-criterion=RDR_POS, value=4}
              PduRDestPduPduRBswModulesRef = Dcm if post-build-variant-condition{matching-criterion=RDR_POS, value=3}
              PduRDestPduPduRBswModulesRef = Dcm if post-build-variant-condition{matching-criterion=RDR_POS, value=6}
              PduRDestPduPduRBswModulesRef = Dcm if post-build-variant-condition{matching-criterion=RDR_POS, value=1}
              PduRDestPduPduRBswModulesRef = Dcm if post-build-variant-condition{matching-criterion=RDR_POS, value=7}
              PduRDestPduPduRBswModulesRef = Dcm if post-build-variant-condition{matching-criterion=RDR_POS, value=5}
              PduRDestPduPduRBswModulesRef = Dcm if post-build-variant-condition{matching-criterion=RDR_POS, value=2}
            PduRSrcPdu_55bb6522 (PduRSrcPdu):
              PduRSourcePduHandleId = 3
              PduRSrcPduDirection = RECEIVE if post-build-variant-condition{matching-criterion=RDR_POS, value=5}
              PduRSrcPduDirection = RECEIVE if post-build-variant-condition{matching-criterion=RDR_POS, value=1}
              PduRSrcPduDirection = RECEIVE if post-build-variant-condition{matching-criterion=RDR_POS, value=3}
              PduRSrcPduDirection = RECEIVE if post-build-variant-condition{matching-criterion=RDR_POS, value=0}
              PduRSrcPduDirection = RECEIVE if post-build-variant-condition{matching-criterion=RDR_POS, value=7}
              PduRSrcPduDirection = RECEIVE if post-build-variant-condition{matching-criterion=RDR_POS, value=2}
              PduRSrcPduDirection = RECEIVE if post-build-variant-condition{matching-criterion=RDR_POS, value=4}
              PduRSrcPduDirection = RECEIVE if post-build-variant-condition{matching-criterion=RDR_POS, value=6}
              PduRSrcPduRef = DIAG_REQ_FNC_PLANT_oVCAN_RADAR_42eb2f27_Rx
              PduRSrcPduPduRBswModulesRef = CanTp if post-build-variant-condition{matching-criterion=RDR_POS, value=6}
              PduRSrcPduPduRBswModulesRef = CanTp if post-build-variant-condition{matching-criterion=RDR_POS, value=7}
              PduRSrcPduPduRBswModulesRef = CanTp if post-build-variant-condition{matching-criterion=RDR_POS, value=5}
              PduRSrcPduPduRBswModulesRef = CanTp if post-build-variant-condition{matching-criterion=RDR_POS, value=1}
              PduRSrcPduPduRBswModulesRef = CanTp if post-build-variant-condition{matching-criterion=RDR_POS, value=0}
              PduRSrcPduPduRBswModulesRef = CanTp if post-build-variant-condition{matching-criterion=RDR_POS, value=2}
              PduRSrcPduPduRBswModulesRef = CanTp if post-build-variant-condition{matching-criterion=RDR_POS, value=4}
              PduRSrcPduPduRBswModulesRef = CanTp if post-build-variant-condition{matching-criterion=RDR_POS, value=3}
          FR_DIAG_REQ_PHY_OBD2_oVCAN_RADAR_0f521c1d_Rx: PduRRoutingPathCommunicationType=TRANSPORT_PROTOCOL if post-build-variant-condition{matching-criterion=RDR_POS, value=3}, PduRRoutingPathCommunicationType=TRANSPORT_PROTOCOL if post-build-variant-condition{matching-criterion=RDR_POS, value=1}, PduRRoutingPathCommunicationType=TRANSPORT_PROTOCOL if post-build-variant-condition{matching-criterion=RDR_POS, value=0}, PduRRoutingPathCommunicationType=TRANSPORT_PROTOCOL if post-build-variant-condition{matching-criterion=RDR_POS, value=7}, PduRRoutingPathCommunicationType=TRANSPORT_PROTOCOL if post-build-variant-condition{matching-criterion=RDR_POS, value=5}, PduRRoutingPathCommunicationType=TRANSPORT_PROTOCOL if post-build-variant-condition{matching-criterion=RDR_POS, value=2}, PduRRoutingPathCommunicationType=TRANSPORT_PROTOCOL if post-build-variant-condition{matching-criterion=RDR_POS, value=4}, PduRRoutingPathCommunicationType=TRANSPORT_PROTOCOL if post-build-variant-condition{matching-criterion=RDR_POS, value=6}, PduRLockRef=PduRLock_PduRExclusiveArea if post-build-variant-condition{matching-criterion=RDR_POS, value=6}, PduRLockRef=PduRLock_PduRExclusiveArea if post-build-variant-condition{matching-criterion=RDR_POS, value=1}, PduRLockRef=PduRLock_PduRExclusiveArea if post-build-variant-condition{matching-criterion=RDR_POS, value=3}, PduRLockRef=PduRLock_PduRExclusiveArea if post-build-variant-condition{matching-criterion=RDR_POS, value=0}, PduRLockRef=PduRLock_PduRExclusiveArea if post-build-variant-condition{matching-criterion=RDR_POS, value=7}, PduRLockRef=PduRLock_PduRExclusiveArea if post-build-variant-condition{matching-criterion=RDR_POS, value=5}, PduRLockRef=PduRLock_PduRExclusiveArea if post-build-variant-condition{matching-criterion=RDR_POS, value=2}, PduRLockRef=PduRLock_PduRExclusiveArea if post-build-variant-condition{matching-criterion=RDR_POS, value=4}
            FR_DIAG_REQ_PHY_OBD2_oVCAN_RADAR_0f521c1d_Rx_1d3adefb_Rx (PduRDestPdu):
              PduRDestPduHandleId = 5
              PduRDestPduDirection = RECEIVE if post-build-variant-condition{matching-criterion=RDR_POS, value=5}
              PduRDestPduDirection = RECEIVE if post-build-variant-condition{matching-criterion=RDR_POS, value=1}
              PduRDestPduDirection = RECEIVE if post-build-variant-condition{matching-criterion=RDR_POS, value=3}
              PduRDestPduDirection = RECEIVE if post-build-variant-condition{matching-criterion=RDR_POS, value=0}
              PduRDestPduDirection = RECEIVE if post-build-variant-condition{matching-criterion=RDR_POS, value=7}
              PduRDestPduDirection = RECEIVE if post-build-variant-condition{matching-criterion=RDR_POS, value=2}
              PduRDestPduDirection = RECEIVE if post-build-variant-condition{matching-criterion=RDR_POS, value=4}
              PduRDestPduDirection = RECEIVE if post-build-variant-condition{matching-criterion=RDR_POS, value=6}
              PduRDestPduRoutingType = API_FORWARDING if post-build-variant-condition{matching-criterion=RDR_POS, value=2}
              PduRDestPduRoutingType = API_FORWARDING if post-build-variant-condition{matching-criterion=RDR_POS, value=1}
              PduRDestPduRoutingType = API_FORWARDING if post-build-variant-condition{matching-criterion=RDR_POS, value=3}
              PduRDestPduRoutingType = API_FORWARDING if post-build-variant-condition{matching-criterion=RDR_POS, value=0}
              PduRDestPduRoutingType = API_FORWARDING if post-build-variant-condition{matching-criterion=RDR_POS, value=5}
              PduRDestPduRoutingType = API_FORWARDING if post-build-variant-condition{matching-criterion=RDR_POS, value=7}
              PduRDestPduRoutingType = API_FORWARDING if post-build-variant-condition{matching-criterion=RDR_POS, value=4}
              PduRDestPduRoutingType = API_FORWARDING if post-build-variant-condition{matching-criterion=RDR_POS, value=6}
              PduRDestPduDataProcessing = IMMEDIATE
              PduRPduLengthHandlingStrategy = UNUSED
              PduRDestPduCrossPartitionDestination = false
              PduRDestPduRef = FR_DIAG_REQ_PHY_OBD2_oVCAN_RADAR_3e4811f1_Rx
              PduRDestPduPduRBswModulesRef = Dcm if post-build-variant-condition{matching-criterion=RDR_POS, value=3}
              PduRDestPduPduRBswModulesRef = Dcm if post-build-variant-condition{matching-criterion=RDR_POS, value=4}
              PduRDestPduPduRBswModulesRef = Dcm if post-build-variant-condition{matching-criterion=RDR_POS, value=2}
              PduRDestPduPduRBswModulesRef = Dcm if post-build-variant-condition{matching-criterion=RDR_POS, value=0}
              PduRDestPduPduRBswModulesRef = Dcm if post-build-variant-condition{matching-criterion=RDR_POS, value=1}
              PduRDestPduPduRBswModulesRef = Dcm if post-build-variant-condition{matching-criterion=RDR_POS, value=5}
              PduRDestPduPduRBswModulesRef = Dcm if post-build-variant-condition{matching-criterion=RDR_POS, value=7}
              PduRDestPduPduRBswModulesRef = Dcm if post-build-variant-condition{matching-criterion=RDR_POS, value=6}
            PduRSrcPdu_1d3adefb (PduRSrcPdu):
              PduRSourcePduHandleId = 5
              PduRSrcPduDirection = RECEIVE if post-build-variant-condition{matching-criterion=RDR_POS, value=7}
              PduRSrcPduDirection = RECEIVE if post-build-variant-condition{matching-criterion=RDR_POS, value=1}
              PduRSrcPduDirection = RECEIVE if post-build-variant-condition{matching-criterion=RDR_POS, value=3}
              PduRSrcPduDirection = RECEIVE if post-build-variant-condition{matching-criterion=RDR_POS, value=0}
              PduRSrcPduDirection = RECEIVE if post-build-variant-condition{matching-criterion=RDR_POS, value=5}
              PduRSrcPduDirection = RECEIVE if post-build-variant-condition{matching-criterion=RDR_POS, value=2}
              PduRSrcPduDirection = RECEIVE if post-build-variant-condition{matching-criterion=RDR_POS, value=4}
              PduRSrcPduDirection = RECEIVE if post-build-variant-condition{matching-criterion=RDR_POS, value=6}
              PduRSrcPduRef = FR_DIAG_REQ_PHY_OBD2_oVCAN_RADAR_0f521c1d_Rx
              PduRSrcPduPduRBswModulesRef = CanTp if post-build-variant-condition{matching-criterion=RDR_POS, value=3}
              PduRSrcPduPduRBswModulesRef = CanTp if post-build-variant-condition{matching-criterion=RDR_POS, value=1}
              PduRSrcPduPduRBswModulesRef = CanTp if post-build-variant-condition{matching-criterion=RDR_POS, value=5}
              PduRSrcPduPduRBswModulesRef = CanTp if post-build-variant-condition{matching-criterion=RDR_POS, value=0}
              PduRSrcPduPduRBswModulesRef = CanTp if post-build-variant-condition{matching-criterion=RDR_POS, value=7}
              PduRSrcPduPduRBswModulesRef = CanTp if post-build-variant-condition{matching-criterion=RDR_POS, value=6}
              PduRSrcPduPduRBswModulesRef = CanTp if post-build-variant-condition{matching-criterion=RDR_POS, value=2}
              PduRSrcPduPduRBswModulesRef = CanTp if post-build-variant-condition{matching-criterion=RDR_POS, value=4}
          FR_DIAG_RES_PHY_OTA_oVCAN_RADAR_9b68fa0b_Tx: PduRRoutingPathCommunicationType=TRANSPORT_PROTOCOL if post-build-variant-condition{matching-criterion=RDR_POS, value=4}, PduRRoutingPathCommunicationType=TRANSPORT_PROTOCOL if post-build-variant-condition{matching-criterion=RDR_POS, value=1}, PduRRoutingPathCommunicationType=TRANSPORT_PROTOCOL if post-build-variant-condition{matching-criterion=RDR_POS, value=3}, PduRRoutingPathCommunicationType=TRANSPORT_PROTOCOL if post-build-variant-condition{matching-criterion=RDR_POS, value=0}, PduRRoutingPathCommunicationType=TRANSPORT_PROTOCOL if post-build-variant-condition{matching-criterion=RDR_POS, value=7}, PduRRoutingPathCommunicationType=TRANSPORT_PROTOCOL if post-build-variant-condition{matching-criterion=RDR_POS, value=5}, PduRRoutingPathCommunicationType=TRANSPORT_PROTOCOL if post-build-variant-condition{matching-criterion=RDR_POS, value=2}, PduRRoutingPathCommunicationType=TRANSPORT_PROTOCOL if post-build-variant-condition{matching-criterion=RDR_POS, value=6}, PduRLockRef=PduRLock_PduRExclusiveArea if post-build-variant-condition{matching-criterion=RDR_POS, value=6}, PduRLockRef=PduRLock_PduRExclusiveArea if post-build-variant-condition{matching-criterion=RDR_POS, value=1}, PduRLockRef=PduRLock_PduRExclusiveArea if post-build-variant-condition{matching-criterion=RDR_POS, value=3}, PduRLockRef=PduRLock_PduRExclusiveArea if post-build-variant-condition{matching-criterion=RDR_POS, value=0}, PduRLockRef=PduRLock_PduRExclusiveArea if post-build-variant-condition{matching-criterion=RDR_POS, value=7}, PduRLockRef=PduRLock_PduRExclusiveArea if post-build-variant-condition{matching-criterion=RDR_POS, value=5}, PduRLockRef=PduRLock_PduRExclusiveArea if post-build-variant-condition{matching-criterion=RDR_POS, value=2}, PduRLockRef=PduRLock_PduRExclusiveArea if post-build-variant-condition{matching-criterion=RDR_POS, value=4}
            FR_DIAG_RES_PHY_OTA_oVCAN_RADAR_9ad9d3d9_Tx (PduRDestPdu):
              PduRDestPduHandleId = 3
              PduRDestPduDirection = TRANSMIT if post-build-variant-condition{matching-criterion=RDR_POS, value=2}
              PduRDestPduDirection = TRANSMIT if post-build-variant-condition{matching-criterion=RDR_POS, value=1}
              PduRDestPduDirection = TRANSMIT if post-build-variant-condition{matching-criterion=RDR_POS, value=3}
              PduRDestPduDirection = TRANSMIT if post-build-variant-condition{matching-criterion=RDR_POS, value=0}
              PduRDestPduDirection = TRANSMIT if post-build-variant-condition{matching-criterion=RDR_POS, value=5}
              PduRDestPduDirection = TRANSMIT if post-build-variant-condition{matching-criterion=RDR_POS, value=7}
              PduRDestPduDirection = TRANSMIT if post-build-variant-condition{matching-criterion=RDR_POS, value=4}
              PduRDestPduDirection = TRANSMIT if post-build-variant-condition{matching-criterion=RDR_POS, value=6}
              PduRDestPduRoutingType = API_FORWARDING if post-build-variant-condition{matching-criterion=RDR_POS, value=2}
              PduRDestPduRoutingType = API_FORWARDING if post-build-variant-condition{matching-criterion=RDR_POS, value=1}
              PduRDestPduRoutingType = API_FORWARDING if post-build-variant-condition{matching-criterion=RDR_POS, value=3}
              PduRDestPduRoutingType = API_FORWARDING if post-build-variant-condition{matching-criterion=RDR_POS, value=0}
              PduRDestPduRoutingType = API_FORWARDING if post-build-variant-condition{matching-criterion=RDR_POS, value=5}
              PduRDestPduRoutingType = API_FORWARDING if post-build-variant-condition{matching-criterion=RDR_POS, value=7}
              PduRDestPduRoutingType = API_FORWARDING if post-build-variant-condition{matching-criterion=RDR_POS, value=4}
              PduRDestPduRoutingType = API_FORWARDING if post-build-variant-condition{matching-criterion=RDR_POS, value=6}
              PduRDestPduDataProcessing = IMMEDIATE
              PduRPduLengthHandlingStrategy = UNUSED
              PduRDestPduCrossPartitionDestination = false
              PduRDestPduRef = FR_DIAG_RES_PHY_OTA_oVCAN_RADAR_9ad9d3d9_Tx
              PduRDestPduPduRBswModulesRef = CanTp if post-build-variant-condition{matching-criterion=RDR_POS, value=5}
              PduRDestPduPduRBswModulesRef = CanTp if post-build-variant-condition{matching-criterion=RDR_POS, value=1}
              PduRDestPduPduRBswModulesRef = CanTp if post-build-variant-condition{matching-criterion=RDR_POS, value=2}
              PduRDestPduPduRBswModulesRef = CanTp if post-build-variant-condition{matching-criterion=RDR_POS, value=0}
              PduRDestPduPduRBswModulesRef = CanTp if post-build-variant-condition{matching-criterion=RDR_POS, value=7}
              PduRDestPduPduRBswModulesRef = CanTp if post-build-variant-condition{matching-criterion=RDR_POS, value=4}
              PduRDestPduPduRBswModulesRef = CanTp if post-build-variant-condition{matching-criterion=RDR_POS, value=6}
              PduRDestPduPduRBswModulesRef = CanTp if post-build-variant-condition{matching-criterion=RDR_POS, value=3}
            PduRSrcPdu_b88278da (PduRSrcPdu):
              PduRSourcePduHandleId = 3
              PduRSrcPduDirection = TRANSMIT if post-build-variant-condition{matching-criterion=RDR_POS, value=4}
              PduRSrcPduDirection = TRANSMIT if post-build-variant-condition{matching-criterion=RDR_POS, value=1}
              PduRSrcPduDirection = TRANSMIT if post-build-variant-condition{matching-criterion=RDR_POS, value=3}
              PduRSrcPduDirection = TRANSMIT if post-build-variant-condition{matching-criterion=RDR_POS, value=0}
              PduRSrcPduDirection = TRANSMIT if post-build-variant-condition{matching-criterion=RDR_POS, value=7}
              PduRSrcPduDirection = TRANSMIT if post-build-variant-condition{matching-criterion=RDR_POS, value=5}
              PduRSrcPduDirection = TRANSMIT if post-build-variant-condition{matching-criterion=RDR_POS, value=2}
              PduRSrcPduDirection = TRANSMIT if post-build-variant-condition{matching-criterion=RDR_POS, value=6}
              PduRSrcPduRef = FR_DIAG_RES_PHY_OTA_oVCAN_RADAR_9b68fa0b_Tx
              PduRSrcPduPduRBswModulesRef = Dcm if post-build-variant-condition{matching-criterion=RDR_POS, value=6}
              PduRSrcPduPduRBswModulesRef = Dcm if post-build-variant-condition{matching-criterion=RDR_POS, value=3}
              PduRSrcPduPduRBswModulesRef = Dcm if post-build-variant-condition{matching-criterion=RDR_POS, value=7}
              PduRSrcPduPduRBswModulesRef = Dcm if post-build-variant-condition{matching-criterion=RDR_POS, value=5}
              PduRSrcPduPduRBswModulesRef = Dcm if post-build-variant-condition{matching-criterion=RDR_POS, value=1}
              PduRSrcPduPduRBswModulesRef = Dcm if post-build-variant-condition{matching-criterion=RDR_POS, value=2}
              PduRSrcPduPduRBswModulesRef = Dcm if post-build-variant-condition{matching-criterion=RDR_POS, value=0}
              PduRSrcPduPduRBswModulesRef = Dcm if post-build-variant-condition{matching-criterion=RDR_POS, value=4}
          PCAN_DIAG_RESP_PHYS_OBD2_oPCAN_RADAR_df0882d3_Tx: PduRRoutingPathCommunicationType=TRANSPORT_PROTOCOL if post-build-variant-condition{matching-criterion=RDR_POS, value=4}, PduRRoutingPathCommunicationType=TRANSPORT_PROTOCOL if post-build-variant-condition{matching-criterion=RDR_POS, value=1}, PduRRoutingPathCommunicationType=TRANSPORT_PROTOCOL if post-build-variant-condition{matching-criterion=RDR_POS, value=3}, PduRRoutingPathCommunicationType=TRANSPORT_PROTOCOL if post-build-variant-condition{matching-criterion=RDR_POS, value=0}, PduRRoutingPathCommunicationType=TRANSPORT_PROTOCOL if post-build-variant-condition{matching-criterion=RDR_POS, value=7}, PduRRoutingPathCommunicationType=TRANSPORT_PROTOCOL if post-build-variant-condition{matching-criterion=RDR_POS, value=5}, PduRRoutingPathCommunicationType=TRANSPORT_PROTOCOL if post-build-variant-condition{matching-criterion=RDR_POS, value=2}, PduRRoutingPathCommunicationType=TRANSPORT_PROTOCOL if post-build-variant-condition{matching-criterion=RDR_POS, value=6}, PduRLockRef=PduRLock_PduRExclusiveArea if post-build-variant-condition{matching-criterion=RDR_POS, value=6}, PduRLockRef=PduRLock_PduRExclusiveArea if post-build-variant-condition{matching-criterion=RDR_POS, value=1}, PduRLockRef=PduRLock_PduRExclusiveArea if post-build-variant-condition{matching-criterion=RDR_POS, value=3}, PduRLockRef=PduRLock_PduRExclusiveArea if post-build-variant-condition{matching-criterion=RDR_POS, value=0}, PduRLockRef=PduRLock_PduRExclusiveArea if post-build-variant-condition{matching-criterion=RDR_POS, value=7}, PduRLockRef=PduRLock_PduRExclusiveArea if post-build-variant-condition{matching-criterion=RDR_POS, value=5}, PduRLockRef=PduRLock_PduRExclusiveArea if post-build-variant-condition{matching-criterion=RDR_POS, value=2}, PduRLockRef=PduRLock_PduRExclusiveArea if post-build-variant-condition{matching-criterion=RDR_POS, value=4}
            PCAN_DIAG_RESP_PHYS_OBD2_oPCAN_RADAR_0c3908eb_Tx (PduRDestPdu):
              PduRDestPduHandleId = 7
              PduRDestPduDirection = TRANSMIT if post-build-variant-condition{matching-criterion=RDR_POS, value=0}
              PduRDestPduDirection = TRANSMIT if post-build-variant-condition{matching-criterion=RDR_POS, value=1}
              PduRDestPduDirection = TRANSMIT if post-build-variant-condition{matching-criterion=RDR_POS, value=3}
              PduRDestPduDirection = TRANSMIT if post-build-variant-condition{matching-criterion=RDR_POS, value=7}
              PduRDestPduDirection = TRANSMIT if post-build-variant-condition{matching-criterion=RDR_POS, value=5}
              PduRDestPduDirection = TRANSMIT if post-build-variant-condition{matching-criterion=RDR_POS, value=2}
              PduRDestPduDirection = TRANSMIT if post-build-variant-condition{matching-criterion=RDR_POS, value=4}
              PduRDestPduDirection = TRANSMIT if post-build-variant-condition{matching-criterion=RDR_POS, value=6}
              PduRDestPduRoutingType = API_FORWARDING if post-build-variant-condition{matching-criterion=RDR_POS, value=5}
              PduRDestPduRoutingType = API_FORWARDING if post-build-variant-condition{matching-criterion=RDR_POS, value=1}
              PduRDestPduRoutingType = API_FORWARDING if post-build-variant-condition{matching-criterion=RDR_POS, value=3}
              PduRDestPduRoutingType = API_FORWARDING if post-build-variant-condition{matching-criterion=RDR_POS, value=0}
              PduRDestPduRoutingType = API_FORWARDING if post-build-variant-condition{matching-criterion=RDR_POS, value=7}
              PduRDestPduRoutingType = API_FORWARDING if post-build-variant-condition{matching-criterion=RDR_POS, value=2}
              PduRDestPduRoutingType = API_FORWARDING if post-build-variant-condition{matching-criterion=RDR_POS, value=4}
              PduRDestPduRoutingType = API_FORWARDING if post-build-variant-condition{matching-criterion=RDR_POS, value=6}
              PduRDestPduDataProcessing = IMMEDIATE
              PduRPduLengthHandlingStrategy = UNUSED
              PduRDestPduCrossPartitionDestination = false
              PduRDestPduRef = PCAN_DIAG_RESP_PHYS_OBD2_oPCAN_RADAR_0c3908eb_Tx
              PduRDestPduPduRBswModulesRef = CanTp if post-build-variant-condition{matching-criterion=RDR_POS, value=2}
              PduRDestPduPduRBswModulesRef = CanTp if post-build-variant-condition{matching-criterion=RDR_POS, value=5}
              PduRDestPduPduRBswModulesRef = CanTp if post-build-variant-condition{matching-criterion=RDR_POS, value=6}
              PduRDestPduPduRBswModulesRef = CanTp if post-build-variant-condition{matching-criterion=RDR_POS, value=0}
              PduRDestPduPduRBswModulesRef = CanTp if post-build-variant-condition{matching-criterion=RDR_POS, value=4}
              PduRDestPduPduRBswModulesRef = CanTp if post-build-variant-condition{matching-criterion=RDR_POS, value=7}
              PduRDestPduPduRBswModulesRef = CanTp if post-build-variant-condition{matching-criterion=RDR_POS, value=1}
              PduRDestPduPduRBswModulesRef = CanTp if post-build-variant-condition{matching-criterion=RDR_POS, value=3}
            PduRSrcPdu_eb36a6cb (PduRSrcPdu):
              PduRSourcePduHandleId = 10
              PduRSrcPduDirection = TRANSMIT if post-build-variant-condition{matching-criterion=RDR_POS, value=7}
              PduRSrcPduDirection = TRANSMIT if post-build-variant-condition{matching-criterion=RDR_POS, value=1}
              PduRSrcPduDirection = TRANSMIT if post-build-variant-condition{matching-criterion=RDR_POS, value=3}
              PduRSrcPduDirection = TRANSMIT if post-build-variant-condition{matching-criterion=RDR_POS, value=0}
              PduRSrcPduDirection = TRANSMIT if post-build-variant-condition{matching-criterion=RDR_POS, value=5}
              PduRSrcPduDirection = TRANSMIT if post-build-variant-condition{matching-criterion=RDR_POS, value=2}
              PduRSrcPduDirection = TRANSMIT if post-build-variant-condition{matching-criterion=RDR_POS, value=4}
              PduRSrcPduDirection = TRANSMIT if post-build-variant-condition{matching-criterion=RDR_POS, value=6}
              PduRSrcPduRef = PCAN_DIAG_RESP_PHYS_OBD2_oPCAN_RADAR_df0882d3_Tx
              PduRSrcPduPduRBswModulesRef = Dcm if post-build-variant-condition{matching-criterion=RDR_POS, value=1}
              PduRSrcPduPduRBswModulesRef = Dcm if post-build-variant-condition{matching-criterion=RDR_POS, value=3}
              PduRSrcPduPduRBswModulesRef = Dcm if post-build-variant-condition{matching-criterion=RDR_POS, value=5}
              PduRSrcPduPduRBswModulesRef = Dcm if post-build-variant-condition{matching-criterion=RDR_POS, value=6}
              PduRSrcPduPduRBswModulesRef = Dcm if post-build-variant-condition{matching-criterion=RDR_POS, value=0}
              PduRSrcPduPduRBswModulesRef = Dcm if post-build-variant-condition{matching-criterion=RDR_POS, value=7}
              PduRSrcPduPduRBswModulesRef = Dcm if post-build-variant-condition{matching-criterion=RDR_POS, value=2}
              PduRSrcPduPduRBswModulesRef = Dcm if post-build-variant-condition{matching-criterion=RDR_POS, value=4}
          PCAN_DIAG_REQ_FUNC_OBD1_oPCAN_RADAR_b9aa9d1d_Rx: PduRRoutingPathCommunicationType=TRANSPORT_PROTOCOL if post-build-variant-condition{matching-criterion=RDR_POS, value=3}, PduRRoutingPathCommunicationType=TRANSPORT_PROTOCOL if post-build-variant-condition{matching-criterion=RDR_POS, value=1}, PduRRoutingPathCommunicationType=TRANSPORT_PROTOCOL if post-build-variant-condition{matching-criterion=RDR_POS, value=0}, PduRRoutingPathCommunicationType=TRANSPORT_PROTOCOL if post-build-variant-condition{matching-criterion=RDR_POS, value=7}, PduRRoutingPathCommunicationType=TRANSPORT_PROTOCOL if post-build-variant-condition{matching-criterion=RDR_POS, value=5}, PduRRoutingPathCommunicationType=TRANSPORT_PROTOCOL if post-build-variant-condition{matching-criterion=RDR_POS, value=2}, PduRRoutingPathCommunicationType=TRANSPORT_PROTOCOL if post-build-variant-condition{matching-criterion=RDR_POS, value=4}, PduRRoutingPathCommunicationType=TRANSPORT_PROTOCOL if post-build-variant-condition{matching-criterion=RDR_POS, value=6}, PduRLockRef=PduRLock_PduRExclusiveArea if post-build-variant-condition{matching-criterion=RDR_POS, value=6}, PduRLockRef=PduRLock_PduRExclusiveArea if post-build-variant-condition{matching-criterion=RDR_POS, value=1}, PduRLockRef=PduRLock_PduRExclusiveArea if post-build-variant-condition{matching-criterion=RDR_POS, value=3}, PduRLockRef=PduRLock_PduRExclusiveArea if post-build-variant-condition{matching-criterion=RDR_POS, value=0}, PduRLockRef=PduRLock_PduRExclusiveArea if post-build-variant-condition{matching-criterion=RDR_POS, value=7}, PduRLockRef=PduRLock_PduRExclusiveArea if post-build-variant-condition{matching-criterion=RDR_POS, value=5}, PduRLockRef=PduRLock_PduRExclusiveArea if post-build-variant-condition{matching-criterion=RDR_POS, value=2}, PduRLockRef=PduRLock_PduRExclusiveArea if post-build-variant-condition{matching-criterion=RDR_POS, value=4}
            PduRSrcPdu_ec57064f (PduRSrcPdu):
              PduRSourcePduHandleId = 9
              PduRSrcPduDirection = RECEIVE if post-build-variant-condition{matching-criterion=RDR_POS, value=1}
              PduRSrcPduDirection = RECEIVE if post-build-variant-condition{matching-criterion=RDR_POS, value=3}
              PduRSrcPduDirection = RECEIVE if post-build-variant-condition{matching-criterion=RDR_POS, value=0}
              PduRSrcPduDirection = RECEIVE if post-build-variant-condition{matching-criterion=RDR_POS, value=7}
              PduRSrcPduDirection = RECEIVE if post-build-variant-condition{matching-criterion=RDR_POS, value=5}
              PduRSrcPduDirection = RECEIVE if post-build-variant-condition{matching-criterion=RDR_POS, value=2}
              PduRSrcPduDirection = RECEIVE if post-build-variant-condition{matching-criterion=RDR_POS, value=4}
              PduRSrcPduDirection = RECEIVE if post-build-variant-condition{matching-criterion=RDR_POS, value=6}
              PduRSrcPduRef = PCAN_DIAG_REQ_FUNC_OBD1_oPCAN_RADAR_b9aa9d1d_Rx
              PduRSrcPduPduRBswModulesRef = CanTp if post-build-variant-condition{matching-criterion=RDR_POS, value=6}
              PduRSrcPduPduRBswModulesRef = CanTp if post-build-variant-condition{matching-criterion=RDR_POS, value=1}
              PduRSrcPduPduRBswModulesRef = CanTp if post-build-variant-condition{matching-criterion=RDR_POS, value=7}
              PduRSrcPduPduRBswModulesRef = CanTp if post-build-variant-condition{matching-criterion=RDR_POS, value=5}
              PduRSrcPduPduRBswModulesRef = CanTp if post-build-variant-condition{matching-criterion=RDR_POS, value=4}
              PduRSrcPduPduRBswModulesRef = CanTp if post-build-variant-condition{matching-criterion=RDR_POS, value=0}
              PduRSrcPduPduRBswModulesRef = CanTp if post-build-variant-condition{matching-criterion=RDR_POS, value=3}
              PduRSrcPduPduRBswModulesRef = CanTp if post-build-variant-condition{matching-criterion=RDR_POS, value=2}
            PCAN_DIAG_REQ_FUNC_OBD1_oPCAN_RADAR_b9aa9d1d_Rx_ec57064f_Rx (PduRDestPdu):
              PduRDestPduHandleId = 9
              PduRDestPduDirection = RECEIVE if post-build-variant-condition{matching-criterion=RDR_POS, value=3}
              PduRDestPduDirection = RECEIVE if post-build-variant-condition{matching-criterion=RDR_POS, value=1}
              PduRDestPduDirection = RECEIVE if post-build-variant-condition{matching-criterion=RDR_POS, value=0}
              PduRDestPduDirection = RECEIVE if post-build-variant-condition{matching-criterion=RDR_POS, value=7}
              PduRDestPduDirection = RECEIVE if post-build-variant-condition{matching-criterion=RDR_POS, value=5}
              PduRDestPduDirection = RECEIVE if post-build-variant-condition{matching-criterion=RDR_POS, value=2}
              PduRDestPduDirection = RECEIVE if post-build-variant-condition{matching-criterion=RDR_POS, value=4}
              PduRDestPduDirection = RECEIVE if post-build-variant-condition{matching-criterion=RDR_POS, value=6}
              PduRDestPduRoutingType = API_FORWARDING if post-build-variant-condition{matching-criterion=RDR_POS, value=1}
              PduRDestPduRoutingType = API_FORWARDING if post-build-variant-condition{matching-criterion=RDR_POS, value=3}
              PduRDestPduRoutingType = API_FORWARDING if post-build-variant-condition{matching-criterion=RDR_POS, value=0}
              PduRDestPduRoutingType = API_FORWARDING if post-build-variant-condition{matching-criterion=RDR_POS, value=7}
              PduRDestPduRoutingType = API_FORWARDING if post-build-variant-condition{matching-criterion=RDR_POS, value=5}
              PduRDestPduRoutingType = API_FORWARDING if post-build-variant-condition{matching-criterion=RDR_POS, value=2}
              PduRDestPduRoutingType = API_FORWARDING if post-build-variant-condition{matching-criterion=RDR_POS, value=4}
              PduRDestPduRoutingType = API_FORWARDING if post-build-variant-condition{matching-criterion=RDR_POS, value=6}
              PduRDestPduDataProcessing = IMMEDIATE
              PduRPduLengthHandlingStrategy = UNUSED
              PduRDestPduCrossPartitionDestination = false
              PduRDestPduRef = PCAN_DIAG_REQ_FUNC_OBD1_oPCAN_RADAR_5664bded_Rx
              PduRDestPduPduRBswModulesRef = Dcm if post-build-variant-condition{matching-criterion=RDR_POS, value=3}
              PduRDestPduPduRBswModulesRef = Dcm if post-build-variant-condition{matching-criterion=RDR_POS, value=4}
              PduRDestPduPduRBswModulesRef = Dcm if post-build-variant-condition{matching-criterion=RDR_POS, value=7}
              PduRDestPduPduRBswModulesRef = Dcm if post-build-variant-condition{matching-criterion=RDR_POS, value=2}
              PduRDestPduPduRBswModulesRef = Dcm if post-build-variant-condition{matching-criterion=RDR_POS, value=6}
              PduRDestPduPduRBswModulesRef = Dcm if post-build-variant-condition{matching-criterion=RDR_POS, value=1}
              PduRDestPduPduRBswModulesRef = Dcm if post-build-variant-condition{matching-criterion=RDR_POS, value=0}
              PduRDestPduPduRBswModulesRef = Dcm if post-build-variant-condition{matching-criterion=RDR_POS, value=5}
          SR2_DIAG_REQ_PHY_OTA_oVCAN_RADAR_68e239a7_Rx: PduRRoutingPathCommunicationType=COMMUNICATION_INTERFACE if post-build-variant-condition{matching-criterion=RDR_POS, value=6}, PduRRoutingPathCommunicationType=COMMUNICATION_INTERFACE if post-build-variant-condition{matching-criterion=RDR_POS, value=1}, PduRRoutingPathCommunicationType=COMMUNICATION_INTERFACE if post-build-variant-condition{matching-criterion=RDR_POS, value=3}, PduRRoutingPathCommunicationType=COMMUNICATION_INTERFACE if post-build-variant-condition{matching-criterion=RDR_POS, value=0}, PduRRoutingPathCommunicationType=COMMUNICATION_INTERFACE if post-build-variant-condition{matching-criterion=RDR_POS, value=7}, PduRRoutingPathCommunicationType=COMMUNICATION_INTERFACE if post-build-variant-condition{matching-criterion=RDR_POS, value=5}, PduRRoutingPathCommunicationType=COMMUNICATION_INTERFACE if post-build-variant-condition{matching-criterion=RDR_POS, value=2}, PduRRoutingPathCommunicationType=COMMUNICATION_INTERFACE if post-build-variant-condition{matching-criterion=RDR_POS, value=4}, PduRLockRef=PduRLock_PduRExclusiveArea if post-build-variant-condition{matching-criterion=RDR_POS, value=1}, PduRLockRef=PduRLock_PduRExclusiveArea if post-build-variant-condition{matching-criterion=RDR_POS, value=0}, PduRLockRef=PduRLock_PduRExclusiveArea if post-build-variant-condition{matching-criterion=RDR_POS, value=7}, PduRLockRef=PduRLock_PduRExclusiveArea if post-build-variant-condition{matching-criterion=RDR_POS, value=6}, PduRLockRef=PduRLock_PduRExclusiveArea if post-build-variant-condition{matching-criterion=RDR_POS, value=4}, PduRLockRef=PduRLock_PduRExclusiveArea if post-build-variant-condition{matching-criterion=RDR_POS, value=3}, PduRLockRef=PduRLock_PduRExclusiveArea if post-build-variant-condition{matching-criterion=RDR_POS, value=2}, PduRLockRef=PduRLock_PduRExclusiveArea if post-build-variant-condition{matching-criterion=RDR_POS, value=5}
            PduRSrcPdu_c9ecf8b2 (PduRSrcPdu):
              PduRSourcePduHandleId = 75
              PduRSrcPduDirection = RECEIVE if post-build-variant-condition{matching-criterion=RDR_POS, value=0}
              PduRSrcPduDirection = RECEIVE if post-build-variant-condition{matching-criterion=RDR_POS, value=1}
              PduRSrcPduDirection = RECEIVE if post-build-variant-condition{matching-criterion=RDR_POS, value=3}
              PduRSrcPduDirection = RECEIVE if post-build-variant-condition{matching-criterion=RDR_POS, value=7}
              PduRSrcPduDirection = RECEIVE if post-build-variant-condition{matching-criterion=RDR_POS, value=5}
              PduRSrcPduDirection = RECEIVE if post-build-variant-condition{matching-criterion=RDR_POS, value=2}
              PduRSrcPduDirection = RECEIVE if post-build-variant-condition{matching-criterion=RDR_POS, value=4}
              PduRSrcPduDirection = RECEIVE if post-build-variant-condition{matching-criterion=RDR_POS, value=6}
              PduRSrcPduRef = SR2_DIAG_REQ_PHY_OTA_oVCAN_RADAR_68e239a7_Rx
              PduRSrcPduPduRBswModulesRef = CanIf if post-build-variant-condition{matching-criterion=RDR_POS, value=1}
              PduRSrcPduPduRBswModulesRef = CanIf if post-build-variant-condition{matching-criterion=RDR_POS, value={3..5}}
              PduRSrcPduPduRBswModulesRef = CanIf if post-build-variant-condition{matching-criterion=RDR_POS, value=0}
              PduRSrcPduPduRBswModulesRef = CanIf if post-build-variant-condition{matching-criterion=RDR_POS, value=7}
              PduRSrcPduPduRBswModulesRef = CanIf if post-build-variant-condition{matching-criterion=RDR_POS, value=2}
              PduRSrcPduPduRBswModulesRef = CanIf if post-build-variant-condition{matching-criterion=RDR_POS, value=6}
            SRR_RL_DIAG_REQ_PHYS_OTA_Tx_oPCAN_RADAR_2e7c92c0_Tx (PduRDestPdu):
              PduRDestPduHandleId = 204
              PduRDestPduDirection = TRANSMIT if post-build-variant-condition{matching-criterion=RDR_POS, value=1}
              PduRDestPduDirection = TRANSMIT if post-build-variant-condition{matching-criterion=RDR_POS, value=0}
              PduRDestPduDirection = TRANSMIT if post-build-variant-condition{matching-criterion=RDR_POS, value=7}
              PduRDestPduDirection = TRANSMIT if post-build-variant-condition{matching-criterion=RDR_POS, value=6}
              PduRDestPduDirection = TRANSMIT if post-build-variant-condition{matching-criterion=RDR_POS, value=4}
              PduRDestPduDirection = TRANSMIT if post-build-variant-condition{matching-criterion=RDR_POS, value=3}
              PduRDestPduDirection = TRANSMIT if post-build-variant-condition{matching-criterion=RDR_POS, value=2}
              PduRDestPduDirection = TRANSMIT if post-build-variant-condition{matching-criterion=RDR_POS, value=5}
              PduRDestPduRoutingType = GATEWAY_ROUTING if post-build-variant-condition{matching-criterion=RDR_POS, value=1}
              PduRDestPduRoutingType = GATEWAY_ROUTING if post-build-variant-condition{matching-criterion=RDR_POS, value=0}
              PduRDestPduRoutingType = GATEWAY_ROUTING if post-build-variant-condition{matching-criterion=RDR_POS, value=7}
              PduRDestPduRoutingType = GATEWAY_ROUTING if post-build-variant-condition{matching-criterion=RDR_POS, value=6}
              PduRDestPduRoutingType = GATEWAY_ROUTING if post-build-variant-condition{matching-criterion=RDR_POS, value=4}
              PduRDestPduRoutingType = GATEWAY_ROUTING if post-build-variant-condition{matching-criterion=RDR_POS, value=3}
              PduRDestPduRoutingType = GATEWAY_ROUTING if post-build-variant-condition{matching-criterion=RDR_POS, value=2}
              PduRDestPduRoutingType = GATEWAY_ROUTING if post-build-variant-condition{matching-criterion=RDR_POS, value=5}
              PduRDestPduDataProcessing = IMMEDIATE
              PduRPduLengthHandlingStrategy = IGNORE
              PduRDestPduCrossPartitionDestination = false
              PduRTransmissionConfirmation = false
              PduRDestPduDataProvision = PDUR_DIRECT
              PduRDestPduRef = SRR_RL_DIAG_REQ_PHYS_OTA_Tx_oPCAN_RADAR_2e7c92c0_Tx
              PduRDestPduPduRBswModulesRef = CanIf if post-build-variant-condition{matching-criterion=RDR_POS, value=1}
              PduRDestPduPduRBswModulesRef = CanIf if post-build-variant-condition{matching-criterion=RDR_POS, value=7}
              PduRDestPduPduRBswModulesRef = CanIf if post-build-variant-condition{matching-criterion=RDR_POS, value=6}
              PduRDestPduPduRBswModulesRef = CanIf if post-build-variant-condition{matching-criterion=RDR_POS, value=4}
              PduRDestPduPduRBswModulesRef = CanIf if post-build-variant-condition{matching-criterion=RDR_POS, value=3}
              PduRDestPduPduRBswModulesRef = CanIf if post-build-variant-condition{matching-criterion=RDR_POS, value=0}
              PduRDestPduPduRBswModulesRef = CanIf if post-build-variant-condition{matching-criterion=RDR_POS, value=2}
              PduRDestPduPduRBswModulesRef = CanIf if post-build-variant-condition{matching-criterion=RDR_POS, value=5}
          SR1_DIAG_RES_PHY_PLANT_oVCAN_RADAR_76f7178b_Tx: PduRRoutingPathCommunicationType=COMMUNICATION_INTERFACE if post-build-variant-condition{matching-criterion=RDR_POS, value=2}, PduRRoutingPathCommunicationType=COMMUNICATION_INTERFACE if post-build-variant-condition{matching-criterion=RDR_POS, value=1}, PduRRoutingPathCommunicationType=COMMUNICATION_INTERFACE if post-build-variant-condition{matching-criterion=RDR_POS, value=3}, PduRRoutingPathCommunicationType=COMMUNICATION_INTERFACE if post-build-variant-condition{matching-criterion=RDR_POS, value=0}, PduRRoutingPathCommunicationType=COMMUNICATION_INTERFACE if post-build-variant-condition{matching-criterion=RDR_POS, value=5}, PduRRoutingPathCommunicationType=COMMUNICATION_INTERFACE if post-build-variant-condition{matching-criterion=RDR_POS, value=7}, PduRRoutingPathCommunicationType=COMMUNICATION_INTERFACE if post-build-variant-condition{matching-criterion=RDR_POS, value=4}, PduRRoutingPathCommunicationType=COMMUNICATION_INTERFACE if post-build-variant-condition{matching-criterion=RDR_POS, value=6}, PduRLockRef=PduRLock_PduRExclusiveArea if post-build-variant-condition{matching-criterion=RDR_POS, value=6}, PduRLockRef=PduRLock_PduRExclusiveArea if post-build-variant-condition{matching-criterion=RDR_POS, value=0}, PduRLockRef=PduRLock_PduRExclusiveArea if post-build-variant-condition{matching-criterion=RDR_POS, value=7}, PduRLockRef=PduRLock_PduRExclusiveArea if post-build-variant-condition{matching-criterion=RDR_POS, value=4}, PduRLockRef=PduRLock_PduRExclusiveArea if post-build-variant-condition{matching-criterion=RDR_POS, value=1}, PduRLockRef=PduRLock_PduRExclusiveArea if post-build-variant-condition{matching-criterion=RDR_POS, value=3}, PduRLockRef=PduRLock_PduRExclusiveArea if post-build-variant-condition{matching-criterion=RDR_POS, value=2}, PduRLockRef=PduRLock_PduRExclusiveArea if post-build-variant-condition{matching-criterion=RDR_POS, value=5}
            SR1_DIAG_RES_PHY_PLANT_oVCAN_RADAR_9afe60a3_Tx (PduRDestPdu):
              PduRDestPduHandleId = 193
              PduRDestPduDirection = TRANSMIT if post-build-variant-condition{matching-criterion=RDR_POS, value=5}
              PduRDestPduDirection = TRANSMIT if post-build-variant-condition{matching-criterion=RDR_POS, value=1}
              PduRDestPduDirection = TRANSMIT if post-build-variant-condition{matching-criterion=RDR_POS, value=3}
              PduRDestPduDirection = TRANSMIT if post-build-variant-condition{matching-criterion=RDR_POS, value=0}
              PduRDestPduDirection = TRANSMIT if post-build-variant-condition{matching-criterion=RDR_POS, value=7}
              PduRDestPduDirection = TRANSMIT if post-build-variant-condition{matching-criterion=RDR_POS, value=2}
              PduRDestPduDirection = TRANSMIT if post-build-variant-condition{matching-criterion=RDR_POS, value=4}
              PduRDestPduDirection = TRANSMIT if post-build-variant-condition{matching-criterion=RDR_POS, value=6}
              PduRDestPduRoutingType = GATEWAY_ROUTING if post-build-variant-condition{matching-criterion=RDR_POS, value=7}
              PduRDestPduRoutingType = GATEWAY_ROUTING if post-build-variant-condition{matching-criterion=RDR_POS, value=0}
              PduRDestPduRoutingType = GATEWAY_ROUTING if post-build-variant-condition{matching-criterion=RDR_POS, value=6}
              PduRDestPduRoutingType = GATEWAY_ROUTING if post-build-variant-condition{matching-criterion=RDR_POS, value=4}
              PduRDestPduRoutingType = GATEWAY_ROUTING if post-build-variant-condition{matching-criterion=RDR_POS, value=1}
              PduRDestPduRoutingType = GATEWAY_ROUTING if post-build-variant-condition{matching-criterion=RDR_POS, value=3}
              PduRDestPduRoutingType = GATEWAY_ROUTING if post-build-variant-condition{matching-criterion=RDR_POS, value=2}
              PduRDestPduRoutingType = GATEWAY_ROUTING if post-build-variant-condition{matching-criterion=RDR_POS, value=5}
              PduRDestPduDataProcessing = IMMEDIATE
              PduRPduLengthHandlingStrategy = IGNORE
              PduRDestPduCrossPartitionDestination = false
              PduRDestPduDataProvision = PDUR_DIRECT
              PduRTransmissionConfirmation = false
              PduRDestPduRef = SR1_DIAG_RES_PHY_PLANT_oVCAN_RADAR_9afe60a3_Tx
              PduRDestPduPduRBswModulesRef = CanIf if post-build-variant-condition{matching-criterion=RDR_POS, value=6}
              PduRDestPduPduRBswModulesRef = CanIf if post-build-variant-condition{matching-criterion=RDR_POS, value=7}
              PduRDestPduPduRBswModulesRef = CanIf if post-build-variant-condition{matching-criterion=RDR_POS, value=4}
              PduRDestPduPduRBswModulesRef = CanIf if post-build-variant-condition{matching-criterion=RDR_POS, value=0}
              PduRDestPduPduRBswModulesRef = CanIf if post-build-variant-condition{matching-criterion=RDR_POS, value=5}
              PduRDestPduPduRBswModulesRef = CanIf if post-build-variant-condition{matching-criterion=RDR_POS, value={1..3}}
            PduRSrcPdu_ce426d3c_001 (PduRSrcPdu):
              PduRSourcePduHandleId = 72
              PduRSrcPduDirection = RECEIVE if post-build-variant-condition{matching-criterion=RDR_POS, value=7}
              PduRSrcPduDirection = RECEIVE if post-build-variant-condition{matching-criterion=RDR_POS, value=0}
              PduRSrcPduDirection = RECEIVE if post-build-variant-condition{matching-criterion=RDR_POS, value=6}
              PduRSrcPduDirection = RECEIVE if post-build-variant-condition{matching-criterion=RDR_POS, value=4}
              PduRSrcPduDirection = RECEIVE if post-build-variant-condition{matching-criterion=RDR_POS, value=1}
              PduRSrcPduDirection = RECEIVE if post-build-variant-condition{matching-criterion=RDR_POS, value=3}
              PduRSrcPduDirection = RECEIVE if post-build-variant-condition{matching-criterion=RDR_POS, value=2}
              PduRSrcPduDirection = RECEIVE if post-build-variant-condition{matching-criterion=RDR_POS, value=5}
              PduRSrcPduRef = SRR_FL_DIAG_RESP_PHYS_PLANT_Rx_oPCAN_RADAR_23870365_Rx
              PduRSrcPduPduRBswModulesRef = CanIf if post-build-variant-condition{matching-criterion=RDR_POS, value=7}
              PduRSrcPduPduRBswModulesRef = CanIf if post-build-variant-condition{matching-criterion=RDR_POS, value=1}
              PduRSrcPduPduRBswModulesRef = CanIf if post-build-variant-condition{matching-criterion=RDR_POS, value=3}
              PduRSrcPduPduRBswModulesRef = CanIf if post-build-variant-condition{matching-criterion=RDR_POS, value=2}
              PduRSrcPduPduRBswModulesRef = CanIf if post-build-variant-condition{matching-criterion=RDR_POS, value=5}
              PduRSrcPduPduRBswModulesRef = CanIf if post-build-variant-condition{matching-criterion=RDR_POS, value=0}
              PduRSrcPduPduRBswModulesRef = CanIf if post-build-variant-condition{matching-criterion=RDR_POS, value=4}
              PduRSrcPduPduRBswModulesRef = CanIf if post-build-variant-condition{matching-criterion=RDR_POS, value=6}
          FR_DIAG_RES_PHY_OBD1_oVCAN_RADAR_add2b4bf_Tx: PduRRoutingPathCommunicationType=TRANSPORT_PROTOCOL if post-build-variant-condition{matching-criterion=RDR_POS, value=3}, PduRRoutingPathCommunicationType=TRANSPORT_PROTOCOL if post-build-variant-condition{matching-criterion=RDR_POS, value=1}, PduRRoutingPathCommunicationType=TRANSPORT_PROTOCOL if post-build-variant-condition{matching-criterion=RDR_POS, value=0}, PduRRoutingPathCommunicationType=TRANSPORT_PROTOCOL if post-build-variant-condition{matching-criterion=RDR_POS, value=7}, PduRRoutingPathCommunicationType=TRANSPORT_PROTOCOL if post-build-variant-condition{matching-criterion=RDR_POS, value=5}, PduRRoutingPathCommunicationType=TRANSPORT_PROTOCOL if post-build-variant-condition{matching-criterion=RDR_POS, value=2}, PduRRoutingPathCommunicationType=TRANSPORT_PROTOCOL if post-build-variant-condition{matching-criterion=RDR_POS, value=4}, PduRRoutingPathCommunicationType=TRANSPORT_PROTOCOL if post-build-variant-condition{matching-criterion=RDR_POS, value=6}, PduRLockRef=PduRLock_PduRExclusiveArea if post-build-variant-condition{matching-criterion=RDR_POS, value=6}, PduRLockRef=PduRLock_PduRExclusiveArea if post-build-variant-condition{matching-criterion=RDR_POS, value=1}, PduRLockRef=PduRLock_PduRExclusiveArea if post-build-variant-condition{matching-criterion=RDR_POS, value=3}, PduRLockRef=PduRLock_PduRExclusiveArea if post-build-variant-condition{matching-criterion=RDR_POS, value=0}, PduRLockRef=PduRLock_PduRExclusiveArea if post-build-variant-condition{matching-criterion=RDR_POS, value=7}, PduRLockRef=PduRLock_PduRExclusiveArea if post-build-variant-condition{matching-criterion=RDR_POS, value=5}, PduRLockRef=PduRLock_PduRExclusiveArea if post-build-variant-condition{matching-criterion=RDR_POS, value=2}, PduRLockRef=PduRLock_PduRExclusiveArea if post-build-variant-condition{matching-criterion=RDR_POS, value=4}
            PduRSrcPdu_39695c5b (PduRSrcPdu):
              PduRSourcePduHandleId = 1
              PduRSrcPduDirection = TRANSMIT if post-build-variant-condition{matching-criterion=RDR_POS, value=4}
              PduRSrcPduDirection = TRANSMIT if post-build-variant-condition{matching-criterion=RDR_POS, value=1}
              PduRSrcPduDirection = TRANSMIT if post-build-variant-condition{matching-criterion=RDR_POS, value=3}
              PduRSrcPduDirection = TRANSMIT if post-build-variant-condition{matching-criterion=RDR_POS, value=0}
              PduRSrcPduDirection = TRANSMIT if post-build-variant-condition{matching-criterion=RDR_POS, value=7}
              PduRSrcPduDirection = TRANSMIT if post-build-variant-condition{matching-criterion=RDR_POS, value=5}
              PduRSrcPduDirection = TRANSMIT if post-build-variant-condition{matching-criterion=RDR_POS, value=2}
              PduRSrcPduDirection = TRANSMIT if post-build-variant-condition{matching-criterion=RDR_POS, value=6}
              PduRSrcPduRef = FR_DIAG_RES_PHY_OBD1_oVCAN_RADAR_add2b4bf_Tx
              PduRSrcPduPduRBswModulesRef = Dcm if post-build-variant-condition{matching-criterion=RDR_POS, value=6}
              PduRSrcPduPduRBswModulesRef = Dcm if post-build-variant-condition{matching-criterion=RDR_POS, value=3}
              PduRSrcPduPduRBswModulesRef = Dcm if post-build-variant-condition{matching-criterion=RDR_POS, value=0}
              PduRSrcPduPduRBswModulesRef = Dcm if post-build-variant-condition{matching-criterion=RDR_POS, value=5}
              PduRSrcPduPduRBswModulesRef = Dcm if post-build-variant-condition{matching-criterion=RDR_POS, value=2}
              PduRSrcPduPduRBswModulesRef = Dcm if post-build-variant-condition{matching-criterion=RDR_POS, value=4}
              PduRSrcPduPduRBswModulesRef = Dcm if post-build-variant-condition{matching-criterion=RDR_POS, value=7}
              PduRSrcPduPduRBswModulesRef = Dcm if post-build-variant-condition{matching-criterion=RDR_POS, value=1}
            FR_DIAG_RES_PHY_OBD1_oVCAN_RADAR_cd47a295_Tx (PduRDestPdu):
              PduRDestPduHandleId = 1
              PduRDestPduDirection = TRANSMIT if post-build-variant-condition{matching-criterion=RDR_POS, value=1}
              PduRDestPduDirection = TRANSMIT if post-build-variant-condition{matching-criterion=RDR_POS, value=3}
              PduRDestPduDirection = TRANSMIT if post-build-variant-condition{matching-criterion=RDR_POS, value=0}
              PduRDestPduDirection = TRANSMIT if post-build-variant-condition{matching-criterion=RDR_POS, value=7}
              PduRDestPduDirection = TRANSMIT if post-build-variant-condition{matching-criterion=RDR_POS, value=5}
              PduRDestPduDirection = TRANSMIT if post-build-variant-condition{matching-criterion=RDR_POS, value=2}
              PduRDestPduDirection = TRANSMIT if post-build-variant-condition{matching-criterion=RDR_POS, value=4}
              PduRDestPduDirection = TRANSMIT if post-build-variant-condition{matching-criterion=RDR_POS, value=6}
              PduRDestPduRoutingType = API_FORWARDING if post-build-variant-condition{matching-criterion=RDR_POS, value=0}
              PduRDestPduRoutingType = API_FORWARDING if post-build-variant-condition{matching-criterion=RDR_POS, value=1}
              PduRDestPduRoutingType = API_FORWARDING if post-build-variant-condition{matching-criterion=RDR_POS, value=3}
              PduRDestPduRoutingType = API_FORWARDING if post-build-variant-condition{matching-criterion=RDR_POS, value=7}
              PduRDestPduRoutingType = API_FORWARDING if post-build-variant-condition{matching-criterion=RDR_POS, value=5}
              PduRDestPduRoutingType = API_FORWARDING if post-build-variant-condition{matching-criterion=RDR_POS, value=2}
              PduRDestPduRoutingType = API_FORWARDING if post-build-variant-condition{matching-criterion=RDR_POS, value=4}
              PduRDestPduRoutingType = API_FORWARDING if post-build-variant-condition{matching-criterion=RDR_POS, value=6}
              PduRDestPduDataProcessing = IMMEDIATE
              PduRPduLengthHandlingStrategy = UNUSED
              PduRDestPduCrossPartitionDestination = false
              PduRDestPduRef = FR_DIAG_RES_PHY_OBD1_oVCAN_RADAR_cd47a295_Tx
              PduRDestPduPduRBswModulesRef = CanTp if post-build-variant-condition{matching-criterion=RDR_POS, value=3}
              PduRDestPduPduRBswModulesRef = CanTp if post-build-variant-condition{matching-criterion=RDR_POS, value=2}
              PduRDestPduPduRBswModulesRef = CanTp if post-build-variant-condition{matching-criterion=RDR_POS, value=5}
              PduRDestPduPduRBswModulesRef = CanTp if post-build-variant-condition{matching-criterion=RDR_POS, value=0}
              PduRDestPduPduRBswModulesRef = CanTp if post-build-variant-condition{matching-criterion=RDR_POS, value=7}
              PduRDestPduPduRBswModulesRef = CanTp if post-build-variant-condition{matching-criterion=RDR_POS, value=6}
              PduRDestPduPduRBswModulesRef = CanTp if post-build-variant-condition{matching-criterion=RDR_POS, value=4}
              PduRDestPduPduRBswModulesRef = CanTp if post-build-variant-condition{matching-criterion=RDR_POS, value=1}
          PCAN_DIAG_RESP_PHYS_PLANT_oPCAN_RADAR_339eb858_Tx: PduRRoutingPathCommunicationType=TRANSPORT_PROTOCOL if post-build-variant-condition{matching-criterion=RDR_POS, value=1}, PduRRoutingPathCommunicationType=TRANSPORT_PROTOCOL if post-build-variant-condition{matching-criterion=RDR_POS, value=3}, PduRRoutingPathCommunicationType=TRANSPORT_PROTOCOL if post-build-variant-condition{matching-criterion=RDR_POS, value=0}, PduRRoutingPathCommunicationType=TRANSPORT_PROTOCOL if post-build-variant-condition{matching-criterion=RDR_POS, value=7}, PduRRoutingPathCommunicationType=TRANSPORT_PROTOCOL if post-build-variant-condition{matching-criterion=RDR_POS, value=5}, PduRRoutingPathCommunicationType=TRANSPORT_PROTOCOL if post-build-variant-condition{matching-criterion=RDR_POS, value=2}, PduRRoutingPathCommunicationType=TRANSPORT_PROTOCOL if post-build-variant-condition{matching-criterion=RDR_POS, value=4}, PduRRoutingPathCommunicationType=TRANSPORT_PROTOCOL if post-build-variant-condition{matching-criterion=RDR_POS, value=6}, PduRLockRef=PduRLock_PduRExclusiveArea if post-build-variant-condition{matching-criterion=RDR_POS, value=6}, PduRLockRef=PduRLock_PduRExclusiveArea if post-build-variant-condition{matching-criterion=RDR_POS, value=1}, PduRLockRef=PduRLock_PduRExclusiveArea if post-build-variant-condition{matching-criterion=RDR_POS, value=3}, PduRLockRef=PduRLock_PduRExclusiveArea if post-build-variant-condition{matching-criterion=RDR_POS, value=0}, PduRLockRef=PduRLock_PduRExclusiveArea if post-build-variant-condition{matching-criterion=RDR_POS, value=7}, PduRLockRef=PduRLock_PduRExclusiveArea if post-build-variant-condition{matching-criterion=RDR_POS, value=5}, PduRLockRef=PduRLock_PduRExclusiveArea if post-build-variant-condition{matching-criterion=RDR_POS, value=2}, PduRLockRef=PduRLock_PduRExclusiveArea if post-build-variant-condition{matching-criterion=RDR_POS, value=4}
            PCAN_DIAG_RESP_PHYS_PLANT_oPCAN_RADAR_cfac777e_Tx (PduRDestPdu):
              PduRDestPduHandleId = 12
              PduRDestPduDirection = TRANSMIT if post-build-variant-condition{matching-criterion=RDR_POS, value=1}
              PduRDestPduDirection = TRANSMIT if post-build-variant-condition{matching-criterion=RDR_POS, value=3}
              PduRDestPduDirection = TRANSMIT if post-build-variant-condition{matching-criterion=RDR_POS, value=0}
              PduRDestPduDirection = TRANSMIT if post-build-variant-condition{matching-criterion=RDR_POS, value=7}
              PduRDestPduDirection = TRANSMIT if post-build-variant-condition{matching-criterion=RDR_POS, value=5}
              PduRDestPduDirection = TRANSMIT if post-build-variant-condition{matching-criterion=RDR_POS, value=2}
              PduRDestPduDirection = TRANSMIT if post-build-variant-condition{matching-criterion=RDR_POS, value=4}
              PduRDestPduDirection = TRANSMIT if post-build-variant-condition{matching-criterion=RDR_POS, value=6}
              PduRDestPduRoutingType = API_FORWARDING if post-build-variant-condition{matching-criterion=RDR_POS, value=6}
              PduRDestPduRoutingType = API_FORWARDING if post-build-variant-condition{matching-criterion=RDR_POS, value=1}
              PduRDestPduRoutingType = API_FORWARDING if post-build-variant-condition{matching-criterion=RDR_POS, value=3}
              PduRDestPduRoutingType = API_FORWARDING if post-build-variant-condition{matching-criterion=RDR_POS, value=0}
              PduRDestPduRoutingType = API_FORWARDING if post-build-variant-condition{matching-criterion=RDR_POS, value=7}
              PduRDestPduRoutingType = API_FORWARDING if post-build-variant-condition{matching-criterion=RDR_POS, value=5}
              PduRDestPduRoutingType = API_FORWARDING if post-build-variant-condition{matching-criterion=RDR_POS, value=2}
              PduRDestPduRoutingType = API_FORWARDING if post-build-variant-condition{matching-criterion=RDR_POS, value=4}
              PduRDestPduDataProcessing = IMMEDIATE
              PduRPduLengthHandlingStrategy = UNUSED
              PduRDestPduCrossPartitionDestination = false
              PduRDestPduRef = PCAN_DIAG_RESP_PHYS_PLANT_oPCAN_RADAR_cfac777e_Tx
              PduRDestPduPduRBswModulesRef = CanTp if post-build-variant-condition{matching-criterion=RDR_POS, value=1}
              PduRDestPduPduRBswModulesRef = CanTp if post-build-variant-condition{matching-criterion=RDR_POS, value=2}
              PduRDestPduPduRBswModulesRef = CanTp if post-build-variant-condition{matching-criterion=RDR_POS, value=6}
              PduRDestPduPduRBswModulesRef = CanTp if post-build-variant-condition{matching-criterion=RDR_POS, value=7}
              PduRDestPduPduRBswModulesRef = CanTp if post-build-variant-condition{matching-criterion=RDR_POS, value=4}
              PduRDestPduPduRBswModulesRef = CanTp if post-build-variant-condition{matching-criterion=RDR_POS, value=5}
              PduRDestPduPduRBswModulesRef = CanTp if post-build-variant-condition{matching-criterion=RDR_POS, value=0}
              PduRDestPduPduRBswModulesRef = CanTp if post-build-variant-condition{matching-criterion=RDR_POS, value=3}
            PduRSrcPdu_5b4521ce (PduRSrcPdu):
              PduRSourcePduHandleId = 14
              PduRSrcPduDirection = TRANSMIT if post-build-variant-condition{matching-criterion=RDR_POS, value=0}
              PduRSrcPduDirection = TRANSMIT if post-build-variant-condition{matching-criterion=RDR_POS, value=1}
              PduRSrcPduDirection = TRANSMIT if post-build-variant-condition{matching-criterion=RDR_POS, value=3}
              PduRSrcPduDirection = TRANSMIT if post-build-variant-condition{matching-criterion=RDR_POS, value=7}
              PduRSrcPduDirection = TRANSMIT if post-build-variant-condition{matching-criterion=RDR_POS, value=5}
              PduRSrcPduDirection = TRANSMIT if post-build-variant-condition{matching-criterion=RDR_POS, value=2}
              PduRSrcPduDirection = TRANSMIT if post-build-variant-condition{matching-criterion=RDR_POS, value=4}
              PduRSrcPduDirection = TRANSMIT if post-build-variant-condition{matching-criterion=RDR_POS, value=6}
              PduRSrcPduRef = PCAN_DIAG_RESP_PHYS_PLANT_oPCAN_RADAR_339eb858_Tx
              PduRSrcPduPduRBswModulesRef = Dcm if post-build-variant-condition{matching-criterion=RDR_POS, value=2}
              PduRSrcPduPduRBswModulesRef = Dcm if post-build-variant-condition{matching-criterion=RDR_POS, value=0}
              PduRSrcPduPduRBswModulesRef = Dcm if post-build-variant-condition{matching-criterion=RDR_POS, value=7}
              PduRSrcPduPduRBswModulesRef = Dcm if post-build-variant-condition{matching-criterion=RDR_POS, value=4}
              PduRSrcPduPduRBswModulesRef = Dcm if post-build-variant-condition{matching-criterion=RDR_POS, value=3}
              PduRSrcPduPduRBswModulesRef = Dcm if post-build-variant-condition{matching-criterion=RDR_POS, value=5}
              PduRSrcPduPduRBswModulesRef = Dcm if post-build-variant-condition{matching-criterion=RDR_POS, value=1}
              PduRSrcPduPduRBswModulesRef = Dcm if post-build-variant-condition{matching-criterion=RDR_POS, value=6}
          PCAN_DIAG_REQ_PHYS_OTA_oPCAN_RADAR_20_0b124a16_Rx: PduRRoutingPathCommunicationType=TRANSPORT_PROTOCOL if post-build-variant-condition{matching-criterion=RDR_POS, value=7}, PduRRoutingPathCommunicationType=TRANSPORT_PROTOCOL if post-build-variant-condition{matching-criterion=RDR_POS, value=1}, PduRRoutingPathCommunicationType=TRANSPORT_PROTOCOL if post-build-variant-condition{matching-criterion=RDR_POS, value=3}, PduRRoutingPathCommunicationType=TRANSPORT_PROTOCOL if post-build-variant-condition{matching-criterion=RDR_POS, value=0}, PduRRoutingPathCommunicationType=TRANSPORT_PROTOCOL if post-build-variant-condition{matching-criterion=RDR_POS, value=5}, PduRRoutingPathCommunicationType=TRANSPORT_PROTOCOL if post-build-variant-condition{matching-criterion=RDR_POS, value=2}, PduRRoutingPathCommunicationType=TRANSPORT_PROTOCOL if post-build-variant-condition{matching-criterion=RDR_POS, value=4}, PduRRoutingPathCommunicationType=TRANSPORT_PROTOCOL if post-build-variant-condition{matching-criterion=RDR_POS, value=6}, PduRLockRef=PduRLock_PduRExclusiveArea if post-build-variant-condition{matching-criterion=RDR_POS, value=6}, PduRLockRef=PduRLock_PduRExclusiveArea if post-build-variant-condition{matching-criterion=RDR_POS, value=1}, PduRLockRef=PduRLock_PduRExclusiveArea if post-build-variant-condition{matching-criterion=RDR_POS, value=3}, PduRLockRef=PduRLock_PduRExclusiveArea if post-build-variant-condition{matching-criterion=RDR_POS, value=0}, PduRLockRef=PduRLock_PduRExclusiveArea if post-build-variant-condition{matching-criterion=RDR_POS, value=7}, PduRLockRef=PduRLock_PduRExclusiveArea if post-build-variant-condition{matching-criterion=RDR_POS, value=5}, PduRLockRef=PduRLock_PduRExclusiveArea if post-build-variant-condition{matching-criterion=RDR_POS, value=2}, PduRLockRef=PduRLock_PduRExclusiveArea if post-build-variant-condition{matching-criterion=RDR_POS, value=4}
            PCAN_DIAG_REQ_PHYS_OTA_oPCAN_RADAR_20_0b124a16_Rx_58857336_Rx (PduRDestPdu):
              PduRDestPduHandleId = 21
              PduRDestPduDirection = RECEIVE if post-build-variant-condition{matching-criterion=RDR_POS, value=5}
              PduRDestPduDirection = RECEIVE if post-build-variant-condition{matching-criterion=RDR_POS, value=1}
              PduRDestPduDirection = RECEIVE if post-build-variant-condition{matching-criterion=RDR_POS, value=3}
              PduRDestPduDirection = RECEIVE if post-build-variant-condition{matching-criterion=RDR_POS, value=0}
              PduRDestPduDirection = RECEIVE if post-build-variant-condition{matching-criterion=RDR_POS, value=7}
              PduRDestPduDirection = RECEIVE if post-build-variant-condition{matching-criterion=RDR_POS, value=2}
              PduRDestPduDirection = RECEIVE if post-build-variant-condition{matching-criterion=RDR_POS, value=4}
              PduRDestPduDirection = RECEIVE if post-build-variant-condition{matching-criterion=RDR_POS, value=6}
              PduRDestPduRoutingType = API_FORWARDING if post-build-variant-condition{matching-criterion=RDR_POS, value=7}
              PduRDestPduRoutingType = API_FORWARDING if post-build-variant-condition{matching-criterion=RDR_POS, value=1}
              PduRDestPduRoutingType = API_FORWARDING if post-build-variant-condition{matching-criterion=RDR_POS, value=3}
              PduRDestPduRoutingType = API_FORWARDING if post-build-variant-condition{matching-criterion=RDR_POS, value=0}
              PduRDestPduRoutingType = API_FORWARDING if post-build-variant-condition{matching-criterion=RDR_POS, value=5}
              PduRDestPduRoutingType = API_FORWARDING if post-build-variant-condition{matching-criterion=RDR_POS, value=2}
              PduRDestPduRoutingType = API_FORWARDING if post-build-variant-condition{matching-criterion=RDR_POS, value=4}
              PduRDestPduRoutingType = API_FORWARDING if post-build-variant-condition{matching-criterion=RDR_POS, value=6}
              PduRDestPduDataProcessing = IMMEDIATE
              PduRPduLengthHandlingStrategy = UNUSED
              PduRDestPduCrossPartitionDestination = false
              PduRDestPduRef = PCAN_DIAG_REQ_PHYS_OTA_oPCAN_RADAR_20_39ae8dba_Rx
              PduRDestPduPduRBswModulesRef = Dcm if post-build-variant-condition{matching-criterion=RDR_POS, value=3}
              PduRDestPduPduRBswModulesRef = Dcm if post-build-variant-condition{matching-criterion=RDR_POS, value=2}
              PduRDestPduPduRBswModulesRef = Dcm if post-build-variant-condition{matching-criterion=RDR_POS, value=7}
              PduRDestPduPduRBswModulesRef = Dcm if post-build-variant-condition{matching-criterion=RDR_POS, value=5}
              PduRDestPduPduRBswModulesRef = Dcm if post-build-variant-condition{matching-criterion=RDR_POS, value=1}
              PduRDestPduPduRBswModulesRef = Dcm if post-build-variant-condition{matching-criterion=RDR_POS, value=0}
              PduRDestPduPduRBswModulesRef = Dcm if post-build-variant-condition{matching-criterion=RDR_POS, value=4}
              PduRDestPduPduRBswModulesRef = Dcm if post-build-variant-condition{matching-criterion=RDR_POS, value=6}
            PduRSrcPdu_58857336 (PduRSrcPdu):
              PduRSourcePduHandleId = 20
              PduRSrcPduDirection = RECEIVE if post-build-variant-condition{matching-criterion=RDR_POS, value=4}
              PduRSrcPduDirection = RECEIVE if post-build-variant-condition{matching-criterion=RDR_POS, value=1}
              PduRSrcPduDirection = RECEIVE if post-build-variant-condition{matching-criterion=RDR_POS, value=3}
              PduRSrcPduDirection = RECEIVE if post-build-variant-condition{matching-criterion=RDR_POS, value=0}
              PduRSrcPduDirection = RECEIVE if post-build-variant-condition{matching-criterion=RDR_POS, value=7}
              PduRSrcPduDirection = RECEIVE if post-build-variant-condition{matching-criterion=RDR_POS, value=5}
              PduRSrcPduDirection = RECEIVE if post-build-variant-condition{matching-criterion=RDR_POS, value=2}
              PduRSrcPduDirection = RECEIVE if post-build-variant-condition{matching-criterion=RDR_POS, value=6}
              PduRSrcPduRef = PCAN_DIAG_REQ_PHYS_OTA_oPCAN_RADAR_20_0b124a16_Rx
              PduRSrcPduPduRBswModulesRef = CanTp if post-build-variant-condition{matching-criterion=RDR_POS, value=6}
              PduRSrcPduPduRBswModulesRef = CanTp if post-build-variant-condition{matching-criterion=RDR_POS, value=1}
              PduRSrcPduPduRBswModulesRef = CanTp if post-build-variant-condition{matching-criterion=RDR_POS, value=5}
              PduRSrcPduPduRBswModulesRef = CanTp if post-build-variant-condition{matching-criterion=RDR_POS, value=0}
              PduRSrcPduPduRBswModulesRef = CanTp if post-build-variant-condition{matching-criterion=RDR_POS, value=2}
              PduRSrcPduPduRBswModulesRef = CanTp if post-build-variant-condition{matching-criterion=RDR_POS, value=7}
              PduRSrcPduPduRBswModulesRef = CanTp if post-build-variant-condition{matching-criterion=RDR_POS, value=3}
              PduRSrcPduPduRBswModulesRef = CanTp if post-build-variant-condition{matching-criterion=RDR_POS, value=4}
          PCAN_DIAG_REQ_FUNC_OBD1_oPCAN_RADAR_20_25c43a7c_Rx: PduRRoutingPathCommunicationType=TRANSPORT_PROTOCOL if post-build-variant-condition{matching-criterion=RDR_POS, value=7}, PduRRoutingPathCommunicationType=TRANSPORT_PROTOCOL if post-build-variant-condition{matching-criterion=RDR_POS, value=1}, PduRRoutingPathCommunicationType=TRANSPORT_PROTOCOL if post-build-variant-condition{matching-criterion=RDR_POS, value=3}, PduRRoutingPathCommunicationType=TRANSPORT_PROTOCOL if post-build-variant-condition{matching-criterion=RDR_POS, value=0}, PduRRoutingPathCommunicationType=TRANSPORT_PROTOCOL if post-build-variant-condition{matching-criterion=RDR_POS, value=5}, PduRRoutingPathCommunicationType=TRANSPORT_PROTOCOL if post-build-variant-condition{matching-criterion=RDR_POS, value=2}, PduRRoutingPathCommunicationType=TRANSPORT_PROTOCOL if post-build-variant-condition{matching-criterion=RDR_POS, value=4}, PduRRoutingPathCommunicationType=TRANSPORT_PROTOCOL if post-build-variant-condition{matching-criterion=RDR_POS, value=6}, PduRLockRef=PduRLock_PduRExclusiveArea if post-build-variant-condition{matching-criterion=RDR_POS, value=6}, PduRLockRef=PduRLock_PduRExclusiveArea if post-build-variant-condition{matching-criterion=RDR_POS, value=1}, PduRLockRef=PduRLock_PduRExclusiveArea if post-build-variant-condition{matching-criterion=RDR_POS, value=3}, PduRLockRef=PduRLock_PduRExclusiveArea if post-build-variant-condition{matching-criterion=RDR_POS, value=0}, PduRLockRef=PduRLock_PduRExclusiveArea if post-build-variant-condition{matching-criterion=RDR_POS, value=7}, PduRLockRef=PduRLock_PduRExclusiveArea if post-build-variant-condition{matching-criterion=RDR_POS, value=5}, PduRLockRef=PduRLock_PduRExclusiveArea if post-build-variant-condition{matching-criterion=RDR_POS, value=2}, PduRLockRef=PduRLock_PduRExclusiveArea if post-build-variant-condition{matching-criterion=RDR_POS, value=4}
            PduRSrcPdu_12ce5aa9 (PduRSrcPdu):
              PduRSourcePduHandleId = 8
              PduRSrcPduDirection = RECEIVE if post-build-variant-condition{matching-criterion=RDR_POS, value=2}
              PduRSrcPduDirection = RECEIVE if post-build-variant-condition{matching-criterion=RDR_POS, value=1}
              PduRSrcPduDirection = RECEIVE if post-build-variant-condition{matching-criterion=RDR_POS, value=3}
              PduRSrcPduDirection = RECEIVE if post-build-variant-condition{matching-criterion=RDR_POS, value=0}
              PduRSrcPduDirection = RECEIVE if post-build-variant-condition{matching-criterion=RDR_POS, value=5}
              PduRSrcPduDirection = RECEIVE if post-build-variant-condition{matching-criterion=RDR_POS, value=7}
              PduRSrcPduDirection = RECEIVE if post-build-variant-condition{matching-criterion=RDR_POS, value=4}
              PduRSrcPduDirection = RECEIVE if post-build-variant-condition{matching-criterion=RDR_POS, value=6}
              PduRSrcPduRef = PCAN_DIAG_REQ_FUNC_OBD1_oPCAN_RADAR_20_25c43a7c_Rx
              PduRSrcPduPduRBswModulesRef = CanTp if post-build-variant-condition{matching-criterion=RDR_POS, value=2}
              PduRSrcPduPduRBswModulesRef = CanTp if post-build-variant-condition{matching-criterion=RDR_POS, value=4}
              PduRSrcPduPduRBswModulesRef = CanTp if post-build-variant-condition{matching-criterion=RDR_POS, value=3}
              PduRSrcPduPduRBswModulesRef = CanTp if post-build-variant-condition{matching-criterion=RDR_POS, value=1}
              PduRSrcPduPduRBswModulesRef = CanTp if post-build-variant-condition{matching-criterion=RDR_POS, value=6}
              PduRSrcPduPduRBswModulesRef = CanTp if post-build-variant-condition{matching-criterion=RDR_POS, value=0}
              PduRSrcPduPduRBswModulesRef = CanTp if post-build-variant-condition{matching-criterion=RDR_POS, value=5}
              PduRSrcPduPduRBswModulesRef = CanTp if post-build-variant-condition{matching-criterion=RDR_POS, value=7}
            PCAN_DIAG_REQ_FUNC_OBD1_oPCAN_RADAR_20_25c43a7c_Rx_12ce5aa9_Rx (PduRDestPdu):
              PduRDestPduHandleId = 8
              PduRDestPduDirection = RECEIVE if post-build-variant-condition{matching-criterion=RDR_POS, value=5}
              PduRDestPduDirection = RECEIVE if post-build-variant-condition{matching-criterion=RDR_POS, value=1}
              PduRDestPduDirection = RECEIVE if post-build-variant-condition{matching-criterion=RDR_POS, value=3}
              PduRDestPduDirection = RECEIVE if post-build-variant-condition{matching-criterion=RDR_POS, value=0}
              PduRDestPduDirection = RECEIVE if post-build-variant-condition{matching-criterion=RDR_POS, value=7}
              PduRDestPduDirection = RECEIVE if post-build-variant-condition{matching-criterion=RDR_POS, value=2}
              PduRDestPduDirection = RECEIVE if post-build-variant-condition{matching-criterion=RDR_POS, value=4}
              PduRDestPduDirection = RECEIVE if post-build-variant-condition{matching-criterion=RDR_POS, value=6}
              PduRDestPduRoutingType = API_FORWARDING if post-build-variant-condition{matching-criterion=RDR_POS, value=3}
              PduRDestPduRoutingType = API_FORWARDING if post-build-variant-condition{matching-criterion=RDR_POS, value=1}
              PduRDestPduRoutingType = API_FORWARDING if post-build-variant-condition{matching-criterion=RDR_POS, value=0}
              PduRDestPduRoutingType = API_FORWARDING if post-build-variant-condition{matching-criterion=RDR_POS, value=7}
              PduRDestPduRoutingType = API_FORWARDING if post-build-variant-condition{matching-criterion=RDR_POS, value=5}
              PduRDestPduRoutingType = API_FORWARDING if post-build-variant-condition{matching-criterion=RDR_POS, value=2}
              PduRDestPduRoutingType = API_FORWARDING if post-build-variant-condition{matching-criterion=RDR_POS, value=4}
              PduRDestPduRoutingType = API_FORWARDING if post-build-variant-condition{matching-criterion=RDR_POS, value=6}
              PduRDestPduDataProcessing = IMMEDIATE
              PduRPduLengthHandlingStrategy = UNUSED
              PduRDestPduCrossPartitionDestination = false
              PduRDestPduRef = PCAN_DIAG_REQ_FUNC_OBD1_oPCAN_RADAR_20_e986e253_Rx
              PduRDestPduPduRBswModulesRef = Dcm if post-build-variant-condition{matching-criterion=RDR_POS, value=2}
              PduRDestPduPduRBswModulesRef = Dcm if post-build-variant-condition{matching-criterion=RDR_POS, value=3}
              PduRDestPduPduRBswModulesRef = Dcm if post-build-variant-condition{matching-criterion=RDR_POS, value=1}
              PduRDestPduPduRBswModulesRef = Dcm if post-build-variant-condition{matching-criterion=RDR_POS, value=5}
              PduRDestPduPduRBswModulesRef = Dcm if post-build-variant-condition{matching-criterion=RDR_POS, value=7}
              PduRDestPduPduRBswModulesRef = Dcm if post-build-variant-condition{matching-criterion=RDR_POS, value=4}
              PduRDestPduPduRBswModulesRef = Dcm if post-build-variant-condition{matching-criterion=RDR_POS, value=6}
              PduRDestPduPduRBswModulesRef = Dcm if post-build-variant-condition{matching-criterion=RDR_POS, value=0}
          SR2_DIAG_RES_PHY_OBD2_oVCAN_RADAR_04d71440_Tx: PduRRoutingPathCommunicationType=COMMUNICATION_INTERFACE if post-build-variant-condition{matching-criterion=RDR_POS, value=7}, PduRRoutingPathCommunicationType=COMMUNICATION_INTERFACE if post-build-variant-condition{matching-criterion=RDR_POS, value=1}, PduRRoutingPathCommunicationType=COMMUNICATION_INTERFACE if post-build-variant-condition{matching-criterion=RDR_POS, value=3}, PduRRoutingPathCommunicationType=COMMUNICATION_INTERFACE if post-build-variant-condition{matching-criterion=RDR_POS, value=0}, PduRRoutingPathCommunicationType=COMMUNICATION_INTERFACE if post-build-variant-condition{matching-criterion=RDR_POS, value=5}, PduRRoutingPathCommunicationType=COMMUNICATION_INTERFACE if post-build-variant-condition{matching-criterion=RDR_POS, value=2}, PduRRoutingPathCommunicationType=COMMUNICATION_INTERFACE if post-build-variant-condition{matching-criterion=RDR_POS, value=4}, PduRRoutingPathCommunicationType=COMMUNICATION_INTERFACE if post-build-variant-condition{matching-criterion=RDR_POS, value=6}, PduRLockRef=PduRLock_PduRExclusiveArea if post-build-variant-condition{matching-criterion=RDR_POS, value=5}, PduRLockRef=PduRLock_PduRExclusiveArea if post-build-variant-condition{matching-criterion=RDR_POS, value=0}, PduRLockRef=PduRLock_PduRExclusiveArea if post-build-variant-condition{matching-criterion=RDR_POS, value=7}, PduRLockRef=PduRLock_PduRExclusiveArea if post-build-variant-condition{matching-criterion=RDR_POS, value=6}, PduRLockRef=PduRLock_PduRExclusiveArea if post-build-variant-condition{matching-criterion=RDR_POS, value=4}, PduRLockRef=PduRLock_PduRExclusiveArea if post-build-variant-condition{matching-criterion=RDR_POS, value=1}, PduRLockRef=PduRLock_PduRExclusiveArea if post-build-variant-condition{matching-criterion=RDR_POS, value=3}, PduRLockRef=PduRLock_PduRExclusiveArea if post-build-variant-condition{matching-criterion=RDR_POS, value=2}
            SR2_DIAG_RES_PHY_OBD2_oVCAN_RADAR_b81d7bcc_Tx (PduRDestPdu):
              PduRDestPduHandleId = 195
              PduRDestPduDirection = TRANSMIT if post-build-variant-condition{matching-criterion=RDR_POS, value=7}
              PduRDestPduDirection = TRANSMIT if post-build-variant-condition{matching-criterion=RDR_POS, value=1}
              PduRDestPduDirection = TRANSMIT if post-build-variant-condition{matching-criterion=RDR_POS, value=3}
              PduRDestPduDirection = TRANSMIT if post-build-variant-condition{matching-criterion=RDR_POS, value=0}
              PduRDestPduDirection = TRANSMIT if post-build-variant-condition{matching-criterion=RDR_POS, value=5}
              PduRDestPduDirection = TRANSMIT if post-build-variant-condition{matching-criterion=RDR_POS, value=2}
              PduRDestPduDirection = TRANSMIT if post-build-variant-condition{matching-criterion=RDR_POS, value=4}
              PduRDestPduDirection = TRANSMIT if post-build-variant-condition{matching-criterion=RDR_POS, value=6}
              PduRDestPduRoutingType = GATEWAY_ROUTING if post-build-variant-condition{matching-criterion=RDR_POS, value=2}
              PduRDestPduRoutingType = GATEWAY_ROUTING if post-build-variant-condition{matching-criterion=RDR_POS, value=0}
              PduRDestPduRoutingType = GATEWAY_ROUTING if post-build-variant-condition{matching-criterion=RDR_POS, value=7}
              PduRDestPduRoutingType = GATEWAY_ROUTING if post-build-variant-condition{matching-criterion=RDR_POS, value=6}
              PduRDestPduRoutingType = GATEWAY_ROUTING if post-build-variant-condition{matching-criterion=RDR_POS, value=4}
              PduRDestPduRoutingType = GATEWAY_ROUTING if post-build-variant-condition{matching-criterion=RDR_POS, value=1}
              PduRDestPduRoutingType = GATEWAY_ROUTING if post-build-variant-condition{matching-criterion=RDR_POS, value=3}
              PduRDestPduRoutingType = GATEWAY_ROUTING if post-build-variant-condition{matching-criterion=RDR_POS, value=5}
              PduRDestPduDataProcessing = IMMEDIATE
              PduRPduLengthHandlingStrategy = IGNORE
              PduRDestPduCrossPartitionDestination = false
              PduRTransmissionConfirmation = false
              PduRDestPduDataProvision = PDUR_DIRECT
              PduRDestPduRef = SR2_DIAG_RES_PHY_OBD2_oVCAN_RADAR_b81d7bcc_Tx
              PduRDestPduPduRBswModulesRef = CanIf if post-build-variant-condition{matching-criterion=RDR_POS, value=0}
              PduRDestPduPduRBswModulesRef = CanIf if post-build-variant-condition{matching-criterion=RDR_POS, value=2}
              PduRDestPduPduRBswModulesRef = CanIf if post-build-variant-condition{matching-criterion=RDR_POS, value=6}
              PduRDestPduPduRBswModulesRef = CanIf if post-build-variant-condition{matching-criterion=RDR_POS, value=7}
              PduRDestPduPduRBswModulesRef = CanIf if post-build-variant-condition{matching-criterion=RDR_POS, value=4}
              PduRDestPduPduRBswModulesRef = CanIf if post-build-variant-condition{matching-criterion=RDR_POS, value=1}
              PduRDestPduPduRBswModulesRef = CanIf if post-build-variant-condition{matching-criterion=RDR_POS, value=5}
              PduRDestPduPduRBswModulesRef = CanIf if post-build-variant-condition{matching-criterion=RDR_POS, value=3}
            PduRSrcPdu_148ccc54_001 (PduRSrcPdu):
              PduRSourcePduHandleId = 78
              PduRSrcPduDirection = RECEIVE if post-build-variant-condition{matching-criterion=RDR_POS, value=2}
              PduRSrcPduDirection = RECEIVE if post-build-variant-condition{matching-criterion=RDR_POS, value=0}
              PduRSrcPduDirection = RECEIVE if post-build-variant-condition{matching-criterion=RDR_POS, value=7}
              PduRSrcPduDirection = RECEIVE if post-build-variant-condition{matching-criterion=RDR_POS, value=6}
              PduRSrcPduDirection = RECEIVE if post-build-variant-condition{matching-criterion=RDR_POS, value=4}
              PduRSrcPduDirection = RECEIVE if post-build-variant-condition{matching-criterion=RDR_POS, value=1}
              PduRSrcPduDirection = RECEIVE if post-build-variant-condition{matching-criterion=RDR_POS, value=3}
              PduRSrcPduDirection = RECEIVE if post-build-variant-condition{matching-criterion=RDR_POS, value=5}
              PduRSrcPduRef = SRR_RL_DIAG_RESP_PHYS_OBD2_Rx_oPCAN_RADAR_4dec4cd0_Rx
              PduRSrcPduPduRBswModulesRef = CanIf if post-build-variant-condition{matching-criterion=RDR_POS, value=6}
              PduRSrcPduPduRBswModulesRef = CanIf if post-build-variant-condition{matching-criterion=RDR_POS, value=1}
              PduRSrcPduPduRBswModulesRef = CanIf if post-build-variant-condition{matching-criterion=RDR_POS, value=5}
              PduRSrcPduPduRBswModulesRef = CanIf if post-build-variant-condition{matching-criterion=RDR_POS, value=4}
              PduRSrcPduPduRBswModulesRef = CanIf if post-build-variant-condition{matching-criterion=RDR_POS, value=2}
              PduRSrcPduPduRBswModulesRef = CanIf if post-build-variant-condition{matching-criterion=RDR_POS, value=3}
              PduRSrcPduPduRBswModulesRef = CanIf if post-build-variant-condition{matching-criterion=RDR_POS, value=7}
              PduRSrcPduPduRBswModulesRef = CanIf if post-build-variant-condition{matching-criterion=RDR_POS, value=0}
          DIAG_REQ_FNC_OTA_oVCAN_RADAR_e787ed21_Rx: PduRRoutingPathCommunicationType=TRANSPORT_PROTOCOL if post-build-variant-condition{matching-criterion=RDR_POS, value=2}, PduRRoutingPathCommunicationType=TRANSPORT_PROTOCOL if post-build-variant-condition{matching-criterion=RDR_POS, value=1}, PduRRoutingPathCommunicationType=TRANSPORT_PROTOCOL if post-build-variant-condition{matching-criterion=RDR_POS, value=3}, PduRRoutingPathCommunicationType=TRANSPORT_PROTOCOL if post-build-variant-condition{matching-criterion=RDR_POS, value=0}, PduRRoutingPathCommunicationType=TRANSPORT_PROTOCOL if post-build-variant-condition{matching-criterion=RDR_POS, value=5}, PduRRoutingPathCommunicationType=TRANSPORT_PROTOCOL if post-build-variant-condition{matching-criterion=RDR_POS, value=7}, PduRRoutingPathCommunicationType=TRANSPORT_PROTOCOL if post-build-variant-condition{matching-criterion=RDR_POS, value=4}, PduRRoutingPathCommunicationType=TRANSPORT_PROTOCOL if post-build-variant-condition{matching-criterion=RDR_POS, value=6}, PduRLockRef=PduRLock_PduRExclusiveArea if post-build-variant-condition{matching-criterion=RDR_POS, value=6}, PduRLockRef=PduRLock_PduRExclusiveArea if post-build-variant-condition{matching-criterion=RDR_POS, value=1}, PduRLockRef=PduRLock_PduRExclusiveArea if post-build-variant-condition{matching-criterion=RDR_POS, value=3}, PduRLockRef=PduRLock_PduRExclusiveArea if post-build-variant-condition{matching-criterion=RDR_POS, value=0}, PduRLockRef=PduRLock_PduRExclusiveArea if post-build-variant-condition{matching-criterion=RDR_POS, value=7}, PduRLockRef=PduRLock_PduRExclusiveArea if post-build-variant-condition{matching-criterion=RDR_POS, value=5}, PduRLockRef=PduRLock_PduRExclusiveArea if post-build-variant-condition{matching-criterion=RDR_POS, value=2}, PduRLockRef=PduRLock_PduRExclusiveArea if post-build-variant-condition{matching-criterion=RDR_POS, value=4}
            DIAG_REQ_FNC_OTA_oVCAN_RADAR_e787ed21_Rx_dbaad71c_Rx (PduRDestPdu):
              PduRDestPduHandleId = 2
              PduRDestPduDirection = RECEIVE if post-build-variant-condition{matching-criterion=RDR_POS, value=3}
              PduRDestPduDirection = RECEIVE if post-build-variant-condition{matching-criterion=RDR_POS, value=1}
              PduRDestPduDirection = RECEIVE if post-build-variant-condition{matching-criterion=RDR_POS, value=0}
              PduRDestPduDirection = RECEIVE if post-build-variant-condition{matching-criterion=RDR_POS, value=7}
              PduRDestPduDirection = RECEIVE if post-build-variant-condition{matching-criterion=RDR_POS, value=5}
              PduRDestPduDirection = RECEIVE if post-build-variant-condition{matching-criterion=RDR_POS, value=2}
              PduRDestPduDirection = RECEIVE if post-build-variant-condition{matching-criterion=RDR_POS, value=4}
              PduRDestPduDirection = RECEIVE if post-build-variant-condition{matching-criterion=RDR_POS, value=6}
              PduRDestPduRoutingType = API_FORWARDING if post-build-variant-condition{matching-criterion=RDR_POS, value=1}
              PduRDestPduRoutingType = API_FORWARDING if post-build-variant-condition{matching-criterion=RDR_POS, value=3}
              PduRDestPduRoutingType = API_FORWARDING if post-build-variant-condition{matching-criterion=RDR_POS, value=0}
              PduRDestPduRoutingType = API_FORWARDING if post-build-variant-condition{matching-criterion=RDR_POS, value=7}
              PduRDestPduRoutingType = API_FORWARDING if post-build-variant-condition{matching-criterion=RDR_POS, value=5}
              PduRDestPduRoutingType = API_FORWARDING if post-build-variant-condition{matching-criterion=RDR_POS, value=2}
              PduRDestPduRoutingType = API_FORWARDING if post-build-variant-condition{matching-criterion=RDR_POS, value=4}
              PduRDestPduRoutingType = API_FORWARDING if post-build-variant-condition{matching-criterion=RDR_POS, value=6}
              PduRDestPduDataProcessing = IMMEDIATE
              PduRPduLengthHandlingStrategy = UNUSED
              PduRDestPduCrossPartitionDestination = false
              PduRDestPduRef = DIAG_REQ_FNC_OTA_oVCAN_RADAR_b630c1e5_Rx
              PduRDestPduPduRBswModulesRef = Dcm if post-build-variant-condition{matching-criterion=RDR_POS, value=4}
              PduRDestPduPduRBswModulesRef = Dcm if post-build-variant-condition{matching-criterion=RDR_POS, value=3}
              PduRDestPduPduRBswModulesRef = Dcm if post-build-variant-condition{matching-criterion=RDR_POS, value=1}
              PduRDestPduPduRBswModulesRef = Dcm if post-build-variant-condition{matching-criterion=RDR_POS, value=5}
              PduRDestPduPduRBswModulesRef = Dcm if post-build-variant-condition{matching-criterion=RDR_POS, value=6}
              PduRDestPduPduRBswModulesRef = Dcm if post-build-variant-condition{matching-criterion=RDR_POS, value=0}
              PduRDestPduPduRBswModulesRef = Dcm if post-build-variant-condition{matching-criterion=RDR_POS, value=7}
              PduRDestPduPduRBswModulesRef = Dcm if post-build-variant-condition{matching-criterion=RDR_POS, value=2}
            PduRSrcPdu_dbaad71c (PduRSrcPdu):
              PduRSourcePduHandleId = 2
              PduRSrcPduDirection = RECEIVE if post-build-variant-condition{matching-criterion=RDR_POS, value=0}
              PduRSrcPduDirection = RECEIVE if post-build-variant-condition{matching-criterion=RDR_POS, value=1}
              PduRSrcPduDirection = RECEIVE if post-build-variant-condition{matching-criterion=RDR_POS, value=3}
              PduRSrcPduDirection = RECEIVE if post-build-variant-condition{matching-criterion=RDR_POS, value=7}
              PduRSrcPduDirection = RECEIVE if post-build-variant-condition{matching-criterion=RDR_POS, value=5}
              PduRSrcPduDirection = RECEIVE if post-build-variant-condition{matching-criterion=RDR_POS, value=2}
              PduRSrcPduDirection = RECEIVE if post-build-variant-condition{matching-criterion=RDR_POS, value=4}
              PduRSrcPduDirection = RECEIVE if post-build-variant-condition{matching-criterion=RDR_POS, value=6}
              PduRSrcPduRef = DIAG_REQ_FNC_OTA_oVCAN_RADAR_e787ed21_Rx
              PduRSrcPduPduRBswModulesRef = CanTp if post-build-variant-condition{matching-criterion=RDR_POS, value=7}
              PduRSrcPduPduRBswModulesRef = CanTp if post-build-variant-condition{matching-criterion=RDR_POS, value=1}
              PduRSrcPduPduRBswModulesRef = CanTp if post-build-variant-condition{matching-criterion=RDR_POS, value=5}
              PduRSrcPduPduRBswModulesRef = CanTp if post-build-variant-condition{matching-criterion=RDR_POS, value=4}
              PduRSrcPduPduRBswModulesRef = CanTp if post-build-variant-condition{matching-criterion=RDR_POS, value=3}
              PduRSrcPduPduRBswModulesRef = CanTp if post-build-variant-condition{matching-criterion=RDR_POS, value=0}
              PduRSrcPduPduRBswModulesRef = CanTp if post-build-variant-condition{matching-criterion=RDR_POS, value=2}
              PduRSrcPduPduRBswModulesRef = CanTp if post-build-variant-condition{matching-criterion=RDR_POS, value=6}
          DIAG_REQ_FNC_OBD1_oVCAN_RADAR_7e5c8685_Rx: PduRRoutingPathCommunicationType=TRANSPORT_PROTOCOL if post-build-variant-condition{matching-criterion=RDR_POS, value=4}, PduRRoutingPathCommunicationType=TRANSPORT_PROTOCOL if post-build-variant-condition{matching-criterion=RDR_POS, value=1}, PduRRoutingPathCommunicationType=TRANSPORT_PROTOCOL if post-build-variant-condition{matching-criterion=RDR_POS, value=3}, PduRRoutingPathCommunicationType=TRANSPORT_PROTOCOL if post-build-variant-condition{matching-criterion=RDR_POS, value=0}, PduRRoutingPathCommunicationType=TRANSPORT_PROTOCOL if post-build-variant-condition{matching-criterion=RDR_POS, value=7}, PduRRoutingPathCommunicationType=TRANSPORT_PROTOCOL if post-build-variant-condition{matching-criterion=RDR_POS, value=5}, PduRRoutingPathCommunicationType=TRANSPORT_PROTOCOL if post-build-variant-condition{matching-criterion=RDR_POS, value=2}, PduRRoutingPathCommunicationType=TRANSPORT_PROTOCOL if post-build-variant-condition{matching-criterion=RDR_POS, value=6}, PduRLockRef=PduRLock_PduRExclusiveArea if post-build-variant-condition{matching-criterion=RDR_POS, value=6}, PduRLockRef=PduRLock_PduRExclusiveArea if post-build-variant-condition{matching-criterion=RDR_POS, value=1}, PduRLockRef=PduRLock_PduRExclusiveArea if post-build-variant-condition{matching-criterion=RDR_POS, value=3}, PduRLockRef=PduRLock_PduRExclusiveArea if post-build-variant-condition{matching-criterion=RDR_POS, value=0}, PduRLockRef=PduRLock_PduRExclusiveArea if post-build-variant-condition{matching-criterion=RDR_POS, value=7}, PduRLockRef=PduRLock_PduRExclusiveArea if post-build-variant-condition{matching-criterion=RDR_POS, value=5}, PduRLockRef=PduRLock_PduRExclusiveArea if post-build-variant-condition{matching-criterion=RDR_POS, value=2}, PduRLockRef=PduRLock_PduRExclusiveArea if post-build-variant-condition{matching-criterion=RDR_POS, value=4}
            DIAG_REQ_FNC_OBD1_oVCAN_RADAR_7e5c8685_Rx_e4e4d778_Rx (PduRDestPdu):
              PduRDestPduHandleId = 0
              PduRDestPduDirection = RECEIVE if post-build-variant-condition{matching-criterion=RDR_POS, value=7}
              PduRDestPduDirection = RECEIVE if post-build-variant-condition{matching-criterion=RDR_POS, value=1}
              PduRDestPduDirection = RECEIVE if post-build-variant-condition{matching-criterion=RDR_POS, value=3}
              PduRDestPduDirection = RECEIVE if post-build-variant-condition{matching-criterion=RDR_POS, value=0}
              PduRDestPduDirection = RECEIVE if post-build-variant-condition{matching-criterion=RDR_POS, value=5}
              PduRDestPduDirection = RECEIVE if post-build-variant-condition{matching-criterion=RDR_POS, value=2}
              PduRDestPduDirection = RECEIVE if post-build-variant-condition{matching-criterion=RDR_POS, value=4}
              PduRDestPduDirection = RECEIVE if post-build-variant-condition{matching-criterion=RDR_POS, value=6}
              PduRDestPduRoutingType = API_FORWARDING if post-build-variant-condition{matching-criterion=RDR_POS, value=0}
              PduRDestPduRoutingType = API_FORWARDING if post-build-variant-condition{matching-criterion=RDR_POS, value=1}
              PduRDestPduRoutingType = API_FORWARDING if post-build-variant-condition{matching-criterion=RDR_POS, value=3}
              PduRDestPduRoutingType = API_FORWARDING if post-build-variant-condition{matching-criterion=RDR_POS, value=7}
              PduRDestPduRoutingType = API_FORWARDING if post-build-variant-condition{matching-criterion=RDR_POS, value=5}
              PduRDestPduRoutingType = API_FORWARDING if post-build-variant-condition{matching-criterion=RDR_POS, value=2}
              PduRDestPduRoutingType = API_FORWARDING if post-build-variant-condition{matching-criterion=RDR_POS, value=4}
              PduRDestPduRoutingType = API_FORWARDING if post-build-variant-condition{matching-criterion=RDR_POS, value=6}
              PduRDestPduDataProcessing = IMMEDIATE
              PduRPduLengthHandlingStrategy = UNUSED
              PduRDestPduCrossPartitionDestination = false
              PduRDestPduRef = DIAG_REQ_FNC_OBD1_oVCAN_RADAR_ea4d23fb_Rx
              PduRDestPduPduRBswModulesRef = Dcm if post-build-variant-condition{matching-criterion=RDR_POS, value=7}
              PduRDestPduPduRBswModulesRef = Dcm if post-build-variant-condition{matching-criterion=RDR_POS, value=0}
              PduRDestPduPduRBswModulesRef = Dcm if post-build-variant-condition{matching-criterion=RDR_POS, value=4}
              PduRDestPduPduRBswModulesRef = Dcm if post-build-variant-condition{matching-criterion=RDR_POS, value=5}
              PduRDestPduPduRBswModulesRef = Dcm if post-build-variant-condition{matching-criterion=RDR_POS, value=3}
              PduRDestPduPduRBswModulesRef = Dcm if post-build-variant-condition{matching-criterion=RDR_POS, value=1}
              PduRDestPduPduRBswModulesRef = Dcm if post-build-variant-condition{matching-criterion=RDR_POS, value=2}
              PduRDestPduPduRBswModulesRef = Dcm if post-build-variant-condition{matching-criterion=RDR_POS, value=6}
            PduRSrcPdu_e4e4d778 (PduRSrcPdu):
              PduRSourcePduHandleId = 0
              PduRSrcPduDirection = RECEIVE if post-build-variant-condition{matching-criterion=RDR_POS, value=4}
              PduRSrcPduDirection = RECEIVE if post-build-variant-condition{matching-criterion=RDR_POS, value=1}
              PduRSrcPduDirection = RECEIVE if post-build-variant-condition{matching-criterion=RDR_POS, value=3}
              PduRSrcPduDirection = RECEIVE if post-build-variant-condition{matching-criterion=RDR_POS, value=0}
              PduRSrcPduDirection = RECEIVE if post-build-variant-condition{matching-criterion=RDR_POS, value=7}
              PduRSrcPduDirection = RECEIVE if post-build-variant-condition{matching-criterion=RDR_POS, value=5}
              PduRSrcPduDirection = RECEIVE if post-build-variant-condition{matching-criterion=RDR_POS, value=2}
              PduRSrcPduDirection = RECEIVE if post-build-variant-condition{matching-criterion=RDR_POS, value=6}
              PduRSrcPduRef = DIAG_REQ_FNC_OBD1_oVCAN_RADAR_7e5c8685_Rx
              PduRSrcPduPduRBswModulesRef = CanTp if post-build-variant-condition{matching-criterion=RDR_POS, value=1}
              PduRSrcPduPduRBswModulesRef = CanTp if post-build-variant-condition{matching-criterion=RDR_POS, value=2}
              PduRSrcPduPduRBswModulesRef = CanTp if post-build-variant-condition{matching-criterion=RDR_POS, value=4}
              PduRSrcPduPduRBswModulesRef = CanTp if post-build-variant-condition{matching-criterion=RDR_POS, value=3}
              PduRSrcPduPduRBswModulesRef = CanTp if post-build-variant-condition{matching-criterion=RDR_POS, value=6}
              PduRSrcPduPduRBswModulesRef = CanTp if post-build-variant-condition{matching-criterion=RDR_POS, value=7}
              PduRSrcPduPduRBswModulesRef = CanTp if post-build-variant-condition{matching-criterion=RDR_POS, value=5}
              PduRSrcPduPduRBswModulesRef = CanTp if post-build-variant-condition{matching-criterion=RDR_POS, value=0}
          PCAN_DIAG_RESP_PHYS_OBD1_oPCAN_RADAR_62c2ee1d_Tx: PduRRoutingPathCommunicationType=TRANSPORT_PROTOCOL if post-build-variant-condition{matching-criterion=RDR_POS, value=3}, PduRRoutingPathCommunicationType=TRANSPORT_PROTOCOL if post-build-variant-condition{matching-criterion=RDR_POS, value=1}, PduRRoutingPathCommunicationType=TRANSPORT_PROTOCOL if post-build-variant-condition{matching-criterion=RDR_POS, value=0}, PduRRoutingPathCommunicationType=TRANSPORT_PROTOCOL if post-build-variant-condition{matching-criterion=RDR_POS, value=7}, PduRRoutingPathCommunicationType=TRANSPORT_PROTOCOL if post-build-variant-condition{matching-criterion=RDR_POS, value=5}, PduRRoutingPathCommunicationType=TRANSPORT_PROTOCOL if post-build-variant-condition{matching-criterion=RDR_POS, value=2}, PduRRoutingPathCommunicationType=TRANSPORT_PROTOCOL if post-build-variant-condition{matching-criterion=RDR_POS, value=4}, PduRRoutingPathCommunicationType=TRANSPORT_PROTOCOL if post-build-variant-condition{matching-criterion=RDR_POS, value=6}, PduRLockRef=PduRLock_PduRExclusiveArea if post-build-variant-condition{matching-criterion=RDR_POS, value=6}, PduRLockRef=PduRLock_PduRExclusiveArea if post-build-variant-condition{matching-criterion=RDR_POS, value=1}, PduRLockRef=PduRLock_PduRExclusiveArea if post-build-variant-condition{matching-criterion=RDR_POS, value=3}, PduRLockRef=PduRLock_PduRExclusiveArea if post-build-variant-condition{matching-criterion=RDR_POS, value=0}, PduRLockRef=PduRLock_PduRExclusiveArea if post-build-variant-condition{matching-criterion=RDR_POS, value=7}, PduRLockRef=PduRLock_PduRExclusiveArea if post-build-variant-condition{matching-criterion=RDR_POS, value=5}, PduRLockRef=PduRLock_PduRExclusiveArea if post-build-variant-condition{matching-criterion=RDR_POS, value=2}, PduRLockRef=PduRLock_PduRExclusiveArea if post-build-variant-condition{matching-criterion=RDR_POS, value=4}
            PduRSrcPdu_6149f4ac (PduRSrcPdu):
              PduRSourcePduHandleId = 8
              PduRSrcPduDirection = TRANSMIT if post-build-variant-condition{matching-criterion=RDR_POS, value=2}
              PduRSrcPduDirection = TRANSMIT if post-build-variant-condition{matching-criterion=RDR_POS, value=1}
              PduRSrcPduDirection = TRANSMIT if post-build-variant-condition{matching-criterion=RDR_POS, value=3}
              PduRSrcPduDirection = TRANSMIT if post-build-variant-condition{matching-criterion=RDR_POS, value=0}
              PduRSrcPduDirection = TRANSMIT if post-build-variant-condition{matching-criterion=RDR_POS, value=5}
              PduRSrcPduDirection = TRANSMIT if post-build-variant-condition{matching-criterion=RDR_POS, value=7}
              PduRSrcPduDirection = TRANSMIT if post-build-variant-condition{matching-criterion=RDR_POS, value=4}
              PduRSrcPduDirection = TRANSMIT if post-build-variant-condition{matching-criterion=RDR_POS, value=6}
              PduRSrcPduRef = PCAN_DIAG_RESP_PHYS_OBD1_oPCAN_RADAR_62c2ee1d_Tx
              PduRSrcPduPduRBswModulesRef = Dcm if post-build-variant-condition{matching-criterion=RDR_POS, value=7}
              PduRSrcPduPduRBswModulesRef = Dcm if post-build-variant-condition{matching-criterion=RDR_POS, value=5}
              PduRSrcPduPduRBswModulesRef = Dcm if post-build-variant-condition{matching-criterion=RDR_POS, value=6}
              PduRSrcPduPduRBswModulesRef = Dcm if post-build-variant-condition{matching-criterion=RDR_POS, value=4}
              PduRSrcPduPduRBswModulesRef = Dcm if post-build-variant-condition{matching-criterion=RDR_POS, value=3}
              PduRSrcPduPduRBswModulesRef = Dcm if post-build-variant-condition{matching-criterion=RDR_POS, value=2}
              PduRSrcPduPduRBswModulesRef = Dcm if post-build-variant-condition{matching-criterion=RDR_POS, value=1}
              PduRSrcPduPduRBswModulesRef = Dcm if post-build-variant-condition{matching-criterion=RDR_POS, value=0}
            PCAN_DIAG_RESP_PHYS_OBD1_oPCAN_RADAR_572eb9fe_Tx (PduRDestPdu):
              PduRDestPduHandleId = 6
              PduRDestPduDirection = TRANSMIT if post-build-variant-condition{matching-criterion=RDR_POS, value=4}
              PduRDestPduDirection = TRANSMIT if post-build-variant-condition{matching-criterion=RDR_POS, value=1}
              PduRDestPduDirection = TRANSMIT if post-build-variant-condition{matching-criterion=RDR_POS, value=3}
              PduRDestPduDirection = TRANSMIT if post-build-variant-condition{matching-criterion=RDR_POS, value=0}
              PduRDestPduDirection = TRANSMIT if post-build-variant-condition{matching-criterion=RDR_POS, value=7}
              PduRDestPduDirection = TRANSMIT if post-build-variant-condition{matching-criterion=RDR_POS, value=5}
              PduRDestPduDirection = TRANSMIT if post-build-variant-condition{matching-criterion=RDR_POS, value=2}
              PduRDestPduDirection = TRANSMIT if post-build-variant-condition{matching-criterion=RDR_POS, value=6}
              PduRDestPduRoutingType = API_FORWARDING if post-build-variant-condition{matching-criterion=RDR_POS, value=0}
              PduRDestPduRoutingType = API_FORWARDING if post-build-variant-condition{matching-criterion=RDR_POS, value=1}
              PduRDestPduRoutingType = API_FORWARDING if post-build-variant-condition{matching-criterion=RDR_POS, value=3}
              PduRDestPduRoutingType = API_FORWARDING if post-build-variant-condition{matching-criterion=RDR_POS, value=7}
              PduRDestPduRoutingType = API_FORWARDING if post-build-variant-condition{matching-criterion=RDR_POS, value=5}
              PduRDestPduRoutingType = API_FORWARDING if post-build-variant-condition{matching-criterion=RDR_POS, value=2}
              PduRDestPduRoutingType = API_FORWARDING if post-build-variant-condition{matching-criterion=RDR_POS, value=4}
              PduRDestPduRoutingType = API_FORWARDING if post-build-variant-condition{matching-criterion=RDR_POS, value=6}
              PduRDestPduDataProcessing = IMMEDIATE
              PduRPduLengthHandlingStrategy = UNUSED
              PduRDestPduCrossPartitionDestination = false
              PduRDestPduRef = PCAN_DIAG_RESP_PHYS_OBD1_oPCAN_RADAR_572eb9fe_Tx
              PduRDestPduPduRBswModulesRef = CanTp if post-build-variant-condition{matching-criterion=RDR_POS, value=1}
              PduRDestPduPduRBswModulesRef = CanTp if post-build-variant-condition{matching-criterion=RDR_POS, value=5}
              PduRDestPduPduRBswModulesRef = CanTp if post-build-variant-condition{matching-criterion=RDR_POS, value=0}
              PduRDestPduPduRBswModulesRef = CanTp if post-build-variant-condition{matching-criterion=RDR_POS, value=6}
              PduRDestPduPduRBswModulesRef = CanTp if post-build-variant-condition{matching-criterion=RDR_POS, value=3}
              PduRDestPduPduRBswModulesRef = CanTp if post-build-variant-condition{matching-criterion=RDR_POS, value=7}
              PduRDestPduPduRBswModulesRef = CanTp if post-build-variant-condition{matching-criterion=RDR_POS, value=2}
              PduRDestPduPduRBswModulesRef = CanTp if post-build-variant-condition{matching-criterion=RDR_POS, value=4}
          PCAN_DIAG_REQ_PHYS_OBD2_oPCAN_RADAR_20_95757328_Rx: PduRRoutingPathCommunicationType=TRANSPORT_PROTOCOL if post-build-variant-condition{matching-criterion=RDR_POS, value=2}, PduRRoutingPathCommunicationType=TRANSPORT_PROTOCOL if post-build-variant-condition{matching-criterion=RDR_POS, value=1}, PduRRoutingPathCommunicationType=TRANSPORT_PROTOCOL if post-build-variant-condition{matching-criterion=RDR_POS, value=3}, PduRRoutingPathCommunicationType=TRANSPORT_PROTOCOL if post-build-variant-condition{matching-criterion=RDR_POS, value=0}, PduRRoutingPathCommunicationType=TRANSPORT_PROTOCOL if post-build-variant-condition{matching-criterion=RDR_POS, value=5}, PduRRoutingPathCommunicationType=TRANSPORT_PROTOCOL if post-build-variant-condition{matching-criterion=RDR_POS, value=7}, PduRRoutingPathCommunicationType=TRANSPORT_PROTOCOL if post-build-variant-condition{matching-criterion=RDR_POS, value=4}, PduRRoutingPathCommunicationType=TRANSPORT_PROTOCOL if post-build-variant-condition{matching-criterion=RDR_POS, value=6}, PduRLockRef=PduRLock_PduRExclusiveArea if post-build-variant-condition{matching-criterion=RDR_POS, value=6}, PduRLockRef=PduRLock_PduRExclusiveArea if post-build-variant-condition{matching-criterion=RDR_POS, value=1}, PduRLockRef=PduRLock_PduRExclusiveArea if post-build-variant-condition{matching-criterion=RDR_POS, value=3}, PduRLockRef=PduRLock_PduRExclusiveArea if post-build-variant-condition{matching-criterion=RDR_POS, value=0}, PduRLockRef=PduRLock_PduRExclusiveArea if post-build-variant-condition{matching-criterion=RDR_POS, value=7}, PduRLockRef=PduRLock_PduRExclusiveArea if post-build-variant-condition{matching-criterion=RDR_POS, value=5}, PduRLockRef=PduRLock_PduRExclusiveArea if post-build-variant-condition{matching-criterion=RDR_POS, value=2}, PduRLockRef=PduRLock_PduRExclusiveArea if post-build-variant-condition{matching-criterion=RDR_POS, value=4}
            PCAN_DIAG_REQ_PHYS_OBD2_oPCAN_RADAR_20_95757328_Rx_5808d905_Rx (PduRDestPdu):
              PduRDestPduHandleId = 18
              PduRDestPduDirection = RECEIVE if post-build-variant-condition{matching-criterion=RDR_POS, value=4}
              PduRDestPduDirection = RECEIVE if post-build-variant-condition{matching-criterion=RDR_POS, value=1}
              PduRDestPduDirection = RECEIVE if post-build-variant-condition{matching-criterion=RDR_POS, value=3}
              PduRDestPduDirection = RECEIVE if post-build-variant-condition{matching-criterion=RDR_POS, value=0}
              PduRDestPduDirection = RECEIVE if post-build-variant-condition{matching-criterion=RDR_POS, value=7}
              PduRDestPduDirection = RECEIVE if post-build-variant-condition{matching-criterion=RDR_POS, value=5}
              PduRDestPduDirection = RECEIVE if post-build-variant-condition{matching-criterion=RDR_POS, value=2}
              PduRDestPduDirection = RECEIVE if post-build-variant-condition{matching-criterion=RDR_POS, value=6}
              PduRDestPduRoutingType = API_FORWARDING if post-build-variant-condition{matching-criterion=RDR_POS, value=0}
              PduRDestPduRoutingType = API_FORWARDING if post-build-variant-condition{matching-criterion=RDR_POS, value=1}
              PduRDestPduRoutingType = API_FORWARDING if post-build-variant-condition{matching-criterion=RDR_POS, value=3}
              PduRDestPduRoutingType = API_FORWARDING if post-build-variant-condition{matching-criterion=RDR_POS, value=7}
              PduRDestPduRoutingType = API_FORWARDING if post-build-variant-condition{matching-criterion=RDR_POS, value=5}
              PduRDestPduRoutingType = API_FORWARDING if post-build-variant-condition{matching-criterion=RDR_POS, value=2}
              PduRDestPduRoutingType = API_FORWARDING if post-build-variant-condition{matching-criterion=RDR_POS, value=4}
              PduRDestPduRoutingType = API_FORWARDING if post-build-variant-condition{matching-criterion=RDR_POS, value=6}
              PduRDestPduDataProcessing = IMMEDIATE
              PduRPduLengthHandlingStrategy = UNUSED
              PduRDestPduCrossPartitionDestination = false
              PduRDestPduRef = PCAN_DIAG_REQ_PHYS_OBD2_oPCAN_RADAR_20_1236930c_Rx
              PduRDestPduPduRBswModulesRef = Dcm if post-build-variant-condition{matching-criterion=RDR_POS, value=6}
              PduRDestPduPduRBswModulesRef = Dcm if post-build-variant-condition{matching-criterion=RDR_POS, value=4}
              PduRDestPduPduRBswModulesRef = Dcm if post-build-variant-condition{matching-criterion=RDR_POS, value=1}
              PduRDestPduPduRBswModulesRef = Dcm if post-build-variant-condition{matching-criterion=RDR_POS, value=7}
              PduRDestPduPduRBswModulesRef = Dcm if post-build-variant-condition{matching-criterion=RDR_POS, value=3}
              PduRDestPduPduRBswModulesRef = Dcm if post-build-variant-condition{matching-criterion=RDR_POS, value=2}
              PduRDestPduPduRBswModulesRef = Dcm if post-build-variant-condition{matching-criterion=RDR_POS, value=0}
              PduRDestPduPduRBswModulesRef = Dcm if post-build-variant-condition{matching-criterion=RDR_POS, value=5}
            PduRSrcPdu_5808d905 (PduRSrcPdu):
              PduRSourcePduHandleId = 18
              PduRSrcPduDirection = RECEIVE if post-build-variant-condition{matching-criterion=RDR_POS, value=1}
              PduRSrcPduDirection = RECEIVE if post-build-variant-condition{matching-criterion=RDR_POS, value=3}
              PduRSrcPduDirection = RECEIVE if post-build-variant-condition{matching-criterion=RDR_POS, value=0}
              PduRSrcPduDirection = RECEIVE if post-build-variant-condition{matching-criterion=RDR_POS, value=7}
              PduRSrcPduDirection = RECEIVE if post-build-variant-condition{matching-criterion=RDR_POS, value=5}
              PduRSrcPduDirection = RECEIVE if post-build-variant-condition{matching-criterion=RDR_POS, value=2}
              PduRSrcPduDirection = RECEIVE if post-build-variant-condition{matching-criterion=RDR_POS, value=4}
              PduRSrcPduDirection = RECEIVE if post-build-variant-condition{matching-criterion=RDR_POS, value=6}
              PduRSrcPduRef = PCAN_DIAG_REQ_PHYS_OBD2_oPCAN_RADAR_20_95757328_Rx
              PduRSrcPduPduRBswModulesRef = CanTp if post-build-variant-condition{matching-criterion=RDR_POS, value=0}
              PduRSrcPduPduRBswModulesRef = CanTp if post-build-variant-condition{matching-criterion=RDR_POS, value=4}
              PduRSrcPduPduRBswModulesRef = CanTp if post-build-variant-condition{matching-criterion=RDR_POS, value=5}
              PduRSrcPduPduRBswModulesRef = CanTp if post-build-variant-condition{matching-criterion=RDR_POS, value=7}
              PduRSrcPduPduRBswModulesRef = CanTp if post-build-variant-condition{matching-criterion=RDR_POS, value=6}
              PduRSrcPduPduRBswModulesRef = CanTp if post-build-variant-condition{matching-criterion=RDR_POS, value=3}
              PduRSrcPduPduRBswModulesRef = CanTp if post-build-variant-condition{matching-criterion=RDR_POS, value=1}
              PduRSrcPduPduRBswModulesRef = CanTp if post-build-variant-condition{matching-criterion=RDR_POS, value=2}
          prop_ADAS_MOIS_info_oVCAN_RADAR_f03aed28_Tx: PduRRoutingPathCommunicationType=COMMUNICATION_INTERFACE if post-build-variant-condition{matching-criterion=RDR_POS, value=1}, PduRRoutingPathCommunicationType=COMMUNICATION_INTERFACE if post-build-variant-condition{matching-criterion=RDR_POS, value=3}, PduRRoutingPathCommunicationType=COMMUNICATION_INTERFACE if post-build-variant-condition{matching-criterion=RDR_POS, value=0}, PduRRoutingPathCommunicationType=COMMUNICATION_INTERFACE if post-build-variant-condition{matching-criterion=RDR_POS, value=7}, PduRRoutingPathCommunicationType=COMMUNICATION_INTERFACE if post-build-variant-condition{matching-criterion=RDR_POS, value=5}, PduRRoutingPathCommunicationType=COMMUNICATION_INTERFACE if post-build-variant-condition{matching-criterion=RDR_POS, value=2}, PduRRoutingPathCommunicationType=COMMUNICATION_INTERFACE if post-build-variant-condition{matching-criterion=RDR_POS, value=4}, PduRRoutingPathCommunicationType=COMMUNICATION_INTERFACE if post-build-variant-condition{matching-criterion=RDR_POS, value=6}, PduRLockRef=PduRLock_PduRExclusiveArea if post-build-variant-condition{matching-criterion=RDR_POS, value=6}, PduRLockRef=PduRLock_PduRExclusiveArea if post-build-variant-condition{matching-criterion=RDR_POS, value=1}, PduRLockRef=PduRLock_PduRExclusiveArea if post-build-variant-condition{matching-criterion=RDR_POS, value=3}, PduRLockRef=PduRLock_PduRExclusiveArea if post-build-variant-condition{matching-criterion=RDR_POS, value=0}, PduRLockRef=PduRLock_PduRExclusiveArea if post-build-variant-condition{matching-criterion=RDR_POS, value=7}, PduRLockRef=PduRLock_PduRExclusiveArea if post-build-variant-condition{matching-criterion=RDR_POS, value=5}, PduRLockRef=PduRLock_PduRExclusiveArea if post-build-variant-condition{matching-criterion=RDR_POS, value=2}, PduRLockRef=PduRLock_PduRExclusiveArea if post-build-variant-condition{matching-criterion=RDR_POS, value=4}
            prop_ADAS_MOIS_info_oVCAN_RADAR_21657ab6_Tx (PduRDestPdu):
              PduRDestPduHandleId = 211
              PduRDestPduDirection = TRANSMIT if post-build-variant-condition{matching-criterion=RDR_POS, value=1}
              PduRDestPduDirection = TRANSMIT if post-build-variant-condition{matching-criterion=RDR_POS, value=3}
              PduRDestPduDirection = TRANSMIT if post-build-variant-condition{matching-criterion=RDR_POS, value=0}
              PduRDestPduDirection = TRANSMIT if post-build-variant-condition{matching-criterion=RDR_POS, value=7}
              PduRDestPduDirection = TRANSMIT if post-build-variant-condition{matching-criterion=RDR_POS, value=5}
              PduRDestPduDirection = TRANSMIT if post-build-variant-condition{matching-criterion=RDR_POS, value=2}
              PduRDestPduDirection = TRANSMIT if post-build-variant-condition{matching-criterion=RDR_POS, value=4}
              PduRDestPduDirection = TRANSMIT if post-build-variant-condition{matching-criterion=RDR_POS, value=6}
              PduRDestPduRoutingType = API_FORWARDING if post-build-variant-condition{matching-criterion=RDR_POS, value=1}
              PduRDestPduRoutingType = API_FORWARDING if post-build-variant-condition{matching-criterion=RDR_POS, value=3}
              PduRDestPduRoutingType = API_FORWARDING if post-build-variant-condition{matching-criterion=RDR_POS, value=0}
              PduRDestPduRoutingType = API_FORWARDING if post-build-variant-condition{matching-criterion=RDR_POS, value=7}
              PduRDestPduRoutingType = API_FORWARDING if post-build-variant-condition{matching-criterion=RDR_POS, value=5}
              PduRDestPduRoutingType = API_FORWARDING if post-build-variant-condition{matching-criterion=RDR_POS, value=2}
              PduRDestPduRoutingType = API_FORWARDING if post-build-variant-condition{matching-criterion=RDR_POS, value=4}
              PduRDestPduRoutingType = API_FORWARDING if post-build-variant-condition{matching-criterion=RDR_POS, value=6}
              PduRDestPduDataProcessing = IMMEDIATE
              PduRPduLengthHandlingStrategy = IGNORE
              PduRDestPduCrossPartitionDestination = false
              PduRTransmissionConfirmation = false
              PduRDestPduDataProvision = PDUR_DIRECT
              PduRDestPduRef = prop_ADAS_MOIS_info_oVCAN_RADAR_21657ab6_Tx
              PduRDestPduPduRBswModulesRef = CanIf if post-build-variant-condition{matching-criterion=RDR_POS, value=4}
              PduRDestPduPduRBswModulesRef = CanIf if post-build-variant-condition{matching-criterion=RDR_POS, value=3}
              PduRDestPduPduRBswModulesRef = CanIf if post-build-variant-condition{matching-criterion=RDR_POS, value=7}
              PduRDestPduPduRBswModulesRef = CanIf if post-build-variant-condition{matching-criterion=RDR_POS, value=5}
              PduRDestPduPduRBswModulesRef = CanIf if post-build-variant-condition{matching-criterion=RDR_POS, value=1}
              PduRDestPduPduRBswModulesRef = CanIf if post-build-variant-condition{matching-criterion=RDR_POS, value=2}
              PduRDestPduPduRBswModulesRef = CanIf if post-build-variant-condition{matching-criterion=RDR_POS, value=0}
              PduRDestPduPduRBswModulesRef = CanIf if post-build-variant-condition{matching-criterion=RDR_POS, value=6}
            PduRSrcPdu_da3b0c2b (PduRSrcPdu):
              PduRSourcePduHandleId = 188
              PduRSrcPduDirection = TRANSMIT if post-build-variant-condition{matching-criterion=RDR_POS, value=2}
              PduRSrcPduDirection = TRANSMIT if post-build-variant-condition{matching-criterion=RDR_POS, value=1}
              PduRSrcPduDirection = TRANSMIT if post-build-variant-condition{matching-criterion=RDR_POS, value=3}
              PduRSrcPduDirection = TRANSMIT if post-build-variant-condition{matching-criterion=RDR_POS, value=0}
              PduRSrcPduDirection = TRANSMIT if post-build-variant-condition{matching-criterion=RDR_POS, value=5}
              PduRSrcPduDirection = TRANSMIT if post-build-variant-condition{matching-criterion=RDR_POS, value=7}
              PduRSrcPduDirection = TRANSMIT if post-build-variant-condition{matching-criterion=RDR_POS, value=4}
              PduRSrcPduDirection = TRANSMIT if post-build-variant-condition{matching-criterion=RDR_POS, value=6}
              PduRSrcPduRef = prop_ADAS_MOIS_info_oVCAN_RADAR_f03aed28_Tx
              PduRSrcPduPduRBswModulesRef = Com if post-build-variant-condition{matching-criterion=RDR_POS, value=4}
              PduRSrcPduPduRBswModulesRef = Com if post-build-variant-condition{matching-criterion=RDR_POS, value=6}
              PduRSrcPduPduRBswModulesRef = Com if post-build-variant-condition{matching-criterion=RDR_POS, value=1}
              PduRSrcPduPduRBswModulesRef = Com if post-build-variant-condition{matching-criterion=RDR_POS, value=2}
              PduRSrcPduPduRBswModulesRef = Com if post-build-variant-condition{matching-criterion=RDR_POS, value=0}
              PduRSrcPduPduRBswModulesRef = Com if post-build-variant-condition{matching-criterion=RDR_POS, value=3}
              PduRSrcPduPduRBswModulesRef = Com if post-build-variant-condition{matching-criterion=RDR_POS, value=5}
              PduRSrcPduPduRBswModulesRef = Com if post-build-variant-condition{matching-criterion=RDR_POS, value=7}
          GW_ETC2_03_oPCAN_RADAR_766d20c0_Rx: PduRRoutingPathCommunicationType=COMMUNICATION_INTERFACE if post-build-variant-condition{matching-criterion=RDR_POS, value=7}, PduRRoutingPathCommunicationType=COMMUNICATION_INTERFACE if post-build-variant-condition{matching-criterion=RDR_POS, value=1}, PduRRoutingPathCommunicationType=COMMUNICATION_INTERFACE if post-build-variant-condition{matching-criterion=RDR_POS, value=3}, PduRRoutingPathCommunicationType=COMMUNICATION_INTERFACE if post-build-variant-condition{matching-criterion=RDR_POS, value=0}, PduRRoutingPathCommunicationType=COMMUNICATION_INTERFACE if post-build-variant-condition{matching-criterion=RDR_POS, value=5}, PduRRoutingPathCommunicationType=COMMUNICATION_INTERFACE if post-build-variant-condition{matching-criterion=RDR_POS, value=2}, PduRRoutingPathCommunicationType=COMMUNICATION_INTERFACE if post-build-variant-condition{matching-criterion=RDR_POS, value=4}, PduRRoutingPathCommunicationType=COMMUNICATION_INTERFACE if post-build-variant-condition{matching-criterion=RDR_POS, value=6}, PduRLockRef=PduRLock_PduRExclusiveArea if post-build-variant-condition{matching-criterion=RDR_POS, value=6}, PduRLockRef=PduRLock_PduRExclusiveArea if post-build-variant-condition{matching-criterion=RDR_POS, value=1}, PduRLockRef=PduRLock_PduRExclusiveArea if post-build-variant-condition{matching-criterion=RDR_POS, value=3}, PduRLockRef=PduRLock_PduRExclusiveArea if post-build-variant-condition{matching-criterion=RDR_POS, value=0}, PduRLockRef=PduRLock_PduRExclusiveArea if post-build-variant-condition{matching-criterion=RDR_POS, value=7}, PduRLockRef=PduRLock_PduRExclusiveArea if post-build-variant-condition{matching-criterion=RDR_POS, value=5}, PduRLockRef=PduRLock_PduRExclusiveArea if post-build-variant-condition{matching-criterion=RDR_POS, value=2}, PduRLockRef=PduRLock_PduRExclusiveArea if post-build-variant-condition{matching-criterion=RDR_POS, value=4}
            GW_ETC2_03_oPCAN_RADAR_766d20c0_Rx_05f07e44_Rx (PduRDestPdu):
              PduRDestPduHandleId = 10
              PduRDestPduDirection = RECEIVE if post-build-variant-condition{matching-criterion=RDR_POS, value=3}
              PduRDestPduDirection = RECEIVE if post-build-variant-condition{matching-criterion=RDR_POS, value=1}
              PduRDestPduDirection = RECEIVE if post-build-variant-condition{matching-criterion=RDR_POS, value=0}
              PduRDestPduDirection = RECEIVE if post-build-variant-condition{matching-criterion=RDR_POS, value=7}
              PduRDestPduDirection = RECEIVE if post-build-variant-condition{matching-criterion=RDR_POS, value=5}
              PduRDestPduDirection = RECEIVE if post-build-variant-condition{matching-criterion=RDR_POS, value=2}
              PduRDestPduDirection = RECEIVE if post-build-variant-condition{matching-criterion=RDR_POS, value=4}
              PduRDestPduDirection = RECEIVE if post-build-variant-condition{matching-criterion=RDR_POS, value=6}
              PduRDestPduRoutingType = API_FORWARDING if post-build-variant-condition{matching-criterion=RDR_POS, value=5}
              PduRDestPduRoutingType = API_FORWARDING if post-build-variant-condition{matching-criterion=RDR_POS, value=1}
              PduRDestPduRoutingType = API_FORWARDING if post-build-variant-condition{matching-criterion=RDR_POS, value=3}
              PduRDestPduRoutingType = API_FORWARDING if post-build-variant-condition{matching-criterion=RDR_POS, value=0}
              PduRDestPduRoutingType = API_FORWARDING if post-build-variant-condition{matching-criterion=RDR_POS, value=7}
              PduRDestPduRoutingType = API_FORWARDING if post-build-variant-condition{matching-criterion=RDR_POS, value=2}
              PduRDestPduRoutingType = API_FORWARDING if post-build-variant-condition{matching-criterion=RDR_POS, value=4}
              PduRDestPduRoutingType = API_FORWARDING if post-build-variant-condition{matching-criterion=RDR_POS, value=6}
              PduRDestPduDataProcessing = IMMEDIATE
              PduRPduLengthHandlingStrategy = IGNORE
              PduRDestPduCrossPartitionDestination = false
              PduRTransmissionConfirmation = false
              PduRDestPduRef = GW_ETC2_03_oPCAN_RADAR_7791e995_Rx
              PduRDestPduPduRBswModulesRef = Com if post-build-variant-condition{matching-criterion=RDR_POS, value=2}
              PduRDestPduPduRBswModulesRef = Com if post-build-variant-condition{matching-criterion=RDR_POS, value=1}
              PduRDestPduPduRBswModulesRef = Com if post-build-variant-condition{matching-criterion=RDR_POS, value=0}
              PduRDestPduPduRBswModulesRef = Com if post-build-variant-condition{matching-criterion=RDR_POS, value=5}
              PduRDestPduPduRBswModulesRef = Com if post-build-variant-condition{matching-criterion=RDR_POS, value=3}
              PduRDestPduPduRBswModulesRef = Com if post-build-variant-condition{matching-criterion=RDR_POS, value=4}
              PduRDestPduPduRBswModulesRef = Com if post-build-variant-condition{matching-criterion=RDR_POS, value=6}
              PduRDestPduPduRBswModulesRef = Com if post-build-variant-condition{matching-criterion=RDR_POS, value=7}
            PduRSrcPdu_05f07e44 (PduRSrcPdu):
              PduRSourcePduHandleId = 12
              PduRSrcPduDirection = RECEIVE if post-build-variant-condition{matching-criterion=RDR_POS, value=3}
              PduRSrcPduDirection = RECEIVE if post-build-variant-condition{matching-criterion=RDR_POS, value=1}
              PduRSrcPduDirection = RECEIVE if post-build-variant-condition{matching-criterion=RDR_POS, value=0}
              PduRSrcPduDirection = RECEIVE if post-build-variant-condition{matching-criterion=RDR_POS, value=7}
              PduRSrcPduDirection = RECEIVE if post-build-variant-condition{matching-criterion=RDR_POS, value=5}
              PduRSrcPduDirection = RECEIVE if post-build-variant-condition{matching-criterion=RDR_POS, value=2}
              PduRSrcPduDirection = RECEIVE if post-build-variant-condition{matching-criterion=RDR_POS, value=4}
              PduRSrcPduDirection = RECEIVE if post-build-variant-condition{matching-criterion=RDR_POS, value=6}
              PduRSrcPduRef = GW_ETC2_03_oPCAN_RADAR_766d20c0_Rx
              PduRSrcPduPduRBswModulesRef = CanIf if post-build-variant-condition{matching-criterion=RDR_POS, value=4}
              PduRSrcPduPduRBswModulesRef = CanIf if post-build-variant-condition{matching-criterion=RDR_POS, value=0}
              PduRSrcPduPduRBswModulesRef = CanIf if post-build-variant-condition{matching-criterion=RDR_POS, value=6}
              PduRSrcPduPduRBswModulesRef = CanIf if post-build-variant-condition{matching-criterion=RDR_POS, value=2}
              PduRSrcPduPduRBswModulesRef = CanIf if post-build-variant-condition{matching-criterion=RDR_POS, value=7}
              PduRSrcPduPduRBswModulesRef = CanIf if post-build-variant-condition{matching-criterion=RDR_POS, value=3}
              PduRSrcPduPduRBswModulesRef = CanIf if post-build-variant-condition{matching-criterion=RDR_POS, value=5}
              PduRSrcPduPduRBswModulesRef = CanIf if post-build-variant-condition{matching-criterion=RDR_POS, value=1}
          DM1_B0_oVCAN_RADAR_6cbb7408_Tx: PduRRoutingPathCommunicationType=COMMUNICATION_INTERFACE if post-build-variant-condition{matching-criterion=RDR_POS, value=4}, PduRRoutingPathCommunicationType=COMMUNICATION_INTERFACE if post-build-variant-condition{matching-criterion=RDR_POS, value=0}, PduRRoutingPathCommunicationType=COMMUNICATION_INTERFACE if post-build-variant-condition{matching-criterion=RDR_POS, value=7}, PduRRoutingPathCommunicationType=COMMUNICATION_INTERFACE if post-build-variant-condition{matching-criterion=RDR_POS, value=6}, PduRRoutingPathCommunicationType=COMMUNICATION_INTERFACE if post-build-variant-condition{matching-criterion=RDR_POS, value=1}, PduRRoutingPathCommunicationType=COMMUNICATION_INTERFACE if post-build-variant-condition{matching-criterion=RDR_POS, value=3}, PduRRoutingPathCommunicationType=COMMUNICATION_INTERFACE if post-build-variant-condition{matching-criterion=RDR_POS, value=2}, PduRRoutingPathCommunicationType=COMMUNICATION_INTERFACE if post-build-variant-condition{matching-criterion=RDR_POS, value=5}, PduRLockRef=PduRLock_PduRExclusiveArea if post-build-variant-condition{matching-criterion=RDR_POS, value=7}, PduRLockRef=PduRLock_PduRExclusiveArea if post-build-variant-condition{matching-criterion=RDR_POS, value=0}, PduRLockRef=PduRLock_PduRExclusiveArea if post-build-variant-condition{matching-criterion=RDR_POS, value=6}, PduRLockRef=PduRLock_PduRExclusiveArea if post-build-variant-condition{matching-criterion=RDR_POS, value=4}, PduRLockRef=PduRLock_PduRExclusiveArea if post-build-variant-condition{matching-criterion=RDR_POS, value=1}, PduRLockRef=PduRLock_PduRExclusiveArea if post-build-variant-condition{matching-criterion=RDR_POS, value=3}, PduRLockRef=PduRLock_PduRExclusiveArea if post-build-variant-condition{matching-criterion=RDR_POS, value=2}, PduRLockRef=PduRLock_PduRExclusiveArea if post-build-variant-condition{matching-criterion=RDR_POS, value=5}
            DM1_B0_oVCAN_RADAR_15753e9e_Tx (PduRDestPdu):
              PduRDestPduHandleId = 1
              PduRDestPduDirection = TRANSMIT if post-build-variant-condition{matching-criterion=RDR_POS, value=5}
              PduRDestPduDirection = TRANSMIT if post-build-variant-condition{matching-criterion=RDR_POS, value=0}
              PduRDestPduDirection = TRANSMIT if post-build-variant-condition{matching-criterion=RDR_POS, value=7}
              PduRDestPduDirection = TRANSMIT if post-build-variant-condition{matching-criterion=RDR_POS, value=6}
              PduRDestPduDirection = TRANSMIT if post-build-variant-condition{matching-criterion=RDR_POS, value=4}
              PduRDestPduDirection = TRANSMIT if post-build-variant-condition{matching-criterion=RDR_POS, value=1}
              PduRDestPduDirection = TRANSMIT if post-build-variant-condition{matching-criterion=RDR_POS, value=3}
              PduRDestPduDirection = TRANSMIT if post-build-variant-condition{matching-criterion=RDR_POS, value=2}
              PduRDestPduRoutingType = GATEWAY_ROUTING if post-build-variant-condition{matching-criterion=RDR_POS, value=5}
              PduRDestPduRoutingType = GATEWAY_ROUTING if post-build-variant-condition{matching-criterion=RDR_POS, value=0}
              PduRDestPduRoutingType = GATEWAY_ROUTING if post-build-variant-condition{matching-criterion=RDR_POS, value=7}
              PduRDestPduRoutingType = GATEWAY_ROUTING if post-build-variant-condition{matching-criterion=RDR_POS, value=6}
              PduRDestPduRoutingType = GATEWAY_ROUTING if post-build-variant-condition{matching-criterion=RDR_POS, value=4}
              PduRDestPduRoutingType = GATEWAY_ROUTING if post-build-variant-condition{matching-criterion=RDR_POS, value=1}
              PduRDestPduRoutingType = GATEWAY_ROUTING if post-build-variant-condition{matching-criterion=RDR_POS, value=3}
              PduRDestPduRoutingType = GATEWAY_ROUTING if post-build-variant-condition{matching-criterion=RDR_POS, value=2}
              PduRDestPduDataProcessing = IMMEDIATE
              PduRPduLengthHandlingStrategy = IGNORE
              PduRDestPduCrossPartitionDestination = false
              PduRDestPduDataProvision = PDUR_DIRECT
              PduRTransmissionConfirmation = false
              PduRDestPduRef = DM1_B0_oVCAN_RADAR_15753e9e_Tx
              PduRDestPduPduRBswModulesRef = CanIf if post-build-variant-condition{matching-criterion=RDR_POS, value=6}
              PduRDestPduPduRBswModulesRef = CanIf if post-build-variant-condition{matching-criterion=RDR_POS, value=7}
              PduRDestPduPduRBswModulesRef = CanIf if post-build-variant-condition{matching-criterion=RDR_POS, value=1}
              PduRDestPduPduRBswModulesRef = CanIf if post-build-variant-condition{matching-criterion=RDR_POS, value=2}
              PduRDestPduPduRBswModulesRef = CanIf if post-build-variant-condition{matching-criterion=RDR_POS, value=5}
              PduRDestPduPduRBswModulesRef = CanIf if post-build-variant-condition{matching-criterion=RDR_POS, value=0}
              PduRDestPduPduRBswModulesRef = CanIf if post-build-variant-condition{matching-criterion=RDR_POS, value=3}
              PduRDestPduPduRBswModulesRef = CanIf if post-build-variant-condition{matching-criterion=RDR_POS, value=4}
            PduRSrcPdu_b7632270_001 (PduRSrcPdu):
              PduRSourcePduHandleId = 4
              PduRSrcPduDirection = RECEIVE if post-build-variant-condition{matching-criterion=RDR_POS, value=4}
              PduRSrcPduDirection = RECEIVE if post-build-variant-condition{matching-criterion=RDR_POS, value=0}
              PduRSrcPduDirection = RECEIVE if post-build-variant-condition{matching-criterion=RDR_POS, value=7}
              PduRSrcPduDirection = RECEIVE if post-build-variant-condition{matching-criterion=RDR_POS, value=6}
              PduRSrcPduDirection = RECEIVE if post-build-variant-condition{matching-criterion=RDR_POS, value=1}
              PduRSrcPduDirection = RECEIVE if post-build-variant-condition{matching-criterion=RDR_POS, value=3}
              PduRSrcPduDirection = RECEIVE if post-build-variant-condition{matching-criterion=RDR_POS, value=2}
              PduRSrcPduDirection = RECEIVE if post-build-variant-condition{matching-criterion=RDR_POS, value=5}
              PduRSrcPduRef = DM1_B0_Rx_oPCAN_RADAR_6b6541a3_Rx
              PduRSrcPduPduRBswModulesRef = CanIf if post-build-variant-condition{matching-criterion=RDR_POS, value=6}
              PduRSrcPduPduRBswModulesRef = CanIf if post-build-variant-condition{matching-criterion=RDR_POS, value=1}
              PduRSrcPduPduRBswModulesRef = CanIf if post-build-variant-condition{matching-criterion=RDR_POS, value=7}
              PduRSrcPduPduRBswModulesRef = CanIf if post-build-variant-condition{matching-criterion=RDR_POS, value=5}
              PduRSrcPduPduRBswModulesRef = CanIf if post-build-variant-condition{matching-criterion=RDR_POS, value=2}
              PduRSrcPduPduRBswModulesRef = CanIf if post-build-variant-condition{matching-criterion=RDR_POS, value=0}
              PduRSrcPduPduRBswModulesRef = CanIf if post-build-variant-condition{matching-criterion=RDR_POS, value=3}
              PduRSrcPduPduRBswModulesRef = CanIf if post-build-variant-condition{matching-criterion=RDR_POS, value=4}
          DM1_B1_oVCAN_RADAR_b12dad8d_Tx: PduRRoutingPathCommunicationType=COMMUNICATION_INTERFACE if post-build-variant-condition{matching-criterion=RDR_POS, value=6}, PduRRoutingPathCommunicationType=COMMUNICATION_INTERFACE if post-build-variant-condition{matching-criterion=RDR_POS, value=0}, PduRRoutingPathCommunicationType=COMMUNICATION_INTERFACE if post-build-variant-condition{matching-criterion=RDR_POS, value=7}, PduRRoutingPathCommunicationType=COMMUNICATION_INTERFACE if post-build-variant-condition{matching-criterion=RDR_POS, value=4}, PduRRoutingPathCommunicationType=COMMUNICATION_INTERFACE if post-build-variant-condition{matching-criterion=RDR_POS, value=1}, PduRRoutingPathCommunicationType=COMMUNICATION_INTERFACE if post-build-variant-condition{matching-criterion=RDR_POS, value=3}, PduRRoutingPathCommunicationType=COMMUNICATION_INTERFACE if post-build-variant-condition{matching-criterion=RDR_POS, value=2}, PduRRoutingPathCommunicationType=COMMUNICATION_INTERFACE if post-build-variant-condition{matching-criterion=RDR_POS, value=5}, PduRLockRef=PduRLock_PduRExclusiveArea if post-build-variant-condition{matching-criterion=RDR_POS, value=4}, PduRLockRef=PduRLock_PduRExclusiveArea if post-build-variant-condition{matching-criterion=RDR_POS, value=0}, PduRLockRef=PduRLock_PduRExclusiveArea if post-build-variant-condition{matching-criterion=RDR_POS, value=7}, PduRLockRef=PduRLock_PduRExclusiveArea if post-build-variant-condition{matching-criterion=RDR_POS, value=6}, PduRLockRef=PduRLock_PduRExclusiveArea if post-build-variant-condition{matching-criterion=RDR_POS, value=1}, PduRLockRef=PduRLock_PduRExclusiveArea if post-build-variant-condition{matching-criterion=RDR_POS, value=3}, PduRLockRef=PduRLock_PduRExclusiveArea if post-build-variant-condition{matching-criterion=RDR_POS, value=2}, PduRLockRef=PduRLock_PduRExclusiveArea if post-build-variant-condition{matching-criterion=RDR_POS, value=5}
            DM1_B1_oVCAN_RADAR_2387ae6d_Tx (PduRDestPdu):
              PduRDestPduHandleId = 2
              PduRDestPduDirection = TRANSMIT if post-build-variant-condition{matching-criterion=RDR_POS, value=5}
              PduRDestPduDirection = TRANSMIT if post-build-variant-condition{matching-criterion=RDR_POS, value=0}
              PduRDestPduDirection = TRANSMIT if post-build-variant-condition{matching-criterion=RDR_POS, value=7}
              PduRDestPduDirection = TRANSMIT if post-build-variant-condition{matching-criterion=RDR_POS, value=6}
              PduRDestPduDirection = TRANSMIT if post-build-variant-condition{matching-criterion=RDR_POS, value=4}
              PduRDestPduDirection = TRANSMIT if post-build-variant-condition{matching-criterion=RDR_POS, value=1}
              PduRDestPduDirection = TRANSMIT if post-build-variant-condition{matching-criterion=RDR_POS, value=3}
              PduRDestPduDirection = TRANSMIT if post-build-variant-condition{matching-criterion=RDR_POS, value=2}
              PduRDestPduRoutingType = GATEWAY_ROUTING if post-build-variant-condition{matching-criterion=RDR_POS, value=6}
              PduRDestPduRoutingType = GATEWAY_ROUTING if post-build-variant-condition{matching-criterion=RDR_POS, value=0}
              PduRDestPduRoutingType = GATEWAY_ROUTING if post-build-variant-condition{matching-criterion=RDR_POS, value=7}
              PduRDestPduRoutingType = GATEWAY_ROUTING if post-build-variant-condition{matching-criterion=RDR_POS, value=4}
              PduRDestPduRoutingType = GATEWAY_ROUTING if post-build-variant-condition{matching-criterion=RDR_POS, value=1}
              PduRDestPduRoutingType = GATEWAY_ROUTING if post-build-variant-condition{matching-criterion=RDR_POS, value=3}
              PduRDestPduRoutingType = GATEWAY_ROUTING if post-build-variant-condition{matching-criterion=RDR_POS, value=2}
              PduRDestPduRoutingType = GATEWAY_ROUTING if post-build-variant-condition{matching-criterion=RDR_POS, value=5}
              PduRDestPduDataProcessing = IMMEDIATE
              PduRPduLengthHandlingStrategy = IGNORE
              PduRDestPduCrossPartitionDestination = false
              PduRDestPduDataProvision = PDUR_DIRECT
              PduRTransmissionConfirmation = false
              PduRDestPduRef = DM1_B1_oVCAN_RADAR_2387ae6d_Tx
              PduRDestPduPduRBswModulesRef = CanIf if post-build-variant-condition{matching-criterion=RDR_POS, value=1}
              PduRDestPduPduRBswModulesRef = CanIf if post-build-variant-condition{matching-criterion=RDR_POS, value=5}
              PduRDestPduPduRBswModulesRef = CanIf if post-build-variant-condition{matching-criterion=RDR_POS, value=4}
              PduRDestPduPduRBswModulesRef = CanIf if post-build-variant-condition{matching-criterion=RDR_POS, value=2}
              PduRDestPduPduRBswModulesRef = CanIf if post-build-variant-condition{matching-criterion=RDR_POS, value=3}
              PduRDestPduPduRBswModulesRef = CanIf if post-build-variant-condition{matching-criterion=RDR_POS, value=0}
              PduRDestPduPduRBswModulesRef = CanIf if post-build-variant-condition{matching-criterion=RDR_POS, value=7}
              PduRDestPduPduRBswModulesRef = CanIf if post-build-variant-condition{matching-criterion=RDR_POS, value=6}
            PduRSrcPdu_2e732dfd_001 (PduRSrcPdu):
              PduRSourcePduHandleId = 5
              PduRSrcPduDirection = RECEIVE if post-build-variant-condition{matching-criterion=RDR_POS, value=5}
              PduRSrcPduDirection = RECEIVE if post-build-variant-condition{matching-criterion=RDR_POS, value=0}
              PduRSrcPduDirection = RECEIVE if post-build-variant-condition{matching-criterion=RDR_POS, value=7}
              PduRSrcPduDirection = RECEIVE if post-build-variant-condition{matching-criterion=RDR_POS, value=6}
              PduRSrcPduDirection = RECEIVE if post-build-variant-condition{matching-criterion=RDR_POS, value=4}
              PduRSrcPduDirection = RECEIVE if post-build-variant-condition{matching-criterion=RDR_POS, value=1}
              PduRSrcPduDirection = RECEIVE if post-build-variant-condition{matching-criterion=RDR_POS, value=3}
              PduRSrcPduDirection = RECEIVE if post-build-variant-condition{matching-criterion=RDR_POS, value=2}
              PduRSrcPduRef = DM1_B1_Rx_oPCAN_RADAR_fe159536_Rx
              PduRSrcPduPduRBswModulesRef = CanIf if post-build-variant-condition{matching-criterion=RDR_POS, value=3}
              PduRSrcPduPduRBswModulesRef = CanIf if post-build-variant-condition{matching-criterion=RDR_POS, value=2}
              PduRSrcPduPduRBswModulesRef = CanIf if post-build-variant-condition{matching-criterion=RDR_POS, value=0}
              PduRSrcPduPduRBswModulesRef = CanIf if post-build-variant-condition{matching-criterion=RDR_POS, value=6}
              PduRSrcPduPduRBswModulesRef = CanIf if post-build-variant-condition{matching-criterion=RDR_POS, value=4}
              PduRSrcPduPduRBswModulesRef = CanIf if post-build-variant-condition{matching-criterion=RDR_POS, value=1}
              PduRSrcPduPduRBswModulesRef = CanIf if post-build-variant-condition{matching-criterion=RDR_POS, value=7}
              PduRSrcPduPduRBswModulesRef = CanIf if post-build-variant-condition{matching-criterion=RDR_POS, value=5}
      PduRLock_PduRExclusiveArea (PduRLock)
        PduRExclusiveArea: PduRExclusiveAreaId=0
    9 x PduRBswModules, all with PduRCancelReceive=false, PduRChangeParameterRequestApi=false:
      Com: PduRCancelTransmit=false, PduRCommunicationInterface=true, PduRLowerModule=false, PduRTransportProtocol=false, PduRTriggertransmit=false, PduRTxConfirmation=false, PduRUpperModule=true, PduRUseTag=false, PduRBswModuleRef=Com
      SoAd: PduRCancelTransmit=false, PduRCommunicationInterface=true, PduRLowerModule=true, PduRTransportProtocol=false, PduRTriggertransmit=true, PduRTxConfirmation=true, PduRUpperModule=false, PduRUseTag=false, PduRBswModuleRef=SoAd
      CanIf: PduRCancelTransmit=false, PduRCommunicationInterface=true, PduRLowerModule=true, PduRTransportProtocol=false, PduRTriggertransmit=false, PduRTxConfirmation=false, PduRUpperModule=false, PduRUseTag=false, PduRBswModuleRef=CanIf
      LdCom: PduRCancelTransmit=false, PduRCommunicationInterface=true, PduRLowerModule=false, PduRTransportProtocol=true, PduRTriggertransmit=false, PduRTxConfirmation=false, PduRUpperModule=true, PduRUseTag=false, PduRBswModuleRef=LdCom
      SomeIpTp: PduRCancelTransmit=false, PduRCommunicationInterface=true, PduRLowerModule=true, PduRTransportProtocol=true, PduRTriggertransmit=true, PduRTxConfirmation=true, PduRUpperModule=true, PduRUseTag=false, PduRBswModuleRef=SomeIpTp
      J1939Dcm: PduRCancelTransmit=false, PduRCommunicationInterface=false, PduRLowerModule=false, PduRTransportProtocol=true, PduRTriggertransmit=false, PduRTxConfirmation=false, PduRUpperModule=true, PduRUseTag=false, PduRBswModuleRef=J1939Dcm
      J1939Tp: PduRCancelTransmit=false, PduRCommunicationInterface=false, PduRLowerModule=true, PduRTransportProtocol=true, PduRTriggertransmit=false, PduRTxConfirmation=false, PduRUpperModule=true, PduRUseTag=false, PduRBswModuleRef=J1939Tp
      CanTp: PduRCancelTransmit=true, PduRCommunicationInterface=false, PduRLowerModule=true, PduRTransportProtocol=true, PduRTriggertransmit=false, PduRTxConfirmation=false, PduRUpperModule=false, PduRUseTag=false, PduRBswModuleRef=CanTp
      Dcm: PduRCancelTransmit=true, PduRCommunicationInterface=false, PduRLowerModule=false, PduRTransportProtocol=true, PduRTriggertransmit=false, PduRTxConfirmation=false, PduRUpperModule=true, PduRUseTag=true, PduRBswModuleRef=Dcm
