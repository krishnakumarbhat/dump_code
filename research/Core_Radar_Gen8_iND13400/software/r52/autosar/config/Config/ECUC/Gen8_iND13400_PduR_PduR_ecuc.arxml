[part 3 of 4: package /ActiveEcuC]
AUTOSAR XML (schema 00053)
package /ActiveEcuC  (continued)
  module config PduR: implementation-config-variant=VARIANT-POST-BUILD-SELECTABLE, module-description=PduR_Impl  (continued)
    PduRRoutingTables: PduRConfigurationId=0  (continued)
      PduRRoutingTable  (continued)
        305 x PduRRoutingPath, all with PduRMulticoreRoutingPath=false:  (continued)
          GW_prop_ADAS_BSIS_info_oPCAN_RADAR_f2d61fec_Tx: PduRRoutingPathCommunicationType=COMMUNICATION_INTERFACE if post-build-variant-condition{matching-criterion=RDR_POS, value=6}, PduRRoutingPathCommunicationType=COMMUNICATION_INTERFACE if post-build-variant-condition{matching-criterion=RDR_POS, value=1}, PduRRoutingPathCommunicationType=COMMUNICATION_INTERFACE if post-build-variant-condition{matching-criterion=RDR_POS, value=3}, PduRRoutingPathCommunicationType=COMMUNICATION_INTERFACE if post-build-variant-condition{matching-criterion=RDR_POS, value=0}, PduRRoutingPathCommunicationType=COMMUNICATION_INTERFACE if post-build-variant-condition{matching-criterion=RDR_POS, value=7}, PduRRoutingPathCommunicationType=COMMUNICATION_INTERFACE if post-build-variant-condition{matching-criterion=RDR_POS, value=5}, PduRRoutingPathCommunicationType=COMMUNICATION_INTERFACE if post-build-variant-condition{matching-criterion=RDR_POS, value=2}, PduRRoutingPathCommunicationType=COMMUNICATION_INTERFACE if post-build-variant-condition{matching-criterion=RDR_POS, value=4}, PduRLockRef=PduRLock_PduRExclusiveArea if post-build-variant-condition{matching-criterion=RDR_POS, value=6}, PduRLockRef=PduRLock_PduRExclusiveArea if post-build-variant-condition{matching-criterion=RDR_POS, value=1}, PduRLockRef=PduRLock_PduRExclusiveArea if post-build-variant-condition{matching-criterion=RDR_POS, value=3}, PduRLockRef=PduRLock_PduRExclusiveArea if post-build-variant-condition{matching-criterion=RDR_POS, value=0}, PduRLockRef=PduRLock_PduRExclusiveArea if post-build-variant-condition{matching-criterion=RDR_POS, value=7}, PduRLockRef=PduRLock_PduRExclusiveArea if post-build-variant-condition{matching-criterion=RDR_POS, value=5}, PduRLockRef=PduRLock_PduRExclusiveArea if post-build-variant-condition{matching-criterion=RDR_POS, value=2}, PduRLockRef=PduRLock_PduRExclusiveArea if post-build-variant-condition{matching-criterion=RDR_POS, value=4}
            PduRSrcPdu_5e070d98 (PduRSrcPdu):
              PduRSourcePduHandleId = 5
              PduRSrcPduDirection = TRANSMIT if post-build-variant-condition{matching-criterion=RDR_POS, value=3}
              PduRSrcPduDirection = TRANSMIT if post-build-variant-condition{matching-criterion=RDR_POS, value=1}
              PduRSrcPduDirection = TRANSMIT if post-build-variant-condition{matching-criterion=RDR_POS, value=0}
              PduRSrcPduDirection = TRANSMIT if post-build-variant-condition{matching-criterion=RDR_POS, value=7}
              PduRSrcPduDirection = TRANSMIT if post-build-variant-condition{matching-criterion=RDR_POS, value=5}
              PduRSrcPduDirection = TRANSMIT if post-build-variant-condition{matching-criterion=RDR_POS, value=2}
              PduRSrcPduDirection = TRANSMIT if post-build-variant-condition{matching-criterion=RDR_POS, value=4}
              PduRSrcPduDirection = TRANSMIT if post-build-variant-condition{matching-criterion=RDR_POS, value=6}
              PduRSrcPduRef = GW_prop_ADAS_BSIS_info_oPCAN_RADAR_f2d61fec_Tx
              PduRSrcPduPduRBswModulesRef = Com if post-build-variant-condition{matching-criterion=RDR_POS, value=7}
              PduRSrcPduPduRBswModulesRef = Com if post-build-variant-condition{matching-criterion=RDR_POS, value=3}
              PduRSrcPduPduRBswModulesRef = Com if post-build-variant-condition{matching-criterion=RDR_POS, value=1}
              PduRSrcPduPduRBswModulesRef = Com if post-build-variant-condition{matching-criterion=RDR_POS, value=2}
              PduRSrcPduPduRBswModulesRef = Com if post-build-variant-condition{matching-criterion=RDR_POS, value=6}
              PduRSrcPduPduRBswModulesRef = Com if post-build-variant-condition{matching-criterion=RDR_POS, value=4}
              PduRSrcPduPduRBswModulesRef = Com if post-build-variant-condition{matching-criterion=RDR_POS, value=5}
              PduRSrcPduPduRBswModulesRef = Com if post-build-variant-condition{matching-criterion=RDR_POS, value=0}
            GW_prop_ADAS_BSIS_info_oPCAN_RADAR_2b91b919_Tx (PduRDestPdu):
              PduRDestPduHandleId = 15
              PduRDestPduDirection = TRANSMIT if post-build-variant-condition{matching-criterion=RDR_POS, value=2}
              PduRDestPduDirection = TRANSMIT if post-build-variant-condition{matching-criterion=RDR_POS, value=1}
              PduRDestPduDirection = TRANSMIT if post-build-variant-condition{matching-criterion=RDR_POS, value=3}
              PduRDestPduDirection = TRANSMIT if post-build-variant-condition{matching-criterion=RDR_POS, value=0}
              PduRDestPduDirection = TRANSMIT if post-build-variant-condition{matching-criterion=RDR_POS, value=5}
              PduRDestPduDirection = TRANSMIT if post-build-variant-condition{matching-criterion=RDR_POS, value=7}
              PduRDestPduDirection = TRANSMIT if post-build-variant-condition{matching-criterion=RDR_POS, value=4}
              PduRDestPduDirection = TRANSMIT if post-build-variant-condition{matching-criterion=RDR_POS, value=6}
              PduRDestPduRoutingType = API_FORWARDING if post-build-variant-condition{matching-criterion=RDR_POS, value=4}
              PduRDestPduRoutingType = API_FORWARDING if post-build-variant-condition{matching-criterion=RDR_POS, value=1}
              PduRDestPduRoutingType = API_FORWARDING if post-build-variant-condition{matching-criterion=RDR_POS, value=3}
              PduRDestPduRoutingType = API_FORWARDING if post-build-variant-condition{matching-criterion=RDR_POS, value=0}
              PduRDestPduRoutingType = API_FORWARDING if post-build-variant-condition{matching-criterion=RDR_POS, value=7}
              PduRDestPduRoutingType = API_FORWARDING if post-build-variant-condition{matching-criterion=RDR_POS, value=5}
              PduRDestPduRoutingType = API_FORWARDING if post-build-variant-condition{matching-criterion=RDR_POS, value=2}
              PduRDestPduRoutingType = API_FORWARDING if post-build-variant-condition{matching-criterion=RDR_POS, value=6}
              PduRDestPduDataProcessing = IMMEDIATE
              PduRPduLengthHandlingStrategy = IGNORE
              PduRDestPduCrossPartitionDestination = false
              PduRTransmissionConfirmation = false
              PduRDestPduDataProvision = PDUR_DIRECT
              PduRDestPduRef = GW_prop_ADAS_BSIS_info_oPCAN_RADAR_2b91b919_Tx
              PduRDestPduPduRBswModulesRef = CanIf if post-build-variant-condition{matching-criterion=RDR_POS, value=2}
              PduRDestPduPduRBswModulesRef = CanIf if post-build-variant-condition{matching-criterion=RDR_POS, value=0}
              PduRDestPduPduRBswModulesRef = CanIf if post-build-variant-condition{matching-criterion=RDR_POS, value=1}
              PduRDestPduPduRBswModulesRef = CanIf if post-build-variant-condition{matching-criterion=RDR_POS, value=4}
              PduRDestPduPduRBswModulesRef = CanIf if post-build-variant-condition{matching-criterion=RDR_POS, value=6}
              PduRDestPduPduRBswModulesRef = CanIf if post-build-variant-condition{matching-criterion=RDR_POS, value=5}
              PduRDestPduPduRBswModulesRef = CanIf if post-build-variant-condition{matching-criterion=RDR_POS, value=7}
              PduRDestPduPduRBswModulesRef = CanIf if post-build-variant-condition{matching-criterion=RDR_POS, value=3}
          PCAN_DIAG_RESP_PHYS_OBD2_oPCAN_RADAR_20_dba92d0f_Tx: PduRRoutingPathCommunicationType=TRANSPORT_PROTOCOL if post-build-variant-condition{matching-criterion=RDR_POS, value=7}, PduRRoutingPathCommunicationType=TRANSPORT_PROTOCOL if post-build-variant-condition{matching-criterion=RDR_POS, value=1}, PduRRoutingPathCommunicationType=TRANSPORT_PROTOCOL if post-build-variant-condition{matching-criterion=RDR_POS, value=3}, PduRRoutingPathCommunicationType=TRANSPORT_PROTOCOL if post-build-variant-condition{matching-criterion=RDR_POS, value=0}, PduRRoutingPathCommunicationType=TRANSPORT_PROTOCOL if post-build-variant-condition{matching-criterion=RDR_POS, value=5}, PduRRoutingPathCommunicationType=TRANSPORT_PROTOCOL if post-build-variant-condition{matching-criterion=RDR_POS, value=2}, PduRRoutingPathCommunicationType=TRANSPORT_PROTOCOL if post-build-variant-condition{matching-criterion=RDR_POS, value=4}, PduRRoutingPathCommunicationType=TRANSPORT_PROTOCOL if post-build-variant-condition{matching-criterion=RDR_POS, value=6}, PduRLockRef=PduRLock_PduRExclusiveArea if post-build-variant-condition{matching-criterion=RDR_POS, value=6}, PduRLockRef=PduRLock_PduRExclusiveArea if post-build-variant-condition{matching-criterion=RDR_POS, value=1}, PduRLockRef=PduRLock_PduRExclusiveArea if post-build-variant-condition{matching-criterion=RDR_POS, value=3}, PduRLockRef=PduRLock_PduRExclusiveArea if post-build-variant-condition{matching-criterion=RDR_POS, value=0}, PduRLockRef=PduRLock_PduRExclusiveArea if post-build-variant-condition{matching-criterion=RDR_POS, value=7}, PduRLockRef=PduRLock_PduRExclusiveArea if post-build-variant-condition{matching-criterion=RDR_POS, value=5}, PduRLockRef=PduRLock_PduRExclusiveArea if post-build-variant-condition{matching-criterion=RDR_POS, value=2}, PduRLockRef=PduRLock_PduRExclusiveArea if post-build-variant-condition{matching-criterion=RDR_POS, value=4}
            PCAN_DIAG_RESP_PHYS_OBD2_oPCAN_RADAR_20_f1bd890a_Tx (PduRDestPdu):
              PduRDestPduHandleId = 8
              PduRDestPduDirection = TRANSMIT if post-build-variant-condition{matching-criterion=RDR_POS, value=1}
              PduRDestPduDirection = TRANSMIT if post-build-variant-condition{matching-criterion=RDR_POS, value=3}
              PduRDestPduDirection = TRANSMIT if post-build-variant-condition{matching-criterion=RDR_POS, value=0}
              PduRDestPduDirection = TRANSMIT if post-build-variant-condition{matching-criterion=RDR_POS, value=7}
              PduRDestPduDirection = TRANSMIT if post-build-variant-condition{matching-criterion=RDR_POS, value=5}
              PduRDestPduDirection = TRANSMIT if post-build-variant-condition{matching-criterion=RDR_POS, value=2}
              PduRDestPduDirection = TRANSMIT if post-build-variant-condition{matching-criterion=RDR_POS, value=4}
              PduRDestPduDirection = TRANSMIT if post-build-variant-condition{matching-criterion=RDR_POS, value=6}
              PduRDestPduRoutingType = API_FORWARDING if post-build-variant-condition{matching-criterion=RDR_POS, value=0}
              PduRDestPduRoutingType = API_FORWARDING if post-build-variant-condition{matching-criterion=RDR_POS, value=1}
              PduRDestPduRoutingType = API_FORWARDING if post-build-variant-condition{matching-criterion=RDR_POS, value=3}
              PduRDestPduRoutingType = API_FORWARDING if post-build-variant-condition{matching-criterion=RDR_POS, value=7}
              PduRDestPduRoutingType = API_FORWARDING if post-build-variant-condition{matching-criterion=RDR_POS, value=5}
              PduRDestPduRoutingType = API_FORWARDING if post-build-variant-condition{matching-criterion=RDR_POS, value=2}
              PduRDestPduRoutingType = API_FORWARDING if post-build-variant-condition{matching-criterion=RDR_POS, value=4}
              PduRDestPduRoutingType = API_FORWARDING if post-build-variant-condition{matching-criterion=RDR_POS, value=6}
              PduRDestPduDataProcessing = IMMEDIATE
              PduRPduLengthHandlingStrategy = UNUSED
              PduRDestPduCrossPartitionDestination = false
              PduRDestPduRef = PCAN_DIAG_RESP_PHYS_OBD2_oPCAN_RADAR_20_f1bd890a_Tx
              PduRDestPduPduRBswModulesRef = CanTp if post-build-variant-condition{matching-criterion=RDR_POS, value=2}
              PduRDestPduPduRBswModulesRef = CanTp if post-build-variant-condition{matching-criterion=RDR_POS, value=1}
              PduRDestPduPduRBswModulesRef = CanTp if post-build-variant-condition{matching-criterion=RDR_POS, value=4}
              PduRDestPduPduRBswModulesRef = CanTp if post-build-variant-condition{matching-criterion=RDR_POS, value=7}
              PduRDestPduPduRBswModulesRef = CanTp if post-build-variant-condition{matching-criterion=RDR_POS, value=3}
              PduRDestPduPduRBswModulesRef = CanTp if post-build-variant-condition{matching-criterion=RDR_POS, value=5}
              PduRDestPduPduRBswModulesRef = CanTp if post-build-variant-condition{matching-criterion=RDR_POS, value=6}
              PduRDestPduPduRBswModulesRef = CanTp if post-build-variant-condition{matching-criterion=RDR_POS, value=0}
            PduRSrcPdu_d30572be (PduRSrcPdu):
              PduRSourcePduHandleId = 9
              PduRSrcPduDirection = TRANSMIT if post-build-variant-condition{matching-criterion=RDR_POS, value=6}
              PduRSrcPduDirection = TRANSMIT if post-build-variant-condition{matching-criterion=RDR_POS, value=1}
              PduRSrcPduDirection = TRANSMIT if post-build-variant-condition{matching-criterion=RDR_POS, value=3}
              PduRSrcPduDirection = TRANSMIT if post-build-variant-condition{matching-criterion=RDR_POS, value=0}
              PduRSrcPduDirection = TRANSMIT if post-build-variant-condition{matching-criterion=RDR_POS, value=7}
              PduRSrcPduDirection = TRANSMIT if post-build-variant-condition{matching-criterion=RDR_POS, value=5}
              PduRSrcPduDirection = TRANSMIT if post-build-variant-condition{matching-criterion=RDR_POS, value=2}
              PduRSrcPduDirection = TRANSMIT if post-build-variant-condition{matching-criterion=RDR_POS, value=4}
              PduRSrcPduRef = PCAN_DIAG_RESP_PHYS_OBD2_oPCAN_RADAR_20_dba92d0f_Tx
              PduRSrcPduPduRBswModulesRef = Dcm if post-build-variant-condition{matching-criterion=RDR_POS, value=3}
              PduRSrcPduPduRBswModulesRef = Dcm if post-build-variant-condition{matching-criterion=RDR_POS, value=0}
              PduRSrcPduPduRBswModulesRef = Dcm if post-build-variant-condition{matching-criterion=RDR_POS, value=1}
              PduRSrcPduPduRBswModulesRef = Dcm if post-build-variant-condition{matching-criterion=RDR_POS, value=5}
              PduRSrcPduPduRBswModulesRef = Dcm if post-build-variant-condition{matching-criterion=RDR_POS, value=7}
              PduRSrcPduPduRBswModulesRef = Dcm if post-build-variant-condition{matching-criterion=RDR_POS, value=6}
              PduRSrcPduPduRBswModulesRef = Dcm if post-build-variant-condition{matching-criterion=RDR_POS, value=2}
              PduRSrcPduPduRBswModulesRef = Dcm if post-build-variant-condition{matching-criterion=RDR_POS, value=4}
          SR1_DIAG_REQ_PHY_PLANT_oVCAN_RADAR_14d98d55_Rx: PduRRoutingPathCommunicationType=COMMUNICATION_INTERFACE if post-build-variant-condition{matching-criterion=RDR_POS, value=2}, PduRRoutingPathCommunicationType=COMMUNICATION_INTERFACE if post-build-variant-condition{matching-criterion=RDR_POS, value=1}, PduRRoutingPathCommunicationType=COMMUNICATION_INTERFACE if post-build-variant-condition{matching-criterion=RDR_POS, value=3}, PduRRoutingPathCommunicationType=COMMUNICATION_INTERFACE if post-build-variant-condition{matching-criterion=RDR_POS, value=0}, PduRRoutingPathCommunicationType=COMMUNICATION_INTERFACE if post-build-variant-condition{matching-criterion=RDR_POS, value=5}, PduRRoutingPathCommunicationType=COMMUNICATION_INTERFACE if post-build-variant-condition{matching-criterion=RDR_POS, value=7}, PduRRoutingPathCommunicationType=COMMUNICATION_INTERFACE if post-build-variant-condition{matching-criterion=RDR_POS, value=4}, PduRRoutingPathCommunicationType=COMMUNICATION_INTERFACE if post-build-variant-condition{matching-criterion=RDR_POS, value=6}, PduRLockRef=PduRLock_PduRExclusiveArea if post-build-variant-condition{matching-criterion=RDR_POS, value=1}, PduRLockRef=PduRLock_PduRExclusiveArea if post-build-variant-condition{matching-criterion=RDR_POS, value=0}, PduRLockRef=PduRLock_PduRExclusiveArea if post-build-variant-condition{matching-criterion=RDR_POS, value=7}, PduRLockRef=PduRLock_PduRExclusiveArea if post-build-variant-condition{matching-criterion=RDR_POS, value=6}, PduRLockRef=PduRLock_PduRExclusiveArea if post-build-variant-condition{matching-criterion=RDR_POS, value=4}, PduRLockRef=PduRLock_PduRExclusiveArea if post-build-variant-condition{matching-criterion=RDR_POS, value=3}, PduRLockRef=PduRLock_PduRExclusiveArea if post-build-variant-condition{matching-criterion=RDR_POS, value=2}, PduRLockRef=PduRLock_PduRExclusiveArea if post-build-variant-condition{matching-criterion=RDR_POS, value=5}
            PduRSrcPdu_baa10f81 (PduRSrcPdu):
              PduRSourcePduHandleId = 68
              PduRSrcPduDirection = RECEIVE if post-build-variant-condition{matching-criterion=RDR_POS, value=1}
              PduRSrcPduDirection = RECEIVE if post-build-variant-condition{matching-criterion=RDR_POS, value=3}
              PduRSrcPduDirection = RECEIVE if post-build-variant-condition{matching-criterion=RDR_POS, value=0}
              PduRSrcPduDirection = RECEIVE if post-build-variant-condition{matching-criterion=RDR_POS, value=7}
              PduRSrcPduDirection = RECEIVE if post-build-variant-condition{matching-criterion=RDR_POS, value=5}
              PduRSrcPduDirection = RECEIVE if post-build-variant-condition{matching-criterion=RDR_POS, value=2}
              PduRSrcPduDirection = RECEIVE if post-build-variant-condition{matching-criterion=RDR_POS, value=4}
              PduRSrcPduDirection = RECEIVE if post-build-variant-condition{matching-criterion=RDR_POS, value=6}
              PduRSrcPduRef = SR1_DIAG_REQ_PHY_PLANT_oVCAN_RADAR_14d98d55_Rx
              PduRSrcPduPduRBswModulesRef = CanIf if post-build-variant-condition{matching-criterion=RDR_POS, value=0}
              PduRSrcPduPduRBswModulesRef = CanIf if post-build-variant-condition{matching-criterion=RDR_POS, value=7}
              PduRSrcPduPduRBswModulesRef = CanIf if post-build-variant-condition{matching-criterion=RDR_POS, value=2}
              PduRSrcPduPduRBswModulesRef = CanIf if post-build-variant-condition{matching-criterion=RDR_POS, value=6}
              PduRSrcPduPduRBswModulesRef = CanIf if post-build-variant-condition{matching-criterion=RDR_POS, value=5}
              PduRSrcPduPduRBswModulesRef = CanIf if post-build-variant-condition{matching-criterion=RDR_POS, value=3}
              PduRSrcPduPduRBswModulesRef = CanIf if post-build-variant-condition{matching-criterion=RDR_POS, value=1}
              PduRSrcPduPduRBswModulesRef = CanIf if post-build-variant-condition{matching-criterion=RDR_POS, value=4}
            SRR_FL_DIAG_REQ_PHYS_PLANT_Tx_oPCAN_RADAR_a38832c1_Tx (PduRDestPdu):
              PduRDestPduHandleId = 201
              PduRDestPduDirection = TRANSMIT if post-build-variant-condition{matching-criterion=RDR_POS, value=5}
              PduRDestPduDirection = TRANSMIT if post-build-variant-condition{matching-criterion=RDR_POS, value=0}
              PduRDestPduDirection = TRANSMIT if post-build-variant-condition{matching-criterion=RDR_POS, value=7}
              PduRDestPduDirection = TRANSMIT if post-build-variant-condition{matching-criterion=RDR_POS, value=6}
              PduRDestPduDirection = TRANSMIT if post-build-variant-condition{matching-criterion=RDR_POS, value=4}
              PduRDestPduDirection = TRANSMIT if post-build-variant-condition{matching-criterion=RDR_POS, value=1}
              PduRDestPduDirection = TRANSMIT if post-build-variant-condition{matching-criterion=RDR_POS, value=3}
              PduRDestPduDirection = TRANSMIT if post-build-variant-condition{matching-criterion=RDR_POS, value=2}
              PduRDestPduRoutingType = GATEWAY_ROUTING if post-build-variant-condition{matching-criterion=RDR_POS, value=5}
              PduRDestPduRoutingType = GATEWAY_ROUTING if post-build-variant-condition{matching-criterion=RDR_POS, value=0}
              PduRDestPduRoutingType = GATEWAY_ROUTING if post-build-variant-condition{matching-criterion=RDR_POS, value=7}
              PduRDestPduRoutingType = GATEWAY_ROUTING if post-build-variant-condition{matching-criterion=RDR_POS, value=6}
              PduRDestPduRoutingType = GATEWAY_ROUTING if post-build-variant-condition{matching-criterion=RDR_POS, value=4}
              PduRDestPduRoutingType = GATEWAY_ROUTING if post-build-variant-condition{matching-criterion=RDR_POS, value=1}
              PduRDestPduRoutingType = GATEWAY_ROUTING if post-build-variant-condition{matching-criterion=RDR_POS, value=3}
              PduRDestPduRoutingType = GATEWAY_ROUTING if post-build-variant-condition{matching-criterion=RDR_POS, value=2}
              PduRDestPduDataProcessing = IMMEDIATE
              PduRPduLengthHandlingStrategy = IGNORE
              PduRDestPduCrossPartitionDestination = false
              PduRDestPduDataProvision = PDUR_DIRECT
              PduRTransmissionConfirmation = false
              PduRDestPduRef = SRR_FL_DIAG_REQ_PHYS_PLANT_Tx_oPCAN_RADAR_a38832c1_Tx
              PduRDestPduPduRBswModulesRef = CanIf if post-build-variant-condition{matching-criterion=RDR_POS, value=1}
              PduRDestPduPduRBswModulesRef = CanIf if post-build-variant-condition{matching-criterion=RDR_POS, value=4}
              PduRDestPduPduRBswModulesRef = CanIf if post-build-variant-condition{matching-criterion=RDR_POS, value=3}
              PduRDestPduPduRBswModulesRef = CanIf if post-build-variant-condition{matching-criterion=RDR_POS, value=5}
              PduRDestPduPduRBswModulesRef = CanIf if post-build-variant-condition{matching-criterion=RDR_POS, value=7}
              PduRDestPduPduRBswModulesRef = CanIf if post-build-variant-condition{matching-criterion=RDR_POS, value=6}
              PduRDestPduPduRBswModulesRef = CanIf if post-build-variant-condition{matching-criterion=RDR_POS, value=0}
              PduRDestPduPduRBswModulesRef = CanIf if post-build-variant-condition{matching-criterion=RDR_POS, value=2}
          PCAN_DIAG_REQ_PHYS_OBD1_oPCAN_RADAR_20_f19508d6_Rx: PduRRoutingPathCommunicationType=TRANSPORT_PROTOCOL if post-build-variant-condition{matching-criterion=RDR_POS, value=7}, PduRRoutingPathCommunicationType=TRANSPORT_PROTOCOL if post-build-variant-condition{matching-criterion=RDR_POS, value=1}, PduRRoutingPathCommunicationType=TRANSPORT_PROTOCOL if post-build-variant-condition{matching-criterion=RDR_POS, value=3}, PduRRoutingPathCommunicationType=TRANSPORT_PROTOCOL if post-build-variant-condition{matching-criterion=RDR_POS, value=0}, PduRRoutingPathCommunicationType=TRANSPORT_PROTOCOL if post-build-variant-condition{matching-criterion=RDR_POS, value=5}, PduRRoutingPathCommunicationType=TRANSPORT_PROTOCOL if post-build-variant-condition{matching-criterion=RDR_POS, value=2}, PduRRoutingPathCommunicationType=TRANSPORT_PROTOCOL if post-build-variant-condition{matching-criterion=RDR_POS, value=4}, PduRRoutingPathCommunicationType=TRANSPORT_PROTOCOL if post-build-variant-condition{matching-criterion=RDR_POS, value=6}, PduRLockRef=PduRLock_PduRExclusiveArea if post-build-variant-condition{matching-criterion=RDR_POS, value=6}, PduRLockRef=PduRLock_PduRExclusiveArea if post-build-variant-condition{matching-criterion=RDR_POS, value=1}, PduRLockRef=PduRLock_PduRExclusiveArea if post-build-variant-condition{matching-criterion=RDR_POS, value=3}, PduRLockRef=PduRLock_PduRExclusiveArea if post-build-variant-condition{matching-criterion=RDR_POS, value=0}, PduRLockRef=PduRLock_PduRExclusiveArea if post-build-variant-condition{matching-criterion=RDR_POS, value=7}, PduRLockRef=PduRLock_PduRExclusiveArea if post-build-variant-condition{matching-criterion=RDR_POS, value=5}, PduRLockRef=PduRLock_PduRExclusiveArea if post-build-variant-condition{matching-criterion=RDR_POS, value=2}, PduRLockRef=PduRLock_PduRExclusiveArea if post-build-variant-condition{matching-criterion=RDR_POS, value=4}
            PCAN_DIAG_REQ_PHYS_OBD1_oPCAN_RADAR_20_f19508d6_Rx_88550f3d_Rx (PduRDestPdu):
              PduRDestPduHandleId = 16
              PduRDestPduDirection = RECEIVE if post-build-variant-condition{matching-criterion=RDR_POS, value=0}
              PduRDestPduDirection = RECEIVE if post-build-variant-condition{matching-criterion=RDR_POS, value=1}
              PduRDestPduDirection = RECEIVE if post-build-variant-condition{matching-criterion=RDR_POS, value=3}
              PduRDestPduDirection = RECEIVE if post-build-variant-condition{matching-criterion=RDR_POS, value=7}
              PduRDestPduDirection = RECEIVE if post-build-variant-condition{matching-criterion=RDR_POS, value=5}
              PduRDestPduDirection = RECEIVE if post-build-variant-condition{matching-criterion=RDR_POS, value=2}
              PduRDestPduDirection = RECEIVE if post-build-variant-condition{matching-criterion=RDR_POS, value=4}
              PduRDestPduDirection = RECEIVE if post-build-variant-condition{matching-criterion=RDR_POS, value=6}
              PduRDestPduRoutingType = API_FORWARDING if post-build-variant-condition{matching-criterion=RDR_POS, value=6}
              PduRDestPduRoutingType = API_FORWARDING if post-build-variant-condition{matching-criterion=RDR_POS, value=1}
              PduRDestPduRoutingType = API_FORWARDING if post-build-variant-condition{matching-criterion=RDR_POS, value=3}
              PduRDestPduRoutingType = API_FORWARDING if post-build-variant-condition{matching-criterion=RDR_POS, value=0}
              PduRDestPduRoutingType = API_FORWARDING if post-build-variant-condition{matching-criterion=RDR_POS, value=7}
              PduRDestPduRoutingType = API_FORWARDING if post-build-variant-condition{matching-criterion=RDR_POS, value=5}
              PduRDestPduRoutingType = API_FORWARDING if post-build-variant-condition{matching-criterion=RDR_POS, value=2}
              PduRDestPduRoutingType = API_FORWARDING if post-build-variant-condition{matching-criterion=RDR_POS, value=4}
              PduRDestPduDataProcessing = IMMEDIATE
              PduRPduLengthHandlingStrategy = UNUSED
              PduRDestPduCrossPartitionDestination = false
              PduRDestPduRef = PCAN_DIAG_REQ_PHYS_OBD1_oPCAN_RADAR_20_3bfe27fe_Rx
              PduRDestPduPduRBswModulesRef = Dcm if post-build-variant-condition{matching-criterion=RDR_POS, value=4}
              PduRDestPduPduRBswModulesRef = Dcm if post-build-variant-condition{matching-criterion=RDR_POS, value=7}
              PduRDestPduPduRBswModulesRef = Dcm if post-build-variant-condition{matching-criterion=RDR_POS, value=5}
              PduRDestPduPduRBswModulesRef = Dcm if post-build-variant-condition{matching-criterion=RDR_POS, value=1}
              PduRDestPduPduRBswModulesRef = Dcm if post-build-variant-condition{matching-criterion=RDR_POS, value=3}
              PduRDestPduPduRBswModulesRef = Dcm if post-build-variant-condition{matching-criterion=RDR_POS, value=2}
              PduRDestPduPduRBswModulesRef = Dcm if post-build-variant-condition{matching-criterion=RDR_POS, value=6}
              PduRDestPduPduRBswModulesRef = Dcm if post-build-variant-condition{matching-criterion=RDR_POS, value=0}
            PduRSrcPdu_88550f3d (PduRSrcPdu):
              PduRSourcePduHandleId = 16
              PduRSrcPduDirection = RECEIVE if post-build-variant-condition{matching-criterion=RDR_POS, value=7}
              PduRSrcPduDirection = RECEIVE if post-build-variant-condition{matching-criterion=RDR_POS, value=1}
              PduRSrcPduDirection = RECEIVE if post-build-variant-condition{matching-criterion=RDR_POS, value=3}
              PduRSrcPduDirection = RECEIVE if post-build-variant-condition{matching-criterion=RDR_POS, value=0}
              PduRSrcPduDirection = RECEIVE if post-build-variant-condition{matching-criterion=RDR_POS, value=5}
              PduRSrcPduDirection = RECEIVE if post-build-variant-condition{matching-criterion=RDR_POS, value=2}
              PduRSrcPduDirection = RECEIVE if post-build-variant-condition{matching-criterion=RDR_POS, value=4}
              PduRSrcPduDirection = RECEIVE if post-build-variant-condition{matching-criterion=RDR_POS, value=6}
              PduRSrcPduRef = PCAN_DIAG_REQ_PHYS_OBD1_oPCAN_RADAR_20_f19508d6_Rx
              PduRSrcPduPduRBswModulesRef = CanTp if post-build-variant-condition{matching-criterion=RDR_POS, value=3}
              PduRSrcPduPduRBswModulesRef = CanTp if post-build-variant-condition{matching-criterion=RDR_POS, value=1}
              PduRSrcPduPduRBswModulesRef = CanTp if post-build-variant-condition{matching-criterion=RDR_POS, value=4}
              PduRSrcPduPduRBswModulesRef = CanTp if post-build-variant-condition{matching-criterion=RDR_POS, value=7}
              PduRSrcPduPduRBswModulesRef = CanTp if post-build-variant-condition{matching-criterion=RDR_POS, value=6}
              PduRSrcPduPduRBswModulesRef = CanTp if post-build-variant-condition{matching-criterion=RDR_POS, value=0}
              PduRSrcPduPduRBswModulesRef = CanTp if post-build-variant-condition{matching-criterion=RDR_POS, value=5}
              PduRSrcPduPduRBswModulesRef = CanTp if post-build-variant-condition{matching-criterion=RDR_POS, value=2}
          SR2_DIAG_REQ_PHY_OBD2_oVCAN_RADAR_211f7451_Rx: PduRRoutingPathCommunicationType=COMMUNICATION_INTERFACE if post-build-variant-condition{matching-criterion=RDR_POS, value=6}, PduRRoutingPathCommunicationType=COMMUNICATION_INTERFACE if post-build-variant-condition{matching-criterion=RDR_POS, value=1}, PduRRoutingPathCommunicationType=COMMUNICATION_INTERFACE if post-build-variant-condition{matching-criterion=RDR_POS, value=3}, PduRRoutingPathCommunicationType=COMMUNICATION_INTERFACE if post-build-variant-condition{matching-criterion=RDR_POS, value=0}, PduRRoutingPathCommunicationType=COMMUNICATION_INTERFACE if post-build-variant-condition{matching-criterion=RDR_POS, value=7}, PduRRoutingPathCommunicationType=COMMUNICATION_INTERFACE if post-build-variant-condition{matching-criterion=RDR_POS, value=5}, PduRRoutingPathCommunicationType=COMMUNICATION_INTERFACE if post-build-variant-condition{matching-criterion=RDR_POS, value=2}, PduRRoutingPathCommunicationType=COMMUNICATION_INTERFACE if post-build-variant-condition{matching-criterion=RDR_POS, value=4}, PduRLockRef=PduRLock_PduRExclusiveArea if post-build-variant-condition{matching-criterion=RDR_POS, value=7}, PduRLockRef=PduRLock_PduRExclusiveArea if post-build-variant-condition{matching-criterion=RDR_POS, value=0}, PduRLockRef=PduRLock_PduRExclusiveArea if post-build-variant-condition{matching-criterion=RDR_POS, value=6}, PduRLockRef=PduRLock_PduRExclusiveArea if post-build-variant-condition{matching-criterion=RDR_POS, value=4}, PduRLockRef=PduRLock_PduRExclusiveArea if post-build-variant-condition{matching-criterion=RDR_POS, value=1}, PduRLockRef=PduRLock_PduRExclusiveArea if post-build-variant-condition{matching-criterion=RDR_POS, value=3}, PduRLockRef=PduRLock_PduRExclusiveArea if post-build-variant-condition{matching-criterion=RDR_POS, value=2}, PduRLockRef=PduRLock_PduRExclusiveArea if post-build-variant-condition{matching-criterion=RDR_POS, value=5}
            PduRSrcPdu_f2d237b5 (PduRSrcPdu):
              PduRSourcePduHandleId = 74
              PduRSrcPduDirection = RECEIVE if post-build-variant-condition{matching-criterion=RDR_POS, value=7}
              PduRSrcPduDirection = RECEIVE if post-build-variant-condition{matching-criterion=RDR_POS, value=1}
              PduRSrcPduDirection = RECEIVE if post-build-variant-condition{matching-criterion=RDR_POS, value=3}
              PduRSrcPduDirection = RECEIVE if post-build-variant-condition{matching-criterion=RDR_POS, value=0}
              PduRSrcPduDirection = RECEIVE if post-build-variant-condition{matching-criterion=RDR_POS, value=5}
              PduRSrcPduDirection = RECEIVE if post-build-variant-condition{matching-criterion=RDR_POS, value=2}
              PduRSrcPduDirection = RECEIVE if post-build-variant-condition{matching-criterion=RDR_POS, value=4}
              PduRSrcPduDirection = RECEIVE if post-build-variant-condition{matching-criterion=RDR_POS, value=6}
              PduRSrcPduRef = SR2_DIAG_REQ_PHY_OBD2_oVCAN_RADAR_211f7451_Rx
              PduRSrcPduPduRBswModulesRef = CanIf if post-build-variant-condition{matching-criterion=RDR_POS, value=1}
              PduRSrcPduPduRBswModulesRef = CanIf if post-build-variant-condition{matching-criterion=RDR_POS, value=7}
              PduRSrcPduPduRBswModulesRef = CanIf if post-build-variant-condition{matching-criterion=RDR_POS, value=6}
              PduRSrcPduPduRBswModulesRef = CanIf if post-build-variant-condition{matching-criterion=RDR_POS, value=0}
              PduRSrcPduPduRBswModulesRef = CanIf if post-build-variant-condition{matching-criterion=RDR_POS, value=3}
              PduRSrcPduPduRBswModulesRef = CanIf if post-build-variant-condition{matching-criterion=RDR_POS, value=5}
              PduRSrcPduPduRBswModulesRef = CanIf if post-build-variant-condition{matching-criterion=RDR_POS, value=2}
              PduRSrcPduPduRBswModulesRef = CanIf if post-build-variant-condition{matching-criterion=RDR_POS, value=4}
            SRR_RL_DIAG_REQ_PHYS_OBD2_Tx_oPCAN_RADAR_0d9bba27_Tx (PduRDestPdu):
              PduRDestPduHandleId = 203
              PduRDestPduDirection = TRANSMIT if post-build-variant-condition{matching-criterion=RDR_POS, value=7}
              PduRDestPduDirection = TRANSMIT if post-build-variant-condition{matching-criterion=RDR_POS, value=0}
              PduRDestPduDirection = TRANSMIT if post-build-variant-condition{matching-criterion=RDR_POS, value=6}
              PduRDestPduDirection = TRANSMIT if post-build-variant-condition{matching-criterion=RDR_POS, value=4}
              PduRDestPduDirection = TRANSMIT if post-build-variant-condition{matching-criterion=RDR_POS, value=1}
              PduRDestPduDirection = TRANSMIT if post-build-variant-condition{matching-criterion=RDR_POS, value=3}
              PduRDestPduDirection = TRANSMIT if post-build-variant-condition{matching-criterion=RDR_POS, value=2}
              PduRDestPduDirection = TRANSMIT if post-build-variant-condition{matching-criterion=RDR_POS, value=5}
              PduRDestPduRoutingType = GATEWAY_ROUTING if post-build-variant-condition{matching-criterion=RDR_POS, value=7}
              PduRDestPduRoutingType = GATEWAY_ROUTING if post-build-variant-condition{matching-criterion=RDR_POS, value=0}
              PduRDestPduRoutingType = GATEWAY_ROUTING if post-build-variant-condition{matching-criterion=RDR_POS, value=6}
              PduRDestPduRoutingType = GATEWAY_ROUTING if post-build-variant-condition{matching-criterion=RDR_POS, value=4}
              PduRDestPduRoutingType = GATEWAY_ROUTING if post-build-variant-condition{matching-criterion=RDR_POS, value=1}
              PduRDestPduRoutingType = GATEWAY_ROUTING if post-build-variant-condition{matching-criterion=RDR_POS, value=3}
              PduRDestPduRoutingType = GATEWAY_ROUTING if post-build-variant-condition{matching-criterion=RDR_POS, value=2}
              PduRDestPduRoutingType = GATEWAY_ROUTING if post-build-variant-condition{matching-criterion=RDR_POS, value=5}
              PduRDestPduDataProcessing = IMMEDIATE
              PduRPduLengthHandlingStrategy = IGNORE
              PduRDestPduCrossPartitionDestination = false
              PduRDestPduDataProvision = PDUR_DIRECT
              PduRTransmissionConfirmation = false
              PduRDestPduRef = SRR_RL_DIAG_REQ_PHYS_OBD2_Tx_oPCAN_RADAR_0d9bba27_Tx
              PduRDestPduPduRBswModulesRef = CanIf if post-build-variant-condition{matching-criterion=RDR_POS, value=7}
              PduRDestPduPduRBswModulesRef = CanIf if post-build-variant-condition{matching-criterion=RDR_POS, value=2}
              PduRDestPduPduRBswModulesRef = CanIf if post-build-variant-condition{matching-criterion=RDR_POS, value=4}
              PduRDestPduPduRBswModulesRef = CanIf if post-build-variant-condition{matching-criterion=RDR_POS, value=3}
              PduRDestPduPduRBswModulesRef = CanIf if post-build-variant-condition{matching-criterion=RDR_POS, value=1}
              PduRDestPduPduRBswModulesRef = CanIf if post-build-variant-condition{matching-criterion=RDR_POS, value=5}
              PduRDestPduPduRBswModulesRef = CanIf if post-build-variant-condition{matching-criterion=RDR_POS, value=6}
              PduRDestPduPduRBswModulesRef = CanIf if post-build-variant-condition{matching-criterion=RDR_POS, value=0}
          PCAN_DIAG_RESP_PHYS_PLANT_oPCAN_RADAR_20_0a0c318a_Tx: PduRRoutingPathCommunicationType=TRANSPORT_PROTOCOL if post-build-variant-condition{matching-criterion=RDR_POS, value=0}, PduRRoutingPathCommunicationType=TRANSPORT_PROTOCOL if post-build-variant-condition{matching-criterion=RDR_POS, value=1}, PduRRoutingPathCommunicationType=TRANSPORT_PROTOCOL if post-build-variant-condition{matching-criterion=RDR_POS, value=3}, PduRRoutingPathCommunicationType=TRANSPORT_PROTOCOL if post-build-variant-condition{matching-criterion=RDR_POS, value=7}, PduRRoutingPathCommunicationType=TRANSPORT_PROTOCOL if post-build-variant-condition{matching-criterion=RDR_POS, value=5}, PduRRoutingPathCommunicationType=TRANSPORT_PROTOCOL if post-build-variant-condition{matching-criterion=RDR_POS, value=2}, PduRRoutingPathCommunicationType=TRANSPORT_PROTOCOL if post-build-variant-condition{matching-criterion=RDR_POS, value=4}, PduRRoutingPathCommunicationType=TRANSPORT_PROTOCOL if post-build-variant-condition{matching-criterion=RDR_POS, value=6}, PduRLockRef=PduRLock_PduRExclusiveArea if post-build-variant-condition{matching-criterion=RDR_POS, value=6}, PduRLockRef=PduRLock_PduRExclusiveArea if post-build-variant-condition{matching-criterion=RDR_POS, value=1}, PduRLockRef=PduRLock_PduRExclusiveArea if post-build-variant-condition{matching-criterion=RDR_POS, value=3}, PduRLockRef=PduRLock_PduRExclusiveArea if post-build-variant-condition{matching-criterion=RDR_POS, value=0}, PduRLockRef=PduRLock_PduRExclusiveArea if post-build-variant-condition{matching-criterion=RDR_POS, value=7}, PduRLockRef=PduRLock_PduRExclusiveArea if post-build-variant-condition{matching-criterion=RDR_POS, value=5}, PduRLockRef=PduRLock_PduRExclusiveArea if post-build-variant-condition{matching-criterion=RDR_POS, value=2}, PduRLockRef=PduRLock_PduRExclusiveArea if post-build-variant-condition{matching-criterion=RDR_POS, value=4}
            PduRSrcPdu_657fa4c9 (PduRSrcPdu):
              PduRSourcePduHandleId = 13
              PduRSrcPduDirection = TRANSMIT if post-build-variant-condition{matching-criterion=RDR_POS, value=6}
              PduRSrcPduDirection = TRANSMIT if post-build-variant-condition{matching-criterion=RDR_POS, value=1}
              PduRSrcPduDirection = TRANSMIT if post-build-variant-condition{matching-criterion=RDR_POS, value=3}
              PduRSrcPduDirection = TRANSMIT if post-build-variant-condition{matching-criterion=RDR_POS, value=0}
              PduRSrcPduDirection = TRANSMIT if post-build-variant-condition{matching-criterion=RDR_POS, value=7}
              PduRSrcPduDirection = TRANSMIT if post-build-variant-condition{matching-criterion=RDR_POS, value=5}
              PduRSrcPduDirection = TRANSMIT if post-build-variant-condition{matching-criterion=RDR_POS, value=2}
              PduRSrcPduDirection = TRANSMIT if post-build-variant-condition{matching-criterion=RDR_POS, value=4}
              PduRSrcPduRef = PCAN_DIAG_RESP_PHYS_PLANT_oPCAN_RADAR_20_0a0c318a_Tx
              PduRSrcPduPduRBswModulesRef = Dcm if post-build-variant-condition{matching-criterion=RDR_POS, value=7}
              PduRSrcPduPduRBswModulesRef = Dcm if post-build-variant-condition{matching-criterion=RDR_POS, value=3}
              PduRSrcPduPduRBswModulesRef = Dcm if post-build-variant-condition{matching-criterion=RDR_POS, value=1}
              PduRSrcPduPduRBswModulesRef = Dcm if post-build-variant-condition{matching-criterion=RDR_POS, value=6}
              PduRSrcPduPduRBswModulesRef = Dcm if post-build-variant-condition{matching-criterion=RDR_POS, value=0}
              PduRSrcPduPduRBswModulesRef = Dcm if post-build-variant-condition{matching-criterion=RDR_POS, value=2}
              PduRSrcPduPduRBswModulesRef = Dcm if post-build-variant-condition{matching-criterion=RDR_POS, value=4}
              PduRSrcPduPduRBswModulesRef = Dcm if post-build-variant-condition{matching-criterion=RDR_POS, value=5}
            PCAN_DIAG_RESP_PHYS_PLANT_oPCAN_RADAR_20_22a7f120_Tx (PduRDestPdu):
              PduRDestPduHandleId = 11
              PduRDestPduDirection = TRANSMIT if post-build-variant-condition{matching-criterion=RDR_POS, value=6}
              PduRDestPduDirection = TRANSMIT if post-build-variant-condition{matching-criterion=RDR_POS, value=1}
              PduRDestPduDirection = TRANSMIT if post-build-variant-condition{matching-criterion=RDR_POS, value=3}
              PduRDestPduDirection = TRANSMIT if post-build-variant-condition{matching-criterion=RDR_POS, value=0}
              PduRDestPduDirection = TRANSMIT if post-build-variant-condition{matching-criterion=RDR_POS, value=7}
              PduRDestPduDirection = TRANSMIT if post-build-variant-condition{matching-criterion=RDR_POS, value=5}
              PduRDestPduDirection = TRANSMIT if post-build-variant-condition{matching-criterion=RDR_POS, value=2}
              PduRDestPduDirection = TRANSMIT if post-build-variant-condition{matching-criterion=RDR_POS, value=4}
              PduRDestPduRoutingType = API_FORWARDING if post-build-variant-condition{matching-criterion=RDR_POS, value=1}
              PduRDestPduRoutingType = API_FORWARDING if post-build-variant-condition{matching-criterion=RDR_POS, value=3}
              PduRDestPduRoutingType = API_FORWARDING if post-build-variant-condition{matching-criterion=RDR_POS, value=0}
              PduRDestPduRoutingType = API_FORWARDING if post-build-variant-condition{matching-criterion=RDR_POS, value=7}
              PduRDestPduRoutingType = API_FORWARDING if post-build-variant-condition{matching-criterion=RDR_POS, value=5}
              PduRDestPduRoutingType = API_FORWARDING if post-build-variant-condition{matching-criterion=RDR_POS, value=2}
              PduRDestPduRoutingType = API_FORWARDING if post-build-variant-condition{matching-criterion=RDR_POS, value=4}
              PduRDestPduRoutingType = API_FORWARDING if post-build-variant-condition{matching-criterion=RDR_POS, value=6}
              PduRDestPduDataProcessing = IMMEDIATE
              PduRPduLengthHandlingStrategy = UNUSED
              PduRDestPduCrossPartitionDestination = false
              PduRDestPduRef = PCAN_DIAG_RESP_PHYS_PLANT_oPCAN_RADAR_20_22a7f120_Tx
              PduRDestPduPduRBswModulesRef = CanTp if post-build-variant-condition{matching-criterion=RDR_POS, value=0}
              PduRDestPduPduRBswModulesRef = CanTp if post-build-variant-condition{matching-criterion=RDR_POS, value=7}
              PduRDestPduPduRBswModulesRef = CanTp if post-build-variant-condition{matching-criterion=RDR_POS, value=2}
              PduRDestPduPduRBswModulesRef = CanTp if post-build-variant-condition{matching-criterion=RDR_POS, value=1}
              PduRDestPduPduRBswModulesRef = CanTp if post-build-variant-condition{matching-criterion=RDR_POS, value=3}
              PduRDestPduPduRBswModulesRef = CanTp if post-build-variant-condition{matching-criterion=RDR_POS, value=6}
              PduRDestPduPduRBswModulesRef = CanTp if post-build-variant-condition{matching-criterion=RDR_POS, value=4}
              PduRDestPduPduRBswModulesRef = CanTp if post-build-variant-condition{matching-criterion=RDR_POS, value=5}
          SR1_DIAG_REQ_PHY_OBD2_oVCAN_RADAR_a42d66a5_Rx: PduRRoutingPathCommunicationType=COMMUNICATION_INTERFACE if post-build-variant-condition{matching-criterion=RDR_POS, value=3}, PduRRoutingPathCommunicationType=COMMUNICATION_INTERFACE if post-build-variant-condition{matching-criterion=RDR_POS, value=1}, PduRRoutingPathCommunicationType=COMMUNICATION_INTERFACE if post-build-variant-condition{matching-criterion=RDR_POS, value=0}, PduRRoutingPathCommunicationType=COMMUNICATION_INTERFACE if post-build-variant-condition{matching-criterion=RDR_POS, value=7}, PduRRoutingPathCommunicationType=COMMUNICATION_INTERFACE if post-build-variant-condition{matching-criterion=RDR_POS, value=5}, PduRRoutingPathCommunicationType=COMMUNICATION_INTERFACE if post-build-variant-condition{matching-criterion=RDR_POS, value=2}, PduRRoutingPathCommunicationType=COMMUNICATION_INTERFACE if post-build-variant-condition{matching-criterion=RDR_POS, value=4}, PduRRoutingPathCommunicationType=COMMUNICATION_INTERFACE if post-build-variant-condition{matching-criterion=RDR_POS, value=6}, PduRLockRef=PduRLock_PduRExclusiveArea if post-build-variant-condition{matching-criterion=RDR_POS, value=2}, PduRLockRef=PduRLock_PduRExclusiveArea if post-build-variant-condition{matching-criterion=RDR_POS, value=0}, PduRLockRef=PduRLock_PduRExclusiveArea if post-build-variant-condition{matching-criterion=RDR_POS, value=7}, PduRLockRef=PduRLock_PduRExclusiveArea if post-build-variant-condition{matching-criterion=RDR_POS, value=6}, PduRLockRef=PduRLock_PduRExclusiveArea if post-build-variant-condition{matching-criterion=RDR_POS, value=4}, PduRLockRef=PduRLock_PduRExclusiveArea if post-build-variant-condition{matching-criterion=RDR_POS, value=1}, PduRLockRef=PduRLock_PduRExclusiveArea if post-build-variant-condition{matching-criterion=RDR_POS, value=3}, PduRLockRef=PduRLock_PduRExclusiveArea if post-build-variant-condition{matching-criterion=RDR_POS, value=5}
            PduRSrcPdu_ee753382 (PduRSrcPdu):
              PduRSourcePduHandleId = 66
              PduRSrcPduDirection = RECEIVE if post-build-variant-condition{matching-criterion=RDR_POS, value=1}
              PduRSrcPduDirection = RECEIVE if post-build-variant-condition{matching-criterion=RDR_POS, value=3}
              PduRSrcPduDirection = RECEIVE if post-build-variant-condition{matching-criterion=RDR_POS, value=0}
              PduRSrcPduDirection = RECEIVE if post-build-variant-condition{matching-criterion=RDR_POS, value=7}
              PduRSrcPduDirection = RECEIVE if post-build-variant-condition{matching-criterion=RDR_POS, value=5}
              PduRSrcPduDirection = RECEIVE if post-build-variant-condition{matching-criterion=RDR_POS, value=2}
              PduRSrcPduDirection = RECEIVE if post-build-variant-condition{matching-criterion=RDR_POS, value=4}
              PduRSrcPduDirection = RECEIVE if post-build-variant-condition{matching-criterion=RDR_POS, value=6}
              PduRSrcPduRef = SR1_DIAG_REQ_PHY_OBD2_oVCAN_RADAR_a42d66a5_Rx
              PduRSrcPduPduRBswModulesRef = CanIf if post-build-variant-condition{matching-criterion=RDR_POS, value=0}
              PduRSrcPduPduRBswModulesRef = CanIf if post-build-variant-condition{matching-criterion=RDR_POS, value=3}
              PduRSrcPduPduRBswModulesRef = CanIf if post-build-variant-condition{matching-criterion=RDR_POS, value=6}
              PduRSrcPduPduRBswModulesRef = CanIf if post-build-variant-condition{matching-criterion=RDR_POS, value=4}
              PduRSrcPduPduRBswModulesRef = CanIf if post-build-variant-condition{matching-criterion=RDR_POS, value=5}
              PduRSrcPduPduRBswModulesRef = CanIf if post-build-variant-condition{matching-criterion=RDR_POS, value=2}
              PduRSrcPduPduRBswModulesRef = CanIf if post-build-variant-condition{matching-criterion=RDR_POS, value=7}
              PduRSrcPduPduRBswModulesRef = CanIf if post-build-variant-condition{matching-criterion=RDR_POS, value=1}
            SRR_FL_DIAG_REQ_PHYS_OBD2_Tx_oPCAN_RADAR_79efce4a_Tx (PduRDestPdu):
              PduRDestPduHandleId = 199
              PduRDestPduDirection = TRANSMIT if post-build-variant-condition{matching-criterion=RDR_POS, value=6}
              PduRDestPduDirection = TRANSMIT if post-build-variant-condition{matching-criterion=RDR_POS, value=0}
              PduRDestPduDirection = TRANSMIT if post-build-variant-condition{matching-criterion=RDR_POS, value=7}
              PduRDestPduDirection = TRANSMIT if post-build-variant-condition{matching-criterion=RDR_POS, value=4}
              PduRDestPduDirection = TRANSMIT if post-build-variant-condition{matching-criterion=RDR_POS, value=1}
              PduRDestPduDirection = TRANSMIT if post-build-variant-condition{matching-criterion=RDR_POS, value=3}
              PduRDestPduDirection = TRANSMIT if post-build-variant-condition{matching-criterion=RDR_POS, value=2}
              PduRDestPduDirection = TRANSMIT if post-build-variant-condition{matching-criterion=RDR_POS, value=5}
              PduRDestPduRoutingType = GATEWAY_ROUTING if post-build-variant-condition{matching-criterion=RDR_POS, value=6}
              PduRDestPduRoutingType = GATEWAY_ROUTING if post-build-variant-condition{matching-criterion=RDR_POS, value=0}
              PduRDestPduRoutingType = GATEWAY_ROUTING if post-build-variant-condition{matching-criterion=RDR_POS, value=7}
              PduRDestPduRoutingType = GATEWAY_ROUTING if post-build-variant-condition{matching-criterion=RDR_POS, value=4}
              PduRDestPduRoutingType = GATEWAY_ROUTING if post-build-variant-condition{matching-criterion=RDR_POS, value=1}
              PduRDestPduRoutingType = GATEWAY_ROUTING if post-build-variant-condition{matching-criterion=RDR_POS, value=3}
              PduRDestPduRoutingType = GATEWAY_ROUTING if post-build-variant-condition{matching-criterion=RDR_POS, value=2}
              PduRDestPduRoutingType = GATEWAY_ROUTING if post-build-variant-condition{matching-criterion=RDR_POS, value=5}
              PduRDestPduDataProcessing = IMMEDIATE
              PduRPduLengthHandlingStrategy = IGNORE
              PduRDestPduCrossPartitionDestination = false
              PduRTransmissionConfirmation = false
              PduRDestPduDataProvision = PDUR_DIRECT
              PduRDestPduRef = SRR_FL_DIAG_REQ_PHYS_OBD2_Tx_oPCAN_RADAR_79efce4a_Tx
              PduRDestPduPduRBswModulesRef = CanIf if post-build-variant-condition{matching-criterion=RDR_POS, value=7}
              PduRDestPduPduRBswModulesRef = CanIf if post-build-variant-condition{matching-criterion=RDR_POS, value=2}
              PduRDestPduPduRBswModulesRef = CanIf if post-build-variant-condition{matching-criterion=RDR_POS, value=1}
              PduRDestPduPduRBswModulesRef = CanIf if post-build-variant-condition{matching-criterion=RDR_POS, value=5}
              PduRDestPduPduRBswModulesRef = CanIf if post-build-variant-condition{matching-criterion=RDR_POS, value=6}
              PduRDestPduPduRBswModulesRef = CanIf if post-build-variant-condition{matching-criterion=RDR_POS, value=4}
              PduRDestPduPduRBswModulesRef = CanIf if post-build-variant-condition{matching-criterion=RDR_POS, value=0}
              PduRDestPduPduRBswModulesRef = CanIf if post-build-variant-condition{matching-criterion=RDR_POS, value=3}
          PCAN_DIAG_REQ_PHYS_OTA_oPCAN_RADAR_45eab9fd_Rx: PduRRoutingPathCommunicationType=TRANSPORT_PROTOCOL if post-build-variant-condition{matching-criterion=RDR_POS, value=1}, PduRRoutingPathCommunicationType=TRANSPORT_PROTOCOL if post-build-variant-condition{matching-criterion=RDR_POS, value=3}, PduRRoutingPathCommunicationType=TRANSPORT_PROTOCOL if post-build-variant-condition{matching-criterion=RDR_POS, value=0}, PduRRoutingPathCommunicationType=TRANSPORT_PROTOCOL if post-build-variant-condition{matching-criterion=RDR_POS, value=7}, PduRRoutingPathCommunicationType=TRANSPORT_PROTOCOL if post-build-variant-condition{matching-criterion=RDR_POS, value=5}, PduRRoutingPathCommunicationType=TRANSPORT_PROTOCOL if post-build-variant-condition{matching-criterion=RDR_POS, value=2}, PduRRoutingPathCommunicationType=TRANSPORT_PROTOCOL if post-build-variant-condition{matching-criterion=RDR_POS, value=4}, PduRRoutingPathCommunicationType=TRANSPORT_PROTOCOL if post-build-variant-condition{matching-criterion=RDR_POS, value=6}, PduRLockRef=PduRLock_PduRExclusiveArea if post-build-variant-condition{matching-criterion=RDR_POS, value=6}, PduRLockRef=PduRLock_PduRExclusiveArea if post-build-variant-condition{matching-criterion=RDR_POS, value=1}, PduRLockRef=PduRLock_PduRExclusiveArea if post-build-variant-condition{matching-criterion=RDR_POS, value=3}, PduRLockRef=PduRLock_PduRExclusiveArea if post-build-variant-condition{matching-criterion=RDR_POS, value=0}, PduRLockRef=PduRLock_PduRExclusiveArea if post-build-variant-condition{matching-criterion=RDR_POS, value=7}, PduRLockRef=PduRLock_PduRExclusiveArea if post-build-variant-condition{matching-criterion=RDR_POS, value=5}, PduRLockRef=PduRLock_PduRExclusiveArea if post-build-variant-condition{matching-criterion=RDR_POS, value=2}, PduRLockRef=PduRLock_PduRExclusiveArea if post-build-variant-condition{matching-criterion=RDR_POS, value=4}
            PCAN_DIAG_REQ_PHYS_OTA_oPCAN_RADAR_45eab9fd_Rx_c794190e_Rx (PduRDestPdu):
              PduRDestPduHandleId = 20
              PduRDestPduDirection = RECEIVE if post-build-variant-condition{matching-criterion=RDR_POS, value=5}
              PduRDestPduDirection = RECEIVE if post-build-variant-condition{matching-criterion=RDR_POS, value=1}
              PduRDestPduDirection = RECEIVE if post-build-variant-condition{matching-criterion=RDR_POS, value=3}
              PduRDestPduDirection = RECEIVE if post-build-variant-condition{matching-criterion=RDR_POS, value=0}
              PduRDestPduDirection = RECEIVE if post-build-variant-condition{matching-criterion=RDR_POS, value=7}
              PduRDestPduDirection = RECEIVE if post-build-variant-condition{matching-criterion=RDR_POS, value=2}
              PduRDestPduDirection = RECEIVE if post-build-variant-condition{matching-criterion=RDR_POS, value=4}
              PduRDestPduDirection = RECEIVE if post-build-variant-condition{matching-criterion=RDR_POS, value=6}
              PduRDestPduRoutingType = API_FORWARDING if post-build-variant-condition{matching-criterion=RDR_POS, value=4}
              PduRDestPduRoutingType = API_FORWARDING if post-build-variant-condition{matching-criterion=RDR_POS, value=1}
              PduRDestPduRoutingType = API_FORWARDING if post-build-variant-condition{matching-criterion=RDR_POS, value=3}
              PduRDestPduRoutingType = API_FORWARDING if post-build-variant-condition{matching-criterion=RDR_POS, value=0}
              PduRDestPduRoutingType = API_FORWARDING if post-build-variant-condition{matching-criterion=RDR_POS, value=7}
              PduRDestPduRoutingType = API_FORWARDING if post-build-variant-condition{matching-criterion=RDR_POS, value=5}
              PduRDestPduRoutingType = API_FORWARDING if post-build-variant-condition{matching-criterion=RDR_POS, value=2}
              PduRDestPduRoutingType = API_FORWARDING if post-build-variant-condition{matching-criterion=RDR_POS, value=6}
              PduRDestPduDataProcessing = IMMEDIATE
              PduRPduLengthHandlingStrategy = UNUSED
              PduRDestPduCrossPartitionDestination = false
              PduRDestPduRef = PCAN_DIAG_REQ_PHYS_OTA_oPCAN_RADAR_1f79965d_Rx
              PduRDestPduPduRBswModulesRef = Dcm if post-build-variant-condition{matching-criterion=RDR_POS, value=7}
              PduRDestPduPduRBswModulesRef = Dcm if post-build-variant-condition{matching-criterion=RDR_POS, value=1}
              PduRDestPduPduRBswModulesRef = Dcm if post-build-variant-condition{matching-criterion=RDR_POS, value=4}
              PduRDestPduPduRBswModulesRef = Dcm if post-build-variant-condition{matching-criterion=RDR_POS, value=3}
              PduRDestPduPduRBswModulesRef = Dcm if post-build-variant-condition{matching-criterion=RDR_POS, value=2}
              PduRDestPduPduRBswModulesRef = Dcm if post-build-variant-condition{matching-criterion=RDR_POS, value=5}
              PduRDestPduPduRBswModulesRef = Dcm if post-build-variant-condition{matching-criterion=RDR_POS, value=6}
              PduRDestPduPduRBswModulesRef = Dcm if post-build-variant-condition{matching-criterion=RDR_POS, value=0}
            PduRSrcPdu_c794190e (PduRSrcPdu):
              PduRSourcePduHandleId = 21
              PduRSrcPduDirection = RECEIVE if post-build-variant-condition{matching-criterion=RDR_POS, value=7}
              PduRSrcPduDirection = RECEIVE if post-build-variant-condition{matching-criterion=RDR_POS, value=1}
              PduRSrcPduDirection = RECEIVE if post-build-variant-condition{matching-criterion=RDR_POS, value=3}
              PduRSrcPduDirection = RECEIVE if post-build-variant-condition{matching-criterion=RDR_POS, value=0}
              PduRSrcPduDirection = RECEIVE if post-build-variant-condition{matching-criterion=RDR_POS, value=5}
              PduRSrcPduDirection = RECEIVE if post-build-variant-condition{matching-criterion=RDR_POS, value=2}
              PduRSrcPduDirection = RECEIVE if post-build-variant-condition{matching-criterion=RDR_POS, value=4}
              PduRSrcPduDirection = RECEIVE if post-build-variant-condition{matching-criterion=RDR_POS, value=6}
              PduRSrcPduRef = PCAN_DIAG_REQ_PHYS_OTA_oPCAN_RADAR_45eab9fd_Rx
              PduRSrcPduPduRBswModulesRef = CanTp if post-build-variant-condition{matching-criterion=RDR_POS, value=1}
              PduRSrcPduPduRBswModulesRef = CanTp if post-build-variant-condition{matching-criterion=RDR_POS, value=5}
              PduRSrcPduPduRBswModulesRef = CanTp if post-build-variant-condition{matching-criterion=RDR_POS, value=7}
              PduRSrcPduPduRBswModulesRef = CanTp if post-build-variant-condition{matching-criterion=RDR_POS, value=3}
              PduRSrcPduPduRBswModulesRef = CanTp if post-build-variant-condition{matching-criterion=RDR_POS, value=6}
              PduRSrcPduPduRBswModulesRef = CanTp if post-build-variant-condition{matching-criterion=RDR_POS, value=2}
              PduRSrcPduPduRBswModulesRef = CanTp if post-build-variant-condition{matching-criterion=RDR_POS, value=4}
              PduRSrcPduPduRBswModulesRef = CanTp if post-build-variant-condition{matching-criterion=RDR_POS, value=0}
          SR1_DIAG_RES_PHY_OBD2_oVCAN_RADAR_17ff2d33_Tx: PduRRoutingPathCommunicationType=COMMUNICATION_INTERFACE if post-build-variant-condition{matching-criterion=RDR_POS, value=0}, PduRRoutingPathCommunicationType=COMMUNICATION_INTERFACE if post-build-variant-condition{matching-criterion=RDR_POS, value=1}, PduRRoutingPathCommunicationType=COMMUNICATION_INTERFACE if post-build-variant-condition{matching-criterion=RDR_POS, value=3}, PduRRoutingPathCommunicationType=COMMUNICATION_INTERFACE if post-build-variant-condition{matching-criterion=RDR_POS, value=7}, PduRRoutingPathCommunicationType=COMMUNICATION_INTERFACE if post-build-variant-condition{matching-criterion=RDR_POS, value=5}, PduRRoutingPathCommunicationType=COMMUNICATION_INTERFACE if post-build-variant-condition{matching-criterion=RDR_POS, value=2}, PduRRoutingPathCommunicationType=COMMUNICATION_INTERFACE if post-build-variant-condition{matching-criterion=RDR_POS, value=4}, PduRRoutingPathCommunicationType=COMMUNICATION_INTERFACE if post-build-variant-condition{matching-criterion=RDR_POS, value=6}, PduRLockRef=PduRLock_PduRExclusiveArea if post-build-variant-condition{matching-criterion=RDR_POS, value=3}, PduRLockRef=PduRLock_PduRExclusiveArea if post-build-variant-condition{matching-criterion=RDR_POS, value=0}, PduRLockRef=PduRLock_PduRExclusiveArea if post-build-variant-condition{matching-criterion=RDR_POS, value=7}, PduRLockRef=PduRLock_PduRExclusiveArea if post-build-variant-condition{matching-criterion=RDR_POS, value=6}, PduRLockRef=PduRLock_PduRExclusiveArea if post-build-variant-condition{matching-criterion=RDR_POS, value=4}, PduRLockRef=PduRLock_PduRExclusiveArea if post-build-variant-condition{matching-criterion=RDR_POS, value=1}, PduRLockRef=PduRLock_PduRExclusiveArea if post-build-variant-condition{matching-criterion=RDR_POS, value=2}, PduRLockRef=PduRLock_PduRExclusiveArea if post-build-variant-condition{matching-criterion=RDR_POS, value=5}
            SR1_DIAG_RES_PHY_OBD2_oVCAN_RADAR_3d2f6938_Tx (PduRDestPdu):
              PduRDestPduHandleId = 191
              PduRDestPduDirection = TRANSMIT if post-build-variant-condition{matching-criterion=RDR_POS, value=3}
              PduRDestPduDirection = TRANSMIT if post-build-variant-condition{matching-criterion=RDR_POS, value=1}
              PduRDestPduDirection = TRANSMIT if post-build-variant-condition{matching-criterion=RDR_POS, value=0}
              PduRDestPduDirection = TRANSMIT if post-build-variant-condition{matching-criterion=RDR_POS, value=7}
              PduRDestPduDirection = TRANSMIT if post-build-variant-condition{matching-criterion=RDR_POS, value=5}
              PduRDestPduDirection = TRANSMIT if post-build-variant-condition{matching-criterion=RDR_POS, value=2}
              PduRDestPduDirection = TRANSMIT if post-build-variant-condition{matching-criterion=RDR_POS, value=4}
              PduRDestPduDirection = TRANSMIT if post-build-variant-condition{matching-criterion=RDR_POS, value=6}
              PduRDestPduRoutingType = GATEWAY_ROUTING if post-build-variant-condition{matching-criterion=RDR_POS, value=5}
              PduRDestPduRoutingType = GATEWAY_ROUTING if post-build-variant-condition{matching-criterion=RDR_POS, value=0}
              PduRDestPduRoutingType = GATEWAY_ROUTING if post-build-variant-condition{matching-criterion=RDR_POS, value=7}
              PduRDestPduRoutingType = GATEWAY_ROUTING if post-build-variant-condition{matching-criterion=RDR_POS, value=6}
              PduRDestPduRoutingType = GATEWAY_ROUTING if post-build-variant-condition{matching-criterion=RDR_POS, value=4}
              PduRDestPduRoutingType = GATEWAY_ROUTING if post-build-variant-condition{matching-criterion=RDR_POS, value=1}
              PduRDestPduRoutingType = GATEWAY_ROUTING if post-build-variant-condition{matching-criterion=RDR_POS, value=3}
              PduRDestPduRoutingType = GATEWAY_ROUTING if post-build-variant-condition{matching-criterion=RDR_POS, value=2}
              PduRDestPduDataProcessing = IMMEDIATE
              PduRPduLengthHandlingStrategy = IGNORE
              PduRDestPduCrossPartitionDestination = false
              PduRTransmissionConfirmation = false
              PduRDestPduDataProvision = PDUR_DIRECT
              PduRDestPduRef = SR1_DIAG_RES_PHY_OBD2_oVCAN_RADAR_3d2f6938_Tx
              PduRDestPduPduRBswModulesRef = CanIf if post-build-variant-condition{matching-criterion=RDR_POS, value=7}
              PduRDestPduPduRBswModulesRef = CanIf if post-build-variant-condition{matching-criterion=RDR_POS, value=1}
              PduRDestPduPduRBswModulesRef = CanIf if post-build-variant-condition{matching-criterion=RDR_POS, value=6}
              PduRDestPduPduRBswModulesRef = CanIf if post-build-variant-condition{matching-criterion=RDR_POS, value=5}
              PduRDestPduPduRBswModulesRef = CanIf if post-build-variant-condition{matching-criterion=RDR_POS, value=2}
              PduRDestPduPduRBswModulesRef = CanIf if post-build-variant-condition{matching-criterion=RDR_POS, value=3}
              PduRDestPduPduRBswModulesRef = CanIf if post-build-variant-condition{matching-criterion=RDR_POS, value=0}
              PduRDestPduPduRBswModulesRef = CanIf if post-build-variant-condition{matching-criterion=RDR_POS, value=4}
            PduRSrcPdu_dd8809d0_001 (PduRSrcPdu):
              PduRSourcePduHandleId = 70
              PduRSrcPduDirection = RECEIVE if post-build-variant-condition{matching-criterion=RDR_POS, value=5}
              PduRSrcPduDirection = RECEIVE if post-build-variant-condition{matching-criterion=RDR_POS, value=0}
              PduRSrcPduDirection = RECEIVE if post-build-variant-condition{matching-criterion=RDR_POS, value=7}
              PduRSrcPduDirection = RECEIVE if post-build-variant-condition{matching-criterion=RDR_POS, value=6}
              PduRSrcPduDirection = RECEIVE if post-build-variant-condition{matching-criterion=RDR_POS, value=4}
              PduRSrcPduDirection = RECEIVE if post-build-variant-condition{matching-criterion=RDR_POS, value=1}
              PduRSrcPduDirection = RECEIVE if post-build-variant-condition{matching-criterion=RDR_POS, value=3}
              PduRSrcPduDirection = RECEIVE if post-build-variant-condition{matching-criterion=RDR_POS, value=2}
              PduRSrcPduRef = SRR_FL_DIAG_RESP_PHYS_OBD2_Rx_oPCAN_RADAR_7e9b2541_Rx
              PduRSrcPduPduRBswModulesRef = CanIf if post-build-variant-condition{matching-criterion=RDR_POS, value=1}
              PduRSrcPduPduRBswModulesRef = CanIf if post-build-variant-condition{matching-criterion=RDR_POS, value=3}
              PduRSrcPduPduRBswModulesRef = CanIf if post-build-variant-condition{matching-criterion=RDR_POS, value=6}
              PduRSrcPduPduRBswModulesRef = CanIf if post-build-variant-condition{matching-criterion=RDR_POS, value=0}
              PduRSrcPduPduRBswModulesRef = CanIf if post-build-variant-condition{matching-criterion=RDR_POS, value=5}
              PduRSrcPduPduRBswModulesRef = CanIf if post-build-variant-condition{matching-criterion=RDR_POS, value=4}
              PduRSrcPduPduRBswModulesRef = CanIf if post-build-variant-condition{matching-criterion=RDR_POS, value=7}
              PduRSrcPduPduRBswModulesRef = CanIf if post-build-variant-condition{matching-criterion=RDR_POS, value=2}
          PCAN_DIAG_REQ_FUNC_OBD2_oPCAN_RADAR_20_41244182_Rx: PduRRoutingPathCommunicationType=TRANSPORT_PROTOCOL if post-build-variant-condition{matching-criterion=RDR_POS, value=3}, PduRRoutingPathCommunicationType=TRANSPORT_PROTOCOL if post-build-variant-condition{matching-criterion=RDR_POS, value=1}, PduRRoutingPathCommunicationType=TRANSPORT_PROTOCOL if post-build-variant-condition{matching-criterion=RDR_POS, value=0}, PduRRoutingPathCommunicationType=TRANSPORT_PROTOCOL if post-build-variant-condition{matching-criterion=RDR_POS, value=7}, PduRRoutingPathCommunicationType=TRANSPORT_PROTOCOL if post-build-variant-condition{matching-criterion=RDR_POS, value=5}, PduRRoutingPathCommunicationType=TRANSPORT_PROTOCOL if post-build-variant-condition{matching-criterion=RDR_POS, value=2}, PduRRoutingPathCommunicationType=TRANSPORT_PROTOCOL if post-build-variant-condition{matching-criterion=RDR_POS, value=4}, PduRRoutingPathCommunicationType=TRANSPORT_PROTOCOL if post-build-variant-condition{matching-criterion=RDR_POS, value=6}, PduRLockRef=PduRLock_PduRExclusiveArea if post-build-variant-condition{matching-criterion=RDR_POS, value=6}, PduRLockRef=PduRLock_PduRExclusiveArea if post-build-variant-condition{matching-criterion=RDR_POS, value=1}, PduRLockRef=PduRLock_PduRExclusiveArea if post-build-variant-condition{matching-criterion=RDR_POS, value=3}, PduRLockRef=PduRLock_PduRExclusiveArea if post-build-variant-condition{matching-criterion=RDR_POS, value=0}, PduRLockRef=PduRLock_PduRExclusiveArea if post-build-variant-condition{matching-criterion=RDR_POS, value=7}, PduRLockRef=PduRLock_PduRExclusiveArea if post-build-variant-condition{matching-criterion=RDR_POS, value=5}, PduRLockRef=PduRLock_PduRExclusiveArea if post-build-variant-condition{matching-criterion=RDR_POS, value=2}, PduRLockRef=PduRLock_PduRExclusiveArea if post-build-variant-condition{matching-criterion=RDR_POS, value=4}
            PCAN_DIAG_REQ_FUNC_OBD2_oPCAN_RADAR_20_41244182_Rx_acafabed_Rx (PduRDestPdu):
              PduRDestPduHandleId = 10
              PduRDestPduDirection = RECEIVE if post-build-variant-condition{matching-criterion=RDR_POS, value=5}
              PduRDestPduDirection = RECEIVE if post-build-variant-condition{matching-criterion=RDR_POS, value=1}
              PduRDestPduDirection = RECEIVE if post-build-variant-condition{matching-criterion=RDR_POS, value=3}
              PduRDestPduDirection = RECEIVE if post-build-variant-condition{matching-criterion=RDR_POS, value=0}
              PduRDestPduDirection = RECEIVE if post-build-variant-condition{matching-criterion=RDR_POS, value=7}
              PduRDestPduDirection = RECEIVE if post-build-variant-condition{matching-criterion=RDR_POS, value=2}
              PduRDestPduDirection = RECEIVE if post-build-variant-condition{matching-criterion=RDR_POS, value=4}
              PduRDestPduDirection = RECEIVE if post-build-variant-condition{matching-criterion=RDR_POS, value=6}
              PduRDestPduRoutingType = API_FORWARDING if post-build-variant-condition{matching-criterion=RDR_POS, value=6}
              PduRDestPduRoutingType = API_FORWARDING if post-build-variant-condition{matching-criterion=RDR_POS, value=1}
              PduRDestPduRoutingType = API_FORWARDING if post-build-variant-condition{matching-criterion=RDR_POS, value=3}
              PduRDestPduRoutingType = API_FORWARDING if post-build-variant-condition{matching-criterion=RDR_POS, value=0}
              PduRDestPduRoutingType = API_FORWARDING if post-build-variant-condition{matching-criterion=RDR_POS, value=7}
              PduRDestPduRoutingType = API_FORWARDING if post-build-variant-condition{matching-criterion=RDR_POS, value=5}
              PduRDestPduRoutingType = API_FORWARDING if post-build-variant-condition{matching-criterion=RDR_POS, value=2}
              PduRDestPduRoutingType = API_FORWARDING if post-build-variant-condition{matching-criterion=RDR_POS, value=4}
              PduRDestPduDataProcessing = IMMEDIATE
              PduRPduLengthHandlingStrategy = UNUSED
              PduRDestPduCrossPartitionDestination = false
              PduRDestPduRef = PCAN_DIAG_REQ_FUNC_OBD2_oPCAN_RADAR_20_c04e56a1_Rx
              PduRDestPduPduRBswModulesRef = Dcm if post-build-variant-condition{matching-criterion=RDR_POS, value=7}
              PduRDestPduPduRBswModulesRef = Dcm if post-build-variant-condition{matching-criterion=RDR_POS, value=5}
              PduRDestPduPduRBswModulesRef = Dcm if post-build-variant-condition{matching-criterion=RDR_POS, value=2}
              PduRDestPduPduRBswModulesRef = Dcm if post-build-variant-condition{matching-criterion=RDR_POS, value=6}
              PduRDestPduPduRBswModulesRef = Dcm if post-build-variant-condition{matching-criterion=RDR_POS, value=1}
              PduRDestPduPduRBswModulesRef = Dcm if post-build-variant-condition{matching-criterion=RDR_POS, value=3}
              PduRDestPduPduRBswModulesRef = Dcm if post-build-variant-condition{matching-criterion=RDR_POS, value=0}
              PduRDestPduPduRBswModulesRef = Dcm if post-build-variant-condition{matching-criterion=RDR_POS, value=4}
            PduRSrcPdu_acafabed (PduRSrcPdu):
              PduRSourcePduHandleId = 10
              PduRSrcPduDirection = RECEIVE if post-build-variant-condition{matching-criterion=RDR_POS, value=6}
              PduRSrcPduDirection = RECEIVE if post-build-variant-condition{matching-criterion=RDR_POS, value=1}
              PduRSrcPduDirection = RECEIVE if post-build-variant-condition{matching-criterion=RDR_POS, value=3}
              PduRSrcPduDirection = RECEIVE if post-build-variant-condition{matching-criterion=RDR_POS, value=0}
              PduRSrcPduDirection = RECEIVE if post-build-variant-condition{matching-criterion=RDR_POS, value=7}
              PduRSrcPduDirection = RECEIVE if post-build-variant-condition{matching-criterion=RDR_POS, value=5}
              PduRSrcPduDirection = RECEIVE if post-build-variant-condition{matching-criterion=RDR_POS, value=2}
              PduRSrcPduDirection = RECEIVE if post-build-variant-condition{matching-criterion=RDR_POS, value=4}
              PduRSrcPduRef = PCAN_DIAG_REQ_FUNC_OBD2_oPCAN_RADAR_20_41244182_Rx
              PduRSrcPduPduRBswModulesRef = CanTp if post-build-variant-condition{matching-criterion=RDR_POS, value=4}
              PduRSrcPduPduRBswModulesRef = CanTp if post-build-variant-condition{matching-criterion=RDR_POS, value=3}
              PduRSrcPduPduRBswModulesRef = CanTp if post-build-variant-condition{matching-criterion=RDR_POS, value=7}
              PduRSrcPduPduRBswModulesRef = CanTp if post-build-variant-condition{matching-criterion=RDR_POS, value=6}
              PduRSrcPduPduRBswModulesRef = CanTp if post-build-variant-condition{matching-criterion=RDR_POS, value=2}
              PduRSrcPduPduRBswModulesRef = CanTp if post-build-variant-condition{matching-criterion=RDR_POS, value=0}
              PduRSrcPduPduRBswModulesRef = CanTp if post-build-variant-condition{matching-criterion=RDR_POS, value=5}
              PduRSrcPduPduRBswModulesRef = CanTp if post-build-variant-condition{matching-criterion=RDR_POS, value=1}
          prop_ADAS_BSIS_info_oVCAN_RADAR_8fdff4c8_Tx: PduRRoutingPathCommunicationType=COMMUNICATION_INTERFACE if post-build-variant-condition{matching-criterion=RDR_POS, value=6}, PduRRoutingPathCommunicationType=COMMUNICATION_INTERFACE if post-build-variant-condition{matching-criterion=RDR_POS, value=1}, PduRRoutingPathCommunicationType=COMMUNICATION_INTERFACE if post-build-variant-condition{matching-criterion=RDR_POS, value=3}, PduRRoutingPathCommunicationType=COMMUNICATION_INTERFACE if post-build-variant-condition{matching-criterion=RDR_POS, value=0}, PduRRoutingPathCommunicationType=COMMUNICATION_INTERFACE if post-build-variant-condition{matching-criterion=RDR_POS, value=7}, PduRRoutingPathCommunicationType=COMMUNICATION_INTERFACE if post-build-variant-condition{matching-criterion=RDR_POS, value=5}, PduRRoutingPathCommunicationType=COMMUNICATION_INTERFACE if post-build-variant-condition{matching-criterion=RDR_POS, value=2}, PduRRoutingPathCommunicationType=COMMUNICATION_INTERFACE if post-build-variant-condition{matching-criterion=RDR_POS, value=4}, PduRLockRef=PduRLock_PduRExclusiveArea if post-build-variant-condition{matching-criterion=RDR_POS, value=5}, PduRLockRef=PduRLock_PduRExclusiveArea if post-build-variant-condition{matching-criterion=RDR_POS, value=0}, PduRLockRef=PduRLock_PduRExclusiveArea if post-build-variant-condition{matching-criterion=RDR_POS, value=7}, PduRLockRef=PduRLock_PduRExclusiveArea if post-build-variant-condition{matching-criterion=RDR_POS, value=6}, PduRLockRef=PduRLock_PduRExclusiveArea if post-build-variant-condition{matching-criterion=RDR_POS, value=4}, PduRLockRef=PduRLock_PduRExclusiveArea if post-build-variant-condition{matching-criterion=RDR_POS, value=1}, PduRLockRef=PduRLock_PduRExclusiveArea if post-build-variant-condition{matching-criterion=RDR_POS, value=3}, PduRLockRef=PduRLock_PduRExclusiveArea if post-build-variant-condition{matching-criterion=RDR_POS, value=2}
            prop_ADAS_BSIS_info_oVCAN_RADAR_a7fddec0_Tx (PduRDestPdu):
              PduRDestPduHandleId = 210
              PduRDestPduDirection = TRANSMIT if post-build-variant-condition{matching-criterion=RDR_POS, value=7}
              PduRDestPduDirection = TRANSMIT if post-build-variant-condition{matching-criterion=RDR_POS, value=1}
              PduRDestPduDirection = TRANSMIT if post-build-variant-condition{matching-criterion=RDR_POS, value=3}
              PduRDestPduDirection = TRANSMIT if post-build-variant-condition{matching-criterion=RDR_POS, value=0}
              PduRDestPduDirection = TRANSMIT if post-build-variant-condition{matching-criterion=RDR_POS, value=5}
              PduRDestPduDirection = TRANSMIT if post-build-variant-condition{matching-criterion=RDR_POS, value=2}
              PduRDestPduDirection = TRANSMIT if post-build-variant-condition{matching-criterion=RDR_POS, value=4}
              PduRDestPduDirection = TRANSMIT if post-build-variant-condition{matching-criterion=RDR_POS, value=6}
              PduRDestPduRoutingType = GATEWAY_ROUTING if post-build-variant-condition{matching-criterion=RDR_POS, value=6}
              PduRDestPduRoutingType = GATEWAY_ROUTING if post-build-variant-condition{matching-criterion=RDR_POS, value=0}
              PduRDestPduRoutingType = GATEWAY_ROUTING if post-build-variant-condition{matching-criterion=RDR_POS, value=7}
              PduRDestPduRoutingType = GATEWAY_ROUTING if post-build-variant-condition{matching-criterion=RDR_POS, value=4}
              PduRDestPduRoutingType = GATEWAY_ROUTING if post-build-variant-condition{matching-criterion=RDR_POS, value=1}
              PduRDestPduRoutingType = GATEWAY_ROUTING if post-build-variant-condition{matching-criterion=RDR_POS, value=3}
              PduRDestPduRoutingType = GATEWAY_ROUTING if post-build-variant-condition{matching-criterion=RDR_POS, value=2}
              PduRDestPduRoutingType = GATEWAY_ROUTING if post-build-variant-condition{matching-criterion=RDR_POS, value=5}
              PduRDestPduDataProcessing = IMMEDIATE
              PduRPduLengthHandlingStrategy = IGNORE
              PduRDestPduCrossPartitionDestination = false
              PduRDestPduDataProvision = PDUR_DIRECT
              PduRTransmissionConfirmation = false
              PduRDestPduRef = prop_ADAS_BSIS_info_oVCAN_RADAR_a7fddec0_Tx
              PduRDestPduPduRBswModulesRef = CanIf if post-build-variant-condition{matching-criterion=RDR_POS, value=5}
              PduRDestPduPduRBswModulesRef = CanIf if post-build-variant-condition{matching-criterion=RDR_POS, value=2}
              PduRDestPduPduRBswModulesRef = CanIf if post-build-variant-condition{matching-criterion=RDR_POS, value=1}
              PduRDestPduPduRBswModulesRef = CanIf if post-build-variant-condition{matching-criterion=RDR_POS, value=7}
              PduRDestPduPduRBswModulesRef = CanIf if post-build-variant-condition{matching-criterion=RDR_POS, value=4}
              PduRDestPduPduRBswModulesRef = CanIf if post-build-variant-condition{matching-criterion=RDR_POS, value=0}
              PduRDestPduPduRBswModulesRef = CanIf if post-build-variant-condition{matching-criterion=RDR_POS, value=6}
              PduRDestPduPduRBswModulesRef = CanIf if post-build-variant-condition{matching-criterion=RDR_POS, value=3}
            PduRSrcPdu_03e5ee26_001 (PduRSrcPdu):
              PduRSourcePduHandleId = 86
              PduRSrcPduDirection = RECEIVE if post-build-variant-condition{matching-criterion=RDR_POS, value=2}
              PduRSrcPduDirection = RECEIVE if post-build-variant-condition{matching-criterion=RDR_POS, value=0}
              PduRSrcPduDirection = RECEIVE if post-build-variant-condition{matching-criterion=RDR_POS, value=7}
              PduRSrcPduDirection = RECEIVE if post-build-variant-condition{matching-criterion=RDR_POS, value=6}
              PduRSrcPduDirection = RECEIVE if post-build-variant-condition{matching-criterion=RDR_POS, value=4}
              PduRSrcPduDirection = RECEIVE if post-build-variant-condition{matching-criterion=RDR_POS, value=1}
              PduRSrcPduDirection = RECEIVE if post-build-variant-condition{matching-criterion=RDR_POS, value=3}
              PduRSrcPduDirection = RECEIVE if post-build-variant-condition{matching-criterion=RDR_POS, value=5}
              PduRSrcPduRef = RDR_prop_ADAS_BSIS_info_oPCAN_RADAR_e19e3fbb_Rx
              PduRSrcPduPduRBswModulesRef = CanIf if post-build-variant-condition{matching-criterion=RDR_POS, value=5}
              PduRSrcPduPduRBswModulesRef = CanIf if post-build-variant-condition{matching-criterion=RDR_POS, value=6}
              PduRSrcPduPduRBswModulesRef = CanIf if post-build-variant-condition{matching-criterion=RDR_POS, value=1}
              PduRSrcPduPduRBswModulesRef = CanIf if post-build-variant-condition{matching-criterion=RDR_POS, value=3}
              PduRSrcPduPduRBswModulesRef = CanIf if post-build-variant-condition{matching-criterion=RDR_POS, value=4}
              PduRSrcPduPduRBswModulesRef = CanIf if post-build-variant-condition{matching-criterion=RDR_POS, value=0}
              PduRSrcPduPduRBswModulesRef = CanIf if post-build-variant-condition{matching-criterion=RDR_POS, value=7}
              PduRSrcPduPduRBswModulesRef = CanIf if post-build-variant-condition{matching-criterion=RDR_POS, value=2}
          PCAN_DIAG_REQ_FUNC_OTA_oPCAN_RADAR_a013523e_Rx: PduRRoutingPathCommunicationType=TRANSPORT_PROTOCOL if post-build-variant-condition{matching-criterion=RDR_POS, value=1}, PduRRoutingPathCommunicationType=TRANSPORT_PROTOCOL if post-build-variant-condition{matching-criterion=RDR_POS, value=3}, PduRRoutingPathCommunicationType=TRANSPORT_PROTOCOL if post-build-variant-condition{matching-criterion=RDR_POS, value=0}, PduRRoutingPathCommunicationType=TRANSPORT_PROTOCOL if post-build-variant-condition{matching-criterion=RDR_POS, value=7}, PduRRoutingPathCommunicationType=TRANSPORT_PROTOCOL if post-build-variant-condition{matching-criterion=RDR_POS, value=5}, PduRRoutingPathCommunicationType=TRANSPORT_PROTOCOL if post-build-variant-condition{matching-criterion=RDR_POS, value=2}, PduRRoutingPathCommunicationType=TRANSPORT_PROTOCOL if post-build-variant-condition{matching-criterion=RDR_POS, value=4}, PduRRoutingPathCommunicationType=TRANSPORT_PROTOCOL if post-build-variant-condition{matching-criterion=RDR_POS, value=6}, PduRLockRef=PduRLock_PduRExclusiveArea if post-build-variant-condition{matching-criterion=RDR_POS, value=6}, PduRLockRef=PduRLock_PduRExclusiveArea if post-build-variant-condition{matching-criterion=RDR_POS, value=1}, PduRLockRef=PduRLock_PduRExclusiveArea if post-build-variant-condition{matching-criterion=RDR_POS, value=3}, PduRLockRef=PduRLock_PduRExclusiveArea if post-build-variant-condition{matching-criterion=RDR_POS, value=0}, PduRLockRef=PduRLock_PduRExclusiveArea if post-build-variant-condition{matching-criterion=RDR_POS, value=7}, PduRLockRef=PduRLock_PduRExclusiveArea if post-build-variant-condition{matching-criterion=RDR_POS, value=5}, PduRLockRef=PduRLock_PduRExclusiveArea if post-build-variant-condition{matching-criterion=RDR_POS, value=2}, PduRLockRef=PduRLock_PduRExclusiveArea if post-build-variant-condition{matching-criterion=RDR_POS, value=4}
            PCAN_DIAG_REQ_FUNC_OTA_oPCAN_RADAR_a013523e_Rx_6f3aa62d_Rx (PduRDestPdu):
              PduRDestPduHandleId = 13
              PduRDestPduDirection = RECEIVE if post-build-variant-condition{matching-criterion=RDR_POS, value=2}
              PduRDestPduDirection = RECEIVE if post-build-variant-condition{matching-criterion=RDR_POS, value=1}
              PduRDestPduDirection = RECEIVE if post-build-variant-condition{matching-criterion=RDR_POS, value=3}
              PduRDestPduDirection = RECEIVE if post-build-variant-condition{matching-criterion=RDR_POS, value=0}
              PduRDestPduDirection = RECEIVE if post-build-variant-condition{matching-criterion=RDR_POS, value=5}
              PduRDestPduDirection = RECEIVE if post-build-variant-condition{matching-criterion=RDR_POS, value=7}
              PduRDestPduDirection = RECEIVE if post-build-variant-condition{matching-criterion=RDR_POS, value=4}
              PduRDestPduDirection = RECEIVE if post-build-variant-condition{matching-criterion=RDR_POS, value=6}
              PduRDestPduRoutingType = API_FORWARDING if post-build-variant-condition{matching-criterion=RDR_POS, value=6}
              PduRDestPduRoutingType = API_FORWARDING if post-build-variant-condition{matching-criterion=RDR_POS, value=1}
              PduRDestPduRoutingType = API_FORWARDING if post-build-variant-condition{matching-criterion=RDR_POS, value=3}
              PduRDestPduRoutingType = API_FORWARDING if post-build-variant-condition{matching-criterion=RDR_POS, value=0}
              PduRDestPduRoutingType = API_FORWARDING if post-build-variant-condition{matching-criterion=RDR_POS, value=7}
              PduRDestPduRoutingType = API_FORWARDING if post-build-variant-condition{matching-criterion=RDR_POS, value=5}
              PduRDestPduRoutingType = API_FORWARDING if post-build-variant-condition{matching-criterion=RDR_POS, value=2}
              PduRDestPduRoutingType = API_FORWARDING if post-build-variant-condition{matching-criterion=RDR_POS, value=4}
              PduRDestPduDataProcessing = IMMEDIATE
              PduRPduLengthHandlingStrategy = UNUSED
              PduRDestPduCrossPartitionDestination = false
              PduRDestPduRef = PCAN_DIAG_REQ_FUNC_OTA_oPCAN_RADAR_8729c499_Rx
              PduRDestPduPduRBswModulesRef = Dcm if post-build-variant-condition{matching-criterion=RDR_POS, value=4}
              PduRDestPduPduRBswModulesRef = Dcm if post-build-variant-condition{matching-criterion=RDR_POS, value=2}
              PduRDestPduPduRBswModulesRef = Dcm if post-build-variant-condition{matching-criterion=RDR_POS, value=3}
              PduRDestPduPduRBswModulesRef = Dcm if post-build-variant-condition{matching-criterion=RDR_POS, value=7}
              PduRDestPduPduRBswModulesRef = Dcm if post-build-variant-condition{matching-criterion=RDR_POS, value=5}
              PduRDestPduPduRBswModulesRef = Dcm if post-build-variant-condition{matching-criterion=RDR_POS, value=0}
              PduRDestPduPduRBswModulesRef = Dcm if post-build-variant-condition{matching-criterion=RDR_POS, value=1}
              PduRDestPduPduRBswModulesRef = Dcm if post-build-variant-condition{matching-criterion=RDR_POS, value=6}
            PduRSrcPdu_6f3aa62d (PduRSrcPdu):
              PduRSourcePduHandleId = 13
              PduRSrcPduDirection = RECEIVE if post-build-variant-condition{matching-criterion=RDR_POS, value=6}
              PduRSrcPduDirection = RECEIVE if post-build-variant-condition{matching-criterion=RDR_POS, value=1}
              PduRSrcPduDirection = RECEIVE if post-build-variant-condition{matching-criterion=RDR_POS, value=3}
              PduRSrcPduDirection = RECEIVE if post-build-variant-condition{matching-criterion=RDR_POS, value=0}
              PduRSrcPduDirection = RECEIVE if post-build-variant-condition{matching-criterion=RDR_POS, value=7}
              PduRSrcPduDirection = RECEIVE if post-build-variant-condition{matching-criterion=RDR_POS, value=5}
              PduRSrcPduDirection = RECEIVE if post-build-variant-condition{matching-criterion=RDR_POS, value=2}
              PduRSrcPduDirection = RECEIVE if post-build-variant-condition{matching-criterion=RDR_POS, value=4}
              PduRSrcPduRef = PCAN_DIAG_REQ_FUNC_OTA_oPCAN_RADAR_a013523e_Rx
              PduRSrcPduPduRBswModulesRef = CanTp if post-build-variant-condition{matching-criterion=RDR_POS, value=1}
              PduRSrcPduPduRBswModulesRef = CanTp if post-build-variant-condition{matching-criterion=RDR_POS, value=7}
              PduRSrcPduPduRBswModulesRef = CanTp if post-build-variant-condition{matching-criterion=RDR_POS, value=6}
              PduRSrcPduPduRBswModulesRef = CanTp if post-build-variant-condition{matching-criterion=RDR_POS, value=3}
              PduRSrcPduPduRBswModulesRef = CanTp if post-build-variant-condition{matching-criterion=RDR_POS, value=2}
              PduRSrcPduPduRBswModulesRef = CanTp if post-build-variant-condition{matching-criterion=RDR_POS, value=4}
              PduRSrcPduPduRBswModulesRef = CanTp if post-build-variant-condition{matching-criterion=RDR_POS, value=0}
              PduRSrcPduPduRBswModulesRef = CanTp if post-build-variant-condition{matching-criterion=RDR_POS, value=5}
          PCAN_DIAG_RESP_PHYS_OBD1_oPCAN_RADAR_20_f26199fd_Tx: PduRRoutingPathCommunicationType=TRANSPORT_PROTOCOL if post-build-variant-condition{matching-criterion=RDR_POS, value=2}, PduRRoutingPathCommunicationType=TRANSPORT_PROTOCOL if post-build-variant-condition{matching-criterion=RDR_POS, value=1}, PduRRoutingPathCommunicationType=TRANSPORT_PROTOCOL if post-build-variant-condition{matching-criterion=RDR_POS, value=3}, PduRRoutingPathCommunicationType=TRANSPORT_PROTOCOL if post-build-variant-condition{matching-criterion=RDR_POS, value=0}, PduRRoutingPathCommunicationType=TRANSPORT_PROTOCOL if post-build-variant-condition{matching-criterion=RDR_POS, value=5}, PduRRoutingPathCommunicationType=TRANSPORT_PROTOCOL if post-build-variant-condition{matching-criterion=RDR_POS, value=7}, PduRRoutingPathCommunicationType=TRANSPORT_PROTOCOL if post-build-variant-condition{matching-criterion=RDR_POS, value=4}, PduRRoutingPathCommunicationType=TRANSPORT_PROTOCOL if post-build-variant-condition{matching-criterion=RDR_POS, value=6}, PduRLockRef=PduRLock_PduRExclusiveArea if post-build-variant-condition{matching-criterion=RDR_POS, value=6}, PduRLockRef=PduRLock_PduRExclusiveArea if post-build-variant-condition{matching-criterion=RDR_POS, value=1}, PduRLockRef=PduRLock_PduRExclusiveArea if post-build-variant-condition{matching-criterion=RDR_POS, value=3}, PduRLockRef=PduRLock_PduRExclusiveArea if post-build-variant-condition{matching-criterion=RDR_POS, value=0}, PduRLockRef=PduRLock_PduRExclusiveArea if post-build-variant-condition{matching-criterion=RDR_POS, value=7}, PduRLockRef=PduRLock_PduRExclusiveArea if post-build-variant-condition{matching-criterion=RDR_POS, value=5}, PduRLockRef=PduRLock_PduRExclusiveArea if post-build-variant-condition{matching-criterion=RDR_POS, value=2}, PduRLockRef=PduRLock_PduRExclusiveArea if post-build-variant-condition{matching-criterion=RDR_POS, value=4}
            PCAN_DIAG_RESP_PHYS_OBD1_oPCAN_RADAR_20_955df2f4_Tx (PduRDestPdu):
              PduRDestPduHandleId = 5
              PduRDestPduDirection = TRANSMIT if post-build-variant-condition{matching-criterion=RDR_POS, value=1}
              PduRDestPduDirection = TRANSMIT if post-build-variant-condition{matching-criterion=RDR_POS, value=3}
              PduRDestPduDirection = TRANSMIT if post-build-variant-condition{matching-criterion=RDR_POS, value=0}
              PduRDestPduDirection = TRANSMIT if post-build-variant-condition{matching-criterion=RDR_POS, value=7}
              PduRDestPduDirection = TRANSMIT if post-build-variant-condition{matching-criterion=RDR_POS, value=5}
              PduRDestPduDirection = TRANSMIT if post-build-variant-condition{matching-criterion=RDR_POS, value=2}
              PduRDestPduDirection = TRANSMIT if post-build-variant-condition{matching-criterion=RDR_POS, value=4}
              PduRDestPduDirection = TRANSMIT if post-build-variant-condition{matching-criterion=RDR_POS, value=6}
              PduRDestPduRoutingType = API_FORWARDING if post-build-variant-condition{matching-criterion=RDR_POS, value=4}
              PduRDestPduRoutingType = API_FORWARDING if post-build-variant-condition{matching-criterion=RDR_POS, value=1}
              PduRDestPduRoutingType = API_FORWARDING if post-build-variant-condition{matching-criterion=RDR_POS, value=3}
              PduRDestPduRoutingType = API_FORWARDING if post-build-variant-condition{matching-criterion=RDR_POS, value=0}
              PduRDestPduRoutingType = API_FORWARDING if post-build-variant-condition{matching-criterion=RDR_POS, value=7}
              PduRDestPduRoutingType = API_FORWARDING if post-build-variant-condition{matching-criterion=RDR_POS, value=5}
              PduRDestPduRoutingType = API_FORWARDING if post-build-variant-condition{matching-criterion=RDR_POS, value=2}
              PduRDestPduRoutingType = API_FORWARDING if post-build-variant-condition{matching-criterion=RDR_POS, value=6}
              PduRDestPduDataProcessing = IMMEDIATE
              PduRPduLengthHandlingStrategy = UNUSED
              PduRDestPduCrossPartitionDestination = false
              PduRDestPduRef = PCAN_DIAG_RESP_PHYS_OBD1_oPCAN_RADAR_20_955df2f4_Tx
              PduRDestPduPduRBswModulesRef = CanTp if post-build-variant-condition{matching-criterion=RDR_POS, value=2}
              PduRDestPduPduRBswModulesRef = CanTp if post-build-variant-condition{matching-criterion=RDR_POS, value=6}
              PduRDestPduPduRBswModulesRef = CanTp if post-build-variant-condition{matching-criterion=RDR_POS, value=3}
              PduRDestPduPduRBswModulesRef = CanTp if post-build-variant-condition{matching-criterion=RDR_POS, value=0}
              PduRDestPduPduRBswModulesRef = CanTp if post-build-variant-condition{matching-criterion=RDR_POS, value=1}
              PduRDestPduPduRBswModulesRef = CanTp if post-build-variant-condition{matching-criterion=RDR_POS, value=4}
              PduRDestPduPduRBswModulesRef = CanTp if post-build-variant-condition{matching-criterion=RDR_POS, value=7}
              PduRDestPduPduRBswModulesRef = CanTp if post-build-variant-condition{matching-criterion=RDR_POS, value=5}
            PduRSrcPdu_5a38c029 (PduRSrcPdu):
              PduRSourcePduHandleId = 7
              PduRSrcPduDirection = TRANSMIT if post-build-variant-condition{matching-criterion=RDR_POS, value=0}
              PduRSrcPduDirection = TRANSMIT if post-build-variant-condition{matching-criterion=RDR_POS, value=1}
              PduRSrcPduDirection = TRANSMIT if post-build-variant-condition{matching-criterion=RDR_POS, value=3}
              PduRSrcPduDirection = TRANSMIT if post-build-variant-condition{matching-criterion=RDR_POS, value=7}
              PduRSrcPduDirection = TRANSMIT if post-build-variant-condition{matching-criterion=RDR_POS, value=5}
              PduRSrcPduDirection = TRANSMIT if post-build-variant-condition{matching-criterion=RDR_POS, value=2}
              PduRSrcPduDirection = TRANSMIT if post-build-variant-condition{matching-criterion=RDR_POS, value=4}
              PduRSrcPduDirection = TRANSMIT if post-build-variant-condition{matching-criterion=RDR_POS, value=6}
              PduRSrcPduRef = PCAN_DIAG_RESP_PHYS_OBD1_oPCAN_RADAR_20_f26199fd_Tx
              PduRSrcPduPduRBswModulesRef = Dcm if post-build-variant-condition{matching-criterion=RDR_POS, value=2}
              PduRSrcPduPduRBswModulesRef = Dcm if post-build-variant-condition{matching-criterion=RDR_POS, value=6}
              PduRSrcPduPduRBswModulesRef = Dcm if post-build-variant-condition{matching-criterion=RDR_POS, value=1}
              PduRSrcPduPduRBswModulesRef = Dcm if post-build-variant-condition{matching-criterion=RDR_POS, value=7}
              PduRSrcPduPduRBswModulesRef = Dcm if post-build-variant-condition{matching-criterion=RDR_POS, value=5}
              PduRSrcPduPduRBswModulesRef = Dcm if post-build-variant-condition{matching-criterion=RDR_POS, value=3}
              PduRSrcPduPduRBswModulesRef = Dcm if post-build-variant-condition{matching-criterion=RDR_POS, value=4}
              PduRSrcPduPduRBswModulesRef = Dcm if post-build-variant-condition{matching-criterion=RDR_POS, value=0}
          RDR_CM_B0_Rx_oPCAN_RADAR_3544966f_Rx: PduRRoutingPathCommunicationType=COMMUNICATION_INTERFACE if post-build-variant-condition{matching-criterion=RDR_POS, value=3}, PduRRoutingPathCommunicationType=COMMUNICATION_INTERFACE if post-build-variant-condition{matching-criterion=RDR_POS, value=1}, PduRRoutingPathCommunicationType=COMMUNICATION_INTERFACE if post-build-variant-condition{matching-criterion=RDR_POS, value=0}, PduRRoutingPathCommunicationType=COMMUNICATION_INTERFACE if post-build-variant-condition{matching-criterion=RDR_POS, value=7}, PduRRoutingPathCommunicationType=COMMUNICATION_INTERFACE if post-build-variant-condition{matching-criterion=RDR_POS, value=5}, PduRRoutingPathCommunicationType=COMMUNICATION_INTERFACE if post-build-variant-condition{matching-criterion=RDR_POS, value=2}, PduRRoutingPathCommunicationType=COMMUNICATION_INTERFACE if post-build-variant-condition{matching-criterion=RDR_POS, value=4}, PduRRoutingPathCommunicationType=COMMUNICATION_INTERFACE if post-build-variant-condition{matching-criterion=RDR_POS, value=6}, PduRLockRef=PduRLock_PduRExclusiveArea if post-build-variant-condition{matching-criterion=RDR_POS, value=6}, PduRLockRef=PduRLock_PduRExclusiveArea if post-build-variant-condition{matching-criterion=RDR_POS, value=0}, PduRLockRef=PduRLock_PduRExclusiveArea if post-build-variant-condition{matching-criterion=RDR_POS, value=7}, PduRLockRef=PduRLock_PduRExclusiveArea if post-build-variant-condition{matching-criterion=RDR_POS, value=4}, PduRLockRef=PduRLock_PduRExclusiveArea if post-build-variant-condition{matching-criterion=RDR_POS, value=1}, PduRLockRef=PduRLock_PduRExclusiveArea if post-build-variant-condition{matching-criterion=RDR_POS, value=3}, PduRLockRef=PduRLock_PduRExclusiveArea if post-build-variant-condition{matching-criterion=RDR_POS, value=2}, PduRLockRef=PduRLock_PduRExclusiveArea if post-build-variant-condition{matching-criterion=RDR_POS, value=5}
            PduRSrcPdu_bae2d263 (PduRSrcPdu):
              PduRSourcePduHandleId = 22
              PduRSrcPduDirection = RECEIVE if post-build-variant-condition{matching-criterion=RDR_POS, value=3}
              PduRSrcPduDirection = RECEIVE if post-build-variant-condition{matching-criterion=RDR_POS, value=1}
              PduRSrcPduDirection = RECEIVE if post-build-variant-condition{matching-criterion=RDR_POS, value=0}
              PduRSrcPduDirection = RECEIVE if post-build-variant-condition{matching-criterion=RDR_POS, value=7}
              PduRSrcPduDirection = RECEIVE if post-build-variant-condition{matching-criterion=RDR_POS, value=5}
              PduRSrcPduDirection = RECEIVE if post-build-variant-condition{matching-criterion=RDR_POS, value=2}
              PduRSrcPduDirection = RECEIVE if post-build-variant-condition{matching-criterion=RDR_POS, value=4}
              PduRSrcPduDirection = RECEIVE if post-build-variant-condition{matching-criterion=RDR_POS, value=6}
              PduRSrcPduRef = RDR_CM_B0_Rx_oPCAN_RADAR_3544966f_Rx
              PduRSrcPduPduRBswModulesRef = CanIf if post-build-variant-condition{matching-criterion=RDR_POS, value=2}
              PduRSrcPduPduRBswModulesRef = CanIf if post-build-variant-condition{matching-criterion=RDR_POS, value=7}
              PduRSrcPduPduRBswModulesRef = CanIf if post-build-variant-condition{matching-criterion=RDR_POS, value=6}
              PduRSrcPduPduRBswModulesRef = CanIf if post-build-variant-condition{matching-criterion=RDR_POS, value=3}
              PduRSrcPduPduRBswModulesRef = CanIf if post-build-variant-condition{matching-criterion=RDR_POS, value=0}
              PduRSrcPduPduRBswModulesRef = CanIf if post-build-variant-condition{matching-criterion=RDR_POS, value=1}
              PduRSrcPduPduRBswModulesRef = CanIf if post-build-variant-condition{matching-criterion=RDR_POS, value=5}
              PduRSrcPduPduRBswModulesRef = CanIf if post-build-variant-condition{matching-criterion=RDR_POS, value=4}
            TPCM_SR1_oVCAN_RADAR_42f3de03_Tx (PduRDestPdu):
              PduRDestPduHandleId = 206
              PduRDestPduDirection = TRANSMIT if post-build-variant-condition{matching-criterion=RDR_POS, value=0}
              PduRDestPduDirection = TRANSMIT if post-build-variant-condition{matching-criterion=RDR_POS, value=7}
              PduRDestPduDirection = TRANSMIT if post-build-variant-condition{matching-criterion=RDR_POS, value=6}
              PduRDestPduDirection = TRANSMIT if post-build-variant-condition{matching-criterion=RDR_POS, value=4}
              PduRDestPduDirection = TRANSMIT if post-build-variant-condition{matching-criterion=RDR_POS, value=1}
              PduRDestPduDirection = TRANSMIT if post-build-variant-condition{matching-criterion=RDR_POS, value=3}
              PduRDestPduDirection = TRANSMIT if post-build-variant-condition{matching-criterion=RDR_POS, value=2}
              PduRDestPduDirection = TRANSMIT if post-build-variant-condition{matching-criterion=RDR_POS, value=5}
              PduRDestPduRoutingType = GATEWAY_ROUTING if post-build-variant-condition{matching-criterion=RDR_POS, value=0}
              PduRDestPduRoutingType = GATEWAY_ROUTING if post-build-variant-condition{matching-criterion=RDR_POS, value=7}
              PduRDestPduRoutingType = GATEWAY_ROUTING if post-build-variant-condition{matching-criterion=RDR_POS, value=6}
              PduRDestPduRoutingType = GATEWAY_ROUTING if post-build-variant-condition{matching-criterion=RDR_POS, value=4}
              PduRDestPduRoutingType = GATEWAY_ROUTING if post-build-variant-condition{matching-criterion=RDR_POS, value=1}
              PduRDestPduRoutingType = GATEWAY_ROUTING if post-build-variant-condition{matching-criterion=RDR_POS, value=3}
              PduRDestPduRoutingType = GATEWAY_ROUTING if post-build-variant-condition{matching-criterion=RDR_POS, value=2}
              PduRDestPduRoutingType = GATEWAY_ROUTING if post-build-variant-condition{matching-criterion=RDR_POS, value=5}
              PduRDestPduDataProcessing = IMMEDIATE
              PduRPduLengthHandlingStrategy = IGNORE
              PduRDestPduCrossPartitionDestination = false
              PduRDestPduDataProvision = PDUR_DIRECT if post-build-variant-condition{matching-criterion=RDR_POS, value=7}
              PduRDestPduDataProvision = PDUR_DIRECT if post-build-variant-condition{matching-criterion=RDR_POS, value=0}
              PduRDestPduDataProvision = PDUR_DIRECT if post-build-variant-condition{matching-criterion=RDR_POS, value=6}
              PduRDestPduDataProvision = PDUR_DIRECT if post-build-variant-condition{matching-criterion=RDR_POS, value=4}
              PduRDestPduDataProvision = PDUR_DIRECT if post-build-variant-condition{matching-criterion=RDR_POS, value=1}
              PduRDestPduDataProvision = PDUR_DIRECT if post-build-variant-condition{matching-criterion=RDR_POS, value=3}
              PduRDestPduDataProvision = PDUR_DIRECT if post-build-variant-condition{matching-criterion=RDR_POS, value=2}
              PduRDestPduDataProvision = PDUR_DIRECT if post-build-variant-condition{matching-criterion=RDR_POS, value=5}
              PduRTransmissionConfirmation = false
              PduRDestPduRef = TPCM_SR1_oVCAN_RADAR_42f3de03_Tx
              PduRDestPduPduRBswModulesRef = CanIf if post-build-variant-condition{matching-criterion=RDR_POS, value=4}
              PduRDestPduPduRBswModulesRef = CanIf if post-build-variant-condition{matching-criterion=RDR_POS, value=2}
              PduRDestPduPduRBswModulesRef = CanIf if post-build-variant-condition{matching-criterion=RDR_POS, value=3}
              PduRDestPduPduRBswModulesRef = CanIf if post-build-variant-condition{matching-criterion=RDR_POS, value=6}
              PduRDestPduPduRBswModulesRef = CanIf if post-build-variant-condition{matching-criterion=RDR_POS, value=5}
              PduRDestPduPduRBswModulesRef = CanIf if post-build-variant-condition{matching-criterion=RDR_POS, value=1}
              PduRDestPduPduRBswModulesRef = CanIf if post-build-variant-condition{matching-criterion=RDR_POS, value=0}
              PduRDestPduPduRBswModulesRef = CanIf if post-build-variant-condition{matching-criterion=RDR_POS, value=7}
          FR_DIAG_RES_PHY_OBD2_oVCAN_RADAR_1018d871_Tx: PduRRoutingPathCommunicationType=TRANSPORT_PROTOCOL if post-build-variant-condition{matching-criterion=RDR_POS, value=3}, PduRRoutingPathCommunicationType=TRANSPORT_PROTOCOL if post-build-variant-condition{matching-criterion=RDR_POS, value=1}, PduRRoutingPathCommunicationType=TRANSPORT_PROTOCOL if post-build-variant-condition{matching-criterion=RDR_POS, value=0}, PduRRoutingPathCommunicationType=TRANSPORT_PROTOCOL if post-build-variant-condition{matching-criterion=RDR_POS, value=7}, PduRRoutingPathCommunicationType=TRANSPORT_PROTOCOL if post-build-variant-condition{matching-criterion=RDR_POS, value=5}, PduRRoutingPathCommunicationType=TRANSPORT_PROTOCOL if post-build-variant-condition{matching-criterion=RDR_POS, value=2}, PduRRoutingPathCommunicationType=TRANSPORT_PROTOCOL if post-build-variant-condition{matching-criterion=RDR_POS, value=4}, PduRRoutingPathCommunicationType=TRANSPORT_PROTOCOL if post-build-variant-condition{matching-criterion=RDR_POS, value=6}, PduRLockRef=PduRLock_PduRExclusiveArea if post-build-variant-condition{matching-criterion=RDR_POS, value=6}, PduRLockRef=PduRLock_PduRExclusiveArea if post-build-variant-condition{matching-criterion=RDR_POS, value=1}, PduRLockRef=PduRLock_PduRExclusiveArea if post-build-variant-condition{matching-criterion=RDR_POS, value=3}, PduRLockRef=PduRLock_PduRExclusiveArea if post-build-variant-condition{matching-criterion=RDR_POS, value=0}, PduRLockRef=PduRLock_PduRExclusiveArea if post-build-variant-condition{matching-criterion=RDR_POS, value=7}, PduRLockRef=PduRLock_PduRExclusiveArea if post-build-variant-condition{matching-criterion=RDR_POS, value=5}, PduRLockRef=PduRLock_PduRExclusiveArea if post-build-variant-condition{matching-criterion=RDR_POS, value=2}, PduRLockRef=PduRLock_PduRExclusiveArea if post-build-variant-condition{matching-criterion=RDR_POS, value=4}
            FR_DIAG_RES_PHY_OBD2_oVCAN_RADAR_96501380_Tx (PduRDestPdu):
              PduRDestPduHandleId = 2
              PduRDestPduDirection = TRANSMIT if post-build-variant-condition{matching-criterion=RDR_POS, value=4}
              PduRDestPduDirection = TRANSMIT if post-build-variant-condition{matching-criterion=RDR_POS, value=1}
              PduRDestPduDirection = TRANSMIT if post-build-variant-condition{matching-criterion=RDR_POS, value=3}
              PduRDestPduDirection = TRANSMIT if post-build-variant-condition{matching-criterion=RDR_POS, value=0}
              PduRDestPduDirection = TRANSMIT if post-build-variant-condition{matching-criterion=RDR_POS, value=7}
              PduRDestPduDirection = TRANSMIT if post-build-variant-condition{matching-criterion=RDR_POS, value=5}
              PduRDestPduDirection = TRANSMIT if post-build-variant-condition{matching-criterion=RDR_POS, value=2}
              PduRDestPduDirection = TRANSMIT if post-build-variant-condition{matching-criterion=RDR_POS, value=6}
              PduRDestPduRoutingType = API_FORWARDING if post-build-variant-condition{matching-criterion=RDR_POS, value=2}
              PduRDestPduRoutingType = API_FORWARDING if post-build-variant-condition{matching-criterion=RDR_POS, value=1}
              PduRDestPduRoutingType = API_FORWARDING if post-build-variant-condition{matching-criterion=RDR_POS, value=3}
              PduRDestPduRoutingType = API_FORWARDING if post-build-variant-condition{matching-criterion=RDR_POS, value=0}
              PduRDestPduRoutingType = API_FORWARDING if post-build-variant-condition{matching-criterion=RDR_POS, value=5}
              PduRDestPduRoutingType = API_FORWARDING if post-build-variant-condition{matching-criterion=RDR_POS, value=7}
              PduRDestPduRoutingType = API_FORWARDING if post-build-variant-condition{matching-criterion=RDR_POS, value=4}
              PduRDestPduRoutingType = API_FORWARDING if post-build-variant-condition{matching-criterion=RDR_POS, value=6}
              PduRDestPduDataProcessing = IMMEDIATE
              PduRPduLengthHandlingStrategy = UNUSED
              PduRDestPduCrossPartitionDestination = false
              PduRDestPduRef = FR_DIAG_RES_PHY_OBD2_oVCAN_RADAR_96501380_Tx
              PduRDestPduPduRBswModulesRef = CanTp if post-build-variant-condition{matching-criterion=RDR_POS, value=0}
              PduRDestPduPduRBswModulesRef = CanTp if post-build-variant-condition{matching-criterion=RDR_POS, value=5}
              PduRDestPduPduRBswModulesRef = CanTp if post-build-variant-condition{matching-criterion=RDR_POS, value=6}
              PduRDestPduPduRBswModulesRef = CanTp if post-build-variant-condition{matching-criterion=RDR_POS, value=1}
              PduRDestPduPduRBswModulesRef = CanTp if post-build-variant-condition{matching-criterion=RDR_POS, value=2}
              PduRDestPduPduRBswModulesRef = CanTp if post-build-variant-condition{matching-criterion=RDR_POS, value=7}
              PduRDestPduPduRBswModulesRef = CanTp if post-build-variant-condition{matching-criterion=RDR_POS, value=3}
              PduRDestPduPduRBswModulesRef = CanTp if post-build-variant-condition{matching-criterion=RDR_POS, value=4}
            PduRSrcPdu_dffb8b0e (PduRSrcPdu):
              PduRSourcePduHandleId = 2
              PduRSrcPduDirection = TRANSMIT if post-build-variant-condition{matching-criterion=RDR_POS, value=5}
              PduRSrcPduDirection = TRANSMIT if post-build-variant-condition{matching-criterion=RDR_POS, value=1}
              PduRSrcPduDirection = TRANSMIT if post-build-variant-condition{matching-criterion=RDR_POS, value=3}
              PduRSrcPduDirection = TRANSMIT if post-build-variant-condition{matching-criterion=RDR_POS, value=0}
              PduRSrcPduDirection = TRANSMIT if post-build-variant-condition{matching-criterion=RDR_POS, value=7}
              PduRSrcPduDirection = TRANSMIT if post-build-variant-condition{matching-criterion=RDR_POS, value=2}
              PduRSrcPduDirection = TRANSMIT if post-build-variant-condition{matching-criterion=RDR_POS, value=4}
              PduRSrcPduDirection = TRANSMIT if post-build-variant-condition{matching-criterion=RDR_POS, value=6}
              PduRSrcPduRef = FR_DIAG_RES_PHY_OBD2_oVCAN_RADAR_1018d871_Tx
              PduRSrcPduPduRBswModulesRef = Dcm if post-build-variant-condition{matching-criterion=RDR_POS, value=0}
              PduRSrcPduPduRBswModulesRef = Dcm if post-build-variant-condition{matching-criterion=RDR_POS, value=3}
              PduRSrcPduPduRBswModulesRef = Dcm if post-build-variant-condition{matching-criterion=RDR_POS, value=2}
              PduRSrcPduPduRBswModulesRef = Dcm if post-build-variant-condition{matching-criterion=RDR_POS, value=7}
              PduRSrcPduPduRBswModulesRef = Dcm if post-build-variant-condition{matching-criterion=RDR_POS, value=4}
              PduRSrcPduPduRBswModulesRef = Dcm if post-build-variant-condition{matching-criterion=RDR_POS, value=6}
              PduRSrcPduPduRBswModulesRef = Dcm if post-build-variant-condition{matching-criterion=RDR_POS, value=1}
              PduRSrcPduPduRBswModulesRef = Dcm if post-build-variant-condition{matching-criterion=RDR_POS, value=5}
          SR2_DIAG_RES_PHY_OBD1_oVCAN_RADAR_b91d788e_Tx: PduRRoutingPathCommunicationType=COMMUNICATION_INTERFACE if post-build-variant-condition{matching-criterion=RDR_POS, value=4}, PduRRoutingPathCommunicationType=COMMUNICATION_INTERFACE if post-build-variant-condition{matching-criterion=RDR_POS, value=1}, PduRRoutingPathCommunicationType=COMMUNICATION_INTERFACE if post-build-variant-condition{matching-criterion=RDR_POS, value=3}, PduRRoutingPathCommunicationType=COMMUNICATION_INTERFACE if post-build-variant-condition{matching-criterion=RDR_POS, value=0}, PduRRoutingPathCommunicationType=COMMUNICATION_INTERFACE if post-build-variant-condition{matching-criterion=RDR_POS, value=7}, PduRRoutingPathCommunicationType=COMMUNICATION_INTERFACE if post-build-variant-condition{matching-criterion=RDR_POS, value=5}, PduRRoutingPathCommunicationType=COMMUNICATION_INTERFACE if post-build-variant-condition{matching-criterion=RDR_POS, value=2}, PduRRoutingPathCommunicationType=COMMUNICATION_INTERFACE if post-build-variant-condition{matching-criterion=RDR_POS, value=6}, PduRLockRef=PduRLock_PduRExclusiveArea if post-build-variant-condition{matching-criterion=RDR_POS, value=1}, PduRLockRef=PduRLock_PduRExclusiveArea if post-build-variant-condition{matching-criterion=RDR_POS, value=0}, PduRLockRef=PduRLock_PduRExclusiveArea if post-build-variant-condition{matching-criterion=RDR_POS, value=7}, PduRLockRef=PduRLock_PduRExclusiveArea if post-build-variant-condition{matching-criterion=RDR_POS, value=6}, PduRLockRef=PduRLock_PduRExclusiveArea if post-build-variant-condition{matching-criterion=RDR_POS, value=4}, PduRLockRef=PduRLock_PduRExclusiveArea if post-build-variant-condition{matching-criterion=RDR_POS, value=3}, PduRLockRef=PduRLock_PduRExclusiveArea if post-build-variant-condition{matching-criterion=RDR_POS, value=2}, PduRLockRef=PduRLock_PduRExclusiveArea if post-build-variant-condition{matching-criterion=RDR_POS, value=5}
            SR2_DIAG_RES_PHY_OBD1_oVCAN_RADAR_e30acad9_Tx (PduRDestPdu):
              PduRDestPduHandleId = 194
              PduRDestPduDirection = TRANSMIT if post-build-variant-condition{matching-criterion=RDR_POS, value=5}
              PduRDestPduDirection = TRANSMIT if post-build-variant-condition{matching-criterion=RDR_POS, value=1}
              PduRDestPduDirection = TRANSMIT if post-build-variant-condition{matching-criterion=RDR_POS, value=3}
              PduRDestPduDirection = TRANSMIT if post-build-variant-condition{matching-criterion=RDR_POS, value=0}
              PduRDestPduDirection = TRANSMIT if post-build-variant-condition{matching-criterion=RDR_POS, value=7}
              PduRDestPduDirection = TRANSMIT if post-build-variant-condition{matching-criterion=RDR_POS, value=2}
              PduRDestPduDirection = TRANSMIT if post-build-variant-condition{matching-criterion=RDR_POS, value=4}
              PduRDestPduDirection = TRANSMIT if post-build-variant-condition{matching-criterion=RDR_POS, value=6}
              PduRDestPduRoutingType = GATEWAY_ROUTING if post-build-variant-condition{matching-criterion=RDR_POS, value=7}
              PduRDestPduRoutingType = GATEWAY_ROUTING if post-build-variant-condition{matching-criterion=RDR_POS, value=0}
              PduRDestPduRoutingType = GATEWAY_ROUTING if post-build-variant-condition{matching-criterion=RDR_POS, value=6}
              PduRDestPduRoutingType = GATEWAY_ROUTING if post-build-variant-condition{matching-criterion=RDR_POS, value=4}
              PduRDestPduRoutingType = GATEWAY_ROUTING if post-build-variant-condition{matching-criterion=RDR_POS, value=1}
              PduRDestPduRoutingType = GATEWAY_ROUTING if post-build-variant-condition{matching-criterion=RDR_POS, value=3}
              PduRDestPduRoutingType = GATEWAY_ROUTING if post-build-variant-condition{matching-criterion=RDR_POS, value=2}
              PduRDestPduRoutingType = GATEWAY_ROUTING if post-build-variant-condition{matching-criterion=RDR_POS, value=5}
              PduRDestPduDataProcessing = IMMEDIATE
              PduRPduLengthHandlingStrategy = IGNORE
              PduRDestPduCrossPartitionDestination = false
              PduRDestPduDataProvision = PDUR_DIRECT
              PduRTransmissionConfirmation = false
              PduRDestPduRef = SR2_DIAG_RES_PHY_OBD1_oVCAN_RADAR_e30acad9_Tx
              PduRDestPduPduRBswModulesRef = CanIf if post-build-variant-condition{matching-criterion=RDR_POS, value=1}
              PduRDestPduPduRBswModulesRef = CanIf if post-build-variant-condition{matching-criterion=RDR_POS, value=7}
              PduRDestPduPduRBswModulesRef = CanIf if post-build-variant-condition{matching-criterion=RDR_POS, value=4}
              PduRDestPduPduRBswModulesRef = CanIf if post-build-variant-condition{matching-criterion=RDR_POS, value=5}
              PduRDestPduPduRBswModulesRef = CanIf if post-build-variant-condition{matching-criterion=RDR_POS, value=0}
              PduRDestPduPduRBswModulesRef = CanIf if post-build-variant-condition{matching-criterion=RDR_POS, value=6}
              PduRDestPduPduRBswModulesRef = CanIf if post-build-variant-condition{matching-criterion=RDR_POS, value=3}
              PduRDestPduPduRBswModulesRef = CanIf if post-build-variant-condition{matching-criterion=RDR_POS, value=2}
            PduRSrcPdu_3a10829e_001 (PduRSrcPdu):
              PduRSourcePduHandleId = 77
              PduRSrcPduDirection = RECEIVE if post-build-variant-condition{matching-criterion=RDR_POS, value=7}
              PduRSrcPduDirection = RECEIVE if post-build-variant-condition{matching-criterion=RDR_POS, value=0}
              PduRSrcPduDirection = RECEIVE if post-build-variant-condition{matching-criterion=RDR_POS, value=6}
              PduRSrcPduDirection = RECEIVE if post-build-variant-condition{matching-criterion=RDR_POS, value=4}
              PduRSrcPduDirection = RECEIVE if post-build-variant-condition{matching-criterion=RDR_POS, value=1}
              PduRSrcPduDirection = RECEIVE if post-build-variant-condition{matching-criterion=RDR_POS, value=3}
              PduRSrcPduDirection = RECEIVE if post-build-variant-condition{matching-criterion=RDR_POS, value=2}
              PduRSrcPduDirection = RECEIVE if post-build-variant-condition{matching-criterion=RDR_POS, value=5}
              PduRSrcPduRef = SRR_RL_DIAG_RESP_PHYS_OBD1_Rx_oPCAN_RADAR_290c372e_Rx
              PduRSrcPduPduRBswModulesRef = CanIf if post-build-variant-condition{matching-criterion=RDR_POS, value=3}
              PduRSrcPduPduRBswModulesRef = CanIf if post-build-variant-condition{matching-criterion=RDR_POS, value=5}
              PduRSrcPduPduRBswModulesRef = CanIf if post-build-variant-condition{matching-criterion=RDR_POS, value=4}
              PduRSrcPduPduRBswModulesRef = CanIf if post-build-variant-condition{matching-criterion=RDR_POS, value=2}
              PduRSrcPduPduRBswModulesRef = CanIf if post-build-variant-condition{matching-criterion=RDR_POS, value=6}
              PduRSrcPduPduRBswModulesRef = CanIf if post-build-variant-condition{matching-criterion=RDR_POS, value=7}
              PduRSrcPduPduRBswModulesRef = CanIf if post-build-variant-condition{matching-criterion=RDR_POS, value=1}
              PduRSrcPduPduRBswModulesRef = CanIf if post-build-variant-condition{matching-criterion=RDR_POS, value=0}
          PCAN_DIAG_REQ_FUNC_OBD2_oPCAN_RADAR_e2bd2c08_Rx: PduRRoutingPathCommunicationType=TRANSPORT_PROTOCOL if post-build-variant-condition{matching-criterion=RDR_POS, value=1}, PduRRoutingPathCommunicationType=TRANSPORT_PROTOCOL if post-build-variant-condition{matching-criterion=RDR_POS, value=3}, PduRRoutingPathCommunicationType=TRANSPORT_PROTOCOL if post-build-variant-condition{matching-criterion=RDR_POS, value=0}, PduRRoutingPathCommunicationType=TRANSPORT_PROTOCOL if post-build-variant-condition{matching-criterion=RDR_POS, value=7}, PduRRoutingPathCommunicationType=TRANSPORT_PROTOCOL if post-build-variant-condition{matching-criterion=RDR_POS, value=5}, PduRRoutingPathCommunicationType=TRANSPORT_PROTOCOL if post-build-variant-condition{matching-criterion=RDR_POS, value=2}, PduRRoutingPathCommunicationType=TRANSPORT_PROTOCOL if post-build-variant-condition{matching-criterion=RDR_POS, value=4}, PduRRoutingPathCommunicationType=TRANSPORT_PROTOCOL if post-build-variant-condition{matching-criterion=RDR_POS, value=6}, PduRLockRef=PduRLock_PduRExclusiveArea if post-build-variant-condition{matching-criterion=RDR_POS, value=6}, PduRLockRef=PduRLock_PduRExclusiveArea if post-build-variant-condition{matching-criterion=RDR_POS, value=1}, PduRLockRef=PduRLock_PduRExclusiveArea if post-build-variant-condition{matching-criterion=RDR_POS, value=3}, PduRLockRef=PduRLock_PduRExclusiveArea if post-build-variant-condition{matching-criterion=RDR_POS, value=0}, PduRLockRef=PduRLock_PduRExclusiveArea if post-build-variant-condition{matching-criterion=RDR_POS, value=7}, PduRLockRef=PduRLock_PduRExclusiveArea if post-build-variant-condition{matching-criterion=RDR_POS, value=5}, PduRLockRef=PduRLock_PduRExclusiveArea if post-build-variant-condition{matching-criterion=RDR_POS, value=2}, PduRLockRef=PduRLock_PduRExclusiveArea if post-build-variant-condition{matching-criterion=RDR_POS, value=4}
            PCAN_DIAG_REQ_FUNC_OBD2_oPCAN_RADAR_e2bd2c08_Rx_dab59121_Rx (PduRDestPdu):
              PduRDestPduHandleId = 11
              PduRDestPduDirection = RECEIVE if post-build-variant-condition{matching-criterion=RDR_POS, value=2}
              PduRDestPduDirection = RECEIVE if post-build-variant-condition{matching-criterion=RDR_POS, value=1}
              PduRDestPduDirection = RECEIVE if post-build-variant-condition{matching-criterion=RDR_POS, value=3}
              PduRDestPduDirection = RECEIVE if post-build-variant-condition{matching-criterion=RDR_POS, value=0}
              PduRDestPduDirection = RECEIVE if post-build-variant-condition{matching-criterion=RDR_POS, value=5}
              PduRDestPduDirection = RECEIVE if post-build-variant-condition{matching-criterion=RDR_POS, value=7}
              PduRDestPduDirection = RECEIVE if post-build-variant-condition{matching-criterion=RDR_POS, value=4}
              PduRDestPduDirection = RECEIVE if post-build-variant-condition{matching-criterion=RDR_POS, value=6}
              PduRDestPduRoutingType = API_FORWARDING if post-build-variant-condition{matching-criterion=RDR_POS, value=0}
              PduRDestPduRoutingType = API_FORWARDING if post-build-variant-condition{matching-criterion=RDR_POS, value=1}
              PduRDestPduRoutingType = API_FORWARDING if post-build-variant-condition{matching-criterion=RDR_POS, value=3}
              PduRDestPduRoutingType = API_FORWARDING if post-build-variant-condition{matching-criterion=RDR_POS, value=7}
              PduRDestPduRoutingType = API_FORWARDING if post-build-variant-condition{matching-criterion=RDR_POS, value=5}
              PduRDestPduRoutingType = API_FORWARDING if post-build-variant-condition{matching-criterion=RDR_POS, value=2}
              PduRDestPduRoutingType = API_FORWARDING if post-build-variant-condition{matching-criterion=RDR_POS, value=4}
              PduRDestPduRoutingType = API_FORWARDING if post-build-variant-condition{matching-criterion=RDR_POS, value=6}
              PduRDestPduDataProcessing = IMMEDIATE
              PduRPduLengthHandlingStrategy = UNUSED
              PduRDestPduCrossPartitionDestination = false
              PduRDestPduRef = PCAN_DIAG_REQ_FUNC_OBD2_oPCAN_RADAR_ebaed123_Rx
              PduRDestPduPduRBswModulesRef = Dcm if post-build-variant-condition{matching-criterion=RDR_POS, value=3}
              PduRDestPduPduRBswModulesRef = Dcm if post-build-variant-condition{matching-criterion=RDR_POS, value=0}
              PduRDestPduPduRBswModulesRef = Dcm if post-build-variant-condition{matching-criterion=RDR_POS, value=1}
              PduRDestPduPduRBswModulesRef = Dcm if post-build-variant-condition{matching-criterion=RDR_POS, value=5}
              PduRDestPduPduRBswModulesRef = Dcm if post-build-variant-condition{matching-criterion=RDR_POS, value=4}
              PduRDestPduPduRBswModulesRef = Dcm if post-build-variant-condition{matching-criterion=RDR_POS, value=6}
              PduRDestPduPduRBswModulesRef = Dcm if post-build-variant-condition{matching-criterion=RDR_POS, value=7}
              PduRDestPduPduRBswModulesRef = Dcm if post-build-variant-condition{matching-criterion=RDR_POS, value=2}
            PduRSrcPdu_dab59121 (PduRSrcPdu):
              PduRSourcePduHandleId = 11
              PduRSrcPduDirection = RECEIVE if post-build-variant-condition{matching-criterion=RDR_POS, value=2}
              PduRSrcPduDirection = RECEIVE if post-build-variant-condition{matching-criterion=RDR_POS, value=1}
              PduRSrcPduDirection = RECEIVE if post-build-variant-condition{matching-criterion=RDR_POS, value=3}
              PduRSrcPduDirection = RECEIVE if post-build-variant-condition{matching-criterion=RDR_POS, value=0}
              PduRSrcPduDirection = RECEIVE if post-build-variant-condition{matching-criterion=RDR_POS, value=5}
              PduRSrcPduDirection = RECEIVE if post-build-variant-condition{matching-criterion=RDR_POS, value=7}
              PduRSrcPduDirection = RECEIVE if post-build-variant-condition{matching-criterion=RDR_POS, value=4}
              PduRSrcPduDirection = RECEIVE if post-build-variant-condition{matching-criterion=RDR_POS, value=6}
              PduRSrcPduRef = PCAN_DIAG_REQ_FUNC_OBD2_oPCAN_RADAR_e2bd2c08_Rx
              PduRSrcPduPduRBswModulesRef = CanTp if post-build-variant-condition{matching-criterion=RDR_POS, value=1}
              PduRSrcPduPduRBswModulesRef = CanTp if post-build-variant-condition{matching-criterion=RDR_POS, value=6}
              PduRSrcPduPduRBswModulesRef = CanTp if post-build-variant-condition{matching-criterion=RDR_POS, value=5}
              PduRSrcPduPduRBswModulesRef = CanTp if post-build-variant-condition{matching-criterion=RDR_POS, value=3}
              PduRSrcPduPduRBswModulesRef = CanTp if post-build-variant-condition{matching-criterion=RDR_POS, value=7}
              PduRSrcPduPduRBswModulesRef = CanTp if post-build-variant-condition{matching-criterion=RDR_POS, value=2}
              PduRSrcPduPduRBswModulesRef = CanTp if post-build-variant-condition{matching-criterion=RDR_POS, value=4}
              PduRSrcPduPduRBswModulesRef = CanTp if post-build-variant-condition{matching-criterion=RDR_POS, value=0}
          PCAN_DIAG_REQ_FUNC_PLANT_oPCAN_RADAR_f6414098_Rx: PduRRoutingPathCommunicationType=TRANSPORT_PROTOCOL if post-build-variant-condition{matching-criterion=RDR_POS, value=7}, PduRRoutingPathCommunicationType=TRANSPORT_PROTOCOL if post-build-variant-condition{matching-criterion=RDR_POS, value=1}, PduRRoutingPathCommunicationType=TRANSPORT_PROTOCOL if post-build-variant-condition{matching-criterion=RDR_POS, value=3}, PduRRoutingPathCommunicationType=TRANSPORT_PROTOCOL if post-build-variant-condition{matching-criterion=RDR_POS, value=0}, PduRRoutingPathCommunicationType=TRANSPORT_PROTOCOL if post-build-variant-condition{matching-criterion=RDR_POS, value=5}, PduRRoutingPathCommunicationType=TRANSPORT_PROTOCOL if post-build-variant-condition{matching-criterion=RDR_POS, value=2}, PduRRoutingPathCommunicationType=TRANSPORT_PROTOCOL if post-build-variant-condition{matching-criterion=RDR_POS, value=4}, PduRRoutingPathCommunicationType=TRANSPORT_PROTOCOL if post-build-variant-condition{matching-criterion=RDR_POS, value=6}, PduRLockRef=PduRLock_PduRExclusiveArea if post-build-variant-condition{matching-criterion=RDR_POS, value=6}, PduRLockRef=PduRLock_PduRExclusiveArea if post-build-variant-condition{matching-criterion=RDR_POS, value=1}, PduRLockRef=PduRLock_PduRExclusiveArea if post-build-variant-condition{matching-criterion=RDR_POS, value=3}, PduRLockRef=PduRLock_PduRExclusiveArea if post-build-variant-condition{matching-criterion=RDR_POS, value=0}, PduRLockRef=PduRLock_PduRExclusiveArea if post-build-variant-condition{matching-criterion=RDR_POS, value=7}, PduRLockRef=PduRLock_PduRExclusiveArea if post-build-variant-condition{matching-criterion=RDR_POS, value=5}, PduRLockRef=PduRLock_PduRExclusiveArea if post-build-variant-condition{matching-criterion=RDR_POS, value=2}, PduRLockRef=PduRLock_PduRExclusiveArea if post-build-variant-condition{matching-criterion=RDR_POS, value=4}
            PCAN_DIAG_REQ_FUNC_PLANT_oPCAN_RADAR_f6414098_Rx_61d1e2e6_Rx (PduRDestPdu):
              PduRDestPduHandleId = 14
              PduRDestPduDirection = RECEIVE if post-build-variant-condition{matching-criterion=RDR_POS, value=5}
              PduRDestPduDirection = RECEIVE if post-build-variant-condition{matching-criterion=RDR_POS, value=1}
              PduRDestPduDirection = RECEIVE if post-build-variant-condition{matching-criterion=RDR_POS, value=3}
              PduRDestPduDirection = RECEIVE if post-build-variant-condition{matching-criterion=RDR_POS, value=0}
              PduRDestPduDirection = RECEIVE if post-build-variant-condition{matching-criterion=RDR_POS, value=7}
              PduRDestPduDirection = RECEIVE if post-build-variant-condition{matching-criterion=RDR_POS, value=2}
              PduRDestPduDirection = RECEIVE if post-build-variant-condition{matching-criterion=RDR_POS, value=4}
              PduRDestPduDirection = RECEIVE if post-build-variant-condition{matching-criterion=RDR_POS, value=6}
              PduRDestPduRoutingType = API_FORWARDING if post-build-variant-condition{matching-criterion=RDR_POS, value=6}
              PduRDestPduRoutingType = API_FORWARDING if post-build-variant-condition{matching-criterion=RDR_POS, value=1}
              PduRDestPduRoutingType = API_FORWARDING if post-build-variant-condition{matching-criterion=RDR_POS, value=3}
              PduRDestPduRoutingType = API_FORWARDING if post-build-variant-condition{matching-criterion=RDR_POS, value=0}
              PduRDestPduRoutingType = API_FORWARDING if post-build-variant-condition{matching-criterion=RDR_POS, value=7}
              PduRDestPduRoutingType = API_FORWARDING if post-build-variant-condition{matching-criterion=RDR_POS, value=5}
              PduRDestPduRoutingType = API_FORWARDING if post-build-variant-condition{matching-criterion=RDR_POS, value=2}
              PduRDestPduRoutingType = API_FORWARDING if post-build-variant-condition{matching-criterion=RDR_POS, value=4}
              PduRDestPduDataProcessing = IMMEDIATE
              PduRPduLengthHandlingStrategy = UNUSED
              PduRDestPduCrossPartitionDestination = false
              PduRDestPduRef = PCAN_DIAG_REQ_FUNC_PLANT_oPCAN_RADAR_8e17ec17_Rx
              PduRDestPduPduRBswModulesRef = Dcm if post-build-variant-condition{matching-criterion=RDR_POS, value=1}
              PduRDestPduPduRBswModulesRef = Dcm if post-build-variant-condition{matching-criterion=RDR_POS, value=3}
              PduRDestPduPduRBswModulesRef = Dcm if post-build-variant-condition{matching-criterion=RDR_POS, value=2}
              PduRDestPduPduRBswModulesRef = Dcm if post-build-variant-condition{matching-criterion=RDR_POS, value=4}
              PduRDestPduPduRBswModulesRef = Dcm if post-build-variant-condition{matching-criterion=RDR_POS, value=0}
              PduRDestPduPduRBswModulesRef = Dcm if post-build-variant-condition{matching-criterion=RDR_POS, value=6}
              PduRDestPduPduRBswModulesRef = Dcm if post-build-variant-condition{matching-criterion=RDR_POS, value=7}
              PduRDestPduPduRBswModulesRef = Dcm if post-build-variant-condition{matching-criterion=RDR_POS, value=5}
            PduRSrcPdu_61d1e2e6 (PduRSrcPdu):
              PduRSourcePduHandleId = 15
              PduRSrcPduDirection = RECEIVE if post-build-variant-condition{matching-criterion=RDR_POS, value=5}
              PduRSrcPduDirection = RECEIVE if post-build-variant-condition{matching-criterion=RDR_POS, value=1}
              PduRSrcPduDirection = RECEIVE if post-build-variant-condition{matching-criterion=RDR_POS, value=3}
              PduRSrcPduDirection = RECEIVE if post-build-variant-condition{matching-criterion=RDR_POS, value=0}
              PduRSrcPduDirection = RECEIVE if post-build-variant-condition{matching-criterion=RDR_POS, value=7}
              PduRSrcPduDirection = RECEIVE if post-build-variant-condition{matching-criterion=RDR_POS, value=2}
              PduRSrcPduDirection = RECEIVE if post-build-variant-condition{matching-criterion=RDR_POS, value=4}
              PduRSrcPduDirection = RECEIVE if post-build-variant-condition{matching-criterion=RDR_POS, value=6}
              PduRSrcPduRef = PCAN_DIAG_REQ_FUNC_PLANT_oPCAN_RADAR_f6414098_Rx
              PduRSrcPduPduRBswModulesRef = CanTp if post-build-variant-condition{matching-criterion=RDR_POS, value=2}
              PduRSrcPduPduRBswModulesRef = CanTp if post-build-variant-condition{matching-criterion=RDR_POS, value=1}
              PduRSrcPduPduRBswModulesRef = CanTp if post-build-variant-condition{matching-criterion=RDR_POS, value=0}
              PduRSrcPduPduRBswModulesRef = CanTp if post-build-variant-condition{matching-criterion=RDR_POS, value=7}
              PduRSrcPduPduRBswModulesRef = CanTp if post-build-variant-condition{matching-criterion=RDR_POS, value=3}
              PduRSrcPduPduRBswModulesRef = CanTp if post-build-variant-condition{matching-criterion=RDR_POS, value=6}
              PduRSrcPduPduRBswModulesRef = CanTp if post-build-variant-condition{matching-criterion=RDR_POS, value=4}
              PduRSrcPduPduRBswModulesRef = CanTp if post-build-variant-condition{matching-criterion=RDR_POS, value=5}
          PCAN_DIAG_REQ_PHYS_OBD2_oPCAN_RADAR_e03546e9_Rx: PduRRoutingPathCommunicationType=TRANSPORT_PROTOCOL if post-build-variant-condition{matching-criterion=RDR_POS, value=2}, PduRRoutingPathCommunicationType=TRANSPORT_PROTOCOL if post-build-variant-condition{matching-criterion=RDR_POS, value=1}, PduRRoutingPathCommunicationType=TRANSPORT_PROTOCOL if post-build-variant-condition{matching-criterion=RDR_POS, value=3}, PduRRoutingPathCommunicationType=TRANSPORT_PROTOCOL if post-build-variant-condition{matching-criterion=RDR_POS, value=0}, PduRRoutingPathCommunicationType=TRANSPORT_PROTOCOL if post-build-variant-condition{matching-criterion=RDR_POS, value=5}, PduRRoutingPathCommunicationType=TRANSPORT_PROTOCOL if post-build-variant-condition{matching-criterion=RDR_POS, value=7}, PduRRoutingPathCommunicationType=TRANSPORT_PROTOCOL if post-build-variant-condition{matching-criterion=RDR_POS, value=4}, PduRRoutingPathCommunicationType=TRANSPORT_PROTOCOL if post-build-variant-condition{matching-criterion=RDR_POS, value=6}, PduRLockRef=PduRLock_PduRExclusiveArea if post-build-variant-condition{matching-criterion=RDR_POS, value=6}, PduRLockRef=PduRLock_PduRExclusiveArea if post-build-variant-condition{matching-criterion=RDR_POS, value=1}, PduRLockRef=PduRLock_PduRExclusiveArea if post-build-variant-condition{matching-criterion=RDR_POS, value=3}, PduRLockRef=PduRLock_PduRExclusiveArea if post-build-variant-condition{matching-criterion=RDR_POS, value=0}, PduRLockRef=PduRLock_PduRExclusiveArea if post-build-variant-condition{matching-criterion=RDR_POS, value=7}, PduRLockRef=PduRLock_PduRExclusiveArea if post-build-variant-condition{matching-criterion=RDR_POS, value=5}, PduRLockRef=PduRLock_PduRExclusiveArea if post-build-variant-condition{matching-criterion=RDR_POS, value=2}, PduRLockRef=PduRLock_PduRExclusiveArea if post-build-variant-condition{matching-criterion=RDR_POS, value=4}
            PCAN_DIAG_REQ_PHYS_OBD2_oPCAN_RADAR_e03546e9_Rx_f2e56351_Rx (PduRDestPdu):
              PduRDestPduHandleId = 19
              PduRDestPduDirection = RECEIVE if post-build-variant-condition{matching-criterion=RDR_POS, value=5}
              PduRDestPduDirection = RECEIVE if post-build-variant-condition{matching-criterion=RDR_POS, value=1}
              PduRDestPduDirection = RECEIVE if post-build-variant-condition{matching-criterion=RDR_POS, value=3}
              PduRDestPduDirection = RECEIVE if post-build-variant-condition{matching-criterion=RDR_POS, value=0}
              PduRDestPduDirection = RECEIVE if post-build-variant-condition{matching-criterion=RDR_POS, value=7}
              PduRDestPduDirection = RECEIVE if post-build-variant-condition{matching-criterion=RDR_POS, value=2}
              PduRDestPduDirection = RECEIVE if post-build-variant-condition{matching-criterion=RDR_POS, value=4}
              PduRDestPduDirection = RECEIVE if post-build-variant-condition{matching-criterion=RDR_POS, value=6}
              PduRDestPduRoutingType = API_FORWARDING if post-build-variant-condition{matching-criterion=RDR_POS, value=1}
              PduRDestPduRoutingType = API_FORWARDING if post-build-variant-condition{matching-criterion=RDR_POS, value=3}
              PduRDestPduRoutingType = API_FORWARDING if post-build-variant-condition{matching-criterion=RDR_POS, value=0}
              PduRDestPduRoutingType = API_FORWARDING if post-build-variant-condition{matching-criterion=RDR_POS, value=7}
              PduRDestPduRoutingType = API_FORWARDING if post-build-variant-condition{matching-criterion=RDR_POS, value=5}
              PduRDestPduRoutingType = API_FORWARDING if post-build-variant-condition{matching-criterion=RDR_POS, value=2}
              PduRDestPduRoutingType = API_FORWARDING if post-build-variant-condition{matching-criterion=RDR_POS, value=4}
              PduRDestPduRoutingType = API_FORWARDING if post-build-variant-condition{matching-criterion=RDR_POS, value=6}
              PduRDestPduDataProcessing = IMMEDIATE
              PduRPduLengthHandlingStrategy = UNUSED
              PduRDestPduCrossPartitionDestination = false
              PduRDestPduRef = PCAN_DIAG_REQ_PHYS_OBD2_oPCAN_RADAR_773f87d8_Rx
              PduRDestPduPduRBswModulesRef = Dcm if post-build-variant-condition{matching-criterion=RDR_POS, value=0}
              PduRDestPduPduRBswModulesRef = Dcm if post-build-variant-condition{matching-criterion=RDR_POS, value=1}
              PduRDestPduPduRBswModulesRef = Dcm if post-build-variant-condition{matching-criterion=RDR_POS, value=4}
              PduRDestPduPduRBswModulesRef = Dcm if post-build-variant-condition{matching-criterion=RDR_POS, value=2}
              PduRDestPduPduRBswModulesRef = Dcm if post-build-variant-condition{matching-criterion=RDR_POS, value={5..7}}
              PduRDestPduPduRBswModulesRef = Dcm if post-build-variant-condition{matching-criterion=RDR_POS, value=3}
            PduRSrcPdu_f2e56351 (PduRSrcPdu):
              PduRSourcePduHandleId = 19
              PduRSrcPduDirection = RECEIVE if post-build-variant-condition{matching-criterion=RDR_POS, value=2}
              PduRSrcPduDirection = RECEIVE if post-build-variant-condition{matching-criterion=RDR_POS, value=1}
              PduRSrcPduDirection = RECEIVE if post-build-variant-condition{matching-criterion=RDR_POS, value=3}
              PduRSrcPduDirection = RECEIVE if post-build-variant-condition{matching-criterion=RDR_POS, value=0}
              PduRSrcPduDirection = RECEIVE if post-build-variant-condition{matching-criterion=RDR_POS, value=5}
              PduRSrcPduDirection = RECEIVE if post-build-variant-condition{matching-criterion=RDR_POS, value=7}
              PduRSrcPduDirection = RECEIVE if post-build-variant-condition{matching-criterion=RDR_POS, value=4}
              PduRSrcPduDirection = RECEIVE if post-build-variant-condition{matching-criterion=RDR_POS, value=6}
              PduRSrcPduRef = PCAN_DIAG_REQ_PHYS_OBD2_oPCAN_RADAR_e03546e9_Rx
              PduRSrcPduPduRBswModulesRef = CanTp if post-build-variant-condition{matching-criterion=RDR_POS, value=0}
              PduRSrcPduPduRBswModulesRef = CanTp if post-build-variant-condition{matching-criterion=RDR_POS, value=6}
              PduRSrcPduPduRBswModulesRef = CanTp if post-build-variant-condition{matching-criterion=RDR_POS, value=7}
              PduRSrcPduPduRBswModulesRef = CanTp if post-build-variant-condition{matching-criterion=RDR_POS, value=1}
              PduRSrcPduPduRBswModulesRef = CanTp if post-build-variant-condition{matching-criterion=RDR_POS, value=4}
              PduRSrcPduPduRBswModulesRef = CanTp if post-build-variant-condition{matching-criterion=RDR_POS, value=5}
              PduRSrcPduPduRBswModulesRef = CanTp if post-build-variant-condition{matching-criterion=RDR_POS, value=2}
              PduRSrcPduPduRBswModulesRef = CanTp if post-build-variant-condition{matching-criterion=RDR_POS, value=3}
          PCAN_DIAG_REQ_FUNC_OTA_oPCAN_RADAR_20_e1100275_Rx: PduRRoutingPathCommunicationType=TRANSPORT_PROTOCOL if post-build-variant-condition{matching-criterion=RDR_POS, value=1}, PduRRoutingPathCommunicationType=TRANSPORT_PROTOCOL if post-build-variant-condition{matching-criterion=RDR_POS, value=3}, PduRRoutingPathCommunicationType=TRANSPORT_PROTOCOL if post-build-variant-condition{matching-criterion=RDR_POS, value=0}, PduRRoutingPathCommunicationType=TRANSPORT_PROTOCOL if post-build-variant-condition{matching-criterion=RDR_POS, value=7}, PduRRoutingPathCommunicationType=TRANSPORT_PROTOCOL if post-build-variant-condition{matching-criterion=RDR_POS, value=5}, PduRRoutingPathCommunicationType=TRANSPORT_PROTOCOL if post-build-variant-condition{matching-criterion=RDR_POS, value=2}, PduRRoutingPathCommunicationType=TRANSPORT_PROTOCOL if post-build-variant-condition{matching-criterion=RDR_POS, value=4}, PduRRoutingPathCommunicationType=TRANSPORT_PROTOCOL if post-build-variant-condition{matching-criterion=RDR_POS, value=6}, PduRLockRef=PduRLock_PduRExclusiveArea if post-build-variant-condition{matching-criterion=RDR_POS, value=6}, PduRLockRef=PduRLock_PduRExclusiveArea if post-build-variant-condition{matching-criterion=RDR_POS, value=1}, PduRLockRef=PduRLock_PduRExclusiveArea if post-build-variant-condition{matching-criterion=RDR_POS, value=3}, PduRLockRef=PduRLock_PduRExclusiveArea if post-build-variant-condition{matching-criterion=RDR_POS, value=0}, PduRLockRef=PduRLock_PduRExclusiveArea if post-build-variant-condition{matching-criterion=RDR_POS, value=7}, PduRLockRef=PduRLock_PduRExclusiveArea if post-build-variant-condition{matching-criterion=RDR_POS, value=5}, PduRLockRef=PduRLock_PduRExclusiveArea if post-build-variant-condition{matching-criterion=RDR_POS, value=2}, PduRLockRef=PduRLock_PduRExclusiveArea if post-build-variant-condition{matching-criterion=RDR_POS, value=4}
            PCAN_DIAG_REQ_FUNC_OTA_oPCAN_RADAR_20_e1100275_Rx_09f61e64_Rx (PduRDestPdu):
              PduRDestPduHandleId = 12
              PduRDestPduDirection = RECEIVE if post-build-variant-condition{matching-criterion=RDR_POS, value=3}
              PduRDestPduDirection = RECEIVE if post-build-variant-condition{matching-criterion=RDR_POS, value=1}
              PduRDestPduDirection = RECEIVE if post-build-variant-condition{matching-criterion=RDR_POS, value=0}
              PduRDestPduDirection = RECEIVE if post-build-variant-condition{matching-criterion=RDR_POS, value=7}
              PduRDestPduDirection = RECEIVE if post-build-variant-condition{matching-criterion=RDR_POS, value=5}
              PduRDestPduDirection = RECEIVE if post-build-variant-condition{matching-criterion=RDR_POS, value=2}
              PduRDestPduDirection = RECEIVE if post-build-variant-condition{matching-criterion=RDR_POS, value=4}
              PduRDestPduDirection = RECEIVE if post-build-variant-condition{matching-criterion=RDR_POS, value=6}
              PduRDestPduRoutingType = API_FORWARDING if post-build-variant-condition{matching-criterion=RDR_POS, value=5}
              PduRDestPduRoutingType = API_FORWARDING if post-build-variant-condition{matching-criterion=RDR_POS, value=1}
              PduRDestPduRoutingType = API_FORWARDING if post-build-variant-condition{matching-criterion=RDR_POS, value=3}
              PduRDestPduRoutingType = API_FORWARDING if post-build-variant-condition{matching-criterion=RDR_POS, value=0}
              PduRDestPduRoutingType = API_FORWARDING if post-build-variant-condition{matching-criterion=RDR_POS, value=7}
              PduRDestPduRoutingType = API_FORWARDING if post-build-variant-condition{matching-criterion=RDR_POS, value=2}
              PduRDestPduRoutingType = API_FORWARDING if post-build-variant-condition{matching-criterion=RDR_POS, value=4}
              PduRDestPduRoutingType = API_FORWARDING if post-build-variant-condition{matching-criterion=RDR_POS, value=6}
              PduRDestPduDataProcessing = IMMEDIATE
              PduRPduLengthHandlingStrategy = UNUSED
              PduRDestPduCrossPartitionDestination = false
              PduRDestPduRef = PCAN_DIAG_REQ_FUNC_OTA_oPCAN_RADAR_20_4ceedd9c_Rx
              PduRDestPduPduRBswModulesRef = Dcm if post-build-variant-condition{matching-criterion=RDR_POS, value=3}
              PduRDestPduPduRBswModulesRef = Dcm if post-build-variant-condition{matching-criterion=RDR_POS, value=4}
              PduRDestPduPduRBswModulesRef = Dcm if post-build-variant-condition{matching-criterion=RDR_POS, value=0}
              PduRDestPduPduRBswModulesRef = Dcm if post-build-variant-condition{matching-criterion=RDR_POS, value=5}
              PduRDestPduPduRBswModulesRef = Dcm if post-build-variant-condition{matching-criterion=RDR_POS, value=2}
              PduRDestPduPduRBswModulesRef = Dcm if post-build-variant-condition{matching-criterion=RDR_POS, value=6}
              PduRDestPduPduRBswModulesRef = Dcm if post-build-variant-condition{matching-criterion=RDR_POS, value=1}
              PduRDestPduPduRBswModulesRef = Dcm if post-build-variant-condition{matching-criterion=RDR_POS, value=7}
            PduRSrcPdu_09f61e64 (PduRSrcPdu):
              PduRSourcePduHandleId = 12
              PduRSrcPduDirection = RECEIVE if post-build-variant-condition{matching-criterion=RDR_POS, value=5}
              PduRSrcPduDirection = RECEIVE if post-build-variant-condition{matching-criterion=RDR_POS, value=1}
              PduRSrcPduDirection = RECEIVE if post-build-variant-condition{matching-criterion=RDR_POS, value=3}
              PduRSrcPduDirection = RECEIVE if post-build-variant-condition{matching-criterion=RDR_POS, value=0}
              PduRSrcPduDirection = RECEIVE if post-build-variant-condition{matching-criterion=RDR_POS, value=7}
              PduRSrcPduDirection = RECEIVE if post-build-variant-condition{matching-criterion=RDR_POS, value=2}
              PduRSrcPduDirection = RECEIVE if post-build-variant-condition{matching-criterion=RDR_POS, value=4}
              PduRSrcPduDirection = RECEIVE if post-build-variant-condition{matching-criterion=RDR_POS, value=6}
              PduRSrcPduRef = PCAN_DIAG_REQ_FUNC_OTA_oPCAN_RADAR_20_e1100275_Rx
              PduRSrcPduPduRBswModulesRef = CanTp if post-build-variant-condition{matching-criterion=RDR_POS, value=1}
              PduRSrcPduPduRBswModulesRef = CanTp if post-build-variant-condition{matching-criterion=RDR_POS, value=7}
              PduRSrcPduPduRBswModulesRef = CanTp if post-build-variant-condition{matching-criterion=RDR_POS, value=6}
              PduRSrcPduPduRBswModulesRef = CanTp if post-build-variant-condition{matching-criterion=RDR_POS, value=5}
              PduRSrcPduPduRBswModulesRef = CanTp if post-build-variant-condition{matching-criterion=RDR_POS, value=3}
              PduRSrcPduPduRBswModulesRef = CanTp if post-build-variant-condition{matching-criterion=RDR_POS, value=4}
              PduRSrcPduPduRBswModulesRef = CanTp if post-build-variant-condition{matching-criterion=RDR_POS, value=0}
              PduRSrcPduPduRBswModulesRef = CanTp if post-build-variant-condition{matching-criterion=RDR_POS, value=2}
          FR_DIAG_REQ_PHY_PLANT_oVCAN_RADAR_d1c8c991_Rx: PduRRoutingPathCommunicationType=TRANSPORT_PROTOCOL if post-build-variant-condition{matching-criterion=RDR_POS, value=3}, PduRRoutingPathCommunicationType=TRANSPORT_PROTOCOL if post-build-variant-condition{matching-criterion=RDR_POS, value=1}, PduRRoutingPathCommunicationType=TRANSPORT_PROTOCOL if post-build-variant-condition{matching-criterion=RDR_POS, value=0}, PduRRoutingPathCommunicationType=TRANSPORT_PROTOCOL if post-build-variant-condition{matching-criterion=RDR_POS, value=7}, PduRRoutingPathCommunicationType=TRANSPORT_PROTOCOL if post-build-variant-condition{matching-criterion=RDR_POS, value=5}, PduRRoutingPathCommunicationType=TRANSPORT_PROTOCOL if post-build-variant-condition{matching-criterion=RDR_POS, value=2}, PduRRoutingPathCommunicationType=TRANSPORT_PROTOCOL if post-build-variant-condition{matching-criterion=RDR_POS, value=4}, PduRRoutingPathCommunicationType=TRANSPORT_PROTOCOL if post-build-variant-condition{matching-criterion=RDR_POS, value=6}, PduRLockRef=PduRLock_PduRExclusiveArea if post-build-variant-condition{matching-criterion=RDR_POS, value=6}, PduRLockRef=PduRLock_PduRExclusiveArea if post-build-variant-condition{matching-criterion=RDR_POS, value=1}, PduRLockRef=PduRLock_PduRExclusiveArea if post-build-variant-condition{matching-criterion=RDR_POS, value=3}, PduRLockRef=PduRLock_PduRExclusiveArea if post-build-variant-condition{matching-criterion=RDR_POS, value=0}, PduRLockRef=PduRLock_PduRExclusiveArea if post-build-variant-condition{matching-criterion=RDR_POS, value=7}, PduRLockRef=PduRLock_PduRExclusiveArea if post-build-variant-condition{matching-criterion=RDR_POS, value=5}, PduRLockRef=PduRLock_PduRExclusiveArea if post-build-variant-condition{matching-criterion=RDR_POS, value=2}, PduRLockRef=PduRLock_PduRExclusiveArea if post-build-variant-condition{matching-criterion=RDR_POS, value=4}
            PduRSrcPdu_199df235 (PduRSrcPdu):
              PduRSourcePduHandleId = 7
              PduRSrcPduDirection = RECEIVE if post-build-variant-condition{matching-criterion=RDR_POS, value=5}
              PduRSrcPduDirection = RECEIVE if post-build-variant-condition{matching-criterion=RDR_POS, value=1}
              PduRSrcPduDirection = RECEIVE if post-build-variant-condition{matching-criterion=RDR_POS, value=3}
              PduRSrcPduDirection = RECEIVE if post-build-variant-condition{matching-criterion=RDR_POS, value=0}
              PduRSrcPduDirection = RECEIVE if post-build-variant-condition{matching-criterion=RDR_POS, value=7}
              PduRSrcPduDirection = RECEIVE if post-build-variant-condition{matching-criterion=RDR_POS, value=2}
              PduRSrcPduDirection = RECEIVE if post-build-variant-condition{matching-criterion=RDR_POS, value=4}
              PduRSrcPduDirection = RECEIVE if post-build-variant-condition{matching-criterion=RDR_POS, value=6}
              PduRSrcPduRef = FR_DIAG_REQ_PHY_PLANT_oVCAN_RADAR_d1c8c991_Rx
              PduRSrcPduPduRBswModulesRef = CanTp if post-build-variant-condition{matching-criterion=RDR_POS, value=7}
              PduRSrcPduPduRBswModulesRef = CanTp if post-build-variant-condition{matching-criterion=RDR_POS, value=0}
              PduRSrcPduPduRBswModulesRef = CanTp if post-build-variant-condition{matching-criterion=RDR_POS, value=6}
              PduRSrcPduPduRBswModulesRef = CanTp if post-build-variant-condition{matching-criterion=RDR_POS, value=5}
              PduRSrcPduPduRBswModulesRef = CanTp if post-build-variant-condition{matching-criterion=RDR_POS, value=1}
              PduRSrcPduPduRBswModulesRef = CanTp if post-build-variant-condition{matching-criterion=RDR_POS, value=3}
              PduRSrcPduPduRBswModulesRef = CanTp if post-build-variant-condition{matching-criterion=RDR_POS, value=2}
              PduRSrcPduPduRBswModulesRef = CanTp if post-build-variant-condition{matching-criterion=RDR_POS, value=4}
            FR_DIAG_REQ_PHY_PLANT_oVCAN_RADAR_d1c8c991_Rx_199df235_Rx (PduRDestPdu):
              PduRDestPduHandleId = 7
              PduRDestPduDirection = RECEIVE if post-build-variant-condition{matching-criterion=RDR_POS, value=3}
              PduRDestPduDirection = RECEIVE if post-build-variant-condition{matching-criterion=RDR_POS, value=1}
              PduRDestPduDirection = RECEIVE if post-build-variant-condition{matching-criterion=RDR_POS, value=0}
              PduRDestPduDirection = RECEIVE if post-build-variant-condition{matching-criterion=RDR_POS, value=7}
              PduRDestPduDirection = RECEIVE if post-build-variant-condition{matching-criterion=RDR_POS, value=5}
              PduRDestPduDirection = RECEIVE if post-build-variant-condition{matching-criterion=RDR_POS, value=2}
              PduRDestPduDirection = RECEIVE if post-build-variant-condition{matching-criterion=RDR_POS, value=4}
              PduRDestPduDirection = RECEIVE if post-build-variant-condition{matching-criterion=RDR_POS, value=6}
              PduRDestPduRoutingType = API_FORWARDING if post-build-variant-condition{matching-criterion=RDR_POS, value=6}
              PduRDestPduRoutingType = API_FORWARDING if post-build-variant-condition{matching-criterion=RDR_POS, value=1}
              PduRDestPduRoutingType = API_FORWARDING if post-build-variant-condition{matching-criterion=RDR_POS, value=3}
              PduRDestPduRoutingType = API_FORWARDING if post-build-variant-condition{matching-criterion=RDR_POS, value=0}
              PduRDestPduRoutingType = API_FORWARDING if post-build-variant-condition{matching-criterion=RDR_POS, value=7}
              PduRDestPduRoutingType = API_FORWARDING if post-build-variant-condition{matching-criterion=RDR_POS, value=5}
              PduRDestPduRoutingType = API_FORWARDING if post-build-variant-condition{matching-criterion=RDR_POS, value=2}
              PduRDestPduRoutingType = API_FORWARDING if post-build-variant-condition{matching-criterion=RDR_POS, value=4}
              PduRDestPduDataProcessing = IMMEDIATE
              PduRPduLengthHandlingStrategy = UNUSED
              PduRDestPduCrossPartitionDestination = false
              PduRDestPduRef = FR_DIAG_REQ_PHY_PLANT_oVCAN_RADAR_03b4032b_Rx
              PduRDestPduPduRBswModulesRef = Dcm if post-build-variant-condition{matching-criterion=RDR_POS, value=6}
              PduRDestPduPduRBswModulesRef = Dcm if post-build-variant-condition{matching-criterion=RDR_POS, value=0}
              PduRDestPduPduRBswModulesRef = Dcm if post-build-variant-condition{matching-criterion=RDR_POS, value=7}
              PduRDestPduPduRBswModulesRef = Dcm if post-build-variant-condition{matching-criterion=RDR_POS, value=4}
              PduRDestPduPduRBswModulesRef = Dcm if post-build-variant-condition{matching-criterion=RDR_POS, value=2}
              PduRDestPduPduRBswModulesRef = Dcm if post-build-variant-condition{matching-criterion=RDR_POS, value=3}
              PduRDestPduPduRBswModulesRef = Dcm if post-build-variant-condition{matching-criterion=RDR_POS, value=5}
              PduRDestPduPduRBswModulesRef = Dcm if post-build-variant-condition{matching-criterion=RDR_POS, value=1}
          PCAN_DIAG_REQ_PHYS_PLANT_oPCAN_RADAR_20_f7a3783e_Rx: PduRRoutingPathCommunicationType=TRANSPORT_PROTOCOL if post-build-variant-condition{matching-criterion=RDR_POS, value=5}, PduRRoutingPathCommunicationType=TRANSPORT_PROTOCOL if post-build-variant-condition{matching-criterion=RDR_POS, value=1}, PduRRoutingPathCommunicationType=TRANSPORT_PROTOCOL if post-build-variant-condition{matching-criterion=RDR_POS, value=3}, PduRRoutingPathCommunicationType=TRANSPORT_PROTOCOL if post-build-variant-condition{matching-criterion=RDR_POS, value=0}, PduRRoutingPathCommunicationType=TRANSPORT_PROTOCOL if post-build-variant-condition{matching-criterion=RDR_POS, value=7}, PduRRoutingPathCommunicationType=TRANSPORT_PROTOCOL if post-build-variant-condition{matching-criterion=RDR_POS, value=2}, PduRRoutingPathCommunicationType=TRANSPORT_PROTOCOL if post-build-variant-condition{matching-criterion=RDR_POS, value=4}, PduRRoutingPathCommunicationType=TRANSPORT_PROTOCOL if post-build-variant-condition{matching-criterion=RDR_POS, value=6}, PduRLockRef=PduRLock_PduRExclusiveArea if post-build-variant-condition{matching-criterion=RDR_POS, value=6}, PduRLockRef=PduRLock_PduRExclusiveArea if post-build-variant-condition{matching-criterion=RDR_POS, value=1}, PduRLockRef=PduRLock_PduRExclusiveArea if post-build-variant-condition{matching-criterion=RDR_POS, value=3}, PduRLockRef=PduRLock_PduRExclusiveArea if post-build-variant-condition{matching-criterion=RDR_POS, value=0}, PduRLockRef=PduRLock_PduRExclusiveArea if post-build-variant-condition{matching-criterion=RDR_POS, value=7}, PduRLockRef=PduRLock_PduRExclusiveArea if post-build-variant-condition{matching-criterion=RDR_POS, value=5}, PduRLockRef=PduRLock_PduRExclusiveArea if post-build-variant-condition{matching-criterion=RDR_POS, value=2}, PduRLockRef=PduRLock_PduRExclusiveArea if post-build-variant-condition{matching-criterion=RDR_POS, value=4}
            PduRSrcPdu_917a13f6 (PduRSrcPdu):
              PduRSourcePduHandleId = 22
              PduRSrcPduDirection = RECEIVE if post-build-variant-condition{matching-criterion=RDR_POS, value=1}
              PduRSrcPduDirection = RECEIVE if post-build-variant-condition{matching-criterion=RDR_POS, value=3}
              PduRSrcPduDirection = RECEIVE if post-build-variant-condition{matching-criterion=RDR_POS, value=0}
              PduRSrcPduDirection = RECEIVE if post-build-variant-condition{matching-criterion=RDR_POS, value=7}
              PduRSrcPduDirection = RECEIVE if post-build-variant-condition{matching-criterion=RDR_POS, value=5}
              PduRSrcPduDirection = RECEIVE if post-build-variant-condition{matching-criterion=RDR_POS, value=2}
              PduRSrcPduDirection = RECEIVE if post-build-variant-condition{matching-criterion=RDR_POS, value=4}
              PduRSrcPduDirection = RECEIVE if post-build-variant-condition{matching-criterion=RDR_POS, value=6}
              PduRSrcPduRef = PCAN_DIAG_REQ_PHYS_PLANT_oPCAN_RADAR_20_f7a3783e_Rx
              PduRSrcPduPduRBswModulesRef = CanTp if post-build-variant-condition{matching-criterion=RDR_POS, value=7}
              PduRSrcPduPduRBswModulesRef = CanTp if post-build-variant-condition{matching-criterion=RDR_POS, value=1}
              PduRSrcPduPduRBswModulesRef = CanTp if post-build-variant-condition{matching-criterion=RDR_POS, value=4}
              PduRSrcPduPduRBswModulesRef = CanTp if post-build-variant-condition{matching-criterion=RDR_POS, value=6}
              PduRSrcPduPduRBswModulesRef = CanTp if post-build-variant-condition{matching-criterion=RDR_POS, value=2}
              PduRSrcPduPduRBswModulesRef = CanTp if post-build-variant-condition{matching-criterion=RDR_POS, value=3}
              PduRSrcPduPduRBswModulesRef = CanTp if post-build-variant-condition{matching-criterion=RDR_POS, value=5}
              PduRSrcPduPduRBswModulesRef = CanTp if post-build-variant-condition{matching-criterion=RDR_POS, value=0}
            PCAN_DIAG_REQ_PHYS_PLANT_oPCAN_RADAR_20_f7a3783e_Rx_917a13f6_Rx (PduRDestPdu):
              PduRDestPduHandleId = 22
              PduRDestPduDirection = RECEIVE if post-build-variant-condition{matching-criterion=RDR_POS, value=2}
              PduRDestPduDirection = RECEIVE if post-build-variant-condition{matching-criterion=RDR_POS, value=1}
              PduRDestPduDirection = RECEIVE if post-build-variant-condition{matching-criterion=RDR_POS, value=3}
              PduRDestPduDirection = RECEIVE if post-build-variant-condition{matching-criterion=RDR_POS, value=0}
              PduRDestPduDirection = RECEIVE if post-build-variant-condition{matching-criterion=RDR_POS, value=5}
              PduRDestPduDirection = RECEIVE if post-build-variant-condition{matching-criterion=RDR_POS, value=7}
              PduRDestPduDirection = RECEIVE if post-build-variant-condition{matching-criterion=RDR_POS, value=4}
              PduRDestPduDirection = RECEIVE if post-build-variant-condition{matching-criterion=RDR_POS, value=6}
              PduRDestPduRoutingType = API_FORWARDING if post-build-variant-condition{matching-criterion=RDR_POS, value=0}
              PduRDestPduRoutingType = API_FORWARDING if post-build-variant-condition{matching-criterion=RDR_POS, value=1}
              PduRDestPduRoutingType = API_FORWARDING if post-build-variant-condition{matching-criterion=RDR_POS, value=3}
              PduRDestPduRoutingType = API_FORWARDING if post-build-variant-condition{matching-criterion=RDR_POS, value=7}
              PduRDestPduRoutingType = API_FORWARDING if post-build-variant-condition{matching-criterion=RDR_POS, value=5}
              PduRDestPduRoutingType = API_FORWARDING if post-build-variant-condition{matching-criterion=RDR_POS, value=2}
              PduRDestPduRoutingType = API_FORWARDING if post-build-variant-condition{matching-criterion=RDR_POS, value=4}
              PduRDestPduRoutingType = API_FORWARDING if post-build-variant-condition{matching-criterion=RDR_POS, value=6}
              PduRDestPduDataProcessing = IMMEDIATE
              PduRPduLengthHandlingStrategy = UNUSED
              PduRDestPduCrossPartitionDestination = false
              PduRDestPduRef = PCAN_DIAG_REQ_PHYS_PLANT_oPCAN_RADAR_20_93ccff8e_Rx
              PduRDestPduPduRBswModulesRef = Dcm if post-build-variant-condition{matching-criterion=RDR_POS, value=0}
              PduRDestPduPduRBswModulesRef = Dcm if post-build-variant-condition{matching-criterion=RDR_POS, value=4}
              PduRDestPduPduRBswModulesRef = Dcm if post-build-variant-condition{matching-criterion=RDR_POS, value=7}
              PduRDestPduPduRBswModulesRef = Dcm if post-build-variant-condition{matching-criterion=RDR_POS, value=1}
              PduRDestPduPduRBswModulesRef = Dcm if post-build-variant-condition{matching-criterion=RDR_POS, value=3}
              PduRDestPduPduRBswModulesRef = Dcm if post-build-variant-condition{matching-criterion=RDR_POS, value=6}
              PduRDestPduPduRBswModulesRef = Dcm if post-build-variant-condition{matching-criterion=RDR_POS, value=2}
              PduRDestPduPduRBswModulesRef = Dcm if post-build-variant-condition{matching-criterion=RDR_POS, value=5}
          SR1_DIAG_REQ_PHY_OBD1_oVCAN_RADAR_ff3ad7b0_Rx: PduRRoutingPathCommunicationType=COMMUNICATION_INTERFACE if post-build-variant-condition{matching-criterion=RDR_POS, value=2}, PduRRoutingPathCommunicationType=COMMUNICATION_INTERFACE if post-build-variant-condition{matching-criterion=RDR_POS, value=1}, PduRRoutingPathCommunicationType=COMMUNICATION_INTERFACE if post-build-variant-condition{matching-criterion=RDR_POS, value=3}, PduRRoutingPathCommunicationType=COMMUNICATION_INTERFACE if post-build-variant-condition{matching-criterion=RDR_POS, value=0}, PduRRoutingPathCommunicationType=COMMUNICATION_INTERFACE if post-build-variant-condition{matching-criterion=RDR_POS, value=5}, PduRRoutingPathCommunicationType=COMMUNICATION_INTERFACE if post-build-variant-condition{matching-criterion=RDR_POS, value=7}, PduRRoutingPathCommunicationType=COMMUNICATION_INTERFACE if post-build-variant-condition{matching-criterion=RDR_POS, value=4}, PduRRoutingPathCommunicationType=COMMUNICATION_INTERFACE if post-build-variant-condition{matching-criterion=RDR_POS, value=6}, PduRLockRef=PduRLock_PduRExclusiveArea if post-build-variant-condition{matching-criterion=RDR_POS, value=1}, PduRLockRef=PduRLock_PduRExclusiveArea if post-build-variant-condition{matching-criterion=RDR_POS, value=0}, PduRLockRef=PduRLock_PduRExclusiveArea if post-build-variant-condition{matching-criterion=RDR_POS, value=7}, PduRLockRef=PduRLock_PduRExclusiveArea if post-build-variant-condition{matching-criterion=RDR_POS, value=6}, PduRLockRef=PduRLock_PduRExclusiveArea if post-build-variant-condition{matching-criterion=RDR_POS, value=4}, PduRLockRef=PduRLock_PduRExclusiveArea if post-build-variant-condition{matching-criterion=RDR_POS, value=3}, PduRLockRef=PduRLock_PduRExclusiveArea if post-build-variant-condition{matching-criterion=RDR_POS, value=2}, PduRLockRef=PduRLock_PduRExclusiveArea if post-build-variant-condition{matching-criterion=RDR_POS, value=5}
            PduRSrcPdu_1fb17dd9 (PduRSrcPdu):
              PduRSourcePduHandleId = 65
              PduRSrcPduDirection = RECEIVE if post-build-variant-condition{matching-criterion=RDR_POS, value=0}
              PduRSrcPduDirection = RECEIVE if post-build-variant-condition{matching-criterion=RDR_POS, value=1}
              PduRSrcPduDirection = RECEIVE if post-build-variant-condition{matching-criterion=RDR_POS, value=3}
              PduRSrcPduDirection = RECEIVE if post-build-variant-condition{matching-criterion=RDR_POS, value=7}
              PduRSrcPduDirection = RECEIVE if post-build-variant-condition{matching-criterion=RDR_POS, value=5}
              PduRSrcPduDirection = RECEIVE if post-build-variant-condition{matching-criterion=RDR_POS, value=2}
              PduRSrcPduDirection = RECEIVE if post-build-variant-condition{matching-criterion=RDR_POS, value=4}
              PduRSrcPduDirection = RECEIVE if post-build-variant-condition{matching-criterion=RDR_POS, value=6}
              PduRSrcPduRef = SR1_DIAG_REQ_PHY_OBD1_oVCAN_RADAR_ff3ad7b0_Rx
              PduRSrcPduPduRBswModulesRef = CanIf if post-build-variant-condition{matching-criterion=RDR_POS, value=1}
              PduRSrcPduPduRBswModulesRef = CanIf if post-build-variant-condition{matching-criterion=RDR_POS, value=3}
              PduRSrcPduPduRBswModulesRef = CanIf if post-build-variant-condition{matching-criterion=RDR_POS, value=7}
              PduRSrcPduPduRBswModulesRef = CanIf if post-build-variant-condition{matching-criterion=RDR_POS, value=2}
              PduRSrcPduPduRBswModulesRef = CanIf if post-build-variant-condition{matching-criterion=RDR_POS, value=0}
              PduRSrcPduPduRBswModulesRef = CanIf if post-build-variant-condition{matching-criterion=RDR_POS, value=4}
              PduRSrcPduPduRBswModulesRef = CanIf if post-build-variant-condition{matching-criterion=RDR_POS, value=6}
              PduRSrcPduPduRBswModulesRef = CanIf if post-build-variant-condition{matching-criterion=RDR_POS, value=5}
            SRR_FL_DIAG_REQ_PHYS_OBD1_Tx_oPCAN_RADAR_1d0fb5b4_Tx (PduRDestPdu):
              PduRDestPduHandleId = 198
              PduRDestPduDirection = TRANSMIT if post-build-variant-condition{matching-criterion=RDR_POS, value=2}
              PduRDestPduDirection = TRANSMIT if post-build-variant-condition{matching-criterion=RDR_POS, value=0}
              PduRDestPduDirection = TRANSMIT if post-build-variant-condition{matching-criterion=RDR_POS, value=7}
              PduRDestPduDirection = TRANSMIT if post-build-variant-condition{matching-criterion=RDR_POS, value=6}
              PduRDestPduDirection = TRANSMIT if post-build-variant-condition{matching-criterion=RDR_POS, value=4}
              PduRDestPduDirection = TRANSMIT if post-build-variant-condition{matching-criterion=RDR_POS, value=1}
              PduRDestPduDirection = TRANSMIT if post-build-variant-condition{matching-criterion=RDR_POS, value=3}
              PduRDestPduDirection = TRANSMIT if post-build-variant-condition{matching-criterion=RDR_POS, value=5}
              PduRDestPduRoutingType = GATEWAY_ROUTING if post-build-variant-condition{matching-criterion=RDR_POS, value=2}
              PduRDestPduRoutingType = GATEWAY_ROUTING if post-build-variant-condition{matching-criterion=RDR_POS, value=0}
              PduRDestPduRoutingType = GATEWAY_ROUTING if post-build-variant-condition{matching-criterion=RDR_POS, value=7}
              PduRDestPduRoutingType = GATEWAY_ROUTING if post-build-variant-condition{matching-criterion=RDR_POS, value=6}
              PduRDestPduRoutingType = GATEWAY_ROUTING if post-build-variant-condition{matching-criterion=RDR_POS, value=4}
              PduRDestPduRoutingType = GATEWAY_ROUTING if post-build-variant-condition{matching-criterion=RDR_POS, value=1}
              PduRDestPduRoutingType = GATEWAY_ROUTING if post-build-variant-condition{matching-criterion=RDR_POS, value=3}
              PduRDestPduRoutingType = GATEWAY_ROUTING if post-build-variant-condition{matching-criterion=RDR_POS, value=5}
              PduRDestPduDataProcessing = IMMEDIATE
              PduRPduLengthHandlingStrategy = IGNORE
              PduRDestPduCrossPartitionDestination = false
              PduRTransmissionConfirmation = false
              PduRDestPduDataProvision = PDUR_DIRECT
              PduRDestPduRef = SRR_FL_DIAG_REQ_PHYS_OBD1_Tx_oPCAN_RADAR_1d0fb5b4_Tx
              PduRDestPduPduRBswModulesRef = CanIf if post-build-variant-condition{matching-criterion=RDR_POS, value=5}
              PduRDestPduPduRBswModulesRef = CanIf if post-build-variant-condition{matching-criterion=RDR_POS, value=2}
              PduRDestPduPduRBswModulesRef = CanIf if post-build-variant-condition{matching-criterion=RDR_POS, value=4}
              PduRDestPduPduRBswModulesRef = CanIf if post-build-variant-condition{matching-criterion=RDR_POS, value=0}
              PduRDestPduPduRBswModulesRef = CanIf if post-build-variant-condition{matching-criterion=RDR_POS, value=6}
              PduRDestPduPduRBswModulesRef = CanIf if post-build-variant-condition{matching-criterion=RDR_POS, value=1}
              PduRDestPduPduRBswModulesRef = CanIf if post-build-variant-condition{matching-criterion=RDR_POS, value=3}
              PduRDestPduPduRBswModulesRef = CanIf if post-build-variant-condition{matching-criterion=RDR_POS, value=7}
          RDR_FUSION_CAPABILITY_oPCAN_RADAR_2f1662f1_Rx: PduRRoutingPathCommunicationType=COMMUNICATION_INTERFACE if post-build-variant-condition{matching-criterion=RDR_POS, value=7}, PduRRoutingPathCommunicationType=COMMUNICATION_INTERFACE if post-build-variant-condition{matching-criterion=RDR_POS, value=1}, PduRRoutingPathCommunicationType=COMMUNICATION_INTERFACE if post-build-variant-condition{matching-criterion=RDR_POS, value=3}, PduRRoutingPathCommunicationType=COMMUNICATION_INTERFACE if post-build-variant-condition{matching-criterion=RDR_POS, value=0}, PduRRoutingPathCommunicationType=COMMUNICATION_INTERFACE if post-build-variant-condition{matching-criterion=RDR_POS, value=5}, PduRRoutingPathCommunicationType=COMMUNICATION_INTERFACE if post-build-variant-condition{matching-criterion=RDR_POS, value=2}, PduRRoutingPathCommunicationType=COMMUNICATION_INTERFACE if post-build-variant-condition{matching-criterion=RDR_POS, value=4}, PduRRoutingPathCommunicationType=COMMUNICATION_INTERFACE if post-build-variant-condition{matching-criterion=RDR_POS, value=6}, PduRLockRef=PduRLock_PduRExclusiveArea if post-build-variant-condition{matching-criterion=RDR_POS, value=6}, PduRLockRef=PduRLock_PduRExclusiveArea if post-build-variant-condition{matching-criterion=RDR_POS, value=1}, PduRLockRef=PduRLock_PduRExclusiveArea if post-build-variant-condition{matching-criterion=RDR_POS, value=3}, PduRLockRef=PduRLock_PduRExclusiveArea if post-build-variant-condition{matching-criterion=RDR_POS, value=0}, PduRLockRef=PduRLock_PduRExclusiveArea if post-build-variant-condition{matching-criterion=RDR_POS, value=7}, PduRLockRef=PduRLock_PduRExclusiveArea if post-build-variant-condition{matching-criterion=RDR_POS, value=5}, PduRLockRef=PduRLock_PduRExclusiveArea if post-build-variant-condition{matching-criterion=RDR_POS, value=2}, PduRLockRef=PduRLock_PduRExclusiveArea if post-build-variant-condition{matching-criterion=RDR_POS, value=4}
            PduRSrcPdu_40343c24 (PduRSrcPdu):
              PduRSourcePduHandleId = 28
              PduRSrcPduDirection = RECEIVE if post-build-variant-condition{matching-criterion=RDR_POS, value=3}
              PduRSrcPduDirection = RECEIVE if post-build-variant-condition{matching-criterion=RDR_POS, value=1}
              PduRSrcPduDirection = RECEIVE if post-build-variant-condition{matching-criterion=RDR_POS, value=0}
              PduRSrcPduDirection = RECEIVE if post-build-variant-condition{matching-criterion=RDR_POS, value=7}
              PduRSrcPduDirection = RECEIVE if post-build-variant-condition{matching-criterion=RDR_POS, value=5}
              PduRSrcPduDirection = RECEIVE if post-build-variant-condition{matching-criterion=RDR_POS, value=2}
              PduRSrcPduDirection = RECEIVE if post-build-variant-condition{matching-criterion=RDR_POS, value=4}
              PduRSrcPduDirection = RECEIVE if post-build-variant-condition{matching-criterion=RDR_POS, value=6}
              PduRSrcPduRef = RDR_FUSION_CAPABILITY_oPCAN_RADAR_2f1662f1_Rx
              PduRSrcPduPduRBswModulesRef = CanIf if post-build-variant-condition{matching-criterion=RDR_POS, value=6}
              PduRSrcPduPduRBswModulesRef = CanIf if post-build-variant-condition{matching-criterion=RDR_POS, value=7}
              PduRSrcPduPduRBswModulesRef = CanIf if post-build-variant-condition{matching-criterion=RDR_POS, value=4}
              PduRSrcPduPduRBswModulesRef = CanIf if post-build-variant-condition{matching-criterion=RDR_POS, value=2}
              PduRSrcPduPduRBswModulesRef = CanIf if post-build-variant-condition{matching-criterion=RDR_POS, value=3}
              PduRSrcPduPduRBswModulesRef = CanIf if post-build-variant-condition{matching-criterion=RDR_POS, value=1}
              PduRSrcPduPduRBswModulesRef = CanIf if post-build-variant-condition{matching-criterion=RDR_POS, value=5}
              PduRSrcPduPduRBswModulesRef = CanIf if post-build-variant-condition{matching-criterion=RDR_POS, value=0}
            RDR_FUSION_CAPABILITY_oPCAN_RADAR_2f1662f1_Rx_40343c24_Rx (PduRDestPdu):
              PduRDestPduHandleId = 21
              PduRDestPduDirection = RECEIVE if post-build-variant-condition{matching-criterion=RDR_POS, value=6}
              PduRDestPduDirection = RECEIVE if post-build-variant-condition{matching-criterion=RDR_POS, value=1}
              PduRDestPduDirection = RECEIVE if post-build-variant-condition{matching-criterion=RDR_POS, value=3}
              PduRDestPduDirection = RECEIVE if post-build-variant-condition{matching-criterion=RDR_POS, value=0}
              PduRDestPduDirection = RECEIVE if post-build-variant-condition{matching-criterion=RDR_POS, value=7}
              PduRDestPduDirection = RECEIVE if post-build-variant-condition{matching-criterion=RDR_POS, value=5}
              PduRDestPduDirection = RECEIVE if post-build-variant-condition{matching-criterion=RDR_POS, value=2}
              PduRDestPduDirection = RECEIVE if post-build-variant-condition{matching-criterion=RDR_POS, value=4}
              PduRDestPduRoutingType = API_FORWARDING if post-build-variant-condition{matching-criterion=RDR_POS, value=1}
              PduRDestPduRoutingType = API_FORWARDING if post-build-variant-condition{matching-criterion=RDR_POS, value=3}
              PduRDestPduRoutingType = API_FORWARDING if post-build-variant-condition{matching-criterion=RDR_POS, value=0}
              PduRDestPduRoutingType = API_FORWARDING if post-build-variant-condition{matching-criterion=RDR_POS, value=7}
              PduRDestPduRoutingType = API_FORWARDING if post-build-variant-condition{matching-criterion=RDR_POS, value=5}
              PduRDestPduRoutingType = API_FORWARDING if post-build-variant-condition{matching-criterion=RDR_POS, value=2}
              PduRDestPduRoutingType = API_FORWARDING if post-build-variant-condition{matching-criterion=RDR_POS, value=4}
              PduRDestPduRoutingType = API_FORWARDING if post-build-variant-condition{matching-criterion=RDR_POS, value=6}
              PduRDestPduDataProcessing = IMMEDIATE
              PduRPduLengthHandlingStrategy = IGNORE
              PduRDestPduCrossPartitionDestination = false
              PduRTransmissionConfirmation = false
              PduRDestPduRef = RDR_FUSION_CAPABILITY_oPCAN_RADAR_d81ad430_Rx
              PduRDestPduPduRBswModulesRef = Com if post-build-variant-condition{matching-criterion=RDR_POS, value=4}
              PduRDestPduPduRBswModulesRef = Com if post-build-variant-condition{matching-criterion=RDR_POS, value=1}
              PduRDestPduPduRBswModulesRef = Com if post-build-variant-condition{matching-criterion=RDR_POS, value=5}
              PduRDestPduPduRBswModulesRef = Com if post-build-variant-condition{matching-criterion=RDR_POS, value=2}
              PduRDestPduPduRBswModulesRef = Com if post-build-variant-condition{matching-criterion=RDR_POS, value=6}
              PduRDestPduPduRBswModulesRef = Com if post-build-variant-condition{matching-criterion=RDR_POS, value=0}
              PduRDestPduPduRBswModulesRef = Com if post-build-variant-condition{matching-criterion=RDR_POS, value=7}
              PduRDestPduPduRBswModulesRef = Com if post-build-variant-condition{matching-criterion=RDR_POS, value=3}
          PCAN_DIAG_REQ_PHYS_OBD1_oPCAN_RADAR_bb22f7fc_Rx: PduRRoutingPathCommunicationType=TRANSPORT_PROTOCOL if post-build-variant-condition{matching-criterion=RDR_POS, value=1}, PduRRoutingPathCommunicationType=TRANSPORT_PROTOCOL if post-build-variant-condition{matching-criterion=RDR_POS, value=3}, PduRRoutingPathCommunicationType=TRANSPORT_PROTOCOL if post-build-variant-condition{matching-criterion=RDR_POS, value=0}, PduRRoutingPathCommunicationType=TRANSPORT_PROTOCOL if post-build-variant-condition{matching-criterion=RDR_POS, value=7}, PduRRoutingPathCommunicationType=TRANSPORT_PROTOCOL if post-build-variant-condition{matching-criterion=RDR_POS, value=5}, PduRRoutingPathCommunicationType=TRANSPORT_PROTOCOL if post-build-variant-condition{matching-criterion=RDR_POS, value=2}, PduRRoutingPathCommunicationType=TRANSPORT_PROTOCOL if post-build-variant-condition{matching-criterion=RDR_POS, value=4}, PduRRoutingPathCommunicationType=TRANSPORT_PROTOCOL if post-build-variant-condition{matching-criterion=RDR_POS, value=6}, PduRLockRef=PduRLock_PduRExclusiveArea if post-build-variant-condition{matching-criterion=RDR_POS, value=6}, PduRLockRef=PduRLock_PduRExclusiveArea if post-build-variant-condition{matching-criterion=RDR_POS, value=1}, PduRLockRef=PduRLock_PduRExclusiveArea if post-build-variant-condition{matching-criterion=RDR_POS, value=3}, PduRLockRef=PduRLock_PduRExclusiveArea if post-build-variant-condition{matching-criterion=RDR_POS, value=0}, PduRLockRef=PduRLock_PduRExclusiveArea if post-build-variant-condition{matching-criterion=RDR_POS, value=7}, PduRLockRef=PduRLock_PduRExclusiveArea if post-build-variant-condition{matching-criterion=RDR_POS, value=5}, PduRLockRef=PduRLock_PduRExclusiveArea if post-build-variant-condition{matching-criterion=RDR_POS, value=2}, PduRLockRef=PduRLock_PduRExclusiveArea if post-build-variant-condition{matching-criterion=RDR_POS, value=4}
            PCAN_DIAG_REQ_PHYS_OBD1_oPCAN_RADAR_bb22f7fc_Rx_d26a3583_Rx (PduRDestPdu):
              PduRDestPduHandleId = 17
              PduRDestPduDirection = RECEIVE if post-build-variant-condition{matching-criterion=RDR_POS, value=7}
              PduRDestPduDirection = RECEIVE if post-build-variant-condition{matching-criterion=RDR_POS, value=1}
              PduRDestPduDirection = RECEIVE if post-build-variant-condition{matching-criterion=RDR_POS, value=3}
              PduRDestPduDirection = RECEIVE if post-build-variant-condition{matching-criterion=RDR_POS, value=0}
              PduRDestPduDirection = RECEIVE if post-build-variant-condition{matching-criterion=RDR_POS, value=5}
              PduRDestPduDirection = RECEIVE if post-build-variant-condition{matching-criterion=RDR_POS, value=2}
              PduRDestPduDirection = RECEIVE if post-build-variant-condition{matching-criterion=RDR_POS, value=4}
              PduRDestPduDirection = RECEIVE if post-build-variant-condition{matching-criterion=RDR_POS, value=6}
              PduRDestPduRoutingType = API_FORWARDING if post-build-variant-condition{matching-criterion=RDR_POS, value=2}
              PduRDestPduRoutingType = API_FORWARDING if post-build-variant-condition{matching-criterion=RDR_POS, value=1}
              PduRDestPduRoutingType = API_FORWARDING if post-build-variant-condition{matching-criterion=RDR_POS, value=3}
              PduRDestPduRoutingType = API_FORWARDING if post-build-variant-condition{matching-criterion=RDR_POS, value=0}
              PduRDestPduRoutingType = API_FORWARDING if post-build-variant-condition{matching-criterion=RDR_POS, value=5}
              PduRDestPduRoutingType = API_FORWARDING if post-build-variant-condition{matching-criterion=RDR_POS, value=7}
              PduRDestPduRoutingType = API_FORWARDING if post-build-variant-condition{matching-criterion=RDR_POS, value=4}
              PduRDestPduRoutingType = API_FORWARDING if post-build-variant-condition{matching-criterion=RDR_POS, value=6}
              PduRDestPduDataProcessing = IMMEDIATE
              PduRPduLengthHandlingStrategy = UNUSED
              PduRDestPduCrossPartitionDestination = false
              PduRDestPduRef = PCAN_DIAG_REQ_PHYS_OBD1_oPCAN_RADAR_caf5eb16_Rx
              PduRDestPduPduRBswModulesRef = Dcm if post-build-variant-condition{matching-criterion=RDR_POS, value=4}
              PduRDestPduPduRBswModulesRef = Dcm if post-build-variant-condition{matching-criterion=RDR_POS, value=1}
              PduRDestPduPduRBswModulesRef = Dcm if post-build-variant-condition{matching-criterion=RDR_POS, value=6}
              PduRDestPduPduRBswModulesRef = Dcm if post-build-variant-condition{matching-criterion=RDR_POS, value=3}
              PduRDestPduPduRBswModulesRef = Dcm if post-build-variant-condition{matching-criterion=RDR_POS, value=5}
              PduRDestPduPduRBswModulesRef = Dcm if post-build-variant-condition{matching-criterion=RDR_POS, value=2}
              PduRDestPduPduRBswModulesRef = Dcm if post-build-variant-condition{matching-criterion=RDR_POS, value=0}
              PduRDestPduPduRBswModulesRef = Dcm if post-build-variant-condition{matching-criterion=RDR_POS, value=7}
            PduRSrcPdu_d26a3583 (PduRSrcPdu):
              PduRSourcePduHandleId = 17
              PduRSrcPduDirection = RECEIVE if post-build-variant-condition{matching-criterion=RDR_POS, value=7}
              PduRSrcPduDirection = RECEIVE if post-build-variant-condition{matching-criterion=RDR_POS, value=1}
              PduRSrcPduDirection = RECEIVE if post-build-variant-condition{matching-criterion=RDR_POS, value=3}
              PduRSrcPduDirection = RECEIVE if post-build-variant-condition{matching-criterion=RDR_POS, value=0}
              PduRSrcPduDirection = RECEIVE if post-build-variant-condition{matching-criterion=RDR_POS, value=5}
              PduRSrcPduDirection = RECEIVE if post-build-variant-condition{matching-criterion=RDR_POS, value=2}
              PduRSrcPduDirection = RECEIVE if post-build-variant-condition{matching-criterion=RDR_POS, value=4}
              PduRSrcPduDirection = RECEIVE if post-build-variant-condition{matching-criterion=RDR_POS, value=6}
              PduRSrcPduRef = PCAN_DIAG_REQ_PHYS_OBD1_oPCAN_RADAR_bb22f7fc_Rx
              PduRSrcPduPduRBswModulesRef = CanTp if post-build-variant-condition{matching-criterion=RDR_POS, value=1}
              PduRSrcPduPduRBswModulesRef = CanTp if post-build-variant-condition{matching-criterion=RDR_POS, value=0}
              PduRSrcPduPduRBswModulesRef = CanTp if post-build-variant-condition{matching-criterion=RDR_POS, value=7}
              PduRSrcPduPduRBswModulesRef = CanTp if post-build-variant-condition{matching-criterion=RDR_POS, value=4}
              PduRSrcPduPduRBswModulesRef = CanTp if post-build-variant-condition{matching-criterion=RDR_POS, value=3}
              PduRSrcPduPduRBswModulesRef = CanTp if post-build-variant-condition{matching-criterion=RDR_POS, value=6}
              PduRSrcPduPduRBswModulesRef = CanTp if post-build-variant-condition{matching-criterion=RDR_POS, value=5}
              PduRSrcPduPduRBswModulesRef = CanTp if post-build-variant-condition{matching-criterion=RDR_POS, value=2}
