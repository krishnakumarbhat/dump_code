[part 14 of 20: package /ActiveEcuC]
AUTOSAR XML (schema 00053)
package /ActiveEcuC  (continued)
  module config Com: implementation-config-variant=VARIANT-PRE-COMPILE, module-description=Com_Impl  (continued)
    ComConfig: ComConfigurationId=0, ComRxImmediateNotificationCacheSize=0, ComRxDeferredNotificationCacheSize=1  (continued)
      109 x ComSignalGroup, all with ComSignalGroupAccess=ACCESS_NEEDED_BY_SWC_OR_COM, ComSignalGroupArrayAccess=true:  (continued)
        SG_Detections_193_196_oRDR_DETECTION_193_196_oPCAN_RADAR_92844e50_Tx: ComTransferProperty=TRIGGERED, ComHandleId=50, ComSystemTemplateSignalGroupRef=SG_Detections_193_196
          83 x ComGroupSignal, all with ComSignalEndianness=LITTLE_ENDIAN, ComTransferProperty=PENDING, ComSignalAccess=ACCESS_NEEDED_BY_SWC_OR_COM:
            DET_ELEVATION_ERR_194_oRDR_DETECTION_193_196_oPCAN_RADAR_62c5d02e_Tx: ComBitPosition=192, ComBitSize=6, ComSignalInitValue=0, ComSignalType=UINT8, ComHandleId=4074, ComSystemTemplateSystemSignalRef=DET_ELEVATION_ERR_194
            DET_AZIMUTH_ERR_193_oRDR_DETECTION_193_196_oPCAN_RADAR_cc4a21cb_Tx: ComBitPosition=105, ComBitSize=7, ComSignalInitValue=0, ComSignalType=UINT8, ComHandleId=4049, ComSystemTemplateSystemSignalRef=DET_AZIMUTH_ERR_193
            DET_RANGE_VELOCITY_ERR_194_oRDR_DETECTION_193_196_oPCAN_RADAR_5ec9dd7b_Tx: ComBitPosition=176, ComBitSize=8, ComSignalInitValue=0, ComSignalType=UINT8, ComHandleId=4113, ComSystemTemplateSystemSignalRef=DET_RANGE_VELOCITY_ERR_194
            DET_ELEVATION_193_oRDR_DETECTION_193_196_oPCAN_RADAR_b94c6b32_Tx: ComBitPosition=72, ComBitSize=8, ComSignalInitValue=0, ComSignalType=UINT8, ComHandleId=4069, ComSystemTemplateSystemSignalRef=DET_ELEVATION_193
            DET_ELEVATION_ERR_195_oRDR_DETECTION_193_196_oPCAN_RADAR_f7b504bb_Tx: ComBitPosition=304, ComBitSize=6, ComSignalInitValue=0, ComSignalType=UINT8, ComHandleId=4075, ComSystemTemplateSystemSignalRef=DET_ELEVATION_ERR_195
            DET_BI_STATIC_FLAG_194_oRDR_DETECTION_193_196_oPCAN_RADAR_6263d7d2_Tx: ComBitPosition=216, ComBitSize=1, ComSignalInitValue=0, ComSignalType=BOOLEAN, ComHandleId=4058, ComSystemTemplateSystemSignalRef=DET_BI_STATIC_FLAG_194
            DET_HVC_FLAG_196_oRDR_DETECTION_193_196_oPCAN_RADAR_a0be495a_Tx: ComBitPosition=422, ComBitSize=1, ComSignalInitValue=0, ComSignalType=BOOLEAN, ComHandleId=4084, ComSystemTemplateSystemSignalRef=DET_HVC_FLAG_196
            DET_SUPER_RES_TARGET_195_oRDR_DETECTION_193_196_oPCAN_RADAR_afb5b961_Tx: ComBitPosition=311, ComBitSize=1, ComSignalInitValue=0, ComSignalType=BOOLEAN, ComHandleId=4126, ComSystemTemplateSystemSignalRef=DET_SUPER_RES_TARGET_195
            DET_AZIMUTH_ERR_196_oRDR_DETECTION_193_196_oPCAN_RADAR_616aadc9_Tx: ComBitPosition=441, ComBitSize=7, ComSignalInitValue=0, ComSignalType=UINT8, ComHandleId=4052, ComSystemTemplateSystemSignalRef=DET_AZIMUTH_ERR_196
            DET_RANGE_195_oRDR_DETECTION_193_196_oPCAN_RADAR_b1a43079_Tx: ComBitPosition=248, ComBitSize=15, ComSignalInitValue=0, ComSignalType=UINT16, ComHandleId=4102, ComSystemTemplateSystemSignalRef=DET_RANGE_195
            DET_EXISTENCE_PROB_195_oRDR_DETECTION_193_196_oPCAN_RADAR_252a71db_Tx: ComBitPosition=336, ComBitSize=6, ComSignalInitValue=0, ComSignalType=UINT8, ComHandleId=4079, ComSystemTemplateSystemSignalRef=DET_EXISTENCE_PROB_195
            DET_ELEVATION_196_oRDR_DETECTION_193_196_oPCAN_RADAR_146ce730_Tx: ComBitPosition=408, ComBitSize=8, ComSignalInitValue=0, ComSignalType=UINT8, ComHandleId=4072, ComSystemTemplateSystemSignalRef=DET_ELEVATION_196
            DET_HVC_FLAG_194_oRDR_DETECTION_193_196_oPCAN_RADAR_512ee631_Tx: ComBitPosition=198, ComBitSize=1, ComSignalInitValue=0, ComSignalType=BOOLEAN, ComHandleId=4082, ComSystemTemplateSystemSignalRef=DET_HVC_FLAG_194
            DET_AZIMUTH_195_oRDR_DETECTION_193_196_oPCAN_RADAR_a13f43c2_Tx: ComBitPosition=312, ComBitSize=13, ComSignalInitValue=0, ComSignalType=UINT16, ComHandleId=4047, ComSystemTemplateSystemSignalRef=DET_AZIMUTH_195
            DET_SNR_195_oRDR_DETECTION_193_196_oPCAN_RADAR_9e2c9104_Tx: ComBitPosition=344, ComBitSize=8, ComSignalInitValue=0, ComSignalType=UINT8, ComHandleId=4122, ComSystemTemplateSystemSignalRef=DET_SNR_195
            DET_CONFD_ELEVATION_196_oRDR_DETECTION_193_196_oPCAN_RADAR_c5ac330c_Tx: ComBitPosition=437, ComBitSize=2, ComSignalInitValue=0, ComSignalType=UINT8, ComHandleId=4068, ComSystemTemplateSystemSignalRef=DET_CONFD_ELEVATION_196
            DET_CONFD_AZIMUTH_194_oRDR_DETECTION_193_196_oPCAN_RADAR_36a99d9d_Tx: ComBitPosition=230, ComBitSize=2, ComSignalInitValue=0, ComSignalType=UINT8, ComHandleId=4062, ComSystemTemplateSystemSignalRef=DET_CONFD_AZIMUTH_194
            DET_RANGE_VELOCITY_196_oRDR_DETECTION_193_196_oPCAN_RADAR_a0e289a2_Tx: ComBitPosition=384, ComBitSize=15, ComSignalInitValue=16384, ComSignalType=UINT16, ComHandleId=4111, ComSystemTemplateSystemSignalRef=DET_RANGE_VELOCITY_196
            DET_BI_STATIC_FLAG_195_oRDR_DETECTION_193_196_oPCAN_RADAR_f7130347_Tx: ComBitPosition=328, ComBitSize=1, ComSignalInitValue=0, ComSignalType=BOOLEAN, ComHandleId=4059, ComSystemTemplateSystemSignalRef=DET_BI_STATIC_FLAG_195
            DET_AZIMUTH_194_oRDR_DETECTION_193_196_oPCAN_RADAR_344f9757_Tx: ComBitPosition=200, ComBitSize=13, ComSignalInitValue=0, ComSignalType=UINT16, ComHandleId=4046, ComSystemTemplateSystemSignalRef=DET_AZIMUTH_194
            DET_CONFD_ELEVATION_195_oRDR_DETECTION_193_196_oPCAN_RADAR_a14c48f2_Tx: ComBitPosition=325, ComBitSize=2, ComSignalInitValue=0, ComSignalType=UINT8, ComHandleId=4067, ComSystemTemplateSystemSignalRef=DET_CONFD_ELEVATION_195
            DET_AZIMUTH_196_oRDR_DETECTION_193_196_oPCAN_RADAR_c5df383c_Tx: ComBitPosition=424, ComBitSize=13, ComSignalInitValue=0, ComSignalType=UINT16, ComHandleId=4048, ComSystemTemplateSystemSignalRef=DET_AZIMUTH_196
            DET_CONFD_AZIMUTH_196_oRDR_DETECTION_193_196_oPCAN_RADAR_c73932f6_Tx: ComBitPosition=454, ComBitSize=2, ComSignalInitValue=0, ComSignalType=UINT8, ComHandleId=4064, ComSystemTemplateSystemSignalRef=DET_CONFD_AZIMUTH_196
            DET_HVC_FLAG_193_oRDR_DETECTION_193_196_oPCAN_RADAR_0d9ec558_Tx: ComBitPosition=86, ComBitSize=1, ComSignalInitValue=0, ComSignalType=BOOLEAN, ComHandleId=4081, ComSystemTemplateSystemSignalRef=DET_HVC_FLAG_193
            DET_RANGE_VELOCITY_194_oRDR_DETECTION_193_196_oPCAN_RADAR_517226c9_Tx: ComBitPosition=160, ComBitSize=15, ComSignalInitValue=16384, ComSignalType=UINT16, ComHandleId=4109, ComSystemTemplateSystemSignalRef=DET_RANGE_VELOCITY_194
            DET_BI_STATIC_FLAG_196_oRDR_DETECTION_193_196_oPCAN_RADAR_93f378b9_Tx: ComBitPosition=440, ComBitSize=1, ComSignalInitValue=0, ComSignalType=BOOLEAN, ComHandleId=4060, ComSystemTemplateSystemSignalRef=DET_BI_STATIC_FLAG_196
            DET_MH_SCAN_INDEX_4LSB_193_196_oRDR_DETECTION_193_196_oPCAN_RADAR_5e5318e0_Tx: ComBitPosition=476, ComBitSize=4, ComSignalInitValue=0, ComSignalType=UINT8, ComHandleId=4091, ComSystemTemplateSystemSignalRef=DET_MH_SCAN_INDEX_4LSB_193_196
            DET_RANGE_VELOCITY_ERR_196_oRDR_DETECTION_193_196_oPCAN_RADAR_af597210_Tx: ComBitPosition=400, ComBitSize=8, ComSignalInitValue=0, ComSignalType=UINT8, ComHandleId=4115, ComSystemTemplateSystemSignalRef=DET_RANGE_VELOCITY_ERR_196
            DET_CONFD_ELEVATION_194_oRDR_DETECTION_193_196_oPCAN_RADAR_343c9c67_Tx: ComBitPosition=213, ComBitSize=2, ComSignalInitValue=0, ComSignalType=UINT8, ComHandleId=4066, ComSystemTemplateSystemSignalRef=DET_CONFD_ELEVATION_194
            DET_SNR_194_oRDR_DETECTION_193_196_oPCAN_RADAR_0b5c4591_Tx: ComBitPosition=232, ComBitSize=8, ComSignalInitValue=0, ComSignalType=UINT8, ComHandleId=4121, ComSystemTemplateSystemSignalRef=DET_SNR_194
            DET_EXISTENCE_PROB_194_oRDR_DETECTION_193_196_oPCAN_RADAR_b05aa54e_Tx: ComBitPosition=224, ComBitSize=6, ComSignalInitValue=0, ComSignalType=UINT8, ComHandleId=4078, ComSystemTemplateSystemSignalRef=DET_EXISTENCE_PROB_194
            DET_RANGE_ERR_193_oRDR_DETECTION_193_196_oPCAN_RADAR_df8c7dec_Tx: ComBitPosition=40, ComBitSize=7, ComSignalInitValue=0, ComSignalType=UINT8, ComHandleId=4104, ComSystemTemplateSystemSignalRef=DET_RANGE_ERR_193
            DET_RCS_196_oRDR_DETECTION_193_196_oPCAN_RADAR_2762bef8_Tx: ComBitPosition=464, ComBitSize=8, ComSignalInitValue=128, ComSignalType=UINT8, ComHandleId=4119, ComSystemTemplateSystemSignalRef=DET_RCS_196
            DET_RCS_195_oRDR_DETECTION_193_196_oPCAN_RADAR_4382c506_Tx: ComBitPosition=352, ComBitSize=8, ComSignalInitValue=128, ComSignalType=UINT8, ComHandleId=4118, ComSystemTemplateSystemSignalRef=DET_RCS_195
            DET_RANGE_ERR_196_oRDR_DETECTION_193_196_oPCAN_RADAR_72acf1ee_Tx: ComBitPosition=376, ComBitSize=7, ComSignalInitValue=0, ComSignalType=UINT8, ComHandleId=4107, ComSystemTemplateSystemSignalRef=DET_RANGE_ERR_196
            DET_HVC_FLAG_195_oRDR_DETECTION_193_196_oPCAN_RADAR_c45e32a4_Tx: ComBitPosition=310, ComBitSize=1, ComSignalInitValue=0, ComSignalType=BOOLEAN, ComHandleId=4083, ComSystemTemplateSystemSignalRef=DET_HVC_FLAG_195
            DET_SUPER_RES_TARGET_196_oRDR_DETECTION_193_196_oPCAN_RADAR_cb55c29f_Tx: ComBitPosition=423, ComBitSize=1, ComSignalInitValue=0, ComSignalType=BOOLEAN, ComHandleId=4127, ComSystemTemplateSystemSignalRef=DET_SUPER_RES_TARGET_196
            DET_RCS_194_oRDR_DETECTION_193_196_oPCAN_RADAR_d6f21193_Tx: ComBitPosition=240, ComBitSize=8, ComSignalInitValue=128, ComSignalType=UINT8, ComHandleId=4117, ComSystemTemplateSystemSignalRef=DET_RCS_194
            DET_RANGE_196_oRDR_DETECTION_193_196_oPCAN_RADAR_d5444b87_Tx: ComBitPosition=360, ComBitSize=15, ComSignalInitValue=0, ComSignalType=UINT16, ComHandleId=4103, ComSystemTemplateSystemSignalRef=DET_RANGE_196
            DET_EXISTENCE_PROB_193_oRDR_DETECTION_193_196_oPCAN_RADAR_ecea8627_Tx: ComBitPosition=112, ComBitSize=6, ComSignalInitValue=0, ComSignalType=UINT8, ComHandleId=4077, ComSystemTemplateSystemSignalRef=DET_EXISTENCE_PROB_193
            DET_CONFD_AZIMUTH_193_oRDR_DETECTION_193_196_oPCAN_RADAR_6a19bef4_Tx: ComBitPosition=118, ComBitSize=2, ComSignalInitValue=0, ComSignalType=UINT8, ComHandleId=4061, ComSystemTemplateSystemSignalRef=DET_CONFD_AZIMUTH_193
            DET_SNR_193_oRDR_DETECTION_193_196_oPCAN_RADAR_57ec66f8_Tx: ComBitPosition=120, ComBitSize=8, ComSignalInitValue=0, ComSignalType=UINT8, ComHandleId=4120, ComSystemTemplateSystemSignalRef=DET_SNR_193
            DET_ELEVATION_ERR_196_oRDR_DETECTION_193_196_oPCAN_RADAR_93557f45_Tx: ComBitPosition=416, ComBitSize=6, ComSignalInitValue=0, ComSignalType=UINT8, ComHandleId=4076, ComSystemTemplateSystemSignalRef=DET_ELEVATION_ERR_196
            DET_SUPER_RES_TARGET_193_oRDR_DETECTION_193_196_oPCAN_RADAR_66754e9d_Tx: ComBitPosition=87, ComBitSize=1, ComSignalInitValue=0, ComSignalType=BOOLEAN, ComHandleId=4124, ComSystemTemplateSystemSignalRef=DET_SUPER_RES_TARGET_193
            DET_ELEVATION_ERR_193_oRDR_DETECTION_193_196_oPCAN_RADAR_3e75f347_Tx: ComBitPosition=80, ComBitSize=6, ComSignalInitValue=0, ComSignalType=UINT8, ComHandleId=4073, ComSystemTemplateSystemSignalRef=DET_ELEVATION_ERR_193
            DET_EXISTENCE_PROB_196_oRDR_DETECTION_193_196_oPCAN_RADAR_41ca0a25_Tx: ComBitPosition=448, ComBitSize=6, ComSignalInitValue=0, ComSignalType=UINT8, ComHandleId=4080, ComSystemTemplateSystemSignalRef=DET_EXISTENCE_PROB_196
            DET_CONFD_AZIMUTH_195_oRDR_DETECTION_193_196_oPCAN_RADAR_a3d94908_Tx: ComBitPosition=342, ComBitSize=2, ComSignalInitValue=0, ComSignalType=UINT8, ComHandleId=4063, ComSystemTemplateSystemSignalRef=DET_CONFD_AZIMUTH_195
            DET_AZIMUTH_ERR_195_oRDR_DETECTION_193_196_oPCAN_RADAR_058ad637_Tx: ComBitPosition=329, ComBitSize=7, ComSignalInitValue=0, ComSignalType=UINT8, ComHandleId=4051, ComSystemTemplateSystemSignalRef=DET_AZIMUTH_ERR_195
            DET_BI_STATIC_FLAG_193_oRDR_DETECTION_193_196_oPCAN_RADAR_3ed3f4bb_Tx: ComBitPosition=104, ComBitSize=1, ComSignalInitValue=0, ComSignalType=BOOLEAN, ComHandleId=4057, ComSystemTemplateSystemSignalRef=DET_BI_STATIC_FLAG_193
            DET_MH_CYCLE_COUNTER_193_196_oRDR_DETECTION_193_196_oPCAN_RADAR_92793d6c_Tx: ComBitPosition=16, ComBitSize=8, ComSignalInitValue=0, ComSignalType=UINT8, ComHandleId=4090, ComSystemTemplateSystemSignalRef=DET_MH_CYCLE_COUNTER_193_196
            DET_RANGE_VELOCITY_ERR_193_oRDR_DETECTION_193_196_oPCAN_RADAR_0279fe12_Tx: ComBitPosition=64, ComBitSize=8, ComSignalInitValue=0, ComSignalType=UINT8, ComHandleId=4112, ComSystemTemplateSystemSignalRef=DET_RANGE_VELOCITY_ERR_193
            DET_RCS_193_oRDR_DETECTION_193_196_oPCAN_RADAR_8a4232fa_Tx: ComBitPosition=128, ComBitSize=8, ComSignalInitValue=128, ComSignalType=UINT8, ComHandleId=4116, ComSystemTemplateSystemSignalRef=DET_RCS_193
            DET_RANGE_193_oRDR_DETECTION_193_196_oPCAN_RADAR_7864c785_Tx: ComBitPosition=24, ComBitSize=15, ComSignalInitValue=0, ComSignalType=UINT16, ComHandleId=4100, ComSystemTemplateSystemSignalRef=DET_RANGE_193
            DET_AZIMUTH_193_oRDR_DETECTION_193_196_oPCAN_RADAR_68ffb43e_Tx: ComBitPosition=88, ComBitSize=13, ComSignalInitValue=0, ComSignalType=UINT16, ComHandleId=4045, ComSystemTemplateSystemSignalRef=DET_AZIMUTH_193
            DET_RANGE_VELOCITY_ERR_195_oRDR_DETECTION_193_196_oPCAN_RADAR_cbb909ee_Tx: ComBitPosition=288, ComBitSize=8, ComSignalInitValue=0, ComSignalType=UINT8, ComHandleId=4114, ComSystemTemplateSystemSignalRef=DET_RANGE_VELOCITY_ERR_195
            DET_RANGE_VELOCITY_193_oRDR_DETECTION_193_196_oPCAN_RADAR_0dc205a0_Tx: ComBitPosition=48, ComBitSize=15, ComSignalInitValue=16384, ComSignalType=UINT16, ComHandleId=4108, ComSystemTemplateSystemSignalRef=DET_RANGE_VELOCITY_193
            DET_RANGE_VELOCITY_195_oRDR_DETECTION_193_196_oPCAN_RADAR_c402f25c_Tx: ComBitPosition=272, ComBitSize=15, ComSignalInitValue=16384, ComSignalType=UINT16, ComHandleId=4110, ComSystemTemplateSystemSignalRef=DET_RANGE_VELOCITY_195
            DET_ELEVATION_194_oRDR_DETECTION_193_196_oPCAN_RADAR_e5fc485b_Tx: ComBitPosition=184, ComBitSize=8, ComSignalInitValue=0, ComSignalType=UINT8, ComHandleId=4070, ComSystemTemplateSystemSignalRef=DET_ELEVATION_194
            DET_AZIMUTH_ERR_194_oRDR_DETECTION_193_196_oPCAN_RADAR_90fa02a2_Tx: ComBitPosition=217, ComBitSize=7, ComSignalInitValue=0, ComSignalType=UINT8, ComHandleId=4050, ComSystemTemplateSystemSignalRef=DET_AZIMUTH_ERR_194
            DET_MH_CRC16_193_196_oRDR_DETECTION_193_196_oPCAN_RADAR_160c9c5b_Tx: ComBitPosition=0, ComBitSize=16, ComSignalInitValue=0, ComSignalType=UINT16, ComHandleId=4089, ComSystemTemplateSystemSignalRef=DET_MH_CRC16_193_196
            DET_RANGE_ERR_194_oRDR_DETECTION_193_196_oPCAN_RADAR_833c5e85_Tx: ComBitPosition=152, ComBitSize=7, ComSignalInitValue=0, ComSignalType=UINT8, ComHandleId=4105, ComSystemTemplateSystemSignalRef=DET_RANGE_ERR_194
            DET_RANGE_ERR_195_oRDR_DETECTION_193_196_oPCAN_RADAR_164c8a10_Tx: ComBitPosition=264, ComBitSize=7, ComSignalInitValue=0, ComSignalType=UINT8, ComHandleId=4106, ComSystemTemplateSystemSignalRef=DET_RANGE_ERR_195
            DET_RANGE_194_oRDR_DETECTION_193_196_oPCAN_RADAR_24d4e4ec_Tx: ComBitPosition=136, ComBitSize=15, ComSignalInitValue=0, ComSignalType=UINT16, ComHandleId=4101, ComSystemTemplateSystemSignalRef=DET_RANGE_194
            DET_SUPER_RES_TARGET_194_oRDR_DETECTION_193_196_oPCAN_RADAR_3ac56df4_Tx: ComBitPosition=199, ComBitSize=1, ComSignalInitValue=0, ComSignalType=BOOLEAN, ComHandleId=4125, ComSystemTemplateSystemSignalRef=DET_SUPER_RES_TARGET_194
            DET_ELEVATION_195_oRDR_DETECTION_193_196_oPCAN_RADAR_708c9cce_Tx: ComBitPosition=296, ComBitSize=8, ComSignalInitValue=0, ComSignalType=UINT8, ComHandleId=4071, ComSystemTemplateSystemSignalRef=DET_ELEVATION_195
            DET_SNR_196_oRDR_DETECTION_193_196_oPCAN_RADAR_facceafa_Tx: ComBitPosition=456, ComBitSize=8, ComSignalInitValue=0, ComSignalType=UINT8, ComHandleId=4123, ComSystemTemplateSystemSignalRef=DET_SNR_196
            DET_CONFD_ELEVATION_193_oRDR_DETECTION_193_196_oPCAN_RADAR_688cbf0e_Tx: ComBitPosition=101, ComBitSize=2, ComSignalInitValue=0, ComSignalType=UINT8, ComHandleId=4065, ComSystemTemplateSystemSignalRef=DET_CONFD_ELEVATION_193
            DET_PROB_1STAZHYPO_196_oRDR_DETECTION_193_196_oPCAN_RADAR_deeba8f1_Tx: ComBitPosition=439, ComBitSize=1, ComSignalInitValue=0, ComSignalType=BOOLEAN, ComHandleId=4099, ComSystemTemplateSystemSignalRef=DET_PROB_1STAZHYPO_196
            DET_PROB_1STAZHYPO_194_oRDR_DETECTION_193_196_oPCAN_RADAR_2f7b079a_Tx: ComBitPosition=215, ComBitSize=1, ComSignalInitValue=0, ComSignalType=BOOLEAN, ComHandleId=4097, ComSystemTemplateSystemSignalRef=DET_PROB_1STAZHYPO_194
            DET_BELOW_RAIN_THOLD_194_oRDR_DETECTION_193_196_oPCAN_RADAR_e14e0497_Tx: ComBitPosition=151, ComBitSize=1, ComSignalInitValue=0, ComSignalType=UINT8, ComHandleId=4054, ComSystemTemplateSystemSignalRef=DET_BELOW_RAIN_THOLD_194
            DET_IDM_194_oRDR_DETECTION_193_196_oPCAN_RADAR_da7cdd8c_Tx: ComBitPosition=175, ComBitSize=1, ComSignalInitValue=0, ComSignalType=UINT8, ComHandleId=4086, ComSystemTemplateSystemSignalRef=DET_IDM_194
            DET_MTD_195_oRDR_DETECTION_193_196_oPCAN_RADAR_29bf3bc2_Tx: ComBitPosition=271, ComBitSize=1, ComSignalInitValue=0, ComSignalType=UINT8, ComHandleId=4094, ComSystemTemplateSystemSignalRef=DET_MTD_195
            DET_MTD_196_oRDR_DETECTION_193_196_oPCAN_RADAR_4d5f403c_Tx: ComBitPosition=383, ComBitSize=1, ComSignalInitValue=0, ComSignalType=UINT8, ComHandleId=4095, ComSystemTemplateSystemSignalRef=DET_MTD_196
            DET_PROB_1STAZHYPO_193_oRDR_DETECTION_193_196_oPCAN_RADAR_73cb24f3_Tx: ComBitPosition=103, ComBitSize=1, ComSignalInitValue=0, ComSignalType=BOOLEAN, ComHandleId=4096, ComSystemTemplateSystemSignalRef=DET_PROB_1STAZHYPO_193
            DET_IDM_195_oRDR_DETECTION_193_196_oPCAN_RADAR_4f0c0919_Tx: ComBitPosition=287, ComBitSize=1, ComSignalInitValue=0, ComSignalType=UINT8, ComHandleId=4087, ComSystemTemplateSystemSignalRef=DET_IDM_195
            DET_MTD_194_oRDR_DETECTION_193_196_oPCAN_RADAR_bccfef57_Tx: ComBitPosition=159, ComBitSize=1, ComSignalInitValue=0, ComSignalType=UINT8, ComHandleId=4093, ComSystemTemplateSystemSignalRef=DET_MTD_194
            DET_IDM_196_oRDR_DETECTION_193_196_oPCAN_RADAR_2bec72e7_Tx: ComBitPosition=399, ComBitSize=1, ComSignalInitValue=0, ComSignalType=UINT8, ComHandleId=4088, ComSystemTemplateSystemSignalRef=DET_IDM_196
            DET_BELOW_RAIN_THOLD_195_oRDR_DETECTION_193_196_oPCAN_RADAR_743ed002_Tx: ComBitPosition=263, ComBitSize=1, ComSignalInitValue=0, ComSignalType=UINT8, ComHandleId=4055, ComSystemTemplateSystemSignalRef=DET_BELOW_RAIN_THOLD_195
            DET_BELOW_RAIN_THOLD_193_oRDR_DETECTION_193_196_oPCAN_RADAR_bdfe27fe_Tx: ComBitPosition=39, ComBitSize=1, ComSignalInitValue=0, ComSignalType=UINT8, ComHandleId=4053, ComSystemTemplateSystemSignalRef=DET_BELOW_RAIN_THOLD_193
            DET_BELOW_RAIN_THOLD_196_oRDR_DETECTION_193_196_oPCAN_RADAR_10deabfc_Tx: ComBitPosition=375, ComBitSize=1, ComSignalInitValue=0, ComSignalType=UINT8, ComHandleId=4056, ComSystemTemplateSystemSignalRef=DET_BELOW_RAIN_THOLD_196
            DET_PROB_1STAZHYPO_195_oRDR_DETECTION_193_196_oPCAN_RADAR_ba0bd30f_Tx: ComBitPosition=327, ComBitSize=1, ComSignalInitValue=0, ComSignalType=BOOLEAN, ComHandleId=4098, ComSystemTemplateSystemSignalRef=DET_PROB_1STAZHYPO_195
            DET_MTD_193_oRDR_DETECTION_193_196_oPCAN_RADAR_e07fcc3e_Tx: ComBitPosition=47, ComBitSize=1, ComSignalInitValue=0, ComSignalType=UINT8, ComHandleId=4092, ComSystemTemplateSystemSignalRef=DET_MTD_193
            DET_IDM_193_oRDR_DETECTION_193_196_oPCAN_RADAR_86ccfee5_Tx: ComBitPosition=63, ComBitSize=1, ComSignalInitValue=0, ComSignalType=UINT8, ComHandleId=4085, ComSystemTemplateSystemSignalRef=DET_IDM_193
        SG_Detections_381_384_oRDR_DETECTION_381_384_oPCAN_RADAR_cd667329_Tx: ComTransferProperty=TRIGGERED, ComHandleId=97, ComSystemTemplateSignalGroupRef=SG_Detections_381_384
          83 x ComGroupSignal, all with ComSignalEndianness=LITTLE_ENDIAN, ComTransferProperty=PENDING, ComSignalAccess=ACCESS_NEEDED_BY_SWC_OR_COM:
            DET_RANGE_ERR_383_oRDR_DETECTION_381_384_oPCAN_RADAR_8513520d_Tx: ComBitPosition=264, ComBitSize=7, ComSignalInitValue=0, ComSignalType=UINT8, ComHandleId=8007, ComSystemTemplateSystemSignalRef=DET_RANGE_ERR_383
            DET_RANGE_VELOCITY_383_oRDR_DETECTION_381_384_oPCAN_RADAR_575d2a41_Tx: ComBitPosition=272, ComBitSize=15, ComSignalInitValue=16384, ComSignalType=UINT16, ComHandleId=8011, ComSystemTemplateSystemSignalRef=DET_RANGE_VELOCITY_383
            DET_HVC_FLAG_383_oRDR_DETECTION_381_384_oPCAN_RADAR_5701eab9_Tx: ComBitPosition=310, ComBitSize=1, ComSignalInitValue=0, ComSignalType=BOOLEAN, ComHandleId=7984, ComSystemTemplateSystemSignalRef=DET_HVC_FLAG_383
            DET_CONFD_AZIMUTH_381_oRDR_DETECTION_381_384_oPCAN_RADAR_c1163e7e_Tx: ComBitPosition=118, ComBitSize=2, ComSignalInitValue=0, ComSignalType=UINT8, ComHandleId=7962, ComSystemTemplateSystemSignalRef=DET_CONFD_AZIMUTH_381
            DET_RANGE_384_oRDR_DETECTION_381_384_oPCAN_RADAR_7e4bcb0d_Tx: ComBitPosition=360, ComBitSize=15, ComSignalInitValue=0, ComSignalType=UINT16, ComHandleId=8004, ComSystemTemplateSystemSignalRef=DET_RANGE_384
            DET_RANGE_381_oRDR_DETECTION_381_384_oPCAN_RADAR_d36b470f_Tx: ComBitPosition=24, ComBitSize=15, ComSignalInitValue=0, ComSignalType=UINT16, ComHandleId=8001, ComSystemTemplateSystemSignalRef=DET_RANGE_381
            DET_ELEVATION_381_oRDR_DETECTION_381_384_oPCAN_RADAR_1243ebb8_Tx: ComBitPosition=72, ComBitSize=8, ComSignalInitValue=0, ComSignalType=UINT8, ComHandleId=7970, ComSystemTemplateSystemSignalRef=DET_ELEVATION_381
            DET_SNR_381_oRDR_DETECTION_381_384_oPCAN_RADAR_fce3e672_Tx: ComBitPosition=120, ComBitSize=8, ComSignalInitValue=0, ComSignalType=UINT8, ComHandleId=8021, ComSystemTemplateSystemSignalRef=DET_SNR_381
            DET_CONFD_ELEVATION_384_oRDR_DETECTION_381_384_oPCAN_RADAR_6ea3b386_Tx: ComBitPosition=437, ComBitSize=2, ComSignalInitValue=0, ComSignalType=UINT8, ComHandleId=7969, ComSystemTemplateSystemSignalRef=DET_CONFD_ELEVATION_384
            DET_AZIMUTH_384_oRDR_DETECTION_381_384_oPCAN_RADAR_6ed0b8b6_Tx: ComBitPosition=424, ComBitSize=13, ComSignalInitValue=0, ComSignalType=UINT16, ComHandleId=7949, ComSystemTemplateSystemSignalRef=DET_AZIMUTH_384
            DET_ELEVATION_ERR_384_oRDR_DETECTION_381_384_oPCAN_RADAR_385affcf_Tx: ComBitPosition=416, ComBitSize=6, ComSignalInitValue=0, ComSignalType=UINT8, ComHandleId=7977, ComSystemTemplateSystemSignalRef=DET_ELEVATION_ERR_384
            DET_RCS_383_oRDR_DETECTION_381_384_oPCAN_RADAR_d0dd1d1b_Tx: ComBitPosition=352, ComBitSize=8, ComSignalInitValue=128, ComSignalType=UINT8, ComHandleId=8019, ComSystemTemplateSystemSignalRef=DET_RCS_383
            DET_CONFD_AZIMUTH_384_oRDR_DETECTION_381_384_oPCAN_RADAR_6c36b27c_Tx: ComBitPosition=454, ComBitSize=2, ComSignalInitValue=0, ComSignalType=UINT8, ComHandleId=7965, ComSystemTemplateSystemSignalRef=DET_CONFD_AZIMUTH_384
            DET_CONFD_AZIMUTH_382_oRDR_DETECTION_381_384_oPCAN_RADAR_a5f64580_Tx: ComBitPosition=230, ComBitSize=2, ComSignalInitValue=0, ComSignalType=UINT8, ComHandleId=7963, ComSystemTemplateSystemSignalRef=DET_CONFD_AZIMUTH_382
            DET_SNR_383_oRDR_DETECTION_381_384_oPCAN_RADAR_0d734919_Tx: ComBitPosition=344, ComBitSize=8, ComSignalInitValue=0, ComSignalType=UINT8, ComHandleId=8023, ComSystemTemplateSystemSignalRef=DET_SNR_383
            DET_RANGE_ERR_382_oRDR_DETECTION_381_384_oPCAN_RADAR_10638698_Tx: ComBitPosition=152, ComBitSize=7, ComSignalInitValue=0, ComSignalType=UINT8, ComHandleId=8006, ComSystemTemplateSystemSignalRef=DET_RANGE_ERR_382
            DET_SNR_382_oRDR_DETECTION_381_384_oPCAN_RADAR_98039d8c_Tx: ComBitPosition=232, ComBitSize=8, ComSignalInitValue=0, ComSignalType=UINT8, ComHandleId=8022, ComSystemTemplateSystemSignalRef=DET_SNR_382
            DET_SNR_384_oRDR_DETECTION_381_384_oPCAN_RADAR_51c36a70_Tx: ComBitPosition=456, ComBitSize=8, ComSignalInitValue=0, ComSignalType=UINT8, ComHandleId=8024, ComSystemTemplateSystemSignalRef=DET_SNR_384
            DET_RCS_381_oRDR_DETECTION_381_384_oPCAN_RADAR_214db270_Tx: ComBitPosition=128, ComBitSize=8, ComSignalInitValue=128, ComSignalType=UINT8, ComHandleId=8017, ComSystemTemplateSystemSignalRef=DET_RCS_381
            DET_AZIMUTH_383_oRDR_DETECTION_381_384_oPCAN_RADAR_32609bdf_Tx: ComBitPosition=312, ComBitSize=13, ComSignalInitValue=0, ComSignalType=UINT16, ComHandleId=7948, ComSystemTemplateSystemSignalRef=DET_AZIMUTH_383
            DET_RANGE_ERR_381_oRDR_DETECTION_381_384_oPCAN_RADAR_7483fd66_Tx: ComBitPosition=40, ComBitSize=7, ComSignalInitValue=0, ComSignalType=UINT8, ComHandleId=8005, ComSystemTemplateSystemSignalRef=DET_RANGE_ERR_381
            DET_RANGE_VELOCITY_ERR_381_oRDR_DETECTION_381_384_oPCAN_RADAR_a9767e98_Tx: ComBitPosition=64, ComBitSize=8, ComSignalInitValue=0, ComSignalType=UINT8, ComHandleId=8013, ComSystemTemplateSystemSignalRef=DET_RANGE_VELOCITY_ERR_381
            DET_RANGE_383_oRDR_DETECTION_381_384_oPCAN_RADAR_22fbe864_Tx: ComBitPosition=248, ComBitSize=15, ComSignalInitValue=0, ComSignalType=UINT16, ComHandleId=8003, ComSystemTemplateSystemSignalRef=DET_RANGE_383
            DET_SUPER_RES_TARGET_381_oRDR_DETECTION_381_384_oPCAN_RADAR_cd7ace17_Tx: ComBitPosition=87, ComBitSize=1, ComSignalInitValue=0, ComSignalType=BOOLEAN, ComHandleId=8025, ComSystemTemplateSystemSignalRef=DET_SUPER_RES_TARGET_381
            DET_SUPER_RES_TARGET_382_oRDR_DETECTION_381_384_oPCAN_RADAR_a99ab5e9_Tx: ComBitPosition=199, ComBitSize=1, ComSignalInitValue=0, ComSignalType=BOOLEAN, ComHandleId=8026, ComSystemTemplateSystemSignalRef=DET_SUPER_RES_TARGET_382
            DET_BI_STATIC_FLAG_382_oRDR_DETECTION_381_384_oPCAN_RADAR_f13c0fcf_Tx: ComBitPosition=216, ComBitSize=1, ComSignalInitValue=0, ComSignalType=BOOLEAN, ComHandleId=7959, ComSystemTemplateSystemSignalRef=DET_BI_STATIC_FLAG_382
            DET_EXISTENCE_PROB_382_oRDR_DETECTION_381_384_oPCAN_RADAR_23057d53_Tx: ComBitPosition=224, ComBitSize=6, ComSignalInitValue=0, ComSignalType=UINT8, ComHandleId=7979, ComSystemTemplateSystemSignalRef=DET_EXISTENCE_PROB_382
            DET_MH_CYCLE_COUNTER_381_384_oRDR_DETECTION_381_384_oPCAN_RADAR_cd9b0015_Tx: ComBitPosition=16, ComBitSize=8, ComSignalInitValue=0, ComSignalType=UINT8, ComHandleId=7991, ComSystemTemplateSystemSignalRef=DET_MH_CYCLE_COUNTER_381_384
            DET_RANGE_ERR_384_oRDR_DETECTION_381_384_oPCAN_RADAR_d9a37164_Tx: ComBitPosition=376, ComBitSize=7, ComSignalInitValue=0, ComSignalType=UINT8, ComHandleId=8008, ComSystemTemplateSystemSignalRef=DET_RANGE_ERR_384
            DET_AZIMUTH_381_oRDR_DETECTION_381_384_oPCAN_RADAR_c3f034b4_Tx: ComBitPosition=88, ComBitSize=13, ComSignalInitValue=0, ComSignalType=UINT16, ComHandleId=7946, ComSystemTemplateSystemSignalRef=DET_AZIMUTH_381
            DET_RCS_382_oRDR_DETECTION_381_384_oPCAN_RADAR_45adc98e_Tx: ComBitPosition=240, ComBitSize=8, ComSignalInitValue=128, ComSignalType=UINT8, ComHandleId=8018, ComSystemTemplateSystemSignalRef=DET_RCS_382
            DET_AZIMUTH_ERR_382_oRDR_DETECTION_381_384_oPCAN_RADAR_03a5dabf_Tx: ComBitPosition=217, ComBitSize=7, ComSignalInitValue=0, ComSignalType=UINT8, ComHandleId=7951, ComSystemTemplateSystemSignalRef=DET_AZIMUTH_ERR_382
            DET_AZIMUTH_ERR_381_oRDR_DETECTION_381_384_oPCAN_RADAR_6745a141_Tx: ComBitPosition=105, ComBitSize=7, ComSignalInitValue=0, ComSignalType=UINT8, ComHandleId=7950, ComSystemTemplateSystemSignalRef=DET_AZIMUTH_ERR_381
            DET_AZIMUTH_ERR_384_oRDR_DETECTION_381_384_oPCAN_RADAR_ca652d43_Tx: ComBitPosition=441, ComBitSize=7, ComSignalInitValue=0, ComSignalType=UINT8, ComHandleId=7953, ComSystemTemplateSystemSignalRef=DET_AZIMUTH_ERR_384
            DET_RANGE_VELOCITY_ERR_384_oRDR_DETECTION_381_384_oPCAN_RADAR_0456f29a_Tx: ComBitPosition=400, ComBitSize=8, ComSignalInitValue=0, ComSignalType=UINT8, ComHandleId=8016, ComSystemTemplateSystemSignalRef=DET_RANGE_VELOCITY_ERR_384
            DET_ELEVATION_ERR_383_oRDR_DETECTION_381_384_oPCAN_RADAR_64eadca6_Tx: ComBitPosition=304, ComBitSize=6, ComSignalInitValue=0, ComSignalType=UINT8, ComHandleId=7976, ComSystemTemplateSystemSignalRef=DET_ELEVATION_ERR_383
            DET_RCS_384_oRDR_DETECTION_381_384_oPCAN_RADAR_8c6d3e72_Tx: ComBitPosition=464, ComBitSize=8, ComSignalInitValue=128, ComSignalType=UINT8, ComHandleId=8020, ComSystemTemplateSystemSignalRef=DET_RCS_384
            DET_ELEVATION_382_oRDR_DETECTION_381_384_oPCAN_RADAR_76a39046_Tx: ComBitPosition=184, ComBitSize=8, ComSignalInitValue=0, ComSignalType=UINT8, ComHandleId=7971, ComSystemTemplateSystemSignalRef=DET_ELEVATION_382
            DET_EXISTENCE_PROB_383_oRDR_DETECTION_381_384_oPCAN_RADAR_b675a9c6_Tx: ComBitPosition=336, ComBitSize=6, ComSignalInitValue=0, ComSignalType=UINT8, ComHandleId=7980, ComSystemTemplateSystemSignalRef=DET_EXISTENCE_PROB_383
            DET_HVC_FLAG_384_oRDR_DETECTION_381_384_oPCAN_RADAR_0bb1c9d0_Tx: ComBitPosition=422, ComBitSize=1, ComSignalInitValue=0, ComSignalType=BOOLEAN, ComHandleId=7985, ComSystemTemplateSystemSignalRef=DET_HVC_FLAG_384
            DET_ELEVATION_ERR_381_oRDR_DETECTION_381_384_oPCAN_RADAR_957a73cd_Tx: ComBitPosition=80, ComBitSize=6, ComSignalInitValue=0, ComSignalType=UINT8, ComHandleId=7974, ComSystemTemplateSystemSignalRef=DET_ELEVATION_ERR_381
            DET_SUPER_RES_TARGET_384_oRDR_DETECTION_381_384_oPCAN_RADAR_605a4215_Tx: ComBitPosition=423, ComBitSize=1, ComSignalInitValue=0, ComSignalType=BOOLEAN, ComHandleId=8028, ComSystemTemplateSystemSignalRef=DET_SUPER_RES_TARGET_384
            DET_BI_STATIC_FLAG_384_oRDR_DETECTION_381_384_oPCAN_RADAR_38fcf833_Tx: ComBitPosition=440, ComBitSize=1, ComSignalInitValue=0, ComSignalType=BOOLEAN, ComHandleId=7961, ComSystemTemplateSystemSignalRef=DET_BI_STATIC_FLAG_384
            DET_EXISTENCE_PROB_381_oRDR_DETECTION_381_384_oPCAN_RADAR_47e506ad_Tx: ComBitPosition=112, ComBitSize=6, ComSignalInitValue=0, ComSignalType=UINT8, ComHandleId=7978, ComSystemTemplateSystemSignalRef=DET_EXISTENCE_PROB_381
            DET_AZIMUTH_ERR_383_oRDR_DETECTION_381_384_oPCAN_RADAR_96d50e2a_Tx: ComBitPosition=329, ComBitSize=7, ComSignalInitValue=0, ComSignalType=UINT8, ComHandleId=7952, ComSystemTemplateSystemSignalRef=DET_AZIMUTH_ERR_383
            DET_RANGE_VELOCITY_ERR_382_oRDR_DETECTION_381_384_oPCAN_RADAR_cd960566_Tx: ComBitPosition=176, ComBitSize=8, ComSignalInitValue=0, ComSignalType=UINT8, ComHandleId=8014, ComSystemTemplateSystemSignalRef=DET_RANGE_VELOCITY_ERR_382
            DET_CONFD_AZIMUTH_383_oRDR_DETECTION_381_384_oPCAN_RADAR_30869115_Tx: ComBitPosition=342, ComBitSize=2, ComSignalInitValue=0, ComSignalType=UINT8, ComHandleId=7964, ComSystemTemplateSystemSignalRef=DET_CONFD_AZIMUTH_383
            DET_RANGE_382_oRDR_DETECTION_381_384_oPCAN_RADAR_b78b3cf1_Tx: ComBitPosition=136, ComBitSize=15, ComSignalInitValue=0, ComSignalType=UINT16, ComHandleId=8002, ComSystemTemplateSystemSignalRef=DET_RANGE_382
            DET_MH_SCAN_INDEX_4LSB_381_384_oRDR_DETECTION_381_384_oPCAN_RADAR_01b12599_Tx: ComBitPosition=476, ComBitSize=4, ComSignalInitValue=0, ComSignalType=UINT8, ComHandleId=7992, ComSystemTemplateSystemSignalRef=DET_MH_SCAN_INDEX_4LSB_381_384
            DET_RANGE_VELOCITY_ERR_383_oRDR_DETECTION_381_384_oPCAN_RADAR_58e6d1f3_Tx: ComBitPosition=288, ComBitSize=8, ComSignalInitValue=0, ComSignalType=UINT8, ComHandleId=8015, ComSystemTemplateSystemSignalRef=DET_RANGE_VELOCITY_ERR_383
            DET_BI_STATIC_FLAG_383_oRDR_DETECTION_381_384_oPCAN_RADAR_644cdb5a_Tx: ComBitPosition=328, ComBitSize=1, ComSignalInitValue=0, ComSignalType=BOOLEAN, ComHandleId=7960, ComSystemTemplateSystemSignalRef=DET_BI_STATIC_FLAG_383
            DET_ELEVATION_ERR_382_oRDR_DETECTION_381_384_oPCAN_RADAR_f19a0833_Tx: ComBitPosition=192, ComBitSize=6, ComSignalInitValue=0, ComSignalType=UINT8, ComHandleId=7975, ComSystemTemplateSystemSignalRef=DET_ELEVATION_ERR_382
            DET_CONFD_ELEVATION_381_oRDR_DETECTION_381_384_oPCAN_RADAR_c3833f84_Tx: ComBitPosition=101, ComBitSize=2, ComSignalInitValue=0, ComSignalType=UINT8, ComHandleId=7966, ComSystemTemplateSystemSignalRef=DET_CONFD_ELEVATION_381
            DET_HVC_FLAG_382_oRDR_DETECTION_381_384_oPCAN_RADAR_c2713e2c_Tx: ComBitPosition=198, ComBitSize=1, ComSignalInitValue=0, ComSignalType=BOOLEAN, ComHandleId=7983, ComSystemTemplateSystemSignalRef=DET_HVC_FLAG_382
            DET_CONFD_ELEVATION_382_oRDR_DETECTION_381_384_oPCAN_RADAR_a763447a_Tx: ComBitPosition=213, ComBitSize=2, ComSignalInitValue=0, ComSignalType=UINT8, ComHandleId=7967, ComSystemTemplateSystemSignalRef=DET_CONFD_ELEVATION_382
            DET_MH_CRC16_381_384_oRDR_DETECTION_381_384_oPCAN_RADAR_49eea122_Tx: ComBitPosition=0, ComBitSize=16, ComSignalInitValue=0, ComSignalType=UINT16, ComHandleId=7990, ComSystemTemplateSystemSignalRef=DET_MH_CRC16_381_384
            DET_AZIMUTH_382_oRDR_DETECTION_381_384_oPCAN_RADAR_a7104f4a_Tx: ComBitPosition=200, ComBitSize=13, ComSignalInitValue=0, ComSignalType=UINT16, ComHandleId=7947, ComSystemTemplateSystemSignalRef=DET_AZIMUTH_382
            DET_ELEVATION_383_oRDR_DETECTION_381_384_oPCAN_RADAR_e3d344d3_Tx: ComBitPosition=296, ComBitSize=8, ComSignalInitValue=0, ComSignalType=UINT8, ComHandleId=7972, ComSystemTemplateSystemSignalRef=DET_ELEVATION_383
            DET_ELEVATION_384_oRDR_DETECTION_381_384_oPCAN_RADAR_bf6367ba_Tx: ComBitPosition=408, ComBitSize=8, ComSignalInitValue=0, ComSignalType=UINT8, ComHandleId=7973, ComSystemTemplateSystemSignalRef=DET_ELEVATION_384
            DET_BI_STATIC_FLAG_381_oRDR_DETECTION_381_384_oPCAN_RADAR_95dc7431_Tx: ComBitPosition=104, ComBitSize=1, ComSignalInitValue=0, ComSignalType=BOOLEAN, ComHandleId=7958, ComSystemTemplateSystemSignalRef=DET_BI_STATIC_FLAG_381
            DET_RANGE_VELOCITY_384_oRDR_DETECTION_381_384_oPCAN_RADAR_0bed0928_Tx: ComBitPosition=384, ComBitSize=15, ComSignalInitValue=16384, ComSignalType=UINT16, ComHandleId=8012, ComSystemTemplateSystemSignalRef=DET_RANGE_VELOCITY_384
            DET_CONFD_ELEVATION_383_oRDR_DETECTION_381_384_oPCAN_RADAR_321390ef_Tx: ComBitPosition=325, ComBitSize=2, ComSignalInitValue=0, ComSignalType=UINT8, ComHandleId=7968, ComSystemTemplateSystemSignalRef=DET_CONFD_ELEVATION_383
            DET_HVC_FLAG_381_oRDR_DETECTION_381_384_oPCAN_RADAR_a69145d2_Tx: ComBitPosition=86, ComBitSize=1, ComSignalInitValue=0, ComSignalType=BOOLEAN, ComHandleId=7982, ComSystemTemplateSystemSignalRef=DET_HVC_FLAG_381
            DET_EXISTENCE_PROB_384_oRDR_DETECTION_381_384_oPCAN_RADAR_eac58aaf_Tx: ComBitPosition=448, ComBitSize=6, ComSignalInitValue=0, ComSignalType=UINT8, ComHandleId=7981, ComSystemTemplateSystemSignalRef=DET_EXISTENCE_PROB_384
            DET_RANGE_VELOCITY_381_oRDR_DETECTION_381_384_oPCAN_RADAR_a6cd852a_Tx: ComBitPosition=48, ComBitSize=15, ComSignalInitValue=16384, ComSignalType=UINT16, ComHandleId=8009, ComSystemTemplateSystemSignalRef=DET_RANGE_VELOCITY_381
            DET_SUPER_RES_TARGET_383_oRDR_DETECTION_381_384_oPCAN_RADAR_3cea617c_Tx: ComBitPosition=311, ComBitSize=1, ComSignalInitValue=0, ComSignalType=BOOLEAN, ComHandleId=8027, ComSystemTemplateSystemSignalRef=DET_SUPER_RES_TARGET_383
            DET_RANGE_VELOCITY_382_oRDR_DETECTION_381_384_oPCAN_RADAR_c22dfed4_Tx: ComBitPosition=160, ComBitSize=15, ComSignalInitValue=16384, ComSignalType=UINT16, ComHandleId=8010, ComSystemTemplateSystemSignalRef=DET_RANGE_VELOCITY_382
            DET_PROB_1STAZHYPO_381_oRDR_DETECTION_381_384_oPCAN_RADAR_d8c4a479_Tx: ComBitPosition=103, ComBitSize=1, ComSignalInitValue=0, ComSignalType=BOOLEAN, ComHandleId=7997, ComSystemTemplateSystemSignalRef=DET_PROB_1STAZHYPO_381
            DET_PROB_1STAZHYPO_383_oRDR_DETECTION_381_384_oPCAN_RADAR_29540b12_Tx: ComBitPosition=327, ComBitSize=1, ComSignalInitValue=0, ComSignalType=BOOLEAN, ComHandleId=7999, ComSystemTemplateSystemSignalRef=DET_PROB_1STAZHYPO_383
            DET_MTD_383_oRDR_DETECTION_381_384_oPCAN_RADAR_bae0e3df_Tx: ComBitPosition=271, ComBitSize=1, ComSignalInitValue=0, ComSignalType=UINT8, ComHandleId=7995, ComSystemTemplateSystemSignalRef=DET_MTD_383
            DET_BELOW_RAIN_THOLD_383_oRDR_DETECTION_381_384_oPCAN_RADAR_e761081f_Tx: ComBitPosition=263, ComBitSize=1, ComSignalInitValue=0, ComSignalType=UINT8, ComHandleId=7956, ComSystemTemplateSystemSignalRef=DET_BELOW_RAIN_THOLD_383
            DET_MTD_382_oRDR_DETECTION_381_384_oPCAN_RADAR_2f90374a_Tx: ComBitPosition=159, ComBitSize=1, ComSignalInitValue=0, ComSignalType=UINT8, ComHandleId=7994, ComSystemTemplateSystemSignalRef=DET_MTD_382
            DET_MTD_381_oRDR_DETECTION_381_384_oPCAN_RADAR_4b704cb4_Tx: ComBitPosition=47, ComBitSize=1, ComSignalInitValue=0, ComSignalType=UINT8, ComHandleId=7993, ComSystemTemplateSystemSignalRef=DET_MTD_381
            DET_BELOW_RAIN_THOLD_384_oRDR_DETECTION_381_384_oPCAN_RADAR_bbd12b76_Tx: ComBitPosition=375, ComBitSize=1, ComSignalInitValue=0, ComSignalType=UINT8, ComHandleId=7957, ComSystemTemplateSystemSignalRef=DET_BELOW_RAIN_THOLD_384
            DET_MTD_384_oRDR_DETECTION_381_384_oPCAN_RADAR_e650c0b6_Tx: ComBitPosition=383, ComBitSize=1, ComSignalInitValue=0, ComSignalType=UINT8, ComHandleId=7996, ComSystemTemplateSystemSignalRef=DET_MTD_384
            DET_PROB_1STAZHYPO_382_oRDR_DETECTION_381_384_oPCAN_RADAR_bc24df87_Tx: ComBitPosition=215, ComBitSize=1, ComSignalInitValue=0, ComSignalType=BOOLEAN, ComHandleId=7998, ComSystemTemplateSystemSignalRef=DET_PROB_1STAZHYPO_382
            DET_BELOW_RAIN_THOLD_382_oRDR_DETECTION_381_384_oPCAN_RADAR_7211dc8a_Tx: ComBitPosition=151, ComBitSize=1, ComSignalInitValue=0, ComSignalType=UINT8, ComHandleId=7955, ComSystemTemplateSystemSignalRef=DET_BELOW_RAIN_THOLD_382
            DET_IDM_383_oRDR_DETECTION_381_384_oPCAN_RADAR_dc53d104_Tx: ComBitPosition=287, ComBitSize=1, ComSignalInitValue=0, ComSignalType=UINT8, ComHandleId=7988, ComSystemTemplateSystemSignalRef=DET_IDM_383
            DET_IDM_382_oRDR_DETECTION_381_384_oPCAN_RADAR_49230591_Tx: ComBitPosition=175, ComBitSize=1, ComSignalInitValue=0, ComSignalType=UINT8, ComHandleId=7987, ComSystemTemplateSystemSignalRef=DET_IDM_382
            DET_PROB_1STAZHYPO_384_oRDR_DETECTION_381_384_oPCAN_RADAR_75e4287b_Tx: ComBitPosition=439, ComBitSize=1, ComSignalInitValue=0, ComSignalType=BOOLEAN, ComHandleId=8000, ComSystemTemplateSystemSignalRef=DET_PROB_1STAZHYPO_384
            DET_IDM_384_oRDR_DETECTION_381_384_oPCAN_RADAR_80e3f26d_Tx: ComBitPosition=399, ComBitSize=1, ComSignalInitValue=0, ComSignalType=UINT8, ComHandleId=7989, ComSystemTemplateSystemSignalRef=DET_IDM_384
            DET_IDM_381_oRDR_DETECTION_381_384_oPCAN_RADAR_2dc37e6f_Tx: ComBitPosition=63, ComBitSize=1, ComSignalInitValue=0, ComSignalType=UINT8, ComHandleId=7986, ComSystemTemplateSystemSignalRef=DET_IDM_381
            DET_BELOW_RAIN_THOLD_381_oRDR_DETECTION_381_384_oPCAN_RADAR_16f1a774_Tx: ComBitPosition=39, ComBitSize=1, ComSignalInitValue=0, ComSignalType=UINT8, ComHandleId=7954, ComSystemTemplateSystemSignalRef=DET_BELOW_RAIN_THOLD_381
        SG_Detections_229_232_oRDR_DETECTION_229_232_oPCAN_RADAR_87d460a6_Tx: ComTransferProperty=TRIGGERED, ComHandleId=59, ComSystemTemplateSignalGroupRef=SG_Detections_229_232
          83 x ComGroupSignal, all with ComSignalEndianness=LITTLE_ENDIAN, ComTransferProperty=PENDING, ComSignalAccess=ACCESS_NEEDED_BY_SWC_OR_COM:
            DET_HVC_FLAG_230_oRDR_DETECTION_229_232_oPCAN_RADAR_4dffcb2a_Tx: ComBitPosition=198, ComBitSize=1, ComSignalInitValue=0, ComSignalType=BOOLEAN, ComHandleId=4829, ComSystemTemplateSystemSignalRef=DET_HVC_FLAG_230
            DET_CONFD_AZIMUTH_231_oRDR_DETECTION_229_232_oPCAN_RADAR_bf086413_Tx: ComBitPosition=342, ComBitSize=2, ComSignalInitValue=0, ComSignalType=UINT8, ComHandleId=4810, ComSystemTemplateSystemSignalRef=DET_CONFD_AZIMUTH_231
            DET_RCS_230_oRDR_DETECTION_229_232_oPCAN_RADAR_ca233c88_Tx: ComBitPosition=240, ComBitSize=8, ComSignalInitValue=128, ComSignalType=UINT8, ComHandleId=4864, ComSystemTemplateSystemSignalRef=DET_RCS_230
            DET_RANGE_VELOCITY_231_oRDR_DETECTION_229_232_oPCAN_RADAR_d8d3df47_Tx: ComBitPosition=272, ComBitSize=15, ComSignalInitValue=16384, ComSignalType=UINT16, ComHandleId=4857, ComSystemTemplateSystemSignalRef=DET_RANGE_VELOCITY_231
            DET_RANGE_ERR_229_oRDR_DETECTION_229_232_oPCAN_RADAR_facd013a_Tx: ComBitPosition=40, ComBitSize=7, ComSignalInitValue=0, ComSignalType=UINT8, ComHandleId=4851, ComSystemTemplateSystemSignalRef=DET_RANGE_ERR_229
            DET_HVC_FLAG_231_oRDR_DETECTION_229_232_oPCAN_RADAR_d88f1fbf_Tx: ComBitPosition=310, ComBitSize=1, ComSignalInitValue=0, ComSignalType=BOOLEAN, ComHandleId=4830, ComSystemTemplateSystemSignalRef=DET_HVC_FLAG_231
            DET_ELEVATION_ERR_229_oRDR_DETECTION_229_232_oPCAN_RADAR_1b348f91_Tx: ComBitPosition=80, ComBitSize=6, ComSignalInitValue=0, ComSignalType=UINT8, ComHandleId=4820, ComSystemTemplateSystemSignalRef=DET_ELEVATION_ERR_229
            DET_AZIMUTH_231_oRDR_DETECTION_229_232_oPCAN_RADAR_bdee6ed9_Tx: ComBitPosition=312, ComBitSize=13, ComSignalInitValue=0, ComSignalType=UINT16, ComHandleId=4794, ComSystemTemplateSystemSignalRef=DET_AZIMUTH_231
            DET_CONFD_ELEVATION_229_oRDR_DETECTION_229_232_oPCAN_RADAR_4dcdc3d8_Tx: ComBitPosition=101, ComBitSize=2, ComSignalInitValue=0, ComSignalType=UINT8, ComHandleId=4812, ComSystemTemplateSystemSignalRef=DET_CONFD_ELEVATION_229
            DET_EXISTENCE_PROB_230_oRDR_DETECTION_229_232_oPCAN_RADAR_ac8b8855_Tx: ComBitPosition=224, ComBitSize=6, ComSignalInitValue=0, ComSignalType=UINT8, ComHandleId=4825, ComSystemTemplateSystemSignalRef=DET_EXISTENCE_PROB_230
            DET_CONFD_AZIMUTH_232_oRDR_DETECTION_229_232_oPCAN_RADAR_dbe81fed_Tx: ComBitPosition=454, ComBitSize=2, ComSignalInitValue=0, ComSignalType=UINT8, ComHandleId=4811, ComSystemTemplateSystemSignalRef=DET_CONFD_AZIMUTH_232
            DET_AZIMUTH_229_oRDR_DETECTION_229_232_oPCAN_RADAR_4dbec8e8_Tx: ComBitPosition=88, ComBitSize=13, ComSignalInitValue=0, ComSignalType=UINT16, ComHandleId=4792, ComSystemTemplateSystemSignalRef=DET_AZIMUTH_229
            DET_ELEVATION_ERR_232_oRDR_DETECTION_229_232_oPCAN_RADAR_8f84525e_Tx: ComBitPosition=416, ComBitSize=6, ComSignalInitValue=0, ComSignalType=UINT8, ComHandleId=4823, ComSystemTemplateSystemSignalRef=DET_ELEVATION_ERR_232
            DET_MH_SCAN_INDEX_4LSB_229_232_oRDR_DETECTION_229_232_oPCAN_RADAR_4b033616_Tx: ComBitPosition=476, ComBitSize=4, ComSignalInitValue=0, ComSignalType=UINT8, ComHandleId=4838, ComSystemTemplateSystemSignalRef=DET_MH_SCAN_INDEX_4LSB_229_232
            DET_SNR_230_oRDR_DETECTION_229_232_oPCAN_RADAR_178d688a_Tx: ComBitPosition=232, ComBitSize=8, ComSignalInitValue=0, ComSignalType=UINT8, ComHandleId=4868, ComSystemTemplateSystemSignalRef=DET_SNR_230
            DET_RANGE_229_oRDR_DETECTION_229_232_oPCAN_RADAR_5d25bb53_Tx: ComBitPosition=24, ComBitSize=15, ComSignalInitValue=0, ComSignalType=UINT16, ComHandleId=4847, ComSystemTemplateSystemSignalRef=DET_RANGE_229
            DET_RANGE_ERR_232_oRDR_DETECTION_229_232_oPCAN_RADAR_6e7ddcf5_Tx: ComBitPosition=376, ComBitSize=7, ComSignalInitValue=0, ComSignalType=UINT8, ComHandleId=4854, ComSystemTemplateSystemSignalRef=DET_RANGE_ERR_232
            DET_RANGE_VELOCITY_ERR_231_oRDR_DETECTION_229_232_oPCAN_RADAR_d76824f5_Tx: ComBitPosition=288, ComBitSize=8, ComSignalInitValue=0, ComSignalType=UINT8, ComHandleId=4861, ComSystemTemplateSystemSignalRef=DET_RANGE_VELOCITY_ERR_231
            DET_MH_CRC16_229_232_oRDR_DETECTION_229_232_oPCAN_RADAR_035cb2ad_Tx: ComBitPosition=0, ComBitSize=16, ComSignalInitValue=0, ComSignalType=UINT16, ComHandleId=4836, ComSystemTemplateSystemSignalRef=DET_MH_CRC16_229_232
            DET_BI_STATIC_FLAG_230_oRDR_DETECTION_229_232_oPCAN_RADAR_7eb2fac9_Tx: ComBitPosition=216, ComBitSize=1, ComSignalInitValue=0, ComSignalType=BOOLEAN, ComHandleId=4805, ComSystemTemplateSystemSignalRef=DET_BI_STATIC_FLAG_230
            DET_RCS_229_oRDR_DETECTION_229_232_oPCAN_RADAR_af034e2c_Tx: ComBitPosition=128, ComBitSize=8, ComSignalInitValue=128, ComSignalType=UINT8, ComHandleId=4863, ComSystemTemplateSystemSignalRef=DET_RCS_229
            DET_AZIMUTH_232_oRDR_DETECTION_229_232_oPCAN_RADAR_d90e1527_Tx: ComBitPosition=424, ComBitSize=13, ComSignalInitValue=0, ComSignalType=UINT16, ComHandleId=4795, ComSystemTemplateSystemSignalRef=DET_AZIMUTH_232
            DET_EXISTENCE_PROB_229_oRDR_DETECTION_229_232_oPCAN_RADAR_c9abfaf1_Tx: ComBitPosition=112, ComBitSize=6, ComSignalInitValue=0, ComSignalType=UINT8, ComHandleId=4824, ComSystemTemplateSystemSignalRef=DET_EXISTENCE_PROB_229
            DET_CONFD_ELEVATION_230_oRDR_DETECTION_229_232_oPCAN_RADAR_28edb17c_Tx: ComBitPosition=213, ComBitSize=2, ComSignalInitValue=0, ComSignalType=UINT8, ComHandleId=4813, ComSystemTemplateSystemSignalRef=DET_CONFD_ELEVATION_230
            DET_ELEVATION_ERR_231_oRDR_DETECTION_229_232_oPCAN_RADAR_eb6429a0_Tx: ComBitPosition=304, ComBitSize=6, ComSignalInitValue=0, ComSignalType=UINT8, ComHandleId=4822, ComSystemTemplateSystemSignalRef=DET_ELEVATION_ERR_231
            DET_RANGE_230_oRDR_DETECTION_229_232_oPCAN_RADAR_3805c9f7_Tx: ComBitPosition=136, ComBitSize=15, ComSignalInitValue=0, ComSignalType=UINT16, ComHandleId=4848, ComSystemTemplateSystemSignalRef=DET_RANGE_230
            DET_RANGE_231_oRDR_DETECTION_229_232_oPCAN_RADAR_ad751d62_Tx: ComBitPosition=248, ComBitSize=15, ComSignalInitValue=0, ComSignalType=UINT16, ComHandleId=4849, ComSystemTemplateSystemSignalRef=DET_RANGE_231
            DET_SNR_231_oRDR_DETECTION_229_232_oPCAN_RADAR_82fdbc1f_Tx: ComBitPosition=344, ComBitSize=8, ComSignalInitValue=0, ComSignalType=UINT8, ComHandleId=4869, ComSystemTemplateSystemSignalRef=DET_SNR_231
            DET_CONFD_AZIMUTH_230_oRDR_DETECTION_229_232_oPCAN_RADAR_2a78b086_Tx: ComBitPosition=230, ComBitSize=2, ComSignalInitValue=0, ComSignalType=UINT8, ComHandleId=4809, ComSystemTemplateSystemSignalRef=DET_CONFD_AZIMUTH_230
            DET_AZIMUTH_ERR_232_oRDR_DETECTION_229_232_oPCAN_RADAR_7dbb80d2_Tx: ComBitPosition=441, ComBitSize=7, ComSignalInitValue=0, ComSignalType=UINT8, ComHandleId=4799, ComSystemTemplateSystemSignalRef=DET_AZIMUTH_ERR_232
            DET_SUPER_RES_TARGET_229_oRDR_DETECTION_229_232_oPCAN_RADAR_4334324b_Tx: ComBitPosition=87, ComBitSize=1, ComSignalInitValue=0, ComSignalType=BOOLEAN, ComHandleId=4871, ComSystemTemplateSystemSignalRef=DET_SUPER_RES_TARGET_229
            DET_ELEVATION_232_oRDR_DETECTION_229_232_oPCAN_RADAR_08bdca2b_Tx: ComBitPosition=408, ComBitSize=8, ComSignalInitValue=0, ComSignalType=UINT8, ComHandleId=4819, ComSystemTemplateSystemSignalRef=DET_ELEVATION_232
            DET_CONFD_ELEVATION_231_oRDR_DETECTION_229_232_oPCAN_RADAR_bd9d65e9_Tx: ComBitPosition=325, ComBitSize=2, ComSignalInitValue=0, ComSignalType=UINT8, ComHandleId=4814, ComSystemTemplateSystemSignalRef=DET_CONFD_ELEVATION_231
            DET_AZIMUTH_ERR_230_oRDR_DETECTION_229_232_oPCAN_RADAR_8c2b2fb9_Tx: ComBitPosition=217, ComBitSize=7, ComSignalInitValue=0, ComSignalType=UINT8, ComHandleId=4797, ComSystemTemplateSystemSignalRef=DET_AZIMUTH_ERR_230
            DET_RANGE_VELOCITY_232_oRDR_DETECTION_229_232_oPCAN_RADAR_bc33a4b9_Tx: ComBitPosition=384, ComBitSize=15, ComSignalInitValue=16384, ComSignalType=UINT16, ComHandleId=4858, ComSystemTemplateSystemSignalRef=DET_RANGE_VELOCITY_232
            DET_EXISTENCE_PROB_231_oRDR_DETECTION_229_232_oPCAN_RADAR_39fb5cc0_Tx: ComBitPosition=336, ComBitSize=6, ComSignalInitValue=0, ComSignalType=UINT8, ComHandleId=4826, ComSystemTemplateSystemSignalRef=DET_EXISTENCE_PROB_231
            DET_ELEVATION_230_oRDR_DETECTION_229_232_oPCAN_RADAR_f92d6540_Tx: ComBitPosition=184, ComBitSize=8, ComSignalInitValue=0, ComSignalType=UINT8, ComHandleId=4817, ComSystemTemplateSystemSignalRef=DET_ELEVATION_230
            DET_HVC_FLAG_232_oRDR_DETECTION_229_232_oPCAN_RADAR_bc6f6441_Tx: ComBitPosition=422, ComBitSize=1, ComSignalInitValue=0, ComSignalType=BOOLEAN, ComHandleId=4831, ComSystemTemplateSystemSignalRef=DET_HVC_FLAG_232
            DET_RANGE_232_oRDR_DETECTION_229_232_oPCAN_RADAR_c995669c_Tx: ComBitPosition=360, ComBitSize=15, ComSignalInitValue=0, ComSignalType=UINT16, ComHandleId=4850, ComSystemTemplateSystemSignalRef=DET_RANGE_232
            DET_CONFD_ELEVATION_232_oRDR_DETECTION_229_232_oPCAN_RADAR_d97d1e17_Tx: ComBitPosition=437, ComBitSize=2, ComSignalInitValue=0, ComSignalType=UINT8, ComHandleId=4815, ComSystemTemplateSystemSignalRef=DET_CONFD_ELEVATION_232
            DET_RANGE_VELOCITY_230_oRDR_DETECTION_229_232_oPCAN_RADAR_4da30bd2_Tx: ComBitPosition=160, ComBitSize=15, ComSignalInitValue=16384, ComSignalType=UINT16, ComHandleId=4856, ComSystemTemplateSystemSignalRef=DET_RANGE_VELOCITY_230
            DET_SNR_232_oRDR_DETECTION_229_232_oPCAN_RADAR_e61dc7e1_Tx: ComBitPosition=456, ComBitSize=8, ComSignalInitValue=0, ComSignalType=UINT8, ComHandleId=4870, ComSystemTemplateSystemSignalRef=DET_SNR_232
            DET_BI_STATIC_FLAG_229_oRDR_DETECTION_229_232_oPCAN_RADAR_1b92886d_Tx: ComBitPosition=104, ComBitSize=1, ComSignalInitValue=0, ComSignalType=BOOLEAN, ComHandleId=4804, ComSystemTemplateSystemSignalRef=DET_BI_STATIC_FLAG_229
            DET_RCS_232_oRDR_DETECTION_229_232_oPCAN_RADAR_3bb393e3_Tx: ComBitPosition=464, ComBitSize=8, ComSignalInitValue=128, ComSignalType=UINT8, ComHandleId=4866, ComSystemTemplateSystemSignalRef=DET_RCS_232
            DET_HVC_FLAG_229_oRDR_DETECTION_229_232_oPCAN_RADAR_28dfb98e_Tx: ComBitPosition=86, ComBitSize=1, ComSignalInitValue=0, ComSignalType=BOOLEAN, ComHandleId=4828, ComSystemTemplateSystemSignalRef=DET_HVC_FLAG_229
            DET_SUPER_RES_TARGET_230_oRDR_DETECTION_229_232_oPCAN_RADAR_261440ef_Tx: ComBitPosition=199, ComBitSize=1, ComSignalInitValue=0, ComSignalType=BOOLEAN, ComHandleId=4872, ComSystemTemplateSystemSignalRef=DET_SUPER_RES_TARGET_230
            DET_ELEVATION_ERR_230_oRDR_DETECTION_229_232_oPCAN_RADAR_7e14fd35_Tx: ComBitPosition=192, ComBitSize=6, ComSignalInitValue=0, ComSignalType=UINT8, ComHandleId=4821, ComSystemTemplateSystemSignalRef=DET_ELEVATION_ERR_230
            DET_EXISTENCE_PROB_232_oRDR_DETECTION_229_232_oPCAN_RADAR_5d1b273e_Tx: ComBitPosition=448, ComBitSize=6, ComSignalInitValue=0, ComSignalType=UINT8, ComHandleId=4827, ComSystemTemplateSystemSignalRef=DET_EXISTENCE_PROB_232
            DET_RANGE_VELOCITY_ERR_232_oRDR_DETECTION_229_232_oPCAN_RADAR_b3885f0b_Tx: ComBitPosition=400, ComBitSize=8, ComSignalInitValue=0, ComSignalType=UINT8, ComHandleId=4862, ComSystemTemplateSystemSignalRef=DET_RANGE_VELOCITY_ERR_232
            DET_BI_STATIC_FLAG_231_oRDR_DETECTION_229_232_oPCAN_RADAR_ebc22e5c_Tx: ComBitPosition=328, ComBitSize=1, ComSignalInitValue=0, ComSignalType=BOOLEAN, ComHandleId=4806, ComSystemTemplateSystemSignalRef=DET_BI_STATIC_FLAG_231
            DET_RANGE_ERR_231_oRDR_DETECTION_229_232_oPCAN_RADAR_0a9da70b_Tx: ComBitPosition=264, ComBitSize=7, ComSignalInitValue=0, ComSignalType=UINT8, ComHandleId=4853, ComSystemTemplateSystemSignalRef=DET_RANGE_ERR_231
            DET_MH_CYCLE_COUNTER_229_232_oRDR_DETECTION_229_232_oPCAN_RADAR_8729139a_Tx: ComBitPosition=16, ComBitSize=8, ComSignalInitValue=0, ComSignalType=UINT8, ComHandleId=4837, ComSystemTemplateSystemSignalRef=DET_MH_CYCLE_COUNTER_229_232
            DET_RANGE_VELOCITY_ERR_229_oRDR_DETECTION_229_232_oPCAN_RADAR_273882c4_Tx: ComBitPosition=64, ComBitSize=8, ComSignalInitValue=0, ComSignalType=UINT8, ComHandleId=4859, ComSystemTemplateSystemSignalRef=DET_RANGE_VELOCITY_ERR_229
            DET_AZIMUTH_ERR_229_oRDR_DETECTION_229_232_oPCAN_RADAR_e90b5d1d_Tx: ComBitPosition=105, ComBitSize=7, ComSignalInitValue=0, ComSignalType=UINT8, ComHandleId=4796, ComSystemTemplateSystemSignalRef=DET_AZIMUTH_ERR_229
            DET_RANGE_VELOCITY_229_oRDR_DETECTION_229_232_oPCAN_RADAR_28837976_Tx: ComBitPosition=48, ComBitSize=15, ComSignalInitValue=16384, ComSignalType=UINT16, ComHandleId=4855, ComSystemTemplateSystemSignalRef=DET_RANGE_VELOCITY_229
            DET_SUPER_RES_TARGET_232_oRDR_DETECTION_229_232_oPCAN_RADAR_d784ef84_Tx: ComBitPosition=423, ComBitSize=1, ComSignalInitValue=0, ComSignalType=BOOLEAN, ComHandleId=4874, ComSystemTemplateSystemSignalRef=DET_SUPER_RES_TARGET_232
            DET_CONFD_AZIMUTH_229_oRDR_DETECTION_229_232_oPCAN_RADAR_4f58c222_Tx: ComBitPosition=118, ComBitSize=2, ComSignalInitValue=0, ComSignalType=UINT8, ComHandleId=4808, ComSystemTemplateSystemSignalRef=DET_CONFD_AZIMUTH_229
            DET_RANGE_ERR_230_oRDR_DETECTION_229_232_oPCAN_RADAR_9fed739e_Tx: ComBitPosition=152, ComBitSize=7, ComSignalInitValue=0, ComSignalType=UINT8, ComHandleId=4852, ComSystemTemplateSystemSignalRef=DET_RANGE_ERR_230
            DET_SNR_229_oRDR_DETECTION_229_232_oPCAN_RADAR_72ad1a2e_Tx: ComBitPosition=120, ComBitSize=8, ComSignalInitValue=0, ComSignalType=UINT8, ComHandleId=4867, ComSystemTemplateSystemSignalRef=DET_SNR_229
            DET_AZIMUTH_230_oRDR_DETECTION_229_232_oPCAN_RADAR_289eba4c_Tx: ComBitPosition=200, ComBitSize=13, ComSignalInitValue=0, ComSignalType=UINT16, ComHandleId=4793, ComSystemTemplateSystemSignalRef=DET_AZIMUTH_230
            DET_BI_STATIC_FLAG_232_oRDR_DETECTION_229_232_oPCAN_RADAR_8f2255a2_Tx: ComBitPosition=440, ComBitSize=1, ComSignalInitValue=0, ComSignalType=BOOLEAN, ComHandleId=4807, ComSystemTemplateSystemSignalRef=DET_BI_STATIC_FLAG_232
            DET_ELEVATION_231_oRDR_DETECTION_229_232_oPCAN_RADAR_6c5db1d5_Tx: ComBitPosition=296, ComBitSize=8, ComSignalInitValue=0, ComSignalType=UINT8, ComHandleId=4818, ComSystemTemplateSystemSignalRef=DET_ELEVATION_231
            DET_SUPER_RES_TARGET_231_oRDR_DETECTION_229_232_oPCAN_RADAR_b364947a_Tx: ComBitPosition=311, ComBitSize=1, ComSignalInitValue=0, ComSignalType=BOOLEAN, ComHandleId=4873, ComSystemTemplateSystemSignalRef=DET_SUPER_RES_TARGET_231
            DET_AZIMUTH_ERR_231_oRDR_DETECTION_229_232_oPCAN_RADAR_195bfb2c_Tx: ComBitPosition=329, ComBitSize=7, ComSignalInitValue=0, ComSignalType=UINT8, ComHandleId=4798, ComSystemTemplateSystemSignalRef=DET_AZIMUTH_ERR_231
            DET_RANGE_VELOCITY_ERR_230_oRDR_DETECTION_229_232_oPCAN_RADAR_4218f060_Tx: ComBitPosition=176, ComBitSize=8, ComSignalInitValue=0, ComSignalType=UINT8, ComHandleId=4860, ComSystemTemplateSystemSignalRef=DET_RANGE_VELOCITY_ERR_230
            DET_RCS_231_oRDR_DETECTION_229_232_oPCAN_RADAR_5f53e81d_Tx: ComBitPosition=352, ComBitSize=8, ComSignalInitValue=128, ComSignalType=UINT8, ComHandleId=4865, ComSystemTemplateSystemSignalRef=DET_RCS_231
            DET_ELEVATION_229_oRDR_DETECTION_229_232_oPCAN_RADAR_9c0d17e4_Tx: ComBitPosition=72, ComBitSize=8, ComSignalInitValue=0, ComSignalType=UINT8, ComHandleId=4816, ComSystemTemplateSystemSignalRef=DET_ELEVATION_229
            DET_PROB_1STAZHYPO_230_oRDR_DETECTION_229_232_oPCAN_RADAR_33aa2a81_Tx: ComBitPosition=215, ComBitSize=1, ComSignalInitValue=0, ComSignalType=BOOLEAN, ComHandleId=4844, ComSystemTemplateSystemSignalRef=DET_PROB_1STAZHYPO_230
            DET_BELOW_RAIN_THOLD_232_oRDR_DETECTION_229_232_oPCAN_RADAR_0c0f86e7_Tx: ComBitPosition=375, ComBitSize=1, ComSignalInitValue=0, ComSignalType=UINT8, ComHandleId=4803, ComSystemTemplateSystemSignalRef=DET_BELOW_RAIN_THOLD_232
            DET_BELOW_RAIN_THOLD_231_oRDR_DETECTION_229_232_oPCAN_RADAR_68effd19_Tx: ComBitPosition=263, ComBitSize=1, ComSignalInitValue=0, ComSignalType=UINT8, ComHandleId=4802, ComSystemTemplateSystemSignalRef=DET_BELOW_RAIN_THOLD_231
            DET_IDM_229_oRDR_DETECTION_229_232_oPCAN_RADAR_a38d8233_Tx: ComBitPosition=63, ComBitSize=1, ComSignalInitValue=0, ComSignalType=UINT8, ComHandleId=4832, ComSystemTemplateSystemSignalRef=DET_IDM_229
            DET_PROB_1STAZHYPO_231_oRDR_DETECTION_229_232_oPCAN_RADAR_a6dafe14_Tx: ComBitPosition=327, ComBitSize=1, ComSignalInitValue=0, ComSignalType=BOOLEAN, ComHandleId=4845, ComSystemTemplateSystemSignalRef=DET_PROB_1STAZHYPO_231
            DET_PROB_1STAZHYPO_229_oRDR_DETECTION_229_232_oPCAN_RADAR_568a5825_Tx: ComBitPosition=103, ComBitSize=1, ComSignalInitValue=0, ComSignalType=BOOLEAN, ComHandleId=4843, ComSystemTemplateSystemSignalRef=DET_PROB_1STAZHYPO_229
            DET_IDM_230_oRDR_DETECTION_229_232_oPCAN_RADAR_c6adf097_Tx: ComBitPosition=175, ComBitSize=1, ComSignalInitValue=0, ComSignalType=UINT8, ComHandleId=4833, ComSystemTemplateSystemSignalRef=DET_IDM_230
            DET_MTD_229_oRDR_DETECTION_229_232_oPCAN_RADAR_c53eb0e8_Tx: ComBitPosition=47, ComBitSize=1, ComSignalInitValue=0, ComSignalType=UINT8, ComHandleId=4839, ComSystemTemplateSystemSignalRef=DET_MTD_229
            DET_BELOW_RAIN_THOLD_230_oRDR_DETECTION_229_232_oPCAN_RADAR_fd9f298c_Tx: ComBitPosition=151, ComBitSize=1, ComSignalInitValue=0, ComSignalType=UINT8, ComHandleId=4801, ComSystemTemplateSystemSignalRef=DET_BELOW_RAIN_THOLD_230
            DET_PROB_1STAZHYPO_232_oRDR_DETECTION_229_232_oPCAN_RADAR_c23a85ea_Tx: ComBitPosition=439, ComBitSize=1, ComSignalInitValue=0, ComSignalType=BOOLEAN, ComHandleId=4846, ComSystemTemplateSystemSignalRef=DET_PROB_1STAZHYPO_232
            DET_BELOW_RAIN_THOLD_229_oRDR_DETECTION_229_232_oPCAN_RADAR_98bf5b28_Tx: ComBitPosition=39, ComBitSize=1, ComSignalInitValue=0, ComSignalType=UINT8, ComHandleId=4800, ComSystemTemplateSystemSignalRef=DET_BELOW_RAIN_THOLD_229
            DET_IDM_231_oRDR_DETECTION_229_232_oPCAN_RADAR_53dd2402_Tx: ComBitPosition=287, ComBitSize=1, ComSignalInitValue=0, ComSignalType=UINT8, ComHandleId=4834, ComSystemTemplateSystemSignalRef=DET_IDM_231
            DET_IDM_232_oRDR_DETECTION_229_232_oPCAN_RADAR_373d5ffc_Tx: ComBitPosition=399, ComBitSize=1, ComSignalInitValue=0, ComSignalType=UINT8, ComHandleId=4835, ComSystemTemplateSystemSignalRef=DET_IDM_232
            DET_MTD_232_oRDR_DETECTION_229_232_oPCAN_RADAR_518e6d27_Tx: ComBitPosition=383, ComBitSize=1, ComSignalInitValue=0, ComSignalType=UINT8, ComHandleId=4842, ComSystemTemplateSystemSignalRef=DET_MTD_232
            DET_MTD_230_oRDR_DETECTION_229_232_oPCAN_RADAR_a01ec24c_Tx: ComBitPosition=159, ComBitSize=1, ComSignalInitValue=0, ComSignalType=UINT8, ComHandleId=4840, ComSystemTemplateSystemSignalRef=DET_MTD_230
            DET_MTD_231_oRDR_DETECTION_229_232_oPCAN_RADAR_356e16d9_Tx: ComBitPosition=271, ComBitSize=1, ComSignalInitValue=0, ComSignalType=UINT8, ComHandleId=4841, ComSystemTemplateSystemSignalRef=DET_MTD_231
        SG_Detections_093_096_oRDR_DETECTION_093_096_oPCAN_RADAR_d02c6cec_Tx: ComTransferProperty=TRIGGERED, ComHandleId=25, ComSystemTemplateSignalGroupRef=SG_Detections_093_096
          83 x ComGroupSignal, all with ComSignalEndianness=LITTLE_ENDIAN, ComTransferProperty=PENDING, ComSignalAccess=ACCESS_NEEDED_BY_SWC_OR_COM:
            DET_RANGE_VELOCITY_093_oRDR_DETECTION_093_096_oPCAN_RADAR_ee53a3f2_Tx: ComBitPosition=48, ComBitSize=15, ComSignalInitValue=16384, ComSignalType=UINT16, ComHandleId=2033, ComSystemTemplateSystemSignalRef=DET_RANGE_VELOCITY_093
            DET_MH_SCAN_INDEX_4LSB_093_096_oRDR_DETECTION_093_096_oPCAN_RADAR_1cfb3a5c_Tx: ComBitPosition=476, ComBitSize=4, ComSignalInitValue=0, ComSignalType=UINT8, ComHandleId=2016, ComSystemTemplateSystemSignalRef=DET_MH_SCAN_INDEX_4LSB_093_096
            DET_RANGE_VELOCITY_094_oRDR_DETECTION_093_096_oPCAN_RADAR_b2e3809b_Tx: ComBitPosition=160, ComBitSize=15, ComSignalInitValue=16384, ComSignalType=UINT16, ComHandleId=2034, ComSystemTemplateSystemSignalRef=DET_RANGE_VELOCITY_094
            DET_CONFD_AZIMUTH_095_oRDR_DETECTION_093_096_oPCAN_RADAR_4048ef5a_Tx: ComBitPosition=342, ComBitSize=2, ComSignalInitValue=0, ComSignalType=UINT8, ComHandleId=1988, ComSystemTemplateSystemSignalRef=DET_CONFD_AZIMUTH_095
            DET_RCS_096_oRDR_DETECTION_093_096_oPCAN_RADAR_c4f318aa_Tx: ComBitPosition=464, ComBitSize=8, ComSignalInitValue=128, ComSignalType=UINT8, ComHandleId=2044, ComSystemTemplateSystemSignalRef=DET_RCS_096
            DET_CONFD_ELEVATION_096_oRDR_DETECTION_093_096_oPCAN_RADAR_263d955e_Tx: ComBitPosition=437, ComBitSize=2, ComSignalInitValue=0, ComSignalType=UINT8, ComHandleId=1993, ComSystemTemplateSystemSignalRef=DET_CONFD_ELEVATION_096
            DET_RANGE_ERR_093_oRDR_DETECTION_093_096_oPCAN_RADAR_3c1ddbbe_Tx: ComBitPosition=40, ComBitSize=7, ComSignalInitValue=0, ComSignalType=UINT8, ComHandleId=2029, ComSystemTemplateSystemSignalRef=DET_RANGE_ERR_093
            DET_AZIMUTH_ERR_093_oRDR_DETECTION_093_096_oPCAN_RADAR_2fdb8799_Tx: ComBitPosition=105, ComBitSize=7, ComSignalInitValue=0, ComSignalType=UINT8, ComHandleId=1974, ComSystemTemplateSystemSignalRef=DET_AZIMUTH_ERR_093
            DET_SUPER_RES_TARGET_095_oRDR_DETECTION_093_096_oPCAN_RADAR_4c241f33_Tx: ComBitPosition=311, ComBitSize=1, ComSignalInitValue=0, ComSignalType=BOOLEAN, ComHandleId=2051, ComSystemTemplateSystemSignalRef=DET_SUPER_RES_TARGET_095
            DET_BI_STATIC_FLAG_096_oRDR_DETECTION_093_096_oPCAN_RADAR_7062deeb_Tx: ComBitPosition=440, ComBitSize=1, ComSignalInitValue=0, ComSignalType=BOOLEAN, ComHandleId=1985, ComSystemTemplateSystemSignalRef=DET_BI_STATIC_FLAG_096
            DET_RANGE_ERR_096_oRDR_DETECTION_093_096_oPCAN_RADAR_913d57bc_Tx: ComBitPosition=376, ComBitSize=7, ComSignalInitValue=0, ComSignalType=UINT8, ComHandleId=2032, ComSystemTemplateSystemSignalRef=DET_RANGE_ERR_096
            DET_ELEVATION_093_oRDR_DETECTION_093_096_oPCAN_RADAR_5addcd60_Tx: ComBitPosition=72, ComBitSize=8, ComSignalInitValue=0, ComSignalType=UINT8, ComHandleId=1994, ComSystemTemplateSystemSignalRef=DET_ELEVATION_093
            DET_ELEVATION_ERR_095_oRDR_DETECTION_093_096_oPCAN_RADAR_1424a2e9_Tx: ComBitPosition=304, ComBitSize=6, ComSignalInitValue=0, ComSignalType=UINT8, ComHandleId=2000, ComSystemTemplateSystemSignalRef=DET_ELEVATION_ERR_095
            DET_SNR_094_oRDR_DETECTION_093_096_oPCAN_RADAR_e8cde3c3_Tx: ComBitPosition=232, ComBitSize=8, ComSignalInitValue=0, ComSignalType=UINT8, ComHandleId=2046, ComSystemTemplateSystemSignalRef=DET_SNR_094
            DET_EXISTENCE_PROB_096_oRDR_DETECTION_093_096_oPCAN_RADAR_a25bac77_Tx: ComBitPosition=448, ComBitSize=6, ComSignalInitValue=0, ComSignalType=UINT8, ComHandleId=2005, ComSystemTemplateSystemSignalRef=DET_EXISTENCE_PROB_096
            DET_RANGE_VELOCITY_ERR_096_oRDR_DETECTION_093_096_oPCAN_RADAR_4cc8d442_Tx: ComBitPosition=400, ComBitSize=8, ComSignalInitValue=0, ComSignalType=UINT8, ComHandleId=2040, ComSystemTemplateSystemSignalRef=DET_RANGE_VELOCITY_ERR_096
            DET_CONFD_AZIMUTH_093_oRDR_DETECTION_093_096_oPCAN_RADAR_898818a6_Tx: ComBitPosition=118, ComBitSize=2, ComSignalInitValue=0, ComSignalType=UINT8, ComHandleId=1986, ComSystemTemplateSystemSignalRef=DET_CONFD_AZIMUTH_093
            DET_CONFD_ELEVATION_094_oRDR_DETECTION_093_096_oPCAN_RADAR_d7ad3a35_Tx: ComBitPosition=213, ComBitSize=2, ComSignalInitValue=0, ComSignalType=UINT8, ComHandleId=1991, ComSystemTemplateSystemSignalRef=DET_CONFD_ELEVATION_094
            DET_MH_CRC16_093_096_oRDR_DETECTION_093_096_oPCAN_RADAR_54a4bee7_Tx: ComBitPosition=0, ComBitSize=16, ComSignalInitValue=0, ComSignalType=UINT16, ComHandleId=2014, ComSystemTemplateSystemSignalRef=DET_MH_CRC16_093_096
            DET_SNR_095_oRDR_DETECTION_093_096_oPCAN_RADAR_7dbd3756_Tx: ComBitPosition=344, ComBitSize=8, ComSignalInitValue=0, ComSignalType=UINT8, ComHandleId=2047, ComSystemTemplateSystemSignalRef=DET_SNR_095
            DET_SNR_096_oRDR_DETECTION_093_096_oPCAN_RADAR_195d4ca8_Tx: ComBitPosition=456, ComBitSize=8, ComSignalInitValue=0, ComSignalType=UINT8, ComHandleId=2048, ComSystemTemplateSystemSignalRef=DET_SNR_096
            DET_ELEVATION_096_oRDR_DETECTION_093_096_oPCAN_RADAR_f7fd4162_Tx: ComBitPosition=408, ComBitSize=8, ComSignalInitValue=0, ComSignalType=UINT8, ComHandleId=1997, ComSystemTemplateSystemSignalRef=DET_ELEVATION_096
            DET_AZIMUTH_096_oRDR_DETECTION_093_096_oPCAN_RADAR_264e9e6e_Tx: ComBitPosition=424, ComBitSize=13, ComSignalInitValue=0, ComSignalType=UINT16, ComHandleId=1973, ComSystemTemplateSystemSignalRef=DET_AZIMUTH_096
            DET_BI_STATIC_FLAG_093_oRDR_DETECTION_093_096_oPCAN_RADAR_dd4252e9_Tx: ComBitPosition=104, ComBitSize=1, ComSignalInitValue=0, ComSignalType=BOOLEAN, ComHandleId=1982, ComSystemTemplateSystemSignalRef=DET_BI_STATIC_FLAG_093
            DET_SUPER_RES_TARGET_093_oRDR_DETECTION_093_096_oPCAN_RADAR_85e4e8cf_Tx: ComBitPosition=87, ComBitSize=1, ComSignalInitValue=0, ComSignalType=BOOLEAN, ComHandleId=2049, ComSystemTemplateSystemSignalRef=DET_SUPER_RES_TARGET_093
            DET_RANGE_VELOCITY_ERR_094_oRDR_DETECTION_093_096_oPCAN_RADAR_bd587b29_Tx: ComBitPosition=176, ComBitSize=8, ComSignalInitValue=0, ComSignalType=UINT8, ComHandleId=2038, ComSystemTemplateSystemSignalRef=DET_RANGE_VELOCITY_ERR_094
            DET_RANGE_ERR_094_oRDR_DETECTION_093_096_oPCAN_RADAR_60adf8d7_Tx: ComBitPosition=152, ComBitSize=7, ComSignalInitValue=0, ComSignalType=UINT8, ComHandleId=2030, ComSystemTemplateSystemSignalRef=DET_RANGE_ERR_094
            DET_BI_STATIC_FLAG_095_oRDR_DETECTION_093_096_oPCAN_RADAR_1482a515_Tx: ComBitPosition=328, ComBitSize=1, ComSignalInitValue=0, ComSignalType=BOOLEAN, ComHandleId=1984, ComSystemTemplateSystemSignalRef=DET_BI_STATIC_FLAG_095
            DET_RANGE_095_oRDR_DETECTION_093_096_oPCAN_RADAR_5235962b_Tx: ComBitPosition=248, ComBitSize=15, ComSignalInitValue=0, ComSignalType=UINT16, ComHandleId=2027, ComSystemTemplateSystemSignalRef=DET_RANGE_095
            DET_SUPER_RES_TARGET_096_oRDR_DETECTION_093_096_oPCAN_RADAR_28c464cd_Tx: ComBitPosition=423, ComBitSize=1, ComSignalInitValue=0, ComSignalType=BOOLEAN, ComHandleId=2052, ComSystemTemplateSystemSignalRef=DET_SUPER_RES_TARGET_096
            DET_HVC_FLAG_093_oRDR_DETECTION_093_096_oPCAN_RADAR_ee0f630a_Tx: ComBitPosition=86, ComBitSize=1, ComSignalInitValue=0, ComSignalType=BOOLEAN, ComHandleId=2006, ComSystemTemplateSystemSignalRef=DET_HVC_FLAG_093
            DET_RANGE_ERR_095_oRDR_DETECTION_093_096_oPCAN_RADAR_f5dd2c42_Tx: ComBitPosition=264, ComBitSize=7, ComSignalInitValue=0, ComSignalType=UINT8, ComHandleId=2031, ComSystemTemplateSystemSignalRef=DET_RANGE_ERR_095
            DET_RANGE_VELOCITY_ERR_095_oRDR_DETECTION_093_096_oPCAN_RADAR_2828afbc_Tx: ComBitPosition=288, ComBitSize=8, ComSignalInitValue=0, ComSignalType=UINT8, ComHandleId=2039, ComSystemTemplateSystemSignalRef=DET_RANGE_VELOCITY_ERR_095
            DET_RANGE_093_oRDR_DETECTION_093_096_oPCAN_RADAR_9bf561d7_Tx: ComBitPosition=24, ComBitSize=15, ComSignalInitValue=0, ComSignalType=UINT16, ComHandleId=2025, ComSystemTemplateSystemSignalRef=DET_RANGE_093
            DET_AZIMUTH_093_oRDR_DETECTION_093_096_oPCAN_RADAR_8b6e126c_Tx: ComBitPosition=88, ComBitSize=13, ComSignalInitValue=0, ComSignalType=UINT16, ComHandleId=1970, ComSystemTemplateSystemSignalRef=DET_AZIMUTH_093
            DET_RCS_093_oRDR_DETECTION_093_096_oPCAN_RADAR_69d394a8_Tx: ComBitPosition=128, ComBitSize=8, ComSignalInitValue=128, ComSignalType=UINT8, ComHandleId=2041, ComSystemTemplateSystemSignalRef=DET_RCS_093
            DET_SNR_093_oRDR_DETECTION_093_096_oPCAN_RADAR_b47dc0aa_Tx: ComBitPosition=120, ComBitSize=8, ComSignalInitValue=0, ComSignalType=UINT8, ComHandleId=2045, ComSystemTemplateSystemSignalRef=DET_SNR_093
            DET_RANGE_VELOCITY_095_oRDR_DETECTION_093_096_oPCAN_RADAR_2793540e_Tx: ComBitPosition=272, ComBitSize=15, ComSignalInitValue=16384, ComSignalType=UINT16, ComHandleId=2035, ComSystemTemplateSystemSignalRef=DET_RANGE_VELOCITY_095
            DET_AZIMUTH_095_oRDR_DETECTION_093_096_oPCAN_RADAR_42aee590_Tx: ComBitPosition=312, ComBitSize=13, ComSignalInitValue=0, ComSignalType=UINT16, ComHandleId=1972, ComSystemTemplateSystemSignalRef=DET_AZIMUTH_095
            DET_CONFD_ELEVATION_093_oRDR_DETECTION_093_096_oPCAN_RADAR_8b1d195c_Tx: ComBitPosition=101, ComBitSize=2, ComSignalInitValue=0, ComSignalType=UINT8, ComHandleId=1990, ComSystemTemplateSystemSignalRef=DET_CONFD_ELEVATION_093
            DET_HVC_FLAG_096_oRDR_DETECTION_093_096_oPCAN_RADAR_432fef08_Tx: ComBitPosition=422, ComBitSize=1, ComSignalInitValue=0, ComSignalType=BOOLEAN, ComHandleId=2009, ComSystemTemplateSystemSignalRef=DET_HVC_FLAG_096
            DET_ELEVATION_ERR_094_oRDR_DETECTION_093_096_oPCAN_RADAR_8154767c_Tx: ComBitPosition=192, ComBitSize=6, ComSignalInitValue=0, ComSignalType=UINT8, ComHandleId=1999, ComSystemTemplateSystemSignalRef=DET_ELEVATION_ERR_094
            DET_AZIMUTH_094_oRDR_DETECTION_093_096_oPCAN_RADAR_d7de3105_Tx: ComBitPosition=200, ComBitSize=13, ComSignalInitValue=0, ComSignalType=UINT16, ComHandleId=1971, ComSystemTemplateSystemSignalRef=DET_AZIMUTH_094
            DET_AZIMUTH_ERR_094_oRDR_DETECTION_093_096_oPCAN_RADAR_736ba4f0_Tx: ComBitPosition=217, ComBitSize=7, ComSignalInitValue=0, ComSignalType=UINT8, ComHandleId=1975, ComSystemTemplateSystemSignalRef=DET_AZIMUTH_ERR_094
            DET_ELEVATION_ERR_093_oRDR_DETECTION_093_096_oPCAN_RADAR_dde45515_Tx: ComBitPosition=80, ComBitSize=6, ComSignalInitValue=0, ComSignalType=UINT8, ComHandleId=1998, ComSystemTemplateSystemSignalRef=DET_ELEVATION_ERR_093
            DET_HVC_FLAG_094_oRDR_DETECTION_093_096_oPCAN_RADAR_b2bf4063_Tx: ComBitPosition=198, ComBitSize=1, ComSignalInitValue=0, ComSignalType=BOOLEAN, ComHandleId=2007, ComSystemTemplateSystemSignalRef=DET_HVC_FLAG_094
            DET_RANGE_VELOCITY_ERR_093_oRDR_DETECTION_093_096_oPCAN_RADAR_e1e85840_Tx: ComBitPosition=64, ComBitSize=8, ComSignalInitValue=0, ComSignalType=UINT8, ComHandleId=2037, ComSystemTemplateSystemSignalRef=DET_RANGE_VELOCITY_ERR_093
            DET_CONFD_AZIMUTH_094_oRDR_DETECTION_093_096_oPCAN_RADAR_d5383bcf_Tx: ComBitPosition=230, ComBitSize=2, ComSignalInitValue=0, ComSignalType=UINT8, ComHandleId=1987, ComSystemTemplateSystemSignalRef=DET_CONFD_AZIMUTH_094
            DET_SUPER_RES_TARGET_094_oRDR_DETECTION_093_096_oPCAN_RADAR_d954cba6_Tx: ComBitPosition=199, ComBitSize=1, ComSignalInitValue=0, ComSignalType=BOOLEAN, ComHandleId=2050, ComSystemTemplateSystemSignalRef=DET_SUPER_RES_TARGET_094
            DET_BI_STATIC_FLAG_094_oRDR_DETECTION_093_096_oPCAN_RADAR_81f27180_Tx: ComBitPosition=216, ComBitSize=1, ComSignalInitValue=0, ComSignalType=BOOLEAN, ComHandleId=1983, ComSystemTemplateSystemSignalRef=DET_BI_STATIC_FLAG_094
            DET_CONFD_ELEVATION_095_oRDR_DETECTION_093_096_oPCAN_RADAR_42ddeea0_Tx: ComBitPosition=325, ComBitSize=2, ComSignalInitValue=0, ComSignalType=UINT8, ComHandleId=1992, ComSystemTemplateSystemSignalRef=DET_CONFD_ELEVATION_095
            DET_RCS_095_oRDR_DETECTION_093_096_oPCAN_RADAR_a0136354_Tx: ComBitPosition=352, ComBitSize=8, ComSignalInitValue=128, ComSignalType=UINT8, ComHandleId=2043, ComSystemTemplateSystemSignalRef=DET_RCS_095
            DET_MH_CYCLE_COUNTER_093_096_oRDR_DETECTION_093_096_oPCAN_RADAR_d0d11fd0_Tx: ComBitPosition=16, ComBitSize=8, ComSignalInitValue=0, ComSignalType=UINT8, ComHandleId=2015, ComSystemTemplateSystemSignalRef=DET_MH_CYCLE_COUNTER_093_096
            DET_ELEVATION_094_oRDR_DETECTION_093_096_oPCAN_RADAR_066dee09_Tx: ComBitPosition=184, ComBitSize=8, ComSignalInitValue=0, ComSignalType=UINT8, ComHandleId=1995, ComSystemTemplateSystemSignalRef=DET_ELEVATION_094
            DET_RCS_094_oRDR_DETECTION_093_096_oPCAN_RADAR_3563b7c1_Tx: ComBitPosition=240, ComBitSize=8, ComSignalInitValue=128, ComSignalType=UINT8, ComHandleId=2042, ComSystemTemplateSystemSignalRef=DET_RCS_094
            DET_HVC_FLAG_095_oRDR_DETECTION_093_096_oPCAN_RADAR_27cf94f6_Tx: ComBitPosition=310, ComBitSize=1, ComSignalInitValue=0, ComSignalType=BOOLEAN, ComHandleId=2008, ComSystemTemplateSystemSignalRef=DET_HVC_FLAG_095
            DET_EXISTENCE_PROB_095_oRDR_DETECTION_093_096_oPCAN_RADAR_c6bbd789_Tx: ComBitPosition=336, ComBitSize=6, ComSignalInitValue=0, ComSignalType=UINT8, ComHandleId=2004, ComSystemTemplateSystemSignalRef=DET_EXISTENCE_PROB_095
            DET_RANGE_VELOCITY_096_oRDR_DETECTION_093_096_oPCAN_RADAR_43732ff0_Tx: ComBitPosition=384, ComBitSize=15, ComSignalInitValue=16384, ComSignalType=UINT16, ComHandleId=2036, ComSystemTemplateSystemSignalRef=DET_RANGE_VELOCITY_096
            DET_AZIMUTH_ERR_096_oRDR_DETECTION_093_096_oPCAN_RADAR_82fb0b9b_Tx: ComBitPosition=441, ComBitSize=7, ComSignalInitValue=0, ComSignalType=UINT8, ComHandleId=1977, ComSystemTemplateSystemSignalRef=DET_AZIMUTH_ERR_096
            DET_ELEVATION_095_oRDR_DETECTION_093_096_oPCAN_RADAR_931d3a9c_Tx: ComBitPosition=296, ComBitSize=8, ComSignalInitValue=0, ComSignalType=UINT8, ComHandleId=1996, ComSystemTemplateSystemSignalRef=DET_ELEVATION_095
            DET_EXISTENCE_PROB_094_oRDR_DETECTION_093_096_oPCAN_RADAR_53cb031c_Tx: ComBitPosition=224, ComBitSize=6, ComSignalInitValue=0, ComSignalType=UINT8, ComHandleId=2003, ComSystemTemplateSystemSignalRef=DET_EXISTENCE_PROB_094
            DET_AZIMUTH_ERR_095_oRDR_DETECTION_093_096_oPCAN_RADAR_e61b7065_Tx: ComBitPosition=329, ComBitSize=7, ComSignalInitValue=0, ComSignalType=UINT8, ComHandleId=1976, ComSystemTemplateSystemSignalRef=DET_AZIMUTH_ERR_095
            DET_RANGE_094_oRDR_DETECTION_093_096_oPCAN_RADAR_c74542be_Tx: ComBitPosition=136, ComBitSize=15, ComSignalInitValue=0, ComSignalType=UINT16, ComHandleId=2026, ComSystemTemplateSystemSignalRef=DET_RANGE_094
            DET_CONFD_AZIMUTH_096_oRDR_DETECTION_093_096_oPCAN_RADAR_24a894a4_Tx: ComBitPosition=454, ComBitSize=2, ComSignalInitValue=0, ComSignalType=UINT8, ComHandleId=1989, ComSystemTemplateSystemSignalRef=DET_CONFD_AZIMUTH_096
            DET_EXISTENCE_PROB_093_oRDR_DETECTION_093_096_oPCAN_RADAR_0f7b2075_Tx: ComBitPosition=112, ComBitSize=6, ComSignalInitValue=0, ComSignalType=UINT8, ComHandleId=2002, ComSystemTemplateSystemSignalRef=DET_EXISTENCE_PROB_093
            DET_ELEVATION_ERR_096_oRDR_DETECTION_093_096_oPCAN_RADAR_70c4d917_Tx: ComBitPosition=416, ComBitSize=6, ComSignalInitValue=0, ComSignalType=UINT8, ComHandleId=2001, ComSystemTemplateSystemSignalRef=DET_ELEVATION_ERR_096
            DET_RANGE_096_oRDR_DETECTION_093_096_oPCAN_RADAR_36d5edd5_Tx: ComBitPosition=360, ComBitSize=15, ComSignalInitValue=0, ComSignalType=UINT16, ComHandleId=2028, ComSystemTemplateSystemSignalRef=DET_RANGE_096
            DET_MTD_096_oRDR_DETECTION_093_096_oPCAN_RADAR_aecee66e_Tx: ComBitPosition=383, ComBitSize=1, ComSignalInitValue=0, ComSignalType=UINT8, ComHandleId=2020, ComSystemTemplateSystemSignalRef=DET_MTD_096
            DET_BELOW_RAIN_THOLD_093_oRDR_DETECTION_093_096_oPCAN_RADAR_5e6f81ac_Tx: ComBitPosition=39, ComBitSize=1, ComSignalInitValue=0, ComSignalType=UINT8, ComHandleId=1978, ComSystemTemplateSystemSignalRef=DET_BELOW_RAIN_THOLD_093
            DET_MTD_095_oRDR_DETECTION_093_096_oPCAN_RADAR_ca2e9d90_Tx: ComBitPosition=271, ComBitSize=1, ComSignalInitValue=0, ComSignalType=UINT8, ComHandleId=2019, ComSystemTemplateSystemSignalRef=DET_MTD_095
            DET_PROB_1STAZHYPO_094_oRDR_DETECTION_093_096_oPCAN_RADAR_cceaa1c8_Tx: ComBitPosition=215, ComBitSize=1, ComSignalInitValue=0, ComSignalType=BOOLEAN, ComHandleId=2022, ComSystemTemplateSystemSignalRef=DET_PROB_1STAZHYPO_094
            DET_MTD_094_oRDR_DETECTION_093_096_oPCAN_RADAR_5f5e4905_Tx: ComBitPosition=159, ComBitSize=1, ComSignalInitValue=0, ComSignalType=UINT8, ComHandleId=2018, ComSystemTemplateSystemSignalRef=DET_MTD_094
            DET_BELOW_RAIN_THOLD_096_oRDR_DETECTION_093_096_oPCAN_RADAR_f34f0dae_Tx: ComBitPosition=375, ComBitSize=1, ComSignalInitValue=0, ComSignalType=UINT8, ComHandleId=1981, ComSystemTemplateSystemSignalRef=DET_BELOW_RAIN_THOLD_096
            DET_PROB_1STAZHYPO_093_oRDR_DETECTION_093_096_oPCAN_RADAR_905a82a1_Tx: ComBitPosition=103, ComBitSize=1, ComSignalInitValue=0, ComSignalType=BOOLEAN, ComHandleId=2021, ComSystemTemplateSystemSignalRef=DET_PROB_1STAZHYPO_093
            DET_PROB_1STAZHYPO_096_oRDR_DETECTION_093_096_oPCAN_RADAR_3d7a0ea3_Tx: ComBitPosition=439, ComBitSize=1, ComSignalInitValue=0, ComSignalType=BOOLEAN, ComHandleId=2024, ComSystemTemplateSystemSignalRef=DET_PROB_1STAZHYPO_096
            DET_IDM_093_oRDR_DETECTION_093_096_oPCAN_RADAR_655d58b7_Tx: ComBitPosition=63, ComBitSize=1, ComSignalInitValue=0, ComSignalType=UINT8, ComHandleId=2010, ComSystemTemplateSystemSignalRef=DET_IDM_093
            DET_PROB_1STAZHYPO_095_oRDR_DETECTION_093_096_oPCAN_RADAR_599a755d_Tx: ComBitPosition=327, ComBitSize=1, ComSignalInitValue=0, ComSignalType=BOOLEAN, ComHandleId=2023, ComSystemTemplateSystemSignalRef=DET_PROB_1STAZHYPO_095
            DET_IDM_096_oRDR_DETECTION_093_096_oPCAN_RADAR_c87dd4b5_Tx: ComBitPosition=399, ComBitSize=1, ComSignalInitValue=0, ComSignalType=UINT8, ComHandleId=2013, ComSystemTemplateSystemSignalRef=DET_IDM_096
            DET_IDM_094_oRDR_DETECTION_093_096_oPCAN_RADAR_39ed7bde_Tx: ComBitPosition=175, ComBitSize=1, ComSignalInitValue=0, ComSignalType=UINT8, ComHandleId=2011, ComSystemTemplateSystemSignalRef=DET_IDM_094
            DET_MTD_093_oRDR_DETECTION_093_096_oPCAN_RADAR_03ee6a6c_Tx: ComBitPosition=47, ComBitSize=1, ComSignalInitValue=0, ComSignalType=UINT8, ComHandleId=2017, ComSystemTemplateSystemSignalRef=DET_MTD_093
            DET_IDM_095_oRDR_DETECTION_093_096_oPCAN_RADAR_ac9daf4b_Tx: ComBitPosition=287, ComBitSize=1, ComSignalInitValue=0, ComSignalType=UINT8, ComHandleId=2012, ComSystemTemplateSystemSignalRef=DET_IDM_095
            DET_BELOW_RAIN_THOLD_094_oRDR_DETECTION_093_096_oPCAN_RADAR_02dfa2c5_Tx: ComBitPosition=151, ComBitSize=1, ComSignalInitValue=0, ComSignalType=UINT8, ComHandleId=1979, ComSystemTemplateSystemSignalRef=DET_BELOW_RAIN_THOLD_094
            DET_BELOW_RAIN_THOLD_095_oRDR_DETECTION_093_096_oPCAN_RADAR_97af7650_Tx: ComBitPosition=263, ComBitSize=1, ComSignalInitValue=0, ComSignalType=UINT8, ComHandleId=1980, ComSystemTemplateSystemSignalRef=DET_BELOW_RAIN_THOLD_095
        SG_Detections_041_044_oRDR_DETECTION_041_044_oPCAN_RADAR_b5a3d501_Tx: ComTransferProperty=TRIGGERED, ComHandleId=12, ComSystemTemplateSignalGroupRef=SG_Detections_041_044
          83 x ComGroupSignal, all with ComSignalEndianness=LITTLE_ENDIAN, ComTransferProperty=PENDING, ComSignalAccess=ACCESS_NEEDED_BY_SWC_OR_COM:
            DET_BI_STATIC_FLAG_043_oRDR_DETECTION_041_044_oPCAN_RADAR_1f76240b_Tx: ComBitPosition=328, ComBitSize=1, ComSignalInitValue=0, ComSignalType=BOOLEAN, ComHandleId=905, ComSystemTemplateSystemSignalRef=DET_BI_STATIC_FLAG_043
            DET_ELEVATION_041_oRDR_DETECTION_041_044_oPCAN_RADAR_697914e9_Tx: ComBitPosition=72, ComBitSize=8, ComSignalInitValue=0, ComSignalType=UINT8, ComHandleId=915, ComSystemTemplateSystemSignalRef=DET_ELEVATION_041
            DET_EXISTENCE_PROB_042_oRDR_DETECTION_041_044_oPCAN_RADAR_583f8202_Tx: ComBitPosition=224, ComBitSize=6, ComSignalInitValue=0, ComSignalType=UINT8, ComHandleId=924, ComSystemTemplateSystemSignalRef=DET_EXISTENCE_PROB_042
            DET_SUPER_RES_TARGET_041_oRDR_DETECTION_041_044_oPCAN_RADAR_b6403146_Tx: ComBitPosition=87, ComBitSize=1, ComSignalInitValue=0, ComSignalType=BOOLEAN, ComHandleId=970, ComSystemTemplateSystemSignalRef=DET_SUPER_RES_TARGET_041
            DET_ELEVATION_044_oRDR_DETECTION_041_044_oPCAN_RADAR_c45998eb_Tx: ComBitPosition=408, ComBitSize=8, ComSignalInitValue=0, ComSignalType=UINT8, ComHandleId=918, ComSystemTemplateSystemSignalRef=DET_ELEVATION_044
            DET_RANGE_VELOCITY_043_oRDR_DETECTION_041_044_oPCAN_RADAR_2c67d510_Tx: ComBitPosition=272, ComBitSize=15, ComSignalInitValue=16384, ComSignalType=UINT16, ComHandleId=956, ComSystemTemplateSystemSignalRef=DET_RANGE_VELOCITY_043
            DET_SUPER_RES_TARGET_043_oRDR_DETECTION_041_044_oPCAN_RADAR_47d09e2d_Tx: ComBitPosition=311, ComBitSize=1, ComSignalInitValue=0, ComSignalType=BOOLEAN, ComHandleId=972, ComSystemTemplateSystemSignalRef=DET_SUPER_RES_TARGET_043
            DET_AZIMUTH_042_oRDR_DETECTION_041_044_oPCAN_RADAR_dc2ab01b_Tx: ComBitPosition=200, ComBitSize=13, ComSignalInitValue=0, ComSignalType=UINT16, ComHandleId=892, ComSystemTemplateSystemSignalRef=DET_AZIMUTH_042
            DET_RANGE_VELOCITY_041_oRDR_DETECTION_041_044_oPCAN_RADAR_ddf77a7b_Tx: ComBitPosition=48, ComBitSize=15, ComSignalInitValue=16384, ComSignalType=UINT16, ComHandleId=954, ComSystemTemplateSystemSignalRef=DET_RANGE_VELOCITY_041
            DET_ELEVATION_ERR_041_oRDR_DETECTION_041_044_oPCAN_RADAR_ee408c9c_Tx: ComBitPosition=80, ComBitSize=6, ComSignalInitValue=0, ComSignalType=UINT8, ComHandleId=919, ComSystemTemplateSystemSignalRef=DET_ELEVATION_ERR_041
            DET_SNR_041_oRDR_DETECTION_041_044_oPCAN_RADAR_87d91923_Tx: ComBitPosition=120, ComBitSize=8, ComSignalInitValue=0, ComSignalType=UINT8, ComHandleId=966, ComSystemTemplateSystemSignalRef=DET_SNR_041
            DET_RANGE_VELOCITY_042_oRDR_DETECTION_041_044_oPCAN_RADAR_b9170185_Tx: ComBitPosition=160, ComBitSize=15, ComSignalInitValue=16384, ComSignalType=UINT16, ComHandleId=955, ComSystemTemplateSystemSignalRef=DET_RANGE_VELOCITY_042
            DET_RANGE_VELOCITY_044_oRDR_DETECTION_041_044_oPCAN_RADAR_70d7f679_Tx: ComBitPosition=384, ComBitSize=15, ComSignalInitValue=16384, ComSignalType=UINT16, ComHandleId=957, ComSystemTemplateSystemSignalRef=DET_RANGE_VELOCITY_044
            DET_RCS_044_oRDR_DETECTION_041_044_oPCAN_RADAR_f757c123_Tx: ComBitPosition=464, ComBitSize=8, ComSignalInitValue=128, ComSignalType=UINT8, ComHandleId=965, ComSystemTemplateSystemSignalRef=DET_RCS_044
            DET_ELEVATION_ERR_044_oRDR_DETECTION_041_044_oPCAN_RADAR_4360009e_Tx: ComBitPosition=416, ComBitSize=6, ComSignalInitValue=0, ComSignalType=UINT8, ComHandleId=922, ComSystemTemplateSystemSignalRef=DET_ELEVATION_ERR_044
            DET_BI_STATIC_FLAG_042_oRDR_DETECTION_041_044_oPCAN_RADAR_8a06f09e_Tx: ComBitPosition=216, ComBitSize=1, ComSignalInitValue=0, ComSignalType=BOOLEAN, ComHandleId=904, ComSystemTemplateSystemSignalRef=DET_BI_STATIC_FLAG_042
            DET_RANGE_043_oRDR_DETECTION_041_044_oPCAN_RADAR_59c11735_Tx: ComBitPosition=248, ComBitSize=15, ComSignalInitValue=0, ComSignalType=UINT16, ComHandleId=948, ComSystemTemplateSystemSignalRef=DET_RANGE_043
            DET_EXISTENCE_PROB_043_oRDR_DETECTION_041_044_oPCAN_RADAR_cd4f5697_Tx: ComBitPosition=336, ComBitSize=6, ComSignalInitValue=0, ComSignalType=UINT8, ComHandleId=925, ComSystemTemplateSystemSignalRef=DET_EXISTENCE_PROB_043
            DET_RCS_041_oRDR_DETECTION_041_044_oPCAN_RADAR_5a774d21_Tx: ComBitPosition=128, ComBitSize=8, ComSignalInitValue=128, ComSignalType=UINT8, ComHandleId=962, ComSystemTemplateSystemSignalRef=DET_RCS_041
            DET_ELEVATION_ERR_043_oRDR_DETECTION_041_044_oPCAN_RADAR_1fd023f7_Tx: ComBitPosition=304, ComBitSize=6, ComSignalInitValue=0, ComSignalType=UINT8, ComHandleId=921, ComSystemTemplateSystemSignalRef=DET_ELEVATION_ERR_043
            DET_SNR_044_oRDR_DETECTION_041_044_oPCAN_RADAR_2af99521_Tx: ComBitPosition=456, ComBitSize=8, ComSignalInitValue=0, ComSignalType=UINT8, ComHandleId=969, ComSystemTemplateSystemSignalRef=DET_SNR_044
            DET_RANGE_041_oRDR_DETECTION_041_044_oPCAN_RADAR_a851b85e_Tx: ComBitPosition=24, ComBitSize=15, ComSignalInitValue=0, ComSignalType=UINT16, ComHandleId=946, ComSystemTemplateSystemSignalRef=DET_RANGE_041
            DET_RANGE_ERR_041_oRDR_DETECTION_041_044_oPCAN_RADAR_0fb90237_Tx: ComBitPosition=40, ComBitSize=7, ComSignalInitValue=0, ComSignalType=UINT8, ComHandleId=950, ComSystemTemplateSystemSignalRef=DET_RANGE_ERR_041
            DET_RANGE_042_oRDR_DETECTION_041_044_oPCAN_RADAR_ccb1c3a0_Tx: ComBitPosition=136, ComBitSize=15, ComSignalInitValue=0, ComSignalType=UINT16, ComHandleId=947, ComSystemTemplateSystemSignalRef=DET_RANGE_042
            DET_AZIMUTH_ERR_043_oRDR_DETECTION_041_044_oPCAN_RADAR_edeff17b_Tx: ComBitPosition=329, ComBitSize=7, ComSignalInitValue=0, ComSignalType=UINT8, ComHandleId=897, ComSystemTemplateSystemSignalRef=DET_AZIMUTH_ERR_043
            DET_RANGE_VELOCITY_ERR_043_oRDR_DETECTION_041_044_oPCAN_RADAR_23dc2ea2_Tx: ComBitPosition=288, ComBitSize=8, ComSignalInitValue=0, ComSignalType=UINT8, ComHandleId=960, ComSystemTemplateSystemSignalRef=DET_RANGE_VELOCITY_ERR_043
            DET_BI_STATIC_FLAG_041_oRDR_DETECTION_041_044_oPCAN_RADAR_eee68b60_Tx: ComBitPosition=104, ComBitSize=1, ComSignalInitValue=0, ComSignalType=BOOLEAN, ComHandleId=903, ComSystemTemplateSystemSignalRef=DET_BI_STATIC_FLAG_041
            DET_ELEVATION_043_oRDR_DETECTION_041_044_oPCAN_RADAR_98e9bb82_Tx: ComBitPosition=296, ComBitSize=8, ComSignalInitValue=0, ComSignalType=UINT8, ComHandleId=917, ComSystemTemplateSystemSignalRef=DET_ELEVATION_043
            DET_AZIMUTH_044_oRDR_DETECTION_041_044_oPCAN_RADAR_15ea47e7_Tx: ComBitPosition=424, ComBitSize=13, ComSignalInitValue=0, ComSignalType=UINT16, ComHandleId=894, ComSystemTemplateSystemSignalRef=DET_AZIMUTH_044
            DET_CONFD_ELEVATION_044_oRDR_DETECTION_041_044_oPCAN_RADAR_15994cd7_Tx: ComBitPosition=437, ComBitSize=2, ComSignalInitValue=0, ComSignalType=UINT8, ComHandleId=914, ComSystemTemplateSystemSignalRef=DET_CONFD_ELEVATION_044
            DET_RANGE_ERR_044_oRDR_DETECTION_041_044_oPCAN_RADAR_a2998e35_Tx: ComBitPosition=376, ComBitSize=7, ComSignalInitValue=0, ComSignalType=UINT8, ComHandleId=953, ComSystemTemplateSystemSignalRef=DET_RANGE_ERR_044
            DET_ELEVATION_042_oRDR_DETECTION_041_044_oPCAN_RADAR_0d996f17_Tx: ComBitPosition=184, ComBitSize=8, ComSignalInitValue=0, ComSignalType=UINT8, ComHandleId=916, ComSystemTemplateSystemSignalRef=DET_ELEVATION_042
            DET_RCS_043_oRDR_DETECTION_041_044_oPCAN_RADAR_abe7e24a_Tx: ComBitPosition=352, ComBitSize=8, ComSignalInitValue=128, ComSignalType=UINT8, ComHandleId=964, ComSystemTemplateSystemSignalRef=DET_RCS_043
            DET_HVC_FLAG_044_oRDR_DETECTION_041_044_oPCAN_RADAR_708b3681_Tx: ComBitPosition=422, ComBitSize=1, ComSignalInitValue=0, ComSignalType=BOOLEAN, ComHandleId=930, ComSystemTemplateSystemSignalRef=DET_HVC_FLAG_044
            DET_HVC_FLAG_041_oRDR_DETECTION_041_044_oPCAN_RADAR_ddabba83_Tx: ComBitPosition=86, ComBitSize=1, ComSignalInitValue=0, ComSignalType=BOOLEAN, ComHandleId=927, ComSystemTemplateSystemSignalRef=DET_HVC_FLAG_041
            DET_MH_CYCLE_COUNTER_041_044_oRDR_DETECTION_041_044_oPCAN_RADAR_b55ea63d_Tx: ComBitPosition=16, ComBitSize=8, ComSignalInitValue=0, ComSignalType=UINT8, ComHandleId=936, ComSystemTemplateSystemSignalRef=DET_MH_CYCLE_COUNTER_041_044
            DET_AZIMUTH_041_oRDR_DETECTION_041_044_oPCAN_RADAR_b8cacbe5_Tx: ComBitPosition=88, ComBitSize=13, ComSignalInitValue=0, ComSignalType=UINT16, ComHandleId=891, ComSystemTemplateSystemSignalRef=DET_AZIMUTH_041
            DET_CONFD_AZIMUTH_044_oRDR_DETECTION_041_044_oPCAN_RADAR_170c4d2d_Tx: ComBitPosition=454, ComBitSize=2, ComSignalInitValue=0, ComSignalType=UINT8, ComHandleId=910, ComSystemTemplateSystemSignalRef=DET_CONFD_AZIMUTH_044
            DET_ELEVATION_ERR_042_oRDR_DETECTION_041_044_oPCAN_RADAR_8aa0f762_Tx: ComBitPosition=192, ComBitSize=6, ComSignalInitValue=0, ComSignalType=UINT8, ComHandleId=920, ComSystemTemplateSystemSignalRef=DET_ELEVATION_ERR_042
            DET_HVC_FLAG_043_oRDR_DETECTION_041_044_oPCAN_RADAR_2c3b15e8_Tx: ComBitPosition=310, ComBitSize=1, ComSignalInitValue=0, ComSignalType=BOOLEAN, ComHandleId=929, ComSystemTemplateSystemSignalRef=DET_HVC_FLAG_043
            DET_SNR_042_oRDR_DETECTION_041_044_oPCAN_RADAR_e33962dd_Tx: ComBitPosition=232, ComBitSize=8, ComSignalInitValue=0, ComSignalType=UINT8, ComHandleId=967, ComSystemTemplateSystemSignalRef=DET_SNR_042
            DET_SUPER_RES_TARGET_042_oRDR_DETECTION_041_044_oPCAN_RADAR_d2a04ab8_Tx: ComBitPosition=199, ComBitSize=1, ComSignalInitValue=0, ComSignalType=BOOLEAN, ComHandleId=971, ComSystemTemplateSystemSignalRef=DET_SUPER_RES_TARGET_042
            DET_AZIMUTH_ERR_042_oRDR_DETECTION_041_044_oPCAN_RADAR_789f25ee_Tx: ComBitPosition=217, ComBitSize=7, ComSignalInitValue=0, ComSignalType=UINT8, ComHandleId=896, ComSystemTemplateSystemSignalRef=DET_AZIMUTH_ERR_042
            DET_MH_SCAN_INDEX_4LSB_041_044_oRDR_DETECTION_041_044_oPCAN_RADAR_797483b1_Tx: ComBitPosition=476, ComBitSize=4, ComSignalInitValue=0, ComSignalType=UINT8, ComHandleId=937, ComSystemTemplateSystemSignalRef=DET_MH_SCAN_INDEX_4LSB_041_044
            DET_EXISTENCE_PROB_041_oRDR_DETECTION_041_044_oPCAN_RADAR_3cdff9fc_Tx: ComBitPosition=112, ComBitSize=6, ComSignalInitValue=0, ComSignalType=UINT8, ComHandleId=923, ComSystemTemplateSystemSignalRef=DET_EXISTENCE_PROB_041
            DET_RCS_042_oRDR_DETECTION_041_044_oPCAN_RADAR_3e9736df_Tx: ComBitPosition=240, ComBitSize=8, ComSignalInitValue=128, ComSignalType=UINT8, ComHandleId=963, ComSystemTemplateSystemSignalRef=DET_RCS_042
            DET_SUPER_RES_TARGET_044_oRDR_DETECTION_041_044_oPCAN_RADAR_1b60bd44_Tx: ComBitPosition=423, ComBitSize=1, ComSignalInitValue=0, ComSignalType=BOOLEAN, ComHandleId=973, ComSystemTemplateSystemSignalRef=DET_SUPER_RES_TARGET_044
            DET_EXISTENCE_PROB_044_oRDR_DETECTION_041_044_oPCAN_RADAR_91ff75fe_Tx: ComBitPosition=448, ComBitSize=6, ComSignalInitValue=0, ComSignalType=UINT8, ComHandleId=926, ComSystemTemplateSystemSignalRef=DET_EXISTENCE_PROB_044
            DET_MH_CRC16_041_044_oRDR_DETECTION_041_044_oPCAN_RADAR_312b070a_Tx: ComBitPosition=0, ComBitSize=16, ComSignalInitValue=0, ComSignalType=UINT16, ComHandleId=935, ComSystemTemplateSystemSignalRef=DET_MH_CRC16_041_044
            DET_CONFD_ELEVATION_043_oRDR_DETECTION_041_044_oPCAN_RADAR_49296fbe_Tx: ComBitPosition=325, ComBitSize=2, ComSignalInitValue=0, ComSignalType=UINT8, ComHandleId=913, ComSystemTemplateSystemSignalRef=DET_CONFD_ELEVATION_043
            DET_RANGE_ERR_042_oRDR_DETECTION_041_044_oPCAN_RADAR_6b5979c9_Tx: ComBitPosition=152, ComBitSize=7, ComSignalInitValue=0, ComSignalType=UINT8, ComHandleId=951, ComSystemTemplateSystemSignalRef=DET_RANGE_ERR_042
            DET_CONFD_AZIMUTH_041_oRDR_DETECTION_041_044_oPCAN_RADAR_ba2cc12f_Tx: ComBitPosition=118, ComBitSize=2, ComSignalInitValue=0, ComSignalType=UINT8, ComHandleId=907, ComSystemTemplateSystemSignalRef=DET_CONFD_AZIMUTH_041
            DET_CONFD_ELEVATION_041_oRDR_DETECTION_041_044_oPCAN_RADAR_b8b9c0d5_Tx: ComBitPosition=101, ComBitSize=2, ComSignalInitValue=0, ComSignalType=UINT8, ComHandleId=911, ComSystemTemplateSystemSignalRef=DET_CONFD_ELEVATION_041
            DET_RANGE_VELOCITY_ERR_041_oRDR_DETECTION_041_044_oPCAN_RADAR_d24c81c9_Tx: ComBitPosition=64, ComBitSize=8, ComSignalInitValue=0, ComSignalType=UINT8, ComHandleId=958, ComSystemTemplateSystemSignalRef=DET_RANGE_VELOCITY_ERR_041
            DET_RANGE_VELOCITY_ERR_044_oRDR_DETECTION_041_044_oPCAN_RADAR_7f6c0dcb_Tx: ComBitPosition=400, ComBitSize=8, ComSignalInitValue=0, ComSignalType=UINT8, ComHandleId=961, ComSystemTemplateSystemSignalRef=DET_RANGE_VELOCITY_ERR_044
            DET_SNR_043_oRDR_DETECTION_041_044_oPCAN_RADAR_7649b648_Tx: ComBitPosition=344, ComBitSize=8, ComSignalInitValue=0, ComSignalType=UINT8, ComHandleId=968, ComSystemTemplateSystemSignalRef=DET_SNR_043
            DET_RANGE_044_oRDR_DETECTION_041_044_oPCAN_RADAR_0571345c_Tx: ComBitPosition=360, ComBitSize=15, ComSignalInitValue=0, ComSignalType=UINT16, ComHandleId=949, ComSystemTemplateSystemSignalRef=DET_RANGE_044
            DET_RANGE_VELOCITY_ERR_042_oRDR_DETECTION_041_044_oPCAN_RADAR_b6acfa37_Tx: ComBitPosition=176, ComBitSize=8, ComSignalInitValue=0, ComSignalType=UINT8, ComHandleId=959, ComSystemTemplateSystemSignalRef=DET_RANGE_VELOCITY_ERR_042
            DET_CONFD_AZIMUTH_043_oRDR_DETECTION_041_044_oPCAN_RADAR_4bbc6e44_Tx: ComBitPosition=342, ComBitSize=2, ComSignalInitValue=0, ComSignalType=UINT8, ComHandleId=909, ComSystemTemplateSystemSignalRef=DET_CONFD_AZIMUTH_043
            DET_CONFD_ELEVATION_042_oRDR_DETECTION_041_044_oPCAN_RADAR_dc59bb2b_Tx: ComBitPosition=213, ComBitSize=2, ComSignalInitValue=0, ComSignalType=UINT8, ComHandleId=912, ComSystemTemplateSystemSignalRef=DET_CONFD_ELEVATION_042
            DET_AZIMUTH_043_oRDR_DETECTION_041_044_oPCAN_RADAR_495a648e_Tx: ComBitPosition=312, ComBitSize=13, ComSignalInitValue=0, ComSignalType=UINT16, ComHandleId=893, ComSystemTemplateSystemSignalRef=DET_AZIMUTH_043
            DET_RANGE_ERR_043_oRDR_DETECTION_041_044_oPCAN_RADAR_fe29ad5c_Tx: ComBitPosition=264, ComBitSize=7, ComSignalInitValue=0, ComSignalType=UINT8, ComHandleId=952, ComSystemTemplateSystemSignalRef=DET_RANGE_ERR_043
            DET_CONFD_AZIMUTH_042_oRDR_DETECTION_041_044_oPCAN_RADAR_deccbad1_Tx: ComBitPosition=230, ComBitSize=2, ComSignalInitValue=0, ComSignalType=UINT8, ComHandleId=908, ComSystemTemplateSystemSignalRef=DET_CONFD_AZIMUTH_042
            DET_BI_STATIC_FLAG_044_oRDR_DETECTION_041_044_oPCAN_RADAR_43c60762_Tx: ComBitPosition=440, ComBitSize=1, ComSignalInitValue=0, ComSignalType=BOOLEAN, ComHandleId=906, ComSystemTemplateSystemSignalRef=DET_BI_STATIC_FLAG_044
            DET_AZIMUTH_ERR_044_oRDR_DETECTION_041_044_oPCAN_RADAR_b15fd212_Tx: ComBitPosition=441, ComBitSize=7, ComSignalInitValue=0, ComSignalType=UINT8, ComHandleId=898, ComSystemTemplateSystemSignalRef=DET_AZIMUTH_ERR_044
            DET_AZIMUTH_ERR_041_oRDR_DETECTION_041_044_oPCAN_RADAR_1c7f5e10_Tx: ComBitPosition=105, ComBitSize=7, ComSignalInitValue=0, ComSignalType=UINT8, ComHandleId=895, ComSystemTemplateSystemSignalRef=DET_AZIMUTH_ERR_041
            DET_HVC_FLAG_042_oRDR_DETECTION_041_044_oPCAN_RADAR_b94bc17d_Tx: ComBitPosition=198, ComBitSize=1, ComSignalInitValue=0, ComSignalType=BOOLEAN, ComHandleId=928, ComSystemTemplateSystemSignalRef=DET_HVC_FLAG_042
            DET_MTD_043_oRDR_DETECTION_041_044_oPCAN_RADAR_c1da1c8e_Tx: ComBitPosition=271, ComBitSize=1, ComSignalInitValue=0, ComSignalType=UINT8, ComHandleId=940, ComSystemTemplateSystemSignalRef=DET_MTD_043
            DET_PROB_1STAZHYPO_041_oRDR_DETECTION_041_044_oPCAN_RADAR_a3fe5b28_Tx: ComBitPosition=103, ComBitSize=1, ComSignalInitValue=0, ComSignalType=BOOLEAN, ComHandleId=942, ComSystemTemplateSystemSignalRef=DET_PROB_1STAZHYPO_041
            DET_BELOW_RAIN_THOLD_043_oRDR_DETECTION_041_044_oPCAN_RADAR_9c5bf74e_Tx: ComBitPosition=263, ComBitSize=1, ComSignalInitValue=0, ComSignalType=UINT8, ComHandleId=901, ComSystemTemplateSystemSignalRef=DET_BELOW_RAIN_THOLD_043
            DET_BELOW_RAIN_THOLD_041_oRDR_DETECTION_041_044_oPCAN_RADAR_6dcb5825_Tx: ComBitPosition=39, ComBitSize=1, ComSignalInitValue=0, ComSignalType=UINT8, ComHandleId=899, ComSystemTemplateSystemSignalRef=DET_BELOW_RAIN_THOLD_041
            DET_MTD_042_oRDR_DETECTION_041_044_oPCAN_RADAR_54aac81b_Tx: ComBitPosition=159, ComBitSize=1, ComSignalInitValue=0, ComSignalType=UINT8, ComHandleId=939, ComSystemTemplateSystemSignalRef=DET_MTD_042
            DET_IDM_041_oRDR_DETECTION_041_044_oPCAN_RADAR_56f9813e_Tx: ComBitPosition=63, ComBitSize=1, ComSignalInitValue=0, ComSignalType=UINT8, ComHandleId=931, ComSystemTemplateSystemSignalRef=DET_IDM_041
            DET_MTD_044_oRDR_DETECTION_041_044_oPCAN_RADAR_9d6a3fe7_Tx: ComBitPosition=383, ComBitSize=1, ComSignalInitValue=0, ComSignalType=UINT8, ComHandleId=941, ComSystemTemplateSystemSignalRef=DET_MTD_044
            DET_IDM_042_oRDR_DETECTION_041_044_oPCAN_RADAR_3219fac0_Tx: ComBitPosition=175, ComBitSize=1, ComSignalInitValue=0, ComSignalType=UINT8, ComHandleId=932, ComSystemTemplateSystemSignalRef=DET_IDM_042
            DET_PROB_1STAZHYPO_044_oRDR_DETECTION_041_044_oPCAN_RADAR_0eded72a_Tx: ComBitPosition=439, ComBitSize=1, ComSignalInitValue=0, ComSignalType=BOOLEAN, ComHandleId=945, ComSystemTemplateSystemSignalRef=DET_PROB_1STAZHYPO_044
            DET_IDM_044_oRDR_DETECTION_041_044_oPCAN_RADAR_fbd90d3c_Tx: ComBitPosition=399, ComBitSize=1, ComSignalInitValue=0, ComSignalType=UINT8, ComHandleId=934, ComSystemTemplateSystemSignalRef=DET_IDM_044
            DET_IDM_043_oRDR_DETECTION_041_044_oPCAN_RADAR_a7692e55_Tx: ComBitPosition=287, ComBitSize=1, ComSignalInitValue=0, ComSignalType=UINT8, ComHandleId=933, ComSystemTemplateSystemSignalRef=DET_IDM_043
            DET_MTD_041_oRDR_DETECTION_041_044_oPCAN_RADAR_304ab3e5_Tx: ComBitPosition=47, ComBitSize=1, ComSignalInitValue=0, ComSignalType=UINT8, ComHandleId=938, ComSystemTemplateSystemSignalRef=DET_MTD_041
            DET_BELOW_RAIN_THOLD_042_oRDR_DETECTION_041_044_oPCAN_RADAR_092b23db_Tx: ComBitPosition=151, ComBitSize=1, ComSignalInitValue=0, ComSignalType=UINT8, ComHandleId=900, ComSystemTemplateSystemSignalRef=DET_BELOW_RAIN_THOLD_042
            DET_BELOW_RAIN_THOLD_044_oRDR_DETECTION_041_044_oPCAN_RADAR_c0ebd427_Tx: ComBitPosition=375, ComBitSize=1, ComSignalInitValue=0, ComSignalType=UINT8, ComHandleId=902, ComSystemTemplateSystemSignalRef=DET_BELOW_RAIN_THOLD_044
            DET_PROB_1STAZHYPO_042_oRDR_DETECTION_041_044_oPCAN_RADAR_c71e20d6_Tx: ComBitPosition=215, ComBitSize=1, ComSignalInitValue=0, ComSignalType=BOOLEAN, ComHandleId=943, ComSystemTemplateSystemSignalRef=DET_PROB_1STAZHYPO_042
            DET_PROB_1STAZHYPO_043_oRDR_DETECTION_041_044_oPCAN_RADAR_526ef443_Tx: ComBitPosition=327, ComBitSize=1, ComSignalInitValue=0, ComSignalType=BOOLEAN, ComHandleId=944, ComSystemTemplateSystemSignalRef=DET_PROB_1STAZHYPO_043
        SG_Detections_045_048_oRDR_DETECTION_045_048_oPCAN_RADAR_c460e153_Tx: ComTransferProperty=TRIGGERED, ComHandleId=13, ComSystemTemplateSignalGroupRef=SG_Detections_045_048
          83 x ComGroupSignal, all with ComSignalEndianness=LITTLE_ENDIAN, ComTransferProperty=PENDING, ComSignalAccess=ACCESS_NEEDED_BY_SWC_OR_COM:
            DET_MH_CYCLE_COUNTER_045_048_oRDR_DETECTION_045_048_oPCAN_RADAR_c49d926f_Tx: ComBitPosition=16, ComBitSize=8, ComSignalInitValue=0, ComSignalType=UINT8, ComHandleId=1019, ComSystemTemplateSystemSignalRef=DET_MH_CYCLE_COUNTER_045_048
            DET_RANGE_046_oRDR_DETECTION_045_048_oPCAN_RADAR_1d530503_Tx: ComBitPosition=136, ComBitSize=15, ComSignalInitValue=0, ComSignalType=UINT16, ComHandleId=1030, ComSystemTemplateSystemSignalRef=DET_RANGE_046
            DET_EXISTENCE_PROB_045_oRDR_DETECTION_045_048_oPCAN_RADAR_ed3d3f5f_Tx: ComBitPosition=112, ComBitSize=6, ComSignalInitValue=0, ComSignalType=UINT8, ComHandleId=1006, ComSystemTemplateSystemSignalRef=DET_EXISTENCE_PROB_045
            DET_BI_STATIC_FLAG_046_oRDR_DETECTION_045_048_oPCAN_RADAR_5be4363d_Tx: ComBitPosition=216, ComBitSize=1, ComSignalInitValue=0, ComSignalType=BOOLEAN, ComHandleId=987, ComSystemTemplateSystemSignalRef=DET_BI_STATIC_FLAG_046
            DET_ELEVATION_047_oRDR_DETECTION_045_048_oPCAN_RADAR_490b7d21_Tx: ComBitPosition=296, ComBitSize=8, ComSignalInitValue=0, ComSignalType=UINT8, ComHandleId=1000, ComSystemTemplateSystemSignalRef=DET_ELEVATION_047
            DET_AZIMUTH_046_oRDR_DETECTION_045_048_oPCAN_RADAR_0dc876b8_Tx: ComBitPosition=200, ComBitSize=13, ComSignalInitValue=0, ComSignalType=UINT16, ComHandleId=975, ComSystemTemplateSystemSignalRef=DET_AZIMUTH_046
            DET_CONFD_AZIMUTH_045_oRDR_DETECTION_045_048_oPCAN_RADAR_6bce078c_Tx: ComBitPosition=118, ComBitSize=2, ComSignalInitValue=0, ComSignalType=UINT8, ComHandleId=990, ComSystemTemplateSystemSignalRef=DET_CONFD_AZIMUTH_045
            DET_AZIMUTH_ERR_046_oRDR_DETECTION_045_048_oPCAN_RADAR_a97de34d_Tx: ComBitPosition=217, ComBitSize=7, ComSignalInitValue=0, ComSignalType=UINT8, ComHandleId=979, ComSystemTemplateSystemSignalRef=DET_AZIMUTH_ERR_046
            DET_ELEVATION_ERR_046_oRDR_DETECTION_045_048_oPCAN_RADAR_5b4231c1_Tx: ComBitPosition=192, ComBitSize=6, ComSignalInitValue=0, ComSignalType=UINT8, ComHandleId=1003, ComSystemTemplateSystemSignalRef=DET_ELEVATION_ERR_046
            DET_RANGE_VELOCITY_045_oRDR_DETECTION_045_048_oPCAN_RADAR_0c15bcd8_Tx: ComBitPosition=48, ComBitSize=15, ComSignalInitValue=16384, ComSignalType=UINT16, ComHandleId=1037, ComSystemTemplateSystemSignalRef=DET_RANGE_VELOCITY_045
            DET_HVC_FLAG_046_oRDR_DETECTION_045_048_oPCAN_RADAR_68a907de_Tx: ComBitPosition=198, ComBitSize=1, ComSignalInitValue=0, ComSignalType=BOOLEAN, ComHandleId=1011, ComSystemTemplateSystemSignalRef=DET_HVC_FLAG_046
            DET_BI_STATIC_FLAG_045_oRDR_DETECTION_045_048_oPCAN_RADAR_3f044dc3_Tx: ComBitPosition=104, ComBitSize=1, ComSignalInitValue=0, ComSignalType=BOOLEAN, ComHandleId=986, ComSystemTemplateSystemSignalRef=DET_BI_STATIC_FLAG_045
            DET_RANGE_VELOCITY_048_oRDR_DETECTION_045_048_oPCAN_RADAR_d19581f4_Tx: ComBitPosition=384, ComBitSize=15, ComSignalInitValue=16384, ComSignalType=UINT16, ComHandleId=1040, ComSystemTemplateSystemSignalRef=DET_RANGE_VELOCITY_048
            DET_CONFD_ELEVATION_048_oRDR_DETECTION_045_048_oPCAN_RADAR_b4db3b5a_Tx: ComBitPosition=437, ComBitSize=2, ComSignalInitValue=0, ComSignalType=UINT8, ComHandleId=997, ComSystemTemplateSystemSignalRef=DET_CONFD_ELEVATION_048
            DET_ELEVATION_045_oRDR_DETECTION_045_048_oPCAN_RADAR_b89bd24a_Tx: ComBitPosition=72, ComBitSize=8, ComSignalInitValue=0, ComSignalType=UINT8, ComHandleId=998, ComSystemTemplateSystemSignalRef=DET_ELEVATION_045
            DET_EXISTENCE_PROB_046_oRDR_DETECTION_045_048_oPCAN_RADAR_89dd44a1_Tx: ComBitPosition=224, ComBitSize=6, ComSignalInitValue=0, ComSignalType=UINT8, ComHandleId=1007, ComSystemTemplateSystemSignalRef=DET_EXISTENCE_PROB_046
            DET_SUPER_RES_TARGET_048_oRDR_DETECTION_045_048_oPCAN_RADAR_ba22cac9_Tx: ComBitPosition=423, ComBitSize=1, ComSignalInitValue=0, ComSignalType=BOOLEAN, ComHandleId=1056, ComSystemTemplateSystemSignalRef=DET_SUPER_RES_TARGET_048
            DET_ELEVATION_ERR_045_oRDR_DETECTION_045_048_oPCAN_RADAR_3fa24a3f_Tx: ComBitPosition=80, ComBitSize=6, ComSignalInitValue=0, ComSignalType=UINT8, ComHandleId=1002, ComSystemTemplateSystemSignalRef=DET_ELEVATION_ERR_045
            DET_RANGE_047_oRDR_DETECTION_045_048_oPCAN_RADAR_8823d196_Tx: ComBitPosition=248, ComBitSize=15, ComSignalInitValue=0, ComSignalType=UINT16, ComHandleId=1031, ComSystemTemplateSystemSignalRef=DET_RANGE_047
            DET_AZIMUTH_ERR_045_oRDR_DETECTION_045_048_oPCAN_RADAR_cd9d98b3_Tx: ComBitPosition=105, ComBitSize=7, ComSignalInitValue=0, ComSignalType=UINT8, ComHandleId=978, ComSystemTemplateSystemSignalRef=DET_AZIMUTH_ERR_045
            DET_CONFD_ELEVATION_046_oRDR_DETECTION_045_048_oPCAN_RADAR_0dbb7d88_Tx: ComBitPosition=213, ComBitSize=2, ComSignalInitValue=0, ComSignalType=UINT8, ComHandleId=995, ComSystemTemplateSystemSignalRef=DET_CONFD_ELEVATION_046
            DET_RANGE_ERR_048_oRDR_DETECTION_045_048_oPCAN_RADAR_03dbf9b8_Tx: ComBitPosition=376, ComBitSize=7, ComSignalInitValue=0, ComSignalType=UINT8, ComHandleId=1036, ComSystemTemplateSystemSignalRef=DET_RANGE_ERR_048
            DET_AZIMUTH_ERR_048_oRDR_DETECTION_045_048_oPCAN_RADAR_101da59f_Tx: ComBitPosition=441, ComBitSize=7, ComSignalInitValue=0, ComSignalType=UINT8, ComHandleId=981, ComSystemTemplateSystemSignalRef=DET_AZIMUTH_ERR_048
            DET_AZIMUTH_047_oRDR_DETECTION_045_048_oPCAN_RADAR_98b8a22d_Tx: ComBitPosition=312, ComBitSize=13, ComSignalInitValue=0, ComSignalType=UINT16, ComHandleId=976, ComSystemTemplateSystemSignalRef=DET_AZIMUTH_047
            DET_RANGE_VELOCITY_046_oRDR_DETECTION_045_048_oPCAN_RADAR_68f5c726_Tx: ComBitPosition=160, ComBitSize=15, ComSignalInitValue=16384, ComSignalType=UINT16, ComHandleId=1038, ComSystemTemplateSystemSignalRef=DET_RANGE_VELOCITY_046
            DET_SNR_047_oRDR_DETECTION_045_048_oPCAN_RADAR_a7ab70eb_Tx: ComBitPosition=344, ComBitSize=8, ComSignalInitValue=0, ComSignalType=UINT8, ComHandleId=1051, ComSystemTemplateSystemSignalRef=DET_SNR_047
            DET_ELEVATION_048_oRDR_DETECTION_045_048_oPCAN_RADAR_651bef66_Tx: ComBitPosition=408, ComBitSize=8, ComSignalInitValue=0, ComSignalType=UINT8, ComHandleId=1001, ComSystemTemplateSystemSignalRef=DET_ELEVATION_048
            DET_RANGE_VELOCITY_ERR_045_oRDR_DETECTION_045_048_oPCAN_RADAR_03ae476a_Tx: ComBitPosition=64, ComBitSize=8, ComSignalInitValue=0, ComSignalType=UINT8, ComHandleId=1041, ComSystemTemplateSystemSignalRef=DET_RANGE_VELOCITY_ERR_045
            DET_RANGE_ERR_046_oRDR_DETECTION_045_048_oPCAN_RADAR_babbbf6a_Tx: ComBitPosition=152, ComBitSize=7, ComSignalInitValue=0, ComSignalType=UINT8, ComHandleId=1034, ComSystemTemplateSystemSignalRef=DET_RANGE_ERR_046
            DET_RANGE_VELOCITY_ERR_047_oRDR_DETECTION_045_048_oPCAN_RADAR_f23ee801_Tx: ComBitPosition=288, ComBitSize=8, ComSignalInitValue=0, ComSignalType=UINT8, ComHandleId=1043, ComSystemTemplateSystemSignalRef=DET_RANGE_VELOCITY_ERR_047
            DET_BI_STATIC_FLAG_048_oRDR_DETECTION_045_048_oPCAN_RADAR_e28470ef_Tx: ComBitPosition=440, ComBitSize=1, ComSignalInitValue=0, ComSignalType=BOOLEAN, ComHandleId=989, ComSystemTemplateSystemSignalRef=DET_BI_STATIC_FLAG_048
            DET_CONFD_ELEVATION_047_oRDR_DETECTION_045_048_oPCAN_RADAR_98cba91d_Tx: ComBitPosition=325, ComBitSize=2, ComSignalInitValue=0, ComSignalType=UINT8, ComHandleId=996, ComSystemTemplateSystemSignalRef=DET_CONFD_ELEVATION_047
            DET_RANGE_VELOCITY_047_oRDR_DETECTION_045_048_oPCAN_RADAR_fd8513b3_Tx: ComBitPosition=272, ComBitSize=15, ComSignalInitValue=16384, ComSignalType=UINT16, ComHandleId=1039, ComSystemTemplateSystemSignalRef=DET_RANGE_VELOCITY_047
            DET_RANGE_ERR_047_oRDR_DETECTION_045_048_oPCAN_RADAR_2fcb6bff_Tx: ComBitPosition=264, ComBitSize=7, ComSignalInitValue=0, ComSignalType=UINT8, ComHandleId=1035, ComSystemTemplateSystemSignalRef=DET_RANGE_ERR_047
            DET_RCS_047_oRDR_DETECTION_045_048_oPCAN_RADAR_7a0524e9_Tx: ComBitPosition=352, ComBitSize=8, ComSignalInitValue=128, ComSignalType=UINT8, ComHandleId=1047, ComSystemTemplateSystemSignalRef=DET_RCS_047
            DET_SNR_045_oRDR_DETECTION_045_048_oPCAN_RADAR_563bdf80_Tx: ComBitPosition=120, ComBitSize=8, ComSignalInitValue=0, ComSignalType=UINT8, ComHandleId=1049, ComSystemTemplateSystemSignalRef=DET_SNR_045
            DET_RCS_048_oRDR_DETECTION_045_048_oPCAN_RADAR_5615b6ae_Tx: ComBitPosition=464, ComBitSize=8, ComSignalInitValue=128, ComSignalType=UINT8, ComHandleId=1048, ComSystemTemplateSystemSignalRef=DET_RCS_048
            DET_SUPER_RES_TARGET_047_oRDR_DETECTION_045_048_oPCAN_RADAR_9632588e_Tx: ComBitPosition=311, ComBitSize=1, ComSignalInitValue=0, ComSignalType=BOOLEAN, ComHandleId=1055, ComSystemTemplateSystemSignalRef=DET_SUPER_RES_TARGET_047
            DET_BI_STATIC_FLAG_047_oRDR_DETECTION_045_048_oPCAN_RADAR_ce94e2a8_Tx: ComBitPosition=328, ComBitSize=1, ComSignalInitValue=0, ComSignalType=BOOLEAN, ComHandleId=988, ComSystemTemplateSystemSignalRef=DET_BI_STATIC_FLAG_047
            DET_CONFD_ELEVATION_045_oRDR_DETECTION_045_048_oPCAN_RADAR_695b0676_Tx: ComBitPosition=101, ComBitSize=2, ComSignalInitValue=0, ComSignalType=UINT8, ComHandleId=994, ComSystemTemplateSystemSignalRef=DET_CONFD_ELEVATION_045
            DET_SNR_046_oRDR_DETECTION_045_048_oPCAN_RADAR_32dba47e_Tx: ComBitPosition=232, ComBitSize=8, ComSignalInitValue=0, ComSignalType=UINT8, ComHandleId=1050, ComSystemTemplateSystemSignalRef=DET_SNR_046
            DET_ELEVATION_ERR_047_oRDR_DETECTION_045_048_oPCAN_RADAR_ce32e554_Tx: ComBitPosition=304, ComBitSize=6, ComSignalInitValue=0, ComSignalType=UINT8, ComHandleId=1004, ComSystemTemplateSystemSignalRef=DET_ELEVATION_ERR_047
            DET_MH_CRC16_045_048_oRDR_DETECTION_045_048_oPCAN_RADAR_40e83358_Tx: ComBitPosition=0, ComBitSize=16, ComSignalInitValue=0, ComSignalType=UINT16, ComHandleId=1018, ComSystemTemplateSystemSignalRef=DET_MH_CRC16_045_048
            DET_AZIMUTH_048_oRDR_DETECTION_045_048_oPCAN_RADAR_b4a8306a_Tx: ComBitPosition=424, ComBitSize=13, ComSignalInitValue=0, ComSignalType=UINT16, ComHandleId=977, ComSystemTemplateSystemSignalRef=DET_AZIMUTH_048
            DET_RCS_045_oRDR_DETECTION_045_048_oPCAN_RADAR_8b958b82_Tx: ComBitPosition=128, ComBitSize=8, ComSignalInitValue=128, ComSignalType=UINT8, ComHandleId=1045, ComSystemTemplateSystemSignalRef=DET_RCS_045
            DET_RANGE_VELOCITY_ERR_048_oRDR_DETECTION_045_048_oPCAN_RADAR_de2e7a46_Tx: ComBitPosition=400, ComBitSize=8, ComSignalInitValue=0, ComSignalType=UINT8, ComHandleId=1044, ComSystemTemplateSystemSignalRef=DET_RANGE_VELOCITY_ERR_048
            DET_CONFD_AZIMUTH_047_oRDR_DETECTION_045_048_oPCAN_RADAR_9a5ea8e7_Tx: ComBitPosition=342, ComBitSize=2, ComSignalInitValue=0, ComSignalType=UINT8, ComHandleId=992, ComSystemTemplateSystemSignalRef=DET_CONFD_AZIMUTH_047
            DET_RCS_046_oRDR_DETECTION_045_048_oPCAN_RADAR_ef75f07c_Tx: ComBitPosition=240, ComBitSize=8, ComSignalInitValue=128, ComSignalType=UINT8, ComHandleId=1046, ComSystemTemplateSystemSignalRef=DET_RCS_046
            DET_SUPER_RES_TARGET_046_oRDR_DETECTION_045_048_oPCAN_RADAR_03428c1b_Tx: ComBitPosition=199, ComBitSize=1, ComSignalInitValue=0, ComSignalType=BOOLEAN, ComHandleId=1054, ComSystemTemplateSystemSignalRef=DET_SUPER_RES_TARGET_046
            DET_HVC_FLAG_047_oRDR_DETECTION_045_048_oPCAN_RADAR_fdd9d34b_Tx: ComBitPosition=310, ComBitSize=1, ComSignalInitValue=0, ComSignalType=BOOLEAN, ComHandleId=1012, ComSystemTemplateSystemSignalRef=DET_HVC_FLAG_047
            DET_AZIMUTH_045_oRDR_DETECTION_045_048_oPCAN_RADAR_69280d46_Tx: ComBitPosition=88, ComBitSize=13, ComSignalInitValue=0, ComSignalType=UINT16, ComHandleId=974, ComSystemTemplateSystemSignalRef=DET_AZIMUTH_045
            DET_CONFD_AZIMUTH_046_oRDR_DETECTION_045_048_oPCAN_RADAR_0f2e7c72_Tx: ComBitPosition=230, ComBitSize=2, ComSignalInitValue=0, ComSignalType=UINT8, ComHandleId=991, ComSystemTemplateSystemSignalRef=DET_CONFD_AZIMUTH_046
            DET_HVC_FLAG_045_oRDR_DETECTION_045_048_oPCAN_RADAR_0c497c20_Tx: ComBitPosition=86, ComBitSize=1, ComSignalInitValue=0, ComSignalType=BOOLEAN, ComHandleId=1010, ComSystemTemplateSystemSignalRef=DET_HVC_FLAG_045
            DET_SUPER_RES_TARGET_045_oRDR_DETECTION_045_048_oPCAN_RADAR_67a2f7e5_Tx: ComBitPosition=87, ComBitSize=1, ComSignalInitValue=0, ComSignalType=BOOLEAN, ComHandleId=1053, ComSystemTemplateSystemSignalRef=DET_SUPER_RES_TARGET_045
            DET_CONFD_AZIMUTH_048_oRDR_DETECTION_045_048_oPCAN_RADAR_b64e3aa0_Tx: ComBitPosition=454, ComBitSize=2, ComSignalInitValue=0, ComSignalType=UINT8, ComHandleId=993, ComSystemTemplateSystemSignalRef=DET_CONFD_AZIMUTH_048
            DET_ELEVATION_046_oRDR_DETECTION_045_048_oPCAN_RADAR_dc7ba9b4_Tx: ComBitPosition=184, ComBitSize=8, ComSignalInitValue=0, ComSignalType=UINT8, ComHandleId=999, ComSystemTemplateSystemSignalRef=DET_ELEVATION_046
            DET_RANGE_VELOCITY_ERR_046_oRDR_DETECTION_045_048_oPCAN_RADAR_674e3c94_Tx: ComBitPosition=176, ComBitSize=8, ComSignalInitValue=0, ComSignalType=UINT8, ComHandleId=1042, ComSystemTemplateSystemSignalRef=DET_RANGE_VELOCITY_ERR_046
            DET_ELEVATION_ERR_048_oRDR_DETECTION_045_048_oPCAN_RADAR_e2227713_Tx: ComBitPosition=416, ComBitSize=6, ComSignalInitValue=0, ComSignalType=UINT8, ComHandleId=1005, ComSystemTemplateSystemSignalRef=DET_ELEVATION_ERR_048
            DET_RANGE_048_oRDR_DETECTION_045_048_oPCAN_RADAR_a43343d1_Tx: ComBitPosition=360, ComBitSize=15, ComSignalInitValue=0, ComSignalType=UINT16, ComHandleId=1032, ComSystemTemplateSystemSignalRef=DET_RANGE_048
            DET_EXISTENCE_PROB_047_oRDR_DETECTION_045_048_oPCAN_RADAR_1cad9034_Tx: ComBitPosition=336, ComBitSize=6, ComSignalInitValue=0, ComSignalType=UINT8, ComHandleId=1008, ComSystemTemplateSystemSignalRef=DET_EXISTENCE_PROB_047
            DET_RANGE_ERR_045_oRDR_DETECTION_045_048_oPCAN_RADAR_de5bc494_Tx: ComBitPosition=40, ComBitSize=7, ComSignalInitValue=0, ComSignalType=UINT8, ComHandleId=1033, ComSystemTemplateSystemSignalRef=DET_RANGE_ERR_045
            DET_MH_SCAN_INDEX_4LSB_045_048_oRDR_DETECTION_045_048_oPCAN_RADAR_08b7b7e3_Tx: ComBitPosition=476, ComBitSize=4, ComSignalInitValue=0, ComSignalType=UINT8, ComHandleId=1020, ComSystemTemplateSystemSignalRef=DET_MH_SCAN_INDEX_4LSB_045_048
            DET_HVC_FLAG_048_oRDR_DETECTION_045_048_oPCAN_RADAR_d1c9410c_Tx: ComBitPosition=422, ComBitSize=1, ComSignalInitValue=0, ComSignalType=BOOLEAN, ComHandleId=1013, ComSystemTemplateSystemSignalRef=DET_HVC_FLAG_048
            DET_SNR_048_oRDR_DETECTION_045_048_oPCAN_RADAR_8bbbe2ac_Tx: ComBitPosition=456, ComBitSize=8, ComSignalInitValue=0, ComSignalType=UINT8, ComHandleId=1052, ComSystemTemplateSystemSignalRef=DET_SNR_048
            DET_AZIMUTH_ERR_047_oRDR_DETECTION_045_048_oPCAN_RADAR_3c0d37d8_Tx: ComBitPosition=329, ComBitSize=7, ComSignalInitValue=0, ComSignalType=UINT8, ComHandleId=980, ComSystemTemplateSystemSignalRef=DET_AZIMUTH_ERR_047
            DET_EXISTENCE_PROB_048_oRDR_DETECTION_045_048_oPCAN_RADAR_30bd0273_Tx: ComBitPosition=448, ComBitSize=6, ComSignalInitValue=0, ComSignalType=UINT8, ComHandleId=1009, ComSystemTemplateSystemSignalRef=DET_EXISTENCE_PROB_048
            DET_RANGE_045_oRDR_DETECTION_045_048_oPCAN_RADAR_79b37efd_Tx: ComBitPosition=24, ComBitSize=15, ComSignalInitValue=0, ComSignalType=UINT16, ComHandleId=1029, ComSystemTemplateSystemSignalRef=DET_RANGE_045
            DET_MTD_045_oRDR_DETECTION_045_048_oPCAN_RADAR_e1a87546_Tx: ComBitPosition=47, ComBitSize=1, ComSignalInitValue=0, ComSignalType=UINT8, ComHandleId=1021, ComSystemTemplateSystemSignalRef=DET_MTD_045
            DET_PROB_1STAZHYPO_046_oRDR_DETECTION_045_048_oPCAN_RADAR_16fce675_Tx: ComBitPosition=215, ComBitSize=1, ComSignalInitValue=0, ComSignalType=BOOLEAN, ComHandleId=1026, ComSystemTemplateSystemSignalRef=DET_PROB_1STAZHYPO_046
            DET_IDM_048_oRDR_DETECTION_045_048_oPCAN_RADAR_5a9b7ab1_Tx: ComBitPosition=399, ComBitSize=1, ComSignalInitValue=0, ComSignalType=UINT8, ComHandleId=1017, ComSystemTemplateSystemSignalRef=DET_IDM_048
            DET_MTD_047_oRDR_DETECTION_045_048_oPCAN_RADAR_1038da2d_Tx: ComBitPosition=271, ComBitSize=1, ComSignalInitValue=0, ComSignalType=UINT8, ComHandleId=1023, ComSystemTemplateSystemSignalRef=DET_MTD_047
            DET_PROB_1STAZHYPO_048_oRDR_DETECTION_045_048_oPCAN_RADAR_af9ca0a7_Tx: ComBitPosition=439, ComBitSize=1, ComSignalInitValue=0, ComSignalType=BOOLEAN, ComHandleId=1028, ComSystemTemplateSystemSignalRef=DET_PROB_1STAZHYPO_048
            DET_BELOW_RAIN_THOLD_047_oRDR_DETECTION_045_048_oPCAN_RADAR_4db931ed_Tx: ComBitPosition=263, ComBitSize=1, ComSignalInitValue=0, ComSignalType=UINT8, ComHandleId=984, ComSystemTemplateSystemSignalRef=DET_BELOW_RAIN_THOLD_047
            DET_IDM_047_oRDR_DETECTION_045_048_oPCAN_RADAR_768be8f6_Tx: ComBitPosition=287, ComBitSize=1, ComSignalInitValue=0, ComSignalType=UINT8, ComHandleId=1016, ComSystemTemplateSystemSignalRef=DET_IDM_047
            DET_MTD_048_oRDR_DETECTION_045_048_oPCAN_RADAR_3c28486a_Tx: ComBitPosition=383, ComBitSize=1, ComSignalInitValue=0, ComSignalType=UINT8, ComHandleId=1024, ComSystemTemplateSystemSignalRef=DET_MTD_048
            DET_PROB_1STAZHYPO_045_oRDR_DETECTION_045_048_oPCAN_RADAR_721c9d8b_Tx: ComBitPosition=103, ComBitSize=1, ComSignalInitValue=0, ComSignalType=BOOLEAN, ComHandleId=1025, ComSystemTemplateSystemSignalRef=DET_PROB_1STAZHYPO_045
            DET_IDM_046_oRDR_DETECTION_045_048_oPCAN_RADAR_e3fb3c63_Tx: ComBitPosition=175, ComBitSize=1, ComSignalInitValue=0, ComSignalType=UINT8, ComHandleId=1015, ComSystemTemplateSystemSignalRef=DET_IDM_046
            DET_BELOW_RAIN_THOLD_048_oRDR_DETECTION_045_048_oPCAN_RADAR_61a9a3aa_Tx: ComBitPosition=375, ComBitSize=1, ComSignalInitValue=0, ComSignalType=UINT8, ComHandleId=985, ComSystemTemplateSystemSignalRef=DET_BELOW_RAIN_THOLD_048
            DET_MTD_046_oRDR_DETECTION_045_048_oPCAN_RADAR_85480eb8_Tx: ComBitPosition=159, ComBitSize=1, ComSignalInitValue=0, ComSignalType=UINT8, ComHandleId=1022, ComSystemTemplateSystemSignalRef=DET_MTD_046
            DET_PROB_1STAZHYPO_047_oRDR_DETECTION_045_048_oPCAN_RADAR_838c32e0_Tx: ComBitPosition=327, ComBitSize=1, ComSignalInitValue=0, ComSignalType=BOOLEAN, ComHandleId=1027, ComSystemTemplateSystemSignalRef=DET_PROB_1STAZHYPO_047
            DET_IDM_045_oRDR_DETECTION_045_048_oPCAN_RADAR_871b479d_Tx: ComBitPosition=63, ComBitSize=1, ComSignalInitValue=0, ComSignalType=UINT8, ComHandleId=1014, ComSystemTemplateSystemSignalRef=DET_IDM_045
            DET_BELOW_RAIN_THOLD_045_oRDR_DETECTION_045_048_oPCAN_RADAR_bc299e86_Tx: ComBitPosition=39, ComBitSize=1, ComSignalInitValue=0, ComSignalType=UINT8, ComHandleId=982, ComSystemTemplateSystemSignalRef=DET_BELOW_RAIN_THOLD_045
            DET_BELOW_RAIN_THOLD_046_oRDR_DETECTION_045_048_oPCAN_RADAR_d8c9e578_Tx: ComBitPosition=151, ComBitSize=1, ComSignalInitValue=0, ComSignalType=UINT8, ComHandleId=983, ComSystemTemplateSystemSignalRef=DET_BELOW_RAIN_THOLD_046
        SG_Detections_021_024_oRDR_DETECTION_021_024_oPCAN_RADAR_ea3d35f7_Tx: ComTransferProperty=TRIGGERED, ComHandleId=7, ComSystemTemplateSignalGroupRef=SG_Detections_021_024
          83 x ComGroupSignal, all with ComSignalEndianness=LITTLE_ENDIAN, ComTransferProperty=PENDING, ComSignalAccess=ACCESS_NEEDED_BY_SWC_OR_COM:
            DET_CONFD_AZIMUTH_024_oRDR_DETECTION_021_024_oPCAN_RADAR_5570c4de_Tx: ComBitPosition=454, ComBitSize=2, ComSignalInitValue=0, ComSignalType=UINT8, ComHandleId=495, ComSystemTemplateSystemSignalRef=DET_CONFD_AZIMUTH_024
            DET_EXISTENCE_PROB_022_oRDR_DETECTION_021_024_oPCAN_RADAR_1a430bf1_Tx: ComBitPosition=224, ComBitSize=6, ComSignalInitValue=0, ComSignalType=UINT8, ComHandleId=509, ComSystemTemplateSystemSignalRef=DET_EXISTENCE_PROB_022
            DET_RANGE_022_oRDR_DETECTION_021_024_oPCAN_RADAR_8ecd4a53_Tx: ComBitPosition=136, ComBitSize=15, ComSignalInitValue=0, ComSignalType=UINT16, ComHandleId=532, ComSystemTemplateSystemSignalRef=DET_RANGE_022
            DET_HVC_FLAG_021_oRDR_DETECTION_021_024_oPCAN_RADAR_9fd73370_Tx: ComBitPosition=86, ComBitSize=1, ComSignalInitValue=0, ComSignalType=BOOLEAN, ComHandleId=512, ComSystemTemplateSystemSignalRef=DET_HVC_FLAG_021
            DET_BI_STATIC_FLAG_021_oRDR_DETECTION_021_024_oPCAN_RADAR_ac9a0293_Tx: ComBitPosition=104, ComBitSize=1, ComSignalInitValue=0, ComSignalType=BOOLEAN, ComHandleId=488, ComSystemTemplateSystemSignalRef=DET_BI_STATIC_FLAG_021
            DET_SNR_022_oRDR_DETECTION_021_024_oPCAN_RADAR_a145eb2e_Tx: ComBitPosition=232, ComBitSize=8, ComSignalInitValue=0, ComSignalType=UINT8, ComHandleId=552, ComSystemTemplateSystemSignalRef=DET_SNR_022
            DET_AZIMUTH_023_oRDR_DETECTION_021_024_oPCAN_RADAR_0b26ed7d_Tx: ComBitPosition=312, ComBitSize=13, ComSignalInitValue=0, ComSignalType=UINT16, ComHandleId=478, ComSystemTemplateSystemSignalRef=DET_AZIMUTH_023
            DET_SNR_024_oRDR_DETECTION_021_024_oPCAN_RADAR_68851cd2_Tx: ComBitPosition=456, ComBitSize=8, ComSignalInitValue=0, ComSignalType=UINT8, ComHandleId=554, ComSystemTemplateSystemSignalRef=DET_SNR_024
            DET_AZIMUTH_ERR_021_oRDR_DETECTION_021_024_oPCAN_RADAR_5e03d7e3_Tx: ComBitPosition=105, ComBitSize=7, ComSignalInitValue=0, ComSignalType=UINT8, ComHandleId=480, ComSystemTemplateSystemSignalRef=DET_AZIMUTH_ERR_021
            DET_CONFD_ELEVATION_023_oRDR_DETECTION_021_024_oPCAN_RADAR_0b55e64d_Tx: ComBitPosition=325, ComBitSize=2, ComSignalInitValue=0, ComSignalType=UINT8, ComHandleId=498, ComSystemTemplateSystemSignalRef=DET_CONFD_ELEVATION_023
            DET_ELEVATION_023_oRDR_DETECTION_021_024_oPCAN_RADAR_da953271_Tx: ComBitPosition=296, ComBitSize=8, ComSignalInitValue=0, ComSignalType=UINT8, ComHandleId=502, ComSystemTemplateSystemSignalRef=DET_ELEVATION_023
            DET_RANGE_023_oRDR_DETECTION_021_024_oPCAN_RADAR_1bbd9ec6_Tx: ComBitPosition=248, ComBitSize=15, ComSignalInitValue=0, ComSignalType=UINT16, ComHandleId=533, ComSystemTemplateSystemSignalRef=DET_RANGE_023
            DET_CONFD_ELEVATION_022_oRDR_DETECTION_021_024_oPCAN_RADAR_9e2532d8_Tx: ComBitPosition=213, ComBitSize=2, ComSignalInitValue=0, ComSignalType=UINT8, ComHandleId=497, ComSystemTemplateSystemSignalRef=DET_CONFD_ELEVATION_022
            DET_RCS_021_oRDR_DETECTION_021_024_oPCAN_RADAR_180bc4d2_Tx: ComBitPosition=128, ComBitSize=8, ComSignalInitValue=128, ComSignalType=UINT8, ComHandleId=547, ComSystemTemplateSystemSignalRef=DET_RCS_021
            DET_RANGE_024_oRDR_DETECTION_021_024_oPCAN_RADAR_470dbdaf_Tx: ComBitPosition=360, ComBitSize=15, ComSignalInitValue=0, ComSignalType=UINT16, ComHandleId=534, ComSystemTemplateSystemSignalRef=DET_RANGE_024
            DET_CONFD_AZIMUTH_022_oRDR_DETECTION_021_024_oPCAN_RADAR_9cb03322_Tx: ComBitPosition=230, ComBitSize=2, ComSignalInitValue=0, ComSignalType=UINT8, ComHandleId=493, ComSystemTemplateSystemSignalRef=DET_CONFD_AZIMUTH_022
            DET_RCS_022_oRDR_DETECTION_021_024_oPCAN_RADAR_7cebbf2c_Tx: ComBitPosition=240, ComBitSize=8, ComSignalInitValue=128, ComSignalType=UINT8, ComHandleId=548, ComSystemTemplateSystemSignalRef=DET_RCS_022
            DET_ELEVATION_ERR_021_oRDR_DETECTION_021_024_oPCAN_RADAR_ac3c056f_Tx: ComBitPosition=80, ComBitSize=6, ComSignalInitValue=0, ComSignalType=UINT8, ComHandleId=504, ComSystemTemplateSystemSignalRef=DET_ELEVATION_ERR_021
            DET_RANGE_VELOCITY_023_oRDR_DETECTION_021_024_oPCAN_RADAR_6e1b5ce3_Tx: ComBitPosition=272, ComBitSize=15, ComSignalInitValue=16384, ComSignalType=UINT16, ComHandleId=541, ComSystemTemplateSystemSignalRef=DET_RANGE_VELOCITY_023
            DET_HVC_FLAG_024_oRDR_DETECTION_021_024_oPCAN_RADAR_32f7bf72_Tx: ComBitPosition=422, ComBitSize=1, ComSignalInitValue=0, ComSignalType=BOOLEAN, ComHandleId=515, ComSystemTemplateSystemSignalRef=DET_HVC_FLAG_024
            DET_AZIMUTH_ERR_022_oRDR_DETECTION_021_024_oPCAN_RADAR_3ae3ac1d_Tx: ComBitPosition=217, ComBitSize=7, ComSignalInitValue=0, ComSignalType=UINT8, ComHandleId=481, ComSystemTemplateSystemSignalRef=DET_AZIMUTH_ERR_022
            DET_ELEVATION_ERR_022_oRDR_DETECTION_021_024_oPCAN_RADAR_c8dc7e91_Tx: ComBitPosition=192, ComBitSize=6, ComSignalInitValue=0, ComSignalType=UINT8, ComHandleId=505, ComSystemTemplateSystemSignalRef=DET_ELEVATION_ERR_022
            DET_MH_SCAN_INDEX_4LSB_021_024_oRDR_DETECTION_021_024_oPCAN_RADAR_26ea6347_Tx: ComBitPosition=476, ComBitSize=4, ComSignalInitValue=0, ComSignalType=UINT8, ComHandleId=522, ComSystemTemplateSystemSignalRef=DET_MH_SCAN_INDEX_4LSB_021_024
            DET_RANGE_ERR_024_oRDR_DETECTION_021_024_oPCAN_RADAR_e0e507c6_Tx: ComBitPosition=376, ComBitSize=7, ComSignalInitValue=0, ComSignalType=UINT8, ComHandleId=538, ComSystemTemplateSystemSignalRef=DET_RANGE_ERR_024
            DET_RANGE_VELOCITY_ERR_024_oRDR_DETECTION_021_024_oPCAN_RADAR_3d108438_Tx: ComBitPosition=400, ComBitSize=8, ComSignalInitValue=0, ComSignalType=UINT8, ComHandleId=546, ComSystemTemplateSystemSignalRef=DET_RANGE_VELOCITY_ERR_024
            DET_AZIMUTH_021_oRDR_DETECTION_021_024_oPCAN_RADAR_fab64216_Tx: ComBitPosition=88, ComBitSize=13, ComSignalInitValue=0, ComSignalType=UINT16, ComHandleId=476, ComSystemTemplateSystemSignalRef=DET_AZIMUTH_021
            DET_AZIMUTH_ERR_023_oRDR_DETECTION_021_024_oPCAN_RADAR_af937888_Tx: ComBitPosition=329, ComBitSize=7, ComSignalInitValue=0, ComSignalType=UINT8, ComHandleId=482, ComSystemTemplateSystemSignalRef=DET_AZIMUTH_ERR_023
            DET_CONFD_ELEVATION_021_oRDR_DETECTION_021_024_oPCAN_RADAR_fac54926_Tx: ComBitPosition=101, ComBitSize=2, ComSignalInitValue=0, ComSignalType=UINT8, ComHandleId=496, ComSystemTemplateSystemSignalRef=DET_CONFD_ELEVATION_021
            DET_SUPER_RES_TARGET_022_oRDR_DETECTION_021_024_oPCAN_RADAR_90dcc34b_Tx: ComBitPosition=199, ComBitSize=1, ComSignalInitValue=0, ComSignalType=BOOLEAN, ComHandleId=556, ComSystemTemplateSystemSignalRef=DET_SUPER_RES_TARGET_022
            DET_BI_STATIC_FLAG_022_oRDR_DETECTION_021_024_oPCAN_RADAR_c87a796d_Tx: ComBitPosition=216, ComBitSize=1, ComSignalInitValue=0, ComSignalType=BOOLEAN, ComHandleId=489, ComSystemTemplateSystemSignalRef=DET_BI_STATIC_FLAG_022
            DET_ELEVATION_024_oRDR_DETECTION_021_024_oPCAN_RADAR_86251118_Tx: ComBitPosition=408, ComBitSize=8, ComSignalInitValue=0, ComSignalType=UINT8, ComHandleId=503, ComSystemTemplateSystemSignalRef=DET_ELEVATION_024
            DET_MH_CRC16_021_024_oRDR_DETECTION_021_024_oPCAN_RADAR_6eb5e7fc_Tx: ComBitPosition=0, ComBitSize=16, ComSignalInitValue=0, ComSignalType=UINT16, ComHandleId=520, ComSystemTemplateSystemSignalRef=DET_MH_CRC16_021_024
            DET_RANGE_ERR_022_oRDR_DETECTION_021_024_oPCAN_RADAR_2925f03a_Tx: ComBitPosition=152, ComBitSize=7, ComSignalInitValue=0, ComSignalType=UINT8, ComHandleId=536, ComSystemTemplateSystemSignalRef=DET_RANGE_ERR_022
            DET_CONFD_AZIMUTH_021_oRDR_DETECTION_021_024_oPCAN_RADAR_f85048dc_Tx: ComBitPosition=118, ComBitSize=2, ComSignalInitValue=0, ComSignalType=UINT8, ComHandleId=492, ComSystemTemplateSystemSignalRef=DET_CONFD_AZIMUTH_021
            DET_RANGE_VELOCITY_ERR_023_oRDR_DETECTION_021_024_oPCAN_RADAR_61a0a751_Tx: ComBitPosition=288, ComBitSize=8, ComSignalInitValue=0, ComSignalType=UINT8, ComHandleId=545, ComSystemTemplateSystemSignalRef=DET_RANGE_VELOCITY_ERR_023
            DET_HVC_FLAG_022_oRDR_DETECTION_021_024_oPCAN_RADAR_fb37488e_Tx: ComBitPosition=198, ComBitSize=1, ComSignalInitValue=0, ComSignalType=BOOLEAN, ComHandleId=513, ComSystemTemplateSystemSignalRef=DET_HVC_FLAG_022
            DET_AZIMUTH_022_oRDR_DETECTION_021_024_oPCAN_RADAR_9e5639e8_Tx: ComBitPosition=200, ComBitSize=13, ComSignalInitValue=0, ComSignalType=UINT16, ComHandleId=477, ComSystemTemplateSystemSignalRef=DET_AZIMUTH_022
            DET_ELEVATION_ERR_024_oRDR_DETECTION_021_024_oPCAN_RADAR_011c896d_Tx: ComBitPosition=416, ComBitSize=6, ComSignalInitValue=0, ComSignalType=UINT8, ComHandleId=507, ComSystemTemplateSystemSignalRef=DET_ELEVATION_ERR_024
            DET_RANGE_ERR_021_oRDR_DETECTION_021_024_oPCAN_RADAR_4dc58bc4_Tx: ComBitPosition=40, ComBitSize=7, ComSignalInitValue=0, ComSignalType=UINT8, ComHandleId=535, ComSystemTemplateSystemSignalRef=DET_RANGE_ERR_021
            DET_RANGE_021_oRDR_DETECTION_021_024_oPCAN_RADAR_ea2d31ad_Tx: ComBitPosition=24, ComBitSize=15, ComSignalInitValue=0, ComSignalType=UINT16, ComHandleId=531, ComSystemTemplateSystemSignalRef=DET_RANGE_021
            DET_SNR_021_oRDR_DETECTION_021_024_oPCAN_RADAR_c5a590d0_Tx: ComBitPosition=120, ComBitSize=8, ComSignalInitValue=0, ComSignalType=UINT8, ComHandleId=551, ComSystemTemplateSystemSignalRef=DET_SNR_021
            DET_EXISTENCE_PROB_023_oRDR_DETECTION_021_024_oPCAN_RADAR_8f33df64_Tx: ComBitPosition=336, ComBitSize=6, ComSignalInitValue=0, ComSignalType=UINT8, ComHandleId=510, ComSystemTemplateSystemSignalRef=DET_EXISTENCE_PROB_023
            DET_BI_STATIC_FLAG_024_oRDR_DETECTION_021_024_oPCAN_RADAR_01ba8e91_Tx: ComBitPosition=440, ComBitSize=1, ComSignalInitValue=0, ComSignalType=BOOLEAN, ComHandleId=491, ComSystemTemplateSystemSignalRef=DET_BI_STATIC_FLAG_024
            DET_SUPER_RES_TARGET_023_oRDR_DETECTION_021_024_oPCAN_RADAR_05ac17de_Tx: ComBitPosition=311, ComBitSize=1, ComSignalInitValue=0, ComSignalType=BOOLEAN, ComHandleId=557, ComSystemTemplateSystemSignalRef=DET_SUPER_RES_TARGET_023
            DET_AZIMUTH_ERR_024_oRDR_DETECTION_021_024_oPCAN_RADAR_f3235be1_Tx: ComBitPosition=441, ComBitSize=7, ComSignalInitValue=0, ComSignalType=UINT8, ComHandleId=483, ComSystemTemplateSystemSignalRef=DET_AZIMUTH_ERR_024
            DET_EXISTENCE_PROB_021_oRDR_DETECTION_021_024_oPCAN_RADAR_7ea3700f_Tx: ComBitPosition=112, ComBitSize=6, ComSignalInitValue=0, ComSignalType=UINT8, ComHandleId=508, ComSystemTemplateSystemSignalRef=DET_EXISTENCE_PROB_021
            DET_EXISTENCE_PROB_024_oRDR_DETECTION_021_024_oPCAN_RADAR_d383fc0d_Tx: ComBitPosition=448, ComBitSize=6, ComSignalInitValue=0, ComSignalType=UINT8, ComHandleId=511, ComSystemTemplateSystemSignalRef=DET_EXISTENCE_PROB_024
            DET_BI_STATIC_FLAG_023_oRDR_DETECTION_021_024_oPCAN_RADAR_5d0aadf8_Tx: ComBitPosition=328, ComBitSize=1, ComSignalInitValue=0, ComSignalType=BOOLEAN, ComHandleId=490, ComSystemTemplateSystemSignalRef=DET_BI_STATIC_FLAG_023
            DET_RANGE_VELOCITY_021_oRDR_DETECTION_021_024_oPCAN_RADAR_9f8bf388_Tx: ComBitPosition=48, ComBitSize=15, ComSignalInitValue=16384, ComSignalType=UINT16, ComHandleId=539, ComSystemTemplateSystemSignalRef=DET_RANGE_VELOCITY_021
            DET_RANGE_VELOCITY_ERR_021_oRDR_DETECTION_021_024_oPCAN_RADAR_9030083a_Tx: ComBitPosition=64, ComBitSize=8, ComSignalInitValue=0, ComSignalType=UINT8, ComHandleId=543, ComSystemTemplateSystemSignalRef=DET_RANGE_VELOCITY_ERR_021
            DET_RCS_023_oRDR_DETECTION_021_024_oPCAN_RADAR_e99b6bb9_Tx: ComBitPosition=352, ComBitSize=8, ComSignalInitValue=128, ComSignalType=UINT8, ComHandleId=549, ComSystemTemplateSystemSignalRef=DET_RCS_023
            DET_MH_CYCLE_COUNTER_021_024_oRDR_DETECTION_021_024_oPCAN_RADAR_eac046cb_Tx: ComBitPosition=16, ComBitSize=8, ComSignalInitValue=0, ComSignalType=UINT8, ComHandleId=521, ComSystemTemplateSystemSignalRef=DET_MH_CYCLE_COUNTER_021_024
            DET_RANGE_ERR_023_oRDR_DETECTION_021_024_oPCAN_RADAR_bc5524af_Tx: ComBitPosition=264, ComBitSize=7, ComSignalInitValue=0, ComSignalType=UINT8, ComHandleId=537, ComSystemTemplateSystemSignalRef=DET_RANGE_ERR_023
            DET_ELEVATION_ERR_023_oRDR_DETECTION_021_024_oPCAN_RADAR_5dacaa04_Tx: ComBitPosition=304, ComBitSize=6, ComSignalInitValue=0, ComSignalType=UINT8, ComHandleId=506, ComSystemTemplateSystemSignalRef=DET_ELEVATION_ERR_023
            DET_SNR_023_oRDR_DETECTION_021_024_oPCAN_RADAR_34353fbb_Tx: ComBitPosition=344, ComBitSize=8, ComSignalInitValue=0, ComSignalType=UINT8, ComHandleId=553, ComSystemTemplateSystemSignalRef=DET_SNR_023
            DET_HVC_FLAG_023_oRDR_DETECTION_021_024_oPCAN_RADAR_6e479c1b_Tx: ComBitPosition=310, ComBitSize=1, ComSignalInitValue=0, ComSignalType=BOOLEAN, ComHandleId=514, ComSystemTemplateSystemSignalRef=DET_HVC_FLAG_023
            DET_RANGE_VELOCITY_024_oRDR_DETECTION_021_024_oPCAN_RADAR_32ab7f8a_Tx: ComBitPosition=384, ComBitSize=15, ComSignalInitValue=16384, ComSignalType=UINT16, ComHandleId=542, ComSystemTemplateSystemSignalRef=DET_RANGE_VELOCITY_024
            DET_ELEVATION_022_oRDR_DETECTION_021_024_oPCAN_RADAR_4fe5e6e4_Tx: ComBitPosition=184, ComBitSize=8, ComSignalInitValue=0, ComSignalType=UINT8, ComHandleId=501, ComSystemTemplateSystemSignalRef=DET_ELEVATION_022
            DET_RANGE_VELOCITY_ERR_022_oRDR_DETECTION_021_024_oPCAN_RADAR_f4d073c4_Tx: ComBitPosition=176, ComBitSize=8, ComSignalInitValue=0, ComSignalType=UINT8, ComHandleId=544, ComSystemTemplateSystemSignalRef=DET_RANGE_VELOCITY_ERR_022
            DET_CONFD_ELEVATION_024_oRDR_DETECTION_021_024_oPCAN_RADAR_57e5c524_Tx: ComBitPosition=437, ComBitSize=2, ComSignalInitValue=0, ComSignalType=UINT8, ComHandleId=499, ComSystemTemplateSystemSignalRef=DET_CONFD_ELEVATION_024
            DET_ELEVATION_021_oRDR_DETECTION_021_024_oPCAN_RADAR_2b059d1a_Tx: ComBitPosition=72, ComBitSize=8, ComSignalInitValue=0, ComSignalType=UINT8, ComHandleId=500, ComSystemTemplateSystemSignalRef=DET_ELEVATION_021
            DET_CONFD_AZIMUTH_023_oRDR_DETECTION_021_024_oPCAN_RADAR_09c0e7b7_Tx: ComBitPosition=342, ComBitSize=2, ComSignalInitValue=0, ComSignalType=UINT8, ComHandleId=494, ComSystemTemplateSystemSignalRef=DET_CONFD_AZIMUTH_023
            DET_AZIMUTH_024_oRDR_DETECTION_021_024_oPCAN_RADAR_5796ce14_Tx: ComBitPosition=424, ComBitSize=13, ComSignalInitValue=0, ComSignalType=UINT16, ComHandleId=479, ComSystemTemplateSystemSignalRef=DET_AZIMUTH_024
            DET_RANGE_VELOCITY_022_oRDR_DETECTION_021_024_oPCAN_RADAR_fb6b8876_Tx: ComBitPosition=160, ComBitSize=15, ComSignalInitValue=16384, ComSignalType=UINT16, ComHandleId=540, ComSystemTemplateSystemSignalRef=DET_RANGE_VELOCITY_022
            DET_SUPER_RES_TARGET_021_oRDR_DETECTION_021_024_oPCAN_RADAR_f43cb8b5_Tx: ComBitPosition=87, ComBitSize=1, ComSignalInitValue=0, ComSignalType=BOOLEAN, ComHandleId=555, ComSystemTemplateSystemSignalRef=DET_SUPER_RES_TARGET_021
            DET_RCS_024_oRDR_DETECTION_021_024_oPCAN_RADAR_b52b48d0_Tx: ComBitPosition=464, ComBitSize=8, ComSignalInitValue=128, ComSignalType=UINT8, ComHandleId=550, ComSystemTemplateSystemSignalRef=DET_RCS_024
            DET_SUPER_RES_TARGET_024_oRDR_DETECTION_021_024_oPCAN_RADAR_591c34b7_Tx: ComBitPosition=423, ComBitSize=1, ComSignalInitValue=0, ComSignalType=BOOLEAN, ComHandleId=558, ComSystemTemplateSystemSignalRef=DET_SUPER_RES_TARGET_024
            DET_IDM_021_oRDR_DETECTION_021_024_oPCAN_RADAR_148508cd_Tx: ComBitPosition=63, ComBitSize=1, ComSignalInitValue=0, ComSignalType=UINT8, ComHandleId=516, ComSystemTemplateSystemSignalRef=DET_IDM_021
            DET_PROB_1STAZHYPO_024_oRDR_DETECTION_021_024_oPCAN_RADAR_4ca25ed9_Tx: ComBitPosition=439, ComBitSize=1, ComSignalInitValue=0, ComSignalType=BOOLEAN, ComHandleId=530, ComSystemTemplateSystemSignalRef=DET_PROB_1STAZHYPO_024
            DET_MTD_023_oRDR_DETECTION_021_024_oPCAN_RADAR_83a6957d_Tx: ComBitPosition=271, ComBitSize=1, ComSignalInitValue=0, ComSignalType=UINT8, ComHandleId=525, ComSystemTemplateSystemSignalRef=DET_MTD_023
            DET_BELOW_RAIN_THOLD_021_oRDR_DETECTION_021_024_oPCAN_RADAR_2fb7d1d6_Tx: ComBitPosition=39, ComBitSize=1, ComSignalInitValue=0, ComSignalType=UINT8, ComHandleId=484, ComSystemTemplateSystemSignalRef=DET_BELOW_RAIN_THOLD_021
            DET_BELOW_RAIN_THOLD_024_oRDR_DETECTION_021_024_oPCAN_RADAR_82975dd4_Tx: ComBitPosition=375, ComBitSize=1, ComSignalInitValue=0, ComSignalType=UINT8, ComHandleId=487, ComSystemTemplateSystemSignalRef=DET_BELOW_RAIN_THOLD_024
            DET_PROB_1STAZHYPO_022_oRDR_DETECTION_021_024_oPCAN_RADAR_8562a925_Tx: ComBitPosition=215, ComBitSize=1, ComSignalInitValue=0, ComSignalType=BOOLEAN, ComHandleId=528, ComSystemTemplateSystemSignalRef=DET_PROB_1STAZHYPO_022
            DET_MTD_021_oRDR_DETECTION_021_024_oPCAN_RADAR_72363a16_Tx: ComBitPosition=47, ComBitSize=1, ComSignalInitValue=0, ComSignalType=UINT8, ComHandleId=523, ComSystemTemplateSystemSignalRef=DET_MTD_021
            DET_MTD_022_oRDR_DETECTION_021_024_oPCAN_RADAR_16d641e8_Tx: ComBitPosition=159, ComBitSize=1, ComSignalInitValue=0, ComSignalType=UINT8, ComHandleId=524, ComSystemTemplateSystemSignalRef=DET_MTD_022
            DET_BELOW_RAIN_THOLD_022_oRDR_DETECTION_021_024_oPCAN_RADAR_4b57aa28_Tx: ComBitPosition=151, ComBitSize=1, ComSignalInitValue=0, ComSignalType=UINT8, ComHandleId=485, ComSystemTemplateSystemSignalRef=DET_BELOW_RAIN_THOLD_022
            DET_IDM_023_oRDR_DETECTION_021_024_oPCAN_RADAR_e515a7a6_Tx: ComBitPosition=287, ComBitSize=1, ComSignalInitValue=0, ComSignalType=UINT8, ComHandleId=518, ComSystemTemplateSystemSignalRef=DET_IDM_023
            DET_IDM_024_oRDR_DETECTION_021_024_oPCAN_RADAR_b9a584cf_Tx: ComBitPosition=399, ComBitSize=1, ComSignalInitValue=0, ComSignalType=UINT8, ComHandleId=519, ComSystemTemplateSystemSignalRef=DET_IDM_024
            DET_PROB_1STAZHYPO_021_oRDR_DETECTION_021_024_oPCAN_RADAR_e182d2db_Tx: ComBitPosition=103, ComBitSize=1, ComSignalInitValue=0, ComSignalType=BOOLEAN, ComHandleId=527, ComSystemTemplateSystemSignalRef=DET_PROB_1STAZHYPO_021
            DET_MTD_024_oRDR_DETECTION_021_024_oPCAN_RADAR_df16b614_Tx: ComBitPosition=383, ComBitSize=1, ComSignalInitValue=0, ComSignalType=UINT8, ComHandleId=526, ComSystemTemplateSystemSignalRef=DET_MTD_024
            DET_IDM_022_oRDR_DETECTION_021_024_oPCAN_RADAR_70657333_Tx: ComBitPosition=175, ComBitSize=1, ComSignalInitValue=0, ComSignalType=UINT8, ComHandleId=517, ComSystemTemplateSystemSignalRef=DET_IDM_022
            DET_PROB_1STAZHYPO_023_oRDR_DETECTION_021_024_oPCAN_RADAR_10127db0_Tx: ComBitPosition=327, ComBitSize=1, ComSignalInitValue=0, ComSignalType=BOOLEAN, ComHandleId=529, ComSystemTemplateSystemSignalRef=DET_PROB_1STAZHYPO_023
            DET_BELOW_RAIN_THOLD_023_oRDR_DETECTION_021_024_oPCAN_RADAR_de277ebd_Tx: ComBitPosition=263, ComBitSize=1, ComSignalInitValue=0, ComSignalType=UINT8, ComHandleId=486, ComSystemTemplateSystemSignalRef=DET_BELOW_RAIN_THOLD_023
        SG_Detections_217_220_oRDR_DETECTION_217_220_oPCAN_RADAR_6c06fe56_Tx: ComTransferProperty=TRIGGERED, ComHandleId=56, ComSystemTemplateSignalGroupRef=SG_Detections_217_220
          83 x ComGroupSignal, all with ComSignalEndianness=LITTLE_ENDIAN, ComTransferProperty=PENDING, ComSignalAccess=ACCESS_NEEDED_BY_SWC_OR_COM:
            DET_RANGE_VELOCITY_ERR_220_oRDR_DETECTION_217_220_oPCAN_RADAR_941996b6_Tx: ComBitPosition=400, ComBitSize=8, ComSignalInitValue=0, ComSignalType=UINT8, ComHandleId=4613, ComSystemTemplateSystemSignalRef=DET_RANGE_VELOCITY_ERR_220
            DET_SUPER_RES_TARGET_218_oRDR_DETECTION_217_220_oPCAN_RADAR_dad4a877_Tx: ComBitPosition=199, ComBitSize=1, ComSignalInitValue=0, ComSignalType=BOOLEAN, ComHandleId=4623, ComSystemTemplateSystemSignalRef=DET_SUPER_RES_TARGET_218
            DET_RANGE_ERR_220_oRDR_DETECTION_217_220_oPCAN_RADAR_49ec1548_Tx: ComBitPosition=376, ComBitSize=7, ComSignalInitValue=0, ComSignalType=UINT8, ComHandleId=4605, ComSystemTemplateSystemSignalRef=DET_RANGE_ERR_220
            DET_RANGE_VELOCITY_ERR_217_oRDR_DETECTION_217_220_oPCAN_RADAR_92c88abf_Tx: ComBitPosition=64, ComBitSize=8, ComSignalInitValue=0, ComSignalType=UINT8, ComHandleId=4610, ComSystemTemplateSystemSignalRef=DET_RANGE_VELOCITY_ERR_217
            DET_MH_SCAN_INDEX_4LSB_217_220_oRDR_DETECTION_217_220_oPCAN_RADAR_a0d1a8e6_Tx: ComBitPosition=476, ComBitSize=4, ComSignalInitValue=0, ComSignalType=UINT8, ComHandleId=4589, ComSystemTemplateSystemSignalRef=DET_MH_SCAN_INDEX_4LSB_217_220
            DET_SUPER_RES_TARGET_220_oRDR_DETECTION_217_220_oPCAN_RADAR_f0152639_Tx: ComBitPosition=423, ComBitSize=1, ComSignalInitValue=0, ComSignalType=BOOLEAN, ComHandleId=4625, ComSystemTemplateSystemSignalRef=DET_SUPER_RES_TARGET_220
            DET_AZIMUTH_ERR_219_oRDR_DETECTION_217_220_oPCAN_RADAR_e59b13b4_Tx: ComBitPosition=329, ComBitSize=7, ComSignalInitValue=0, ComSignalType=UINT8, ComHandleId=4549, ComSystemTemplateSystemSignalRef=DET_AZIMUTH_ERR_219
            DET_RANGE_217_oRDR_DETECTION_217_220_oPCAN_RADAR_e8d5b328_Tx: ComBitPosition=24, ComBitSize=15, ComSignalInitValue=0, ComSignalType=UINT16, ComHandleId=4598, ComSystemTemplateSystemSignalRef=DET_RANGE_217
            DET_RANGE_VELOCITY_ERR_218_oRDR_DETECTION_217_220_oPCAN_RADAR_bed818f8_Tx: ComBitPosition=176, ComBitSize=8, ComSignalInitValue=0, ComSignalType=UINT8, ComHandleId=4611, ComSystemTemplateSystemSignalRef=DET_RANGE_VELOCITY_ERR_218
            DET_RANGE_ERR_217_oRDR_DETECTION_217_220_oPCAN_RADAR_4f3d0941_Tx: ComBitPosition=40, ComBitSize=7, ComSignalInitValue=0, ComSignalType=UINT8, ComHandleId=4602, ComSystemTemplateSystemSignalRef=DET_RANGE_ERR_217
            DET_SUPER_RES_TARGET_219_oRDR_DETECTION_217_220_oPCAN_RADAR_4fa47ce2_Tx: ComBitPosition=311, ComBitSize=1, ComSignalInitValue=0, ComSignalType=BOOLEAN, ComHandleId=4624, ComSystemTemplateSystemSignalRef=DET_SUPER_RES_TARGET_219
            DET_CONFD_ELEVATION_217_oRDR_DETECTION_217_220_oPCAN_RADAR_f83dcba3_Tx: ComBitPosition=101, ComBitSize=2, ComSignalInitValue=0, ComSignalType=UINT8, ComHandleId=4563, ComSystemTemplateSystemSignalRef=DET_CONFD_ELEVATION_217
            DET_SNR_218_oRDR_DETECTION_217_220_oPCAN_RADAR_eb4d8012_Tx: ComBitPosition=232, ComBitSize=8, ComSignalInitValue=0, ComSignalType=UINT8, ComHandleId=4619, ComSystemTemplateSystemSignalRef=DET_SNR_218
            DET_EXISTENCE_PROB_218_oRDR_DETECTION_217_220_oPCAN_RADAR_504b60cd_Tx: ComBitPosition=224, ComBitSize=6, ComSignalInitValue=0, ComSignalType=UINT8, ComHandleId=4576, ComSystemTemplateSystemSignalRef=DET_EXISTENCE_PROB_218
            DET_RANGE_VELOCITY_219_oRDR_DETECTION_217_220_oPCAN_RADAR_241337df_Tx: ComBitPosition=272, ComBitSize=15, ComSignalInitValue=16384, ComSignalType=UINT16, ComHandleId=4608, ComSystemTemplateSystemSignalRef=DET_RANGE_VELOCITY_219
            DET_BI_STATIC_FLAG_218_oRDR_DETECTION_217_220_oPCAN_RADAR_82721251_Tx: ComBitPosition=216, ComBitSize=1, ComSignalInitValue=0, ComSignalType=BOOLEAN, ComHandleId=4556, ComSystemTemplateSystemSignalRef=DET_BI_STATIC_FLAG_218
            DET_ELEVATION_ERR_220_oRDR_DETECTION_217_220_oPCAN_RADAR_a8159be3_Tx: ComBitPosition=416, ComBitSize=6, ComSignalInitValue=0, ComSignalType=UINT8, ComHandleId=4574, ComSystemTemplateSystemSignalRef=DET_ELEVATION_ERR_220
            DET_HVC_FLAG_220_oRDR_DETECTION_217_220_oPCAN_RADAR_9bfeadfc_Tx: ComBitPosition=422, ComBitSize=1, ComSignalInitValue=0, ComSignalType=BOOLEAN, ComHandleId=4582, ComSystemTemplateSystemSignalRef=DET_HVC_FLAG_220
            DET_ELEVATION_ERR_219_oRDR_DETECTION_217_220_oPCAN_RADAR_17a4c138_Tx: ComBitPosition=304, ComBitSize=6, ComSignalInitValue=0, ComSignalType=UINT8, ComHandleId=4573, ComSystemTemplateSystemSignalRef=DET_ELEVATION_ERR_219
            DET_EXISTENCE_PROB_217_oRDR_DETECTION_217_220_oPCAN_RADAR_7c5bf28a_Tx: ComBitPosition=112, ComBitSize=6, ComSignalInitValue=0, ComSignalType=UINT8, ComHandleId=4575, ComSystemTemplateSystemSignalRef=DET_EXISTENCE_PROB_217
            DET_ELEVATION_ERR_218_oRDR_DETECTION_217_220_oPCAN_RADAR_82d415ad_Tx: ComBitPosition=192, ComBitSize=6, ComSignalInitValue=0, ComSignalType=UINT8, ComHandleId=4572, ComSystemTemplateSystemSignalRef=DET_ELEVATION_ERR_218
            DET_RCS_220_oRDR_DETECTION_217_220_oPCAN_RADAR_1c225a5e_Tx: ComBitPosition=464, ComBitSize=8, ComSignalInitValue=128, ComSignalType=UINT8, ComHandleId=4617, ComSystemTemplateSystemSignalRef=DET_RCS_220
            DET_MH_CRC16_217_220_oRDR_DETECTION_217_220_oPCAN_RADAR_e88e2c5d_Tx: ComBitPosition=0, ComBitSize=16, ComSignalInitValue=0, ComSignalType=UINT16, ComHandleId=4587, ComSystemTemplateSystemSignalRef=DET_MH_CRC16_217_220
            DET_BI_STATIC_FLAG_219_oRDR_DETECTION_217_220_oPCAN_RADAR_1702c6c4_Tx: ComBitPosition=328, ComBitSize=1, ComSignalInitValue=0, ComSignalType=BOOLEAN, ComHandleId=4557, ComSystemTemplateSystemSignalRef=DET_BI_STATIC_FLAG_219
            DET_ELEVATION_217_oRDR_DETECTION_217_220_oPCAN_RADAR_29fd1f9f_Tx: ComBitPosition=72, ComBitSize=8, ComSignalInitValue=0, ComSignalType=UINT8, ComHandleId=4567, ComSystemTemplateSystemSignalRef=DET_ELEVATION_217
            DET_EXISTENCE_PROB_220_oRDR_DETECTION_217_220_oPCAN_RADAR_7a8aee83_Tx: ComBitPosition=448, ComBitSize=6, ComSignalInitValue=0, ComSignalType=UINT8, ComHandleId=4578, ComSystemTemplateSystemSignalRef=DET_EXISTENCE_PROB_220
            DET_EXISTENCE_PROB_219_oRDR_DETECTION_217_220_oPCAN_RADAR_c53bb458_Tx: ComBitPosition=336, ComBitSize=6, ComSignalInitValue=0, ComSignalType=UINT8, ComHandleId=4577, ComSystemTemplateSystemSignalRef=DET_EXISTENCE_PROB_219
            DET_RANGE_VELOCITY_ERR_219_oRDR_DETECTION_217_220_oPCAN_RADAR_2ba8cc6d_Tx: ComBitPosition=288, ComBitSize=8, ComSignalInitValue=0, ComSignalType=UINT8, ComHandleId=4612, ComSystemTemplateSystemSignalRef=DET_RANGE_VELOCITY_ERR_219
            DET_CONFD_AZIMUTH_217_oRDR_DETECTION_217_220_oPCAN_RADAR_faa8ca59_Tx: ComBitPosition=118, ComBitSize=2, ComSignalInitValue=0, ComSignalType=UINT8, ComHandleId=4559, ComSystemTemplateSystemSignalRef=DET_CONFD_AZIMUTH_217
            DET_SNR_219_oRDR_DETECTION_217_220_oPCAN_RADAR_7e3d5487_Tx: ComBitPosition=344, ComBitSize=8, ComSignalInitValue=0, ComSignalType=UINT8, ComHandleId=4620, ComSystemTemplateSystemSignalRef=DET_SNR_219
            DET_AZIMUTH_218_oRDR_DETECTION_217_220_oPCAN_RADAR_d45e52d4_Tx: ComBitPosition=200, ComBitSize=13, ComSignalInitValue=0, ComSignalType=UINT16, ComHandleId=4544, ComSystemTemplateSystemSignalRef=DET_AZIMUTH_218
            DET_HVC_FLAG_217_oRDR_DETECTION_217_220_oPCAN_RADAR_9d2fb1f5_Tx: ComBitPosition=86, ComBitSize=1, ComSignalInitValue=0, ComSignalType=BOOLEAN, ComHandleId=4579, ComSystemTemplateSystemSignalRef=DET_HVC_FLAG_217
            DET_ELEVATION_218_oRDR_DETECTION_217_220_oPCAN_RADAR_05ed8dd8_Tx: ComBitPosition=184, ComBitSize=8, ComSignalInitValue=0, ComSignalType=UINT8, ComHandleId=4568, ComSystemTemplateSystemSignalRef=DET_ELEVATION_218
            DET_ELEVATION_219_oRDR_DETECTION_217_220_oPCAN_RADAR_909d594d_Tx: ComBitPosition=296, ComBitSize=8, ComSignalInitValue=0, ComSignalType=UINT8, ComHandleId=4569, ComSystemTemplateSystemSignalRef=DET_ELEVATION_219
            DET_AZIMUTH_ERR_217_oRDR_DETECTION_217_220_oPCAN_RADAR_5cfb5566_Tx: ComBitPosition=105, ComBitSize=7, ComSignalInitValue=0, ComSignalType=UINT8, ComHandleId=4547, ComSystemTemplateSystemSignalRef=DET_AZIMUTH_ERR_217
            DET_AZIMUTH_217_oRDR_DETECTION_217_220_oPCAN_RADAR_f84ec093_Tx: ComBitPosition=88, ComBitSize=13, ComSignalInitValue=0, ComSignalType=UINT16, ComHandleId=4543, ComSystemTemplateSystemSignalRef=DET_AZIMUTH_217
            DET_HVC_FLAG_218_oRDR_DETECTION_217_220_oPCAN_RADAR_b13f23b2_Tx: ComBitPosition=198, ComBitSize=1, ComSignalInitValue=0, ComSignalType=BOOLEAN, ComHandleId=4580, ComSystemTemplateSystemSignalRef=DET_HVC_FLAG_218
            DET_RANGE_ERR_219_oRDR_DETECTION_217_220_oPCAN_RADAR_f65d4f93_Tx: ComBitPosition=264, ComBitSize=7, ComSignalInitValue=0, ComSignalType=UINT8, ComHandleId=4604, ComSystemTemplateSystemSignalRef=DET_RANGE_ERR_219
            DET_AZIMUTH_ERR_218_oRDR_DETECTION_217_220_oPCAN_RADAR_70ebc721_Tx: ComBitPosition=217, ComBitSize=7, ComSignalInitValue=0, ComSignalType=UINT8, ComHandleId=4548, ComSystemTemplateSystemSignalRef=DET_AZIMUTH_ERR_218
            DET_RCS_218_oRDR_DETECTION_217_220_oPCAN_RADAR_36e3d410_Tx: ComBitPosition=240, ComBitSize=8, ComSignalInitValue=128, ComSignalType=UINT8, ComHandleId=4615, ComSystemTemplateSystemSignalRef=DET_RCS_218
            DET_RCS_217_oRDR_DETECTION_217_220_oPCAN_RADAR_1af34657_Tx: ComBitPosition=128, ComBitSize=8, ComSignalInitValue=128, ComSignalType=UINT8, ComHandleId=4614, ComSystemTemplateSystemSignalRef=DET_RCS_217
            DET_RANGE_219_oRDR_DETECTION_217_220_oPCAN_RADAR_51b5f5fa_Tx: ComBitPosition=248, ComBitSize=15, ComSignalInitValue=0, ComSignalType=UINT16, ComHandleId=4600, ComSystemTemplateSystemSignalRef=DET_RANGE_219
            DET_BI_STATIC_FLAG_217_oRDR_DETECTION_217_220_oPCAN_RADAR_ae628016_Tx: ComBitPosition=104, ComBitSize=1, ComSignalInitValue=0, ComSignalType=BOOLEAN, ComHandleId=4555, ComSystemTemplateSystemSignalRef=DET_BI_STATIC_FLAG_217
            DET_CONFD_ELEVATION_220_oRDR_DETECTION_217_220_oPCAN_RADAR_feecd7aa_Tx: ComBitPosition=437, ComBitSize=2, ComSignalInitValue=0, ComSignalType=UINT8, ComHandleId=4566, ComSystemTemplateSystemSignalRef=DET_CONFD_ELEVATION_220
            DET_RCS_219_oRDR_DETECTION_217_220_oPCAN_RADAR_a3930085_Tx: ComBitPosition=352, ComBitSize=8, ComSignalInitValue=128, ComSignalType=UINT8, ComHandleId=4616, ComSystemTemplateSystemSignalRef=DET_RCS_219
            DET_CONFD_ELEVATION_219_oRDR_DETECTION_217_220_oPCAN_RADAR_415d8d71_Tx: ComBitPosition=325, ComBitSize=2, ComSignalInitValue=0, ComSignalType=UINT8, ComHandleId=4565, ComSystemTemplateSystemSignalRef=DET_CONFD_ELEVATION_219
            DET_SNR_217_oRDR_DETECTION_217_220_oPCAN_RADAR_c75d1255_Tx: ComBitPosition=120, ComBitSize=8, ComSignalInitValue=0, ComSignalType=UINT8, ComHandleId=4618, ComSystemTemplateSystemSignalRef=DET_SNR_217
            DET_BI_STATIC_FLAG_220_oRDR_DETECTION_217_220_oPCAN_RADAR_a8b39c1f_Tx: ComBitPosition=440, ComBitSize=1, ComSignalInitValue=0, ComSignalType=BOOLEAN, ComHandleId=4558, ComSystemTemplateSystemSignalRef=DET_BI_STATIC_FLAG_220
            DET_AZIMUTH_ERR_220_oRDR_DETECTION_217_220_oPCAN_RADAR_5a2a496f_Tx: ComBitPosition=441, ComBitSize=7, ComSignalInitValue=0, ComSignalType=UINT8, ComHandleId=4550, ComSystemTemplateSystemSignalRef=DET_AZIMUTH_ERR_220
            DET_RANGE_VELOCITY_217_oRDR_DETECTION_217_220_oPCAN_RADAR_9d73710d_Tx: ComBitPosition=48, ComBitSize=15, ComSignalInitValue=16384, ComSignalType=UINT16, ComHandleId=4606, ComSystemTemplateSystemSignalRef=DET_RANGE_VELOCITY_217
            DET_CONFD_AZIMUTH_218_oRDR_DETECTION_217_220_oPCAN_RADAR_d6b8581e_Tx: ComBitPosition=230, ComBitSize=2, ComSignalInitValue=0, ComSignalType=UINT8, ComHandleId=4560, ComSystemTemplateSystemSignalRef=DET_CONFD_AZIMUTH_218
            DET_SNR_220_oRDR_DETECTION_217_220_oPCAN_RADAR_c18c0e5c_Tx: ComBitPosition=456, ComBitSize=8, ComSignalInitValue=0, ComSignalType=UINT8, ComHandleId=4621, ComSystemTemplateSystemSignalRef=DET_SNR_220
            DET_AZIMUTH_219_oRDR_DETECTION_217_220_oPCAN_RADAR_412e8641_Tx: ComBitPosition=312, ComBitSize=13, ComSignalInitValue=0, ComSignalType=UINT16, ComHandleId=4545, ComSystemTemplateSystemSignalRef=DET_AZIMUTH_219
            DET_HVC_FLAG_219_oRDR_DETECTION_217_220_oPCAN_RADAR_244ff727_Tx: ComBitPosition=310, ComBitSize=1, ComSignalInitValue=0, ComSignalType=BOOLEAN, ComHandleId=4581, ComSystemTemplateSystemSignalRef=DET_HVC_FLAG_219
            DET_CONFD_AZIMUTH_220_oRDR_DETECTION_217_220_oPCAN_RADAR_fc79d650_Tx: ComBitPosition=454, ComBitSize=2, ComSignalInitValue=0, ComSignalType=UINT8, ComHandleId=4562, ComSystemTemplateSystemSignalRef=DET_CONFD_AZIMUTH_220
            DET_CONFD_ELEVATION_218_oRDR_DETECTION_217_220_oPCAN_RADAR_d42d59e4_Tx: ComBitPosition=213, ComBitSize=2, ComSignalInitValue=0, ComSignalType=UINT8, ComHandleId=4564, ComSystemTemplateSystemSignalRef=DET_CONFD_ELEVATION_218
            DET_ELEVATION_220_oRDR_DETECTION_217_220_oPCAN_RADAR_2f2c0396_Tx: ComBitPosition=408, ComBitSize=8, ComSignalInitValue=0, ComSignalType=UINT8, ComHandleId=4570, ComSystemTemplateSystemSignalRef=DET_ELEVATION_220
            DET_SUPER_RES_TARGET_217_oRDR_DETECTION_217_220_oPCAN_RADAR_f6c43a30_Tx: ComBitPosition=87, ComBitSize=1, ComSignalInitValue=0, ComSignalType=BOOLEAN, ComHandleId=4622, ComSystemTemplateSystemSignalRef=DET_SUPER_RES_TARGET_217
            DET_RANGE_VELOCITY_218_oRDR_DETECTION_217_220_oPCAN_RADAR_b163e34a_Tx: ComBitPosition=160, ComBitSize=15, ComSignalInitValue=16384, ComSignalType=UINT16, ComHandleId=4607, ComSystemTemplateSystemSignalRef=DET_RANGE_VELOCITY_218
            DET_AZIMUTH_220_oRDR_DETECTION_217_220_oPCAN_RADAR_fe9fdc9a_Tx: ComBitPosition=424, ComBitSize=13, ComSignalInitValue=0, ComSignalType=UINT16, ComHandleId=4546, ComSystemTemplateSystemSignalRef=DET_AZIMUTH_220
            DET_MH_CYCLE_COUNTER_217_220_oRDR_DETECTION_217_220_oPCAN_RADAR_6cfb8d6a_Tx: ComBitPosition=16, ComBitSize=8, ComSignalInitValue=0, ComSignalType=UINT8, ComHandleId=4588, ComSystemTemplateSystemSignalRef=DET_MH_CYCLE_COUNTER_217_220
            DET_CONFD_AZIMUTH_219_oRDR_DETECTION_217_220_oPCAN_RADAR_43c88c8b_Tx: ComBitPosition=342, ComBitSize=2, ComSignalInitValue=0, ComSignalType=UINT8, ComHandleId=4561, ComSystemTemplateSystemSignalRef=DET_CONFD_AZIMUTH_219
            DET_ELEVATION_ERR_217_oRDR_DETECTION_217_220_oPCAN_RADAR_aec487ea_Tx: ComBitPosition=80, ComBitSize=6, ComSignalInitValue=0, ComSignalType=UINT8, ComHandleId=4571, ComSystemTemplateSystemSignalRef=DET_ELEVATION_ERR_217
            DET_RANGE_ERR_218_oRDR_DETECTION_217_220_oPCAN_RADAR_632d9b06_Tx: ComBitPosition=152, ComBitSize=7, ComSignalInitValue=0, ComSignalType=UINT8, ComHandleId=4603, ComSystemTemplateSystemSignalRef=DET_RANGE_ERR_218
            DET_RANGE_220_oRDR_DETECTION_217_220_oPCAN_RADAR_ee04af21_Tx: ComBitPosition=360, ComBitSize=15, ComSignalInitValue=0, ComSignalType=UINT16, ComHandleId=4601, ComSystemTemplateSystemSignalRef=DET_RANGE_220
            DET_RANGE_VELOCITY_220_oRDR_DETECTION_217_220_oPCAN_RADAR_9ba26d04_Tx: ComBitPosition=384, ComBitSize=15, ComSignalInitValue=16384, ComSignalType=UINT16, ComHandleId=4609, ComSystemTemplateSystemSignalRef=DET_RANGE_VELOCITY_220
            DET_RANGE_218_oRDR_DETECTION_217_220_oPCAN_RADAR_c4c5216f_Tx: ComBitPosition=136, ComBitSize=15, ComSignalInitValue=0, ComSignalType=UINT16, ComHandleId=4599, ComSystemTemplateSystemSignalRef=DET_RANGE_218
            DET_IDM_219_oRDR_DETECTION_217_220_oPCAN_RADAR_af1dcc9a_Tx: ComBitPosition=287, ComBitSize=1, ComSignalInitValue=0, ComSignalType=UINT8, ComHandleId=4585, ComSystemTemplateSystemSignalRef=DET_IDM_219
            DET_BELOW_RAIN_THOLD_218_oRDR_DETECTION_217_220_oPCAN_RADAR_015fc114_Tx: ComBitPosition=151, ComBitSize=1, ComSignalInitValue=0, ComSignalType=UINT8, ComHandleId=4552, ComSystemTemplateSystemSignalRef=DET_BELOW_RAIN_THOLD_218
            DET_IDM_217_oRDR_DETECTION_217_220_oPCAN_RADAR_167d8a48_Tx: ComBitPosition=63, ComBitSize=1, ComSignalInitValue=0, ComSignalType=UINT8, ComHandleId=4583, ComSystemTemplateSystemSignalRef=DET_IDM_217
            DET_MTD_217_oRDR_DETECTION_217_220_oPCAN_RADAR_70ceb893_Tx: ComBitPosition=47, ComBitSize=1, ComSignalInitValue=0, ComSignalType=UINT8, ComHandleId=4590, ComSystemTemplateSystemSignalRef=DET_MTD_217
            DET_MTD_220_oRDR_DETECTION_217_220_oPCAN_RADAR_761fa49a_Tx: ComBitPosition=383, ComBitSize=1, ComSignalInitValue=0, ComSignalType=UINT8, ComHandleId=4593, ComSystemTemplateSystemSignalRef=DET_MTD_220
            DET_BELOW_RAIN_THOLD_219_oRDR_DETECTION_217_220_oPCAN_RADAR_942f1581_Tx: ComBitPosition=263, ComBitSize=1, ComSignalInitValue=0, ComSignalType=UINT8, ComHandleId=4553, ComSystemTemplateSystemSignalRef=DET_BELOW_RAIN_THOLD_219
            DET_BELOW_RAIN_THOLD_220_oRDR_DETECTION_217_220_oPCAN_RADAR_2b9e4f5a_Tx: ComBitPosition=375, ComBitSize=1, ComSignalInitValue=0, ComSignalType=UINT8, ComHandleId=4554, ComSystemTemplateSystemSignalRef=DET_BELOW_RAIN_THOLD_220
            DET_PROB_1STAZHYPO_219_oRDR_DETECTION_217_220_oPCAN_RADAR_5a1a168c_Tx: ComBitPosition=327, ComBitSize=1, ComSignalInitValue=0, ComSignalType=BOOLEAN, ComHandleId=4596, ComSystemTemplateSystemSignalRef=DET_PROB_1STAZHYPO_219
            DET_PROB_1STAZHYPO_220_oRDR_DETECTION_217_220_oPCAN_RADAR_e5ab4c57_Tx: ComBitPosition=439, ComBitSize=1, ComSignalInitValue=0, ComSignalType=BOOLEAN, ComHandleId=4597, ComSystemTemplateSystemSignalRef=DET_PROB_1STAZHYPO_220
            DET_MTD_218_oRDR_DETECTION_217_220_oPCAN_RADAR_5cde2ad4_Tx: ComBitPosition=159, ComBitSize=1, ComSignalInitValue=0, ComSignalType=UINT8, ComHandleId=4591, ComSystemTemplateSystemSignalRef=DET_MTD_218
            DET_PROB_1STAZHYPO_218_oRDR_DETECTION_217_220_oPCAN_RADAR_cf6ac219_Tx: ComBitPosition=215, ComBitSize=1, ComSignalInitValue=0, ComSignalType=BOOLEAN, ComHandleId=4595, ComSystemTemplateSystemSignalRef=DET_PROB_1STAZHYPO_218
            DET_IDM_218_oRDR_DETECTION_217_220_oPCAN_RADAR_3a6d180f_Tx: ComBitPosition=175, ComBitSize=1, ComSignalInitValue=0, ComSignalType=UINT8, ComHandleId=4584, ComSystemTemplateSystemSignalRef=DET_IDM_218
            DET_MTD_219_oRDR_DETECTION_217_220_oPCAN_RADAR_c9aefe41_Tx: ComBitPosition=271, ComBitSize=1, ComSignalInitValue=0, ComSignalType=UINT8, ComHandleId=4592, ComSystemTemplateSystemSignalRef=DET_MTD_219
            DET_BELOW_RAIN_THOLD_217_oRDR_DETECTION_217_220_oPCAN_RADAR_2d4f5353_Tx: ComBitPosition=39, ComBitSize=1, ComSignalInitValue=0, ComSignalType=UINT8, ComHandleId=4551, ComSystemTemplateSystemSignalRef=DET_BELOW_RAIN_THOLD_217
            DET_PROB_1STAZHYPO_217_oRDR_DETECTION_217_220_oPCAN_RADAR_e37a505e_Tx: ComBitPosition=103, ComBitSize=1, ComSignalInitValue=0, ComSignalType=BOOLEAN, ComHandleId=4594, ComSystemTemplateSystemSignalRef=DET_PROB_1STAZHYPO_217
            DET_IDM_220_oRDR_DETECTION_217_220_oPCAN_RADAR_10ac9641_Tx: ComBitPosition=399, ComBitSize=1, ComSignalInitValue=0, ComSignalType=UINT8, ComHandleId=4586, ComSystemTemplateSystemSignalRef=DET_IDM_220
        SG_Detections_105_108_oRDR_DETECTION_105_108_oPCAN_RADAR_ec23834b_Tx: ComTransferProperty=TRIGGERED, ComHandleId=28, ComSystemTemplateSignalGroupRef=SG_Detections_105_108
          83 x ComGroupSignal, all with ComSignalEndianness=LITTLE_ENDIAN, ComTransferProperty=PENDING, ComSignalAccess=ACCESS_NEEDED_BY_SWC_OR_COM:
            DET_ELEVATION_108_oRDR_DETECTION_105_108_oPCAN_RADAR_fadd4796_Tx: ComBitPosition=408, ComBitSize=8, ComSignalInitValue=0, ComSignalType=UINT8, ComHandleId=2246, ComSystemTemplateSystemSignalRef=DET_ELEVATION_108
            DET_AZIMUTH_ERR_107_oRDR_DETECTION_105_108_oPCAN_RADAR_a3cb9f28_Tx: ComBitPosition=329, ComBitSize=7, ComSignalInitValue=0, ComSignalType=UINT8, ComHandleId=2225, ComSystemTemplateSystemSignalRef=DET_AZIMUTH_ERR_107
            DET_ELEVATION_ERR_108_oRDR_DETECTION_105_108_oPCAN_RADAR_7de4dfe3_Tx: ComBitPosition=416, ComBitSize=6, ComSignalInitValue=0, ComSignalType=UINT8, ComHandleId=2250, ComSystemTemplateSystemSignalRef=DET_ELEVATION_ERR_108
            DET_BI_STATIC_FLAG_108_oRDR_DETECTION_105_108_oPCAN_RADAR_7d42d81f_Tx: ComBitPosition=440, ComBitSize=1, ComSignalInitValue=0, ComSignalType=BOOLEAN, ComHandleId=2234, ComSystemTemplateSystemSignalRef=DET_BI_STATIC_FLAG_108
            DET_SNR_105_oRDR_DETECTION_105_108_oPCAN_RADAR_c9fd7770_Tx: ComBitPosition=120, ComBitSize=8, ComSignalInitValue=0, ComSignalType=UINT8, ComHandleId=2294, ComSystemTemplateSystemSignalRef=DET_SNR_105
            DET_AZIMUTH_108_oRDR_DETECTION_105_108_oPCAN_RADAR_2b6e989a_Tx: ComBitPosition=424, ComBitSize=13, ComSignalInitValue=0, ComSignalType=UINT16, ComHandleId=2222, ComSystemTemplateSystemSignalRef=DET_AZIMUTH_108
            DET_RCS_107_oRDR_DETECTION_105_108_oPCAN_RADAR_e5c38c19_Tx: ComBitPosition=352, ComBitSize=8, ComSignalInitValue=128, ComSignalType=UINT8, ComHandleId=2292, ComSystemTemplateSystemSignalRef=DET_RCS_107
            DET_EXISTENCE_PROB_106_oRDR_DETECTION_105_108_oPCAN_RADAR_161bec51_Tx: ComBitPosition=224, ComBitSize=6, ComSignalInitValue=0, ComSignalType=UINT8, ComHandleId=2252, ComSystemTemplateSystemSignalRef=DET_EXISTENCE_PROB_106
            DET_RANGE_ERR_105_oRDR_DETECTION_105_108_oPCAN_RADAR_419d6c64_Tx: ComBitPosition=40, ComBitSize=7, ComSignalInitValue=0, ComSignalType=UINT8, ComHandleId=2278, ComSystemTemplateSystemSignalRef=DET_RANGE_ERR_105
            DET_RCS_105_oRDR_DETECTION_105_108_oPCAN_RADAR_14532372_Tx: ComBitPosition=128, ComBitSize=8, ComSignalInitValue=128, ComSignalType=UINT8, ComHandleId=2290, ComSystemTemplateSystemSignalRef=DET_RCS_105
            DET_CONFD_AZIMUTH_106_oRDR_DETECTION_105_108_oPCAN_RADAR_90e8d482_Tx: ComBitPosition=230, ComBitSize=2, ComSignalInitValue=0, ComSignalType=UINT8, ComHandleId=2236, ComSystemTemplateSystemSignalRef=DET_CONFD_AZIMUTH_106
            DET_RANGE_ERR_108_oRDR_DETECTION_105_108_oPCAN_RADAR_9c1d5148_Tx: ComBitPosition=376, ComBitSize=7, ComSignalInitValue=0, ComSignalType=UINT8, ComHandleId=2281, ComSystemTemplateSystemSignalRef=DET_RANGE_ERR_108
            DET_RANGE_VELOCITY_105_oRDR_DETECTION_105_108_oPCAN_RADAR_93d31428_Tx: ComBitPosition=48, ComBitSize=15, ComSignalInitValue=16384, ComSignalType=UINT16, ComHandleId=2282, ComSystemTemplateSystemSignalRef=DET_RANGE_VELOCITY_105
            DET_CONFD_ELEVATION_108_oRDR_DETECTION_105_108_oPCAN_RADAR_2b1d93aa_Tx: ComBitPosition=437, ComBitSize=2, ComSignalInitValue=0, ComSignalType=UINT8, ComHandleId=2242, ComSystemTemplateSystemSignalRef=DET_CONFD_ELEVATION_108
            DET_AZIMUTH_ERR_106_oRDR_DETECTION_105_108_oPCAN_RADAR_36bb4bbd_Tx: ComBitPosition=217, ComBitSize=7, ComSignalInitValue=0, ComSignalType=UINT8, ComHandleId=2224, ComSystemTemplateSystemSignalRef=DET_AZIMUTH_ERR_106
            DET_CONFD_AZIMUTH_107_oRDR_DETECTION_105_108_oPCAN_RADAR_05980017_Tx: ComBitPosition=342, ComBitSize=2, ComSignalInitValue=0, ComSignalType=UINT8, ComHandleId=2237, ComSystemTemplateSystemSignalRef=DET_CONFD_AZIMUTH_107
            DET_RANGE_VELOCITY_ERR_106_oRDR_DETECTION_105_108_oPCAN_RADAR_f8889464_Tx: ComBitPosition=176, ComBitSize=8, ComSignalInitValue=0, ComSignalType=UINT8, ComHandleId=2287, ComSystemTemplateSystemSignalRef=DET_RANGE_VELOCITY_ERR_106
            DET_ELEVATION_105_oRDR_DETECTION_105_108_oPCAN_RADAR_275d7aba_Tx: ComBitPosition=72, ComBitSize=8, ComSignalInitValue=0, ComSignalType=UINT8, ComHandleId=2243, ComSystemTemplateSystemSignalRef=DET_ELEVATION_105
            DET_ELEVATION_ERR_107_oRDR_DETECTION_105_108_oPCAN_RADAR_51f44da4_Tx: ComBitPosition=304, ComBitSize=6, ComSignalInitValue=0, ComSignalType=UINT8, ComHandleId=2249, ComSystemTemplateSystemSignalRef=DET_ELEVATION_ERR_107
            DET_AZIMUTH_105_oRDR_DETECTION_105_108_oPCAN_RADAR_f6eea5b6_Tx: ComBitPosition=88, ComBitSize=13, ComSignalInitValue=0, ComSignalType=UINT16, ComHandleId=2219, ComSystemTemplateSystemSignalRef=DET_AZIMUTH_105
            DET_RANGE_VELOCITY_107_oRDR_DETECTION_105_108_oPCAN_RADAR_6243bb43_Tx: ComBitPosition=272, ComBitSize=15, ComSignalInitValue=16384, ComSignalType=UINT16, ComHandleId=2284, ComSystemTemplateSystemSignalRef=DET_RANGE_VELOCITY_107
            DET_HVC_FLAG_105_oRDR_DETECTION_105_108_oPCAN_RADAR_938fd4d0_Tx: ComBitPosition=86, ComBitSize=1, ComSignalInitValue=0, ComSignalType=BOOLEAN, ComHandleId=2255, ComSystemTemplateSystemSignalRef=DET_HVC_FLAG_105
            DET_MH_SCAN_INDEX_4LSB_105_108_oRDR_DETECTION_105_108_oPCAN_RADAR_20f4d5fb_Tx: ComBitPosition=476, ComBitSize=4, ComSignalInitValue=0, ComSignalType=UINT8, ComHandleId=2265, ComSystemTemplateSystemSignalRef=DET_MH_SCAN_INDEX_4LSB_105_108
            DET_EXISTENCE_PROB_105_oRDR_DETECTION_105_108_oPCAN_RADAR_72fb97af_Tx: ComBitPosition=112, ComBitSize=6, ComSignalInitValue=0, ComSignalType=UINT8, ComHandleId=2251, ComSystemTemplateSystemSignalRef=DET_EXISTENCE_PROB_105
            DET_RCS_106_oRDR_DETECTION_105_108_oPCAN_RADAR_70b3588c_Tx: ComBitPosition=240, ComBitSize=8, ComSignalInitValue=128, ComSignalType=UINT8, ComHandleId=2291, ComSystemTemplateSystemSignalRef=DET_RCS_106
            DET_SNR_106_oRDR_DETECTION_105_108_oPCAN_RADAR_ad1d0c8e_Tx: ComBitPosition=232, ComBitSize=8, ComSignalInitValue=0, ComSignalType=UINT8, ComHandleId=2295, ComSystemTemplateSystemSignalRef=DET_SNR_106
            DET_AZIMUTH_ERR_108_oRDR_DETECTION_105_108_oPCAN_RADAR_8fdb0d6f_Tx: ComBitPosition=441, ComBitSize=7, ComSignalInitValue=0, ComSignalType=UINT8, ComHandleId=2226, ComSystemTemplateSystemSignalRef=DET_AZIMUTH_ERR_108
            DET_CONFD_AZIMUTH_108_oRDR_DETECTION_105_108_oPCAN_RADAR_29889250_Tx: ComBitPosition=454, ComBitSize=2, ComSignalInitValue=0, ComSignalType=UINT8, ComHandleId=2238, ComSystemTemplateSystemSignalRef=DET_CONFD_AZIMUTH_108
            DET_ELEVATION_107_oRDR_DETECTION_105_108_oPCAN_RADAR_d6cdd5d1_Tx: ComBitPosition=296, ComBitSize=8, ComSignalInitValue=0, ComSignalType=UINT8, ComHandleId=2245, ComSystemTemplateSystemSignalRef=DET_ELEVATION_107
            DET_RANGE_VELOCITY_ERR_105_oRDR_DETECTION_105_108_oPCAN_RADAR_9c68ef9a_Tx: ComBitPosition=64, ComBitSize=8, ComSignalInitValue=0, ComSignalType=UINT8, ComHandleId=2286, ComSystemTemplateSystemSignalRef=DET_RANGE_VELOCITY_ERR_105
            DET_BI_STATIC_FLAG_107_oRDR_DETECTION_105_108_oPCAN_RADAR_51524a58_Tx: ComBitPosition=328, ComBitSize=1, ComSignalInitValue=0, ComSignalType=BOOLEAN, ComHandleId=2233, ComSystemTemplateSystemSignalRef=DET_BI_STATIC_FLAG_107
            DET_SUPER_RES_TARGET_106_oRDR_DETECTION_105_108_oPCAN_RADAR_9c8424eb_Tx: ComBitPosition=199, ComBitSize=1, ComSignalInitValue=0, ComSignalType=BOOLEAN, ComHandleId=2299, ComSystemTemplateSystemSignalRef=DET_SUPER_RES_TARGET_106
            DET_AZIMUTH_ERR_105_oRDR_DETECTION_105_108_oPCAN_RADAR_525b3043_Tx: ComBitPosition=105, ComBitSize=7, ComSignalInitValue=0, ComSignalType=UINT8, ComHandleId=2223, ComSystemTemplateSystemSignalRef=DET_AZIMUTH_ERR_105
            DET_HVC_FLAG_108_oRDR_DETECTION_105_108_oPCAN_RADAR_4e0fe9fc_Tx: ComBitPosition=422, ComBitSize=1, ComSignalInitValue=0, ComSignalType=BOOLEAN, ComHandleId=2258, ComSystemTemplateSystemSignalRef=DET_HVC_FLAG_108
            DET_MH_CYCLE_COUNTER_105_108_oRDR_DETECTION_105_108_oPCAN_RADAR_ecdef077_Tx: ComBitPosition=16, ComBitSize=8, ComSignalInitValue=0, ComSignalType=UINT8, ComHandleId=2264, ComSystemTemplateSystemSignalRef=DET_MH_CYCLE_COUNTER_105_108
            DET_RANGE_ERR_106_oRDR_DETECTION_105_108_oPCAN_RADAR_257d179a_Tx: ComBitPosition=152, ComBitSize=7, ComSignalInitValue=0, ComSignalType=UINT8, ComHandleId=2279, ComSystemTemplateSystemSignalRef=DET_RANGE_ERR_106
            DET_AZIMUTH_107_oRDR_DETECTION_105_108_oPCAN_RADAR_077e0add_Tx: ComBitPosition=312, ComBitSize=13, ComSignalInitValue=0, ComSignalType=UINT16, ComHandleId=2221, ComSystemTemplateSystemSignalRef=DET_AZIMUTH_107
            DET_SNR_108_oRDR_DETECTION_105_108_oPCAN_RADAR_147d4a5c_Tx: ComBitPosition=456, ComBitSize=8, ComSignalInitValue=0, ComSignalType=UINT8, ComHandleId=2297, ComSystemTemplateSystemSignalRef=DET_SNR_108
            DET_HVC_FLAG_106_oRDR_DETECTION_105_108_oPCAN_RADAR_f76faf2e_Tx: ComBitPosition=198, ComBitSize=1, ComSignalInitValue=0, ComSignalType=BOOLEAN, ComHandleId=2256, ComSystemTemplateSystemSignalRef=DET_HVC_FLAG_106
            DET_RANGE_VELOCITY_ERR_108_oRDR_DETECTION_105_108_oPCAN_RADAR_41e8d2b6_Tx: ComBitPosition=400, ComBitSize=8, ComSignalInitValue=0, ComSignalType=UINT8, ComHandleId=2289, ComSystemTemplateSystemSignalRef=DET_RANGE_VELOCITY_ERR_108
            DET_RCS_108_oRDR_DETECTION_105_108_oPCAN_RADAR_c9d31e5e_Tx: ComBitPosition=464, ComBitSize=8, ComSignalInitValue=128, ComSignalType=UINT8, ComHandleId=2293, ComSystemTemplateSystemSignalRef=DET_RCS_108
            DET_SNR_107_oRDR_DETECTION_105_108_oPCAN_RADAR_386dd81b_Tx: ComBitPosition=344, ComBitSize=8, ComSignalInitValue=0, ComSignalType=UINT8, ComHandleId=2296, ComSystemTemplateSystemSignalRef=DET_SNR_107
            DET_CONFD_ELEVATION_105_oRDR_DETECTION_105_108_oPCAN_RADAR_f69dae86_Tx: ComBitPosition=101, ComBitSize=2, ComSignalInitValue=0, ComSignalType=UINT8, ComHandleId=2239, ComSystemTemplateSystemSignalRef=DET_CONFD_ELEVATION_105
            DET_MH_CRC16_105_108_oRDR_DETECTION_105_108_oPCAN_RADAR_68ab5140_Tx: ComBitPosition=0, ComBitSize=16, ComSignalInitValue=0, ComSignalType=UINT16, ComHandleId=2263, ComSystemTemplateSystemSignalRef=DET_MH_CRC16_105_108
            DET_RANGE_107_oRDR_DETECTION_105_108_oPCAN_RADAR_17e57966_Tx: ComBitPosition=248, ComBitSize=15, ComSignalInitValue=0, ComSignalType=UINT16, ComHandleId=2276, ComSystemTemplateSystemSignalRef=DET_RANGE_107
            DET_SUPER_RES_TARGET_107_oRDR_DETECTION_105_108_oPCAN_RADAR_09f4f07e_Tx: ComBitPosition=311, ComBitSize=1, ComSignalInitValue=0, ComSignalType=BOOLEAN, ComHandleId=2300, ComSystemTemplateSystemSignalRef=DET_SUPER_RES_TARGET_107
            DET_EXISTENCE_PROB_108_oRDR_DETECTION_105_108_oPCAN_RADAR_af7baa83_Tx: ComBitPosition=448, ComBitSize=6, ComSignalInitValue=0, ComSignalType=UINT8, ComHandleId=2254, ComSystemTemplateSystemSignalRef=DET_EXISTENCE_PROB_108
            DET_RANGE_VELOCITY_106_oRDR_DETECTION_105_108_oPCAN_RADAR_f7336fd6_Tx: ComBitPosition=160, ComBitSize=15, ComSignalInitValue=16384, ComSignalType=UINT16, ComHandleId=2283, ComSystemTemplateSystemSignalRef=DET_RANGE_VELOCITY_106
            DET_CONFD_ELEVATION_106_oRDR_DETECTION_105_108_oPCAN_RADAR_927dd578_Tx: ComBitPosition=213, ComBitSize=2, ComSignalInitValue=0, ComSignalType=UINT8, ComHandleId=2240, ComSystemTemplateSystemSignalRef=DET_CONFD_ELEVATION_106
            DET_BI_STATIC_FLAG_105_oRDR_DETECTION_105_108_oPCAN_RADAR_a0c2e533_Tx: ComBitPosition=104, ComBitSize=1, ComSignalInitValue=0, ComSignalType=BOOLEAN, ComHandleId=2231, ComSystemTemplateSystemSignalRef=DET_BI_STATIC_FLAG_105
            DET_RANGE_VELOCITY_108_oRDR_DETECTION_105_108_oPCAN_RADAR_4e532904_Tx: ComBitPosition=384, ComBitSize=15, ComSignalInitValue=16384, ComSignalType=UINT16, ComHandleId=2285, ComSystemTemplateSystemSignalRef=DET_RANGE_VELOCITY_108
            DET_SUPER_RES_TARGET_105_oRDR_DETECTION_105_108_oPCAN_RADAR_f8645f15_Tx: ComBitPosition=87, ComBitSize=1, ComSignalInitValue=0, ComSignalType=BOOLEAN, ComHandleId=2298, ComSystemTemplateSystemSignalRef=DET_SUPER_RES_TARGET_105
            DET_SUPER_RES_TARGET_108_oRDR_DETECTION_105_108_oPCAN_RADAR_25e46239_Tx: ComBitPosition=423, ComBitSize=1, ComSignalInitValue=0, ComSignalType=BOOLEAN, ComHandleId=2301, ComSystemTemplateSystemSignalRef=DET_SUPER_RES_TARGET_108
            DET_HVC_FLAG_107_oRDR_DETECTION_105_108_oPCAN_RADAR_621f7bbb_Tx: ComBitPosition=310, ComBitSize=1, ComSignalInitValue=0, ComSignalType=BOOLEAN, ComHandleId=2257, ComSystemTemplateSystemSignalRef=DET_HVC_FLAG_107
            DET_ELEVATION_ERR_105_oRDR_DETECTION_105_108_oPCAN_RADAR_a064e2cf_Tx: ComBitPosition=80, ComBitSize=6, ComSignalInitValue=0, ComSignalType=UINT8, ComHandleId=2247, ComSystemTemplateSystemSignalRef=DET_ELEVATION_ERR_105
            DET_RANGE_ERR_107_oRDR_DETECTION_105_108_oPCAN_RADAR_b00dc30f_Tx: ComBitPosition=264, ComBitSize=7, ComSignalInitValue=0, ComSignalType=UINT8, ComHandleId=2280, ComSystemTemplateSystemSignalRef=DET_RANGE_ERR_107
            DET_AZIMUTH_106_oRDR_DETECTION_105_108_oPCAN_RADAR_920ede48_Tx: ComBitPosition=200, ComBitSize=13, ComSignalInitValue=0, ComSignalType=UINT16, ComHandleId=2220, ComSystemTemplateSystemSignalRef=DET_AZIMUTH_106
            DET_BI_STATIC_FLAG_106_oRDR_DETECTION_105_108_oPCAN_RADAR_c4229ecd_Tx: ComBitPosition=216, ComBitSize=1, ComSignalInitValue=0, ComSignalType=BOOLEAN, ComHandleId=2232, ComSystemTemplateSystemSignalRef=DET_BI_STATIC_FLAG_106
            DET_ELEVATION_106_oRDR_DETECTION_105_108_oPCAN_RADAR_43bd0144_Tx: ComBitPosition=184, ComBitSize=8, ComSignalInitValue=0, ComSignalType=UINT8, ComHandleId=2244, ComSystemTemplateSystemSignalRef=DET_ELEVATION_106
            DET_CONFD_AZIMUTH_105_oRDR_DETECTION_105_108_oPCAN_RADAR_f408af7c_Tx: ComBitPosition=118, ComBitSize=2, ComSignalInitValue=0, ComSignalType=UINT8, ComHandleId=2235, ComSystemTemplateSystemSignalRef=DET_CONFD_AZIMUTH_105
            DET_CONFD_ELEVATION_107_oRDR_DETECTION_105_108_oPCAN_RADAR_070d01ed_Tx: ComBitPosition=325, ComBitSize=2, ComSignalInitValue=0, ComSignalType=UINT8, ComHandleId=2241, ComSystemTemplateSystemSignalRef=DET_CONFD_ELEVATION_107
            DET_EXISTENCE_PROB_107_oRDR_DETECTION_105_108_oPCAN_RADAR_836b38c4_Tx: ComBitPosition=336, ComBitSize=6, ComSignalInitValue=0, ComSignalType=UINT8, ComHandleId=2253, ComSystemTemplateSystemSignalRef=DET_EXISTENCE_PROB_107
            DET_ELEVATION_ERR_106_oRDR_DETECTION_105_108_oPCAN_RADAR_c4849931_Tx: ComBitPosition=192, ComBitSize=6, ComSignalInitValue=0, ComSignalType=UINT8, ComHandleId=2248, ComSystemTemplateSystemSignalRef=DET_ELEVATION_ERR_106
            DET_RANGE_106_oRDR_DETECTION_105_108_oPCAN_RADAR_8295adf3_Tx: ComBitPosition=136, ComBitSize=15, ComSignalInitValue=0, ComSignalType=UINT16, ComHandleId=2275, ComSystemTemplateSystemSignalRef=DET_RANGE_106
            DET_RANGE_105_oRDR_DETECTION_105_108_oPCAN_RADAR_e675d60d_Tx: ComBitPosition=24, ComBitSize=15, ComSignalInitValue=0, ComSignalType=UINT16, ComHandleId=2274, ComSystemTemplateSystemSignalRef=DET_RANGE_105
            DET_RANGE_108_oRDR_DETECTION_105_108_oPCAN_RADAR_3bf5eb21_Tx: ComBitPosition=360, ComBitSize=15, ComSignalInitValue=0, ComSignalType=UINT16, ComHandleId=2277, ComSystemTemplateSystemSignalRef=DET_RANGE_108
            DET_RANGE_VELOCITY_ERR_107_oRDR_DETECTION_105_108_oPCAN_RADAR_6df840f1_Tx: ComBitPosition=288, ComBitSize=8, ComSignalInitValue=0, ComSignalType=UINT8, ComHandleId=2288, ComSystemTemplateSystemSignalRef=DET_RANGE_VELOCITY_ERR_107
            DET_PROB_1STAZHYPO_107_oRDR_DETECTION_105_108_oPCAN_RADAR_1c4a9a10_Tx: ComBitPosition=327, ComBitSize=1, ComSignalInitValue=0, ComSignalType=BOOLEAN, ComHandleId=2272, ComSystemTemplateSystemSignalRef=DET_PROB_1STAZHYPO_107
            DET_PROB_1STAZHYPO_106_oRDR_DETECTION_105_108_oPCAN_RADAR_893a4e85_Tx: ComBitPosition=215, ComBitSize=1, ComSignalInitValue=0, ComSignalType=BOOLEAN, ComHandleId=2271, ComSystemTemplateSystemSignalRef=DET_PROB_1STAZHYPO_106
            DET_PROB_1STAZHYPO_105_oRDR_DETECTION_105_108_oPCAN_RADAR_edda357b_Tx: ComBitPosition=103, ComBitSize=1, ComSignalInitValue=0, ComSignalType=BOOLEAN, ComHandleId=2270, ComSystemTemplateSystemSignalRef=DET_PROB_1STAZHYPO_105
            DET_BELOW_RAIN_THOLD_106_oRDR_DETECTION_105_108_oPCAN_RADAR_470f4d88_Tx: ComBitPosition=151, ComBitSize=1, ComSignalInitValue=0, ComSignalType=UINT8, ComHandleId=2228, ComSystemTemplateSystemSignalRef=DET_BELOW_RAIN_THOLD_106
            DET_MTD_107_oRDR_DETECTION_105_108_oPCAN_RADAR_8ffe72dd_Tx: ComBitPosition=271, ComBitSize=1, ComSignalInitValue=0, ComSignalType=UINT8, ComHandleId=2268, ComSystemTemplateSystemSignalRef=DET_MTD_107
            DET_IDM_105_oRDR_DETECTION_105_108_oPCAN_RADAR_18ddef6d_Tx: ComBitPosition=63, ComBitSize=1, ComSignalInitValue=0, ComSignalType=UINT8, ComHandleId=2259, ComSystemTemplateSystemSignalRef=DET_IDM_105
            DET_BELOW_RAIN_THOLD_108_oRDR_DETECTION_105_108_oPCAN_RADAR_fe6f0b5a_Tx: ComBitPosition=375, ComBitSize=1, ComSignalInitValue=0, ComSignalType=UINT8, ComHandleId=2230, ComSystemTemplateSystemSignalRef=DET_BELOW_RAIN_THOLD_108
            DET_MTD_105_oRDR_DETECTION_105_108_oPCAN_RADAR_7e6eddb6_Tx: ComBitPosition=47, ComBitSize=1, ComSignalInitValue=0, ComSignalType=UINT8, ComHandleId=2266, ComSystemTemplateSystemSignalRef=DET_MTD_105
            DET_IDM_106_oRDR_DETECTION_105_108_oPCAN_RADAR_7c3d9493_Tx: ComBitPosition=175, ComBitSize=1, ComSignalInitValue=0, ComSignalType=UINT8, ComHandleId=2260, ComSystemTemplateSystemSignalRef=DET_IDM_106
            DET_MTD_106_oRDR_DETECTION_105_108_oPCAN_RADAR_1a8ea648_Tx: ComBitPosition=159, ComBitSize=1, ComSignalInitValue=0, ComSignalType=UINT8, ComHandleId=2267, ComSystemTemplateSystemSignalRef=DET_MTD_106
            DET_PROB_1STAZHYPO_108_oRDR_DETECTION_105_108_oPCAN_RADAR_305a0857_Tx: ComBitPosition=439, ComBitSize=1, ComSignalInitValue=0, ComSignalType=BOOLEAN, ComHandleId=2273, ComSystemTemplateSystemSignalRef=DET_PROB_1STAZHYPO_108
            DET_IDM_108_oRDR_DETECTION_105_108_oPCAN_RADAR_c55dd241_Tx: ComBitPosition=399, ComBitSize=1, ComSignalInitValue=0, ComSignalType=UINT8, ComHandleId=2262, ComSystemTemplateSystemSignalRef=DET_IDM_108
            DET_MTD_108_oRDR_DETECTION_105_108_oPCAN_RADAR_a3eee09a_Tx: ComBitPosition=383, ComBitSize=1, ComSignalInitValue=0, ComSignalType=UINT8, ComHandleId=2269, ComSystemTemplateSystemSignalRef=DET_MTD_108
            DET_BELOW_RAIN_THOLD_107_oRDR_DETECTION_105_108_oPCAN_RADAR_d27f991d_Tx: ComBitPosition=263, ComBitSize=1, ComSignalInitValue=0, ComSignalType=UINT8, ComHandleId=2229, ComSystemTemplateSystemSignalRef=DET_BELOW_RAIN_THOLD_107
            DET_BELOW_RAIN_THOLD_105_oRDR_DETECTION_105_108_oPCAN_RADAR_23ef3676_Tx: ComBitPosition=39, ComBitSize=1, ComSignalInitValue=0, ComSignalType=UINT8, ComHandleId=2227, ComSystemTemplateSystemSignalRef=DET_BELOW_RAIN_THOLD_105
            DET_IDM_107_oRDR_DETECTION_105_108_oPCAN_RADAR_e94d4006_Tx: ComBitPosition=287, ComBitSize=1, ComSignalInitValue=0, ComSignalType=UINT8, ComHandleId=2261, ComSystemTemplateSystemSignalRef=DET_IDM_107
