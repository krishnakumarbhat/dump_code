[part 7 of 20: package /ActiveEcuC]
AUTOSAR XML (schema 00053)
package /ActiveEcuC  (continued)
  module config Com: implementation-config-variant=VARIANT-PRE-COMPILE, module-description=Com_Impl  (continued)
    ComConfig: ComConfigurationId=0, ComRxImmediateNotificationCacheSize=0, ComRxDeferredNotificationCacheSize=1  (continued)
      109 x ComSignalGroup, all with ComSignalGroupAccess=ACCESS_NEEDED_BY_SWC_OR_COM, ComSignalGroupArrayAccess=true:  (continued)
        SG_Detections_213_216_oRDR_DETECTION_213_216_oPCAN_RADAR_80aaa8dc_Tx: ComTransferProperty=TRIGGERED, ComHandleId=55, ComSystemTemplateSignalGroupRef=SG_Detections_213_216
          83 x ComGroupSignal, all with ComSignalEndianness=LITTLE_ENDIAN, ComTransferProperty=PENDING, ComSignalAccess=ACCESS_NEEDED_BY_SWC_OR_COM:
            DET_RANGE_VELOCITY_216_oRDR_DETECTION_213_216_oPCAN_RADAR_a78f7851_Tx: ComBitPosition=384, ComBitSize=15, ComSignalInitValue=16384, ComSignalType=UINT16, ComHandleId=4526, ComSystemTemplateSystemSignalRef=DET_RANGE_VELOCITY_216
            DET_EXISTENCE_PROB_215_oRDR_DETECTION_213_216_oPCAN_RADAR_22478028_Tx: ComBitPosition=336, ComBitSize=6, ComSignalInitValue=0, ComSignalType=UINT8, ComHandleId=4494, ComSystemTemplateSystemSignalRef=DET_EXISTENCE_PROB_215
            DET_RANGE_ERR_214_oRDR_DETECTION_213_216_oPCAN_RADAR_8451af76_Tx: ComBitPosition=152, ComBitSize=7, ComSignalInitValue=0, ComSignalType=UINT8, ComHandleId=4520, ComSystemTemplateSystemSignalRef=DET_RANGE_ERR_214
            DET_RANGE_213_oRDR_DETECTION_213_216_oPCAN_RADAR_7f093676_Tx: ComBitPosition=24, ComBitSize=15, ComSignalInitValue=0, ComSignalType=UINT16, ComHandleId=4515, ComSystemTemplateSystemSignalRef=DET_RANGE_213
            DET_EXISTENCE_PROB_216_oRDR_DETECTION_213_216_oPCAN_RADAR_46a7fbd6_Tx: ComBitPosition=448, ComBitSize=6, ComSignalInitValue=0, ComSignalType=UINT8, ComHandleId=4495, ComSystemTemplateSystemSignalRef=DET_EXISTENCE_PROB_216
            DET_MH_SCAN_INDEX_4LSB_213_216_oRDR_DETECTION_213_216_oPCAN_RADAR_4c7dfe6c_Tx: ComBitPosition=476, ComBitSize=4, ComSignalInitValue=0, ComSignalType=UINT8, ComHandleId=4506, ComSystemTemplateSystemSignalRef=DET_MH_SCAN_INDEX_4LSB_213_216
            DET_RANGE_VELOCITY_ERR_215_oRDR_DETECTION_213_216_oPCAN_RADAR_ccd4f81d_Tx: ComBitPosition=288, ComBitSize=8, ComSignalInitValue=0, ComSignalType=UINT8, ComHandleId=4529, ComSystemTemplateSystemSignalRef=DET_RANGE_VELOCITY_ERR_215
            DET_BI_STATIC_FLAG_214_oRDR_DETECTION_213_216_oPCAN_RADAR_650e2621_Tx: ComBitPosition=216, ComBitSize=1, ComSignalInitValue=0, ComSignalType=BOOLEAN, ComHandleId=4473, ComSystemTemplateSystemSignalRef=DET_BI_STATIC_FLAG_214
            DET_CONFD_AZIMUTH_213_oRDR_DETECTION_213_216_oPCAN_RADAR_6d744f07_Tx: ComBitPosition=118, ComBitSize=2, ComSignalInitValue=0, ComSignalType=UINT8, ComHandleId=4476, ComSystemTemplateSystemSignalRef=DET_CONFD_AZIMUTH_213
            DET_AZIMUTH_ERR_214_oRDR_DETECTION_213_216_oPCAN_RADAR_9797f351_Tx: ComBitPosition=217, ComBitSize=7, ComSignalInitValue=0, ComSignalType=UINT8, ComHandleId=4465, ComSystemTemplateSystemSignalRef=DET_AZIMUTH_ERR_214
            DET_EXISTENCE_PROB_214_oRDR_DETECTION_213_216_oPCAN_RADAR_b73754bd_Tx: ComBitPosition=224, ComBitSize=6, ComSignalInitValue=0, ComSignalType=UINT8, ComHandleId=4493, ComSystemTemplateSystemSignalRef=DET_EXISTENCE_PROB_214
            DET_RANGE_VELOCITY_215_oRDR_DETECTION_213_216_oPCAN_RADAR_c36f03af_Tx: ComBitPosition=272, ComBitSize=15, ComSignalInitValue=16384, ComSignalType=UINT16, ComHandleId=4525, ComSystemTemplateSystemSignalRef=DET_RANGE_VELOCITY_215
            DET_CONFD_AZIMUTH_214_oRDR_DETECTION_213_216_oPCAN_RADAR_31c46c6e_Tx: ComBitPosition=230, ComBitSize=2, ComSignalInitValue=0, ComSignalType=UINT8, ComHandleId=4477, ComSystemTemplateSystemSignalRef=DET_CONFD_AZIMUTH_214
            DET_ELEVATION_ERR_214_oRDR_DETECTION_213_216_oPCAN_RADAR_65a821dd_Tx: ComBitPosition=192, ComBitSize=6, ComSignalInitValue=0, ComSignalType=UINT8, ComHandleId=4489, ComSystemTemplateSystemSignalRef=DET_ELEVATION_ERR_214
            DET_RANGE_215_oRDR_DETECTION_213_216_oPCAN_RADAR_b6c9c18a_Tx: ComBitPosition=248, ComBitSize=15, ComSignalInitValue=0, ComSignalType=UINT16, ComHandleId=4517, ComSystemTemplateSystemSignalRef=DET_RANGE_215
            DET_AZIMUTH_ERR_216_oRDR_DETECTION_213_216_oPCAN_RADAR_66075c3a_Tx: ComBitPosition=441, ComBitSize=7, ComSignalInitValue=0, ComSignalType=UINT8, ComHandleId=4467, ComSystemTemplateSystemSignalRef=DET_AZIMUTH_ERR_216
            DET_ELEVATION_ERR_213_oRDR_DETECTION_213_216_oPCAN_RADAR_391802b4_Tx: ComBitPosition=80, ComBitSize=6, ComSignalInitValue=0, ComSignalType=UINT8, ComHandleId=4488, ComSystemTemplateSystemSignalRef=DET_ELEVATION_ERR_213
            DET_AZIMUTH_213_oRDR_DETECTION_213_216_oPCAN_RADAR_6f9245cd_Tx: ComBitPosition=88, ComBitSize=13, ComSignalInitValue=0, ComSignalType=UINT16, ComHandleId=4460, ComSystemTemplateSystemSignalRef=DET_AZIMUTH_213
            DET_SUPER_RES_TARGET_215_oRDR_DETECTION_213_216_oPCAN_RADAR_a8d84892_Tx: ComBitPosition=311, ComBitSize=1, ComSignalInitValue=0, ComSignalType=BOOLEAN, ComHandleId=4541, ComSystemTemplateSystemSignalRef=DET_SUPER_RES_TARGET_215
            DET_ELEVATION_214_oRDR_DETECTION_213_216_oPCAN_RADAR_e291b9a8_Tx: ComBitPosition=184, ComBitSize=8, ComSignalInitValue=0, ComSignalType=UINT8, ComHandleId=4485, ComSystemTemplateSystemSignalRef=DET_ELEVATION_214
            DET_RANGE_VELOCITY_214_oRDR_DETECTION_213_216_oPCAN_RADAR_561fd73a_Tx: ComBitPosition=160, ComBitSize=15, ComSignalInitValue=16384, ComSignalType=UINT16, ComHandleId=4524, ComSystemTemplateSystemSignalRef=DET_RANGE_VELOCITY_214
            DET_ELEVATION_ERR_216_oRDR_DETECTION_213_216_oPCAN_RADAR_94388eb6_Tx: ComBitPosition=416, ComBitSize=6, ComSignalInitValue=0, ComSignalType=UINT8, ComHandleId=4491, ComSystemTemplateSystemSignalRef=DET_ELEVATION_ERR_216
            DET_CONFD_AZIMUTH_216_oRDR_DETECTION_213_216_oPCAN_RADAR_c054c305_Tx: ComBitPosition=454, ComBitSize=2, ComSignalInitValue=0, ComSignalType=UINT8, ComHandleId=4479, ComSystemTemplateSystemSignalRef=DET_CONFD_AZIMUTH_216
            DET_SUPER_RES_TARGET_213_oRDR_DETECTION_213_216_oPCAN_RADAR_6118bf6e_Tx: ComBitPosition=87, ComBitSize=1, ComSignalInitValue=0, ComSignalType=BOOLEAN, ComHandleId=4539, ComSystemTemplateSystemSignalRef=DET_SUPER_RES_TARGET_213
            DET_BI_STATIC_FLAG_215_oRDR_DETECTION_213_216_oPCAN_RADAR_f07ef2b4_Tx: ComBitPosition=328, ComBitSize=1, ComSignalInitValue=0, ComSignalType=BOOLEAN, ComHandleId=4474, ComSystemTemplateSystemSignalRef=DET_BI_STATIC_FLAG_215
            DET_SNR_215_oRDR_DETECTION_213_216_oPCAN_RADAR_994160f7_Tx: ComBitPosition=344, ComBitSize=8, ComSignalInitValue=0, ComSignalType=UINT8, ComHandleId=4537, ComSystemTemplateSystemSignalRef=DET_SNR_215
            DET_RANGE_VELOCITY_213_oRDR_DETECTION_213_216_oPCAN_RADAR_0aaff453_Tx: ComBitPosition=48, ComBitSize=15, ComSignalInitValue=16384, ComSignalType=UINT16, ComHandleId=4523, ComSystemTemplateSystemSignalRef=DET_RANGE_VELOCITY_213
            DET_BI_STATIC_FLAG_216_oRDR_DETECTION_213_216_oPCAN_RADAR_949e894a_Tx: ComBitPosition=440, ComBitSize=1, ComSignalInitValue=0, ComSignalType=BOOLEAN, ComHandleId=4475, ComSystemTemplateSystemSignalRef=DET_BI_STATIC_FLAG_216
            DET_AZIMUTH_ERR_213_oRDR_DETECTION_213_216_oPCAN_RADAR_cb27d038_Tx: ComBitPosition=105, ComBitSize=7, ComSignalInitValue=0, ComSignalType=UINT8, ComHandleId=4464, ComSystemTemplateSystemSignalRef=DET_AZIMUTH_ERR_213
            DET_RANGE_214_oRDR_DETECTION_213_216_oPCAN_RADAR_23b9151f_Tx: ComBitPosition=136, ComBitSize=15, ComSignalInitValue=0, ComSignalType=UINT16, ComHandleId=4516, ComSystemTemplateSystemSignalRef=DET_RANGE_214
            DET_ELEVATION_216_oRDR_DETECTION_213_216_oPCAN_RADAR_130116c3_Tx: ComBitPosition=408, ComBitSize=8, ComSignalInitValue=0, ComSignalType=UINT8, ComHandleId=4487, ComSystemTemplateSystemSignalRef=DET_ELEVATION_216
            DET_RANGE_ERR_215_oRDR_DETECTION_213_216_oPCAN_RADAR_11217be3_Tx: ComBitPosition=264, ComBitSize=7, ComSignalInitValue=0, ComSignalType=UINT8, ComHandleId=4521, ComSystemTemplateSystemSignalRef=DET_RANGE_ERR_215
            DET_RANGE_VELOCITY_ERR_213_oRDR_DETECTION_213_216_oPCAN_RADAR_05140fe1_Tx: ComBitPosition=64, ComBitSize=8, ComSignalInitValue=0, ComSignalType=UINT8, ComHandleId=4527, ComSystemTemplateSystemSignalRef=DET_RANGE_VELOCITY_ERR_213
            DET_ELEVATION_215_oRDR_DETECTION_213_216_oPCAN_RADAR_77e16d3d_Tx: ComBitPosition=296, ComBitSize=8, ComSignalInitValue=0, ComSignalType=UINT8, ComHandleId=4486, ComSystemTemplateSystemSignalRef=DET_ELEVATION_215
            DET_BI_STATIC_FLAG_213_oRDR_DETECTION_213_216_oPCAN_RADAR_39be0548_Tx: ComBitPosition=104, ComBitSize=1, ComSignalInitValue=0, ComSignalType=BOOLEAN, ComHandleId=4472, ComSystemTemplateSystemSignalRef=DET_BI_STATIC_FLAG_213
            DET_AZIMUTH_ERR_215_oRDR_DETECTION_213_216_oPCAN_RADAR_02e727c4_Tx: ComBitPosition=329, ComBitSize=7, ComSignalInitValue=0, ComSignalType=UINT8, ComHandleId=4466, ComSystemTemplateSystemSignalRef=DET_AZIMUTH_ERR_215
            DET_ELEVATION_ERR_215_oRDR_DETECTION_213_216_oPCAN_RADAR_f0d8f548_Tx: ComBitPosition=304, ComBitSize=6, ComSignalInitValue=0, ComSignalType=UINT8, ComHandleId=4490, ComSystemTemplateSystemSignalRef=DET_ELEVATION_ERR_215
            DET_SNR_213_oRDR_DETECTION_213_216_oPCAN_RADAR_5081970b_Tx: ComBitPosition=120, ComBitSize=8, ComSignalInitValue=0, ComSignalType=UINT8, ComHandleId=4535, ComSystemTemplateSystemSignalRef=DET_SNR_213
            DET_HVC_FLAG_213_oRDR_DETECTION_213_216_oPCAN_RADAR_0af334ab_Tx: ComBitPosition=86, ComBitSize=1, ComSignalInitValue=0, ComSignalType=BOOLEAN, ComHandleId=4496, ComSystemTemplateSystemSignalRef=DET_HVC_FLAG_213
            DET_EXISTENCE_PROB_213_oRDR_DETECTION_213_216_oPCAN_RADAR_eb8777d4_Tx: ComBitPosition=112, ComBitSize=6, ComSignalInitValue=0, ComSignalType=UINT8, ComHandleId=4492, ComSystemTemplateSystemSignalRef=DET_EXISTENCE_PROB_213
            DET_CONFD_ELEVATION_214_oRDR_DETECTION_213_216_oPCAN_RADAR_33516d94_Tx: ComBitPosition=213, ComBitSize=2, ComSignalInitValue=0, ComSignalType=UINT8, ComHandleId=4481, ComSystemTemplateSystemSignalRef=DET_CONFD_ELEVATION_214
            DET_RANGE_VELOCITY_ERR_216_oRDR_DETECTION_213_216_oPCAN_RADAR_a83483e3_Tx: ComBitPosition=400, ComBitSize=8, ComSignalInitValue=0, ComSignalType=UINT8, ComHandleId=4530, ComSystemTemplateSystemSignalRef=DET_RANGE_VELOCITY_ERR_216
            DET_AZIMUTH_216_oRDR_DETECTION_213_216_oPCAN_RADAR_c2b2c9cf_Tx: ComBitPosition=424, ComBitSize=13, ComSignalInitValue=0, ComSignalType=UINT16, ComHandleId=4463, ComSystemTemplateSystemSignalRef=DET_AZIMUTH_216
            DET_SUPER_RES_TARGET_216_oRDR_DETECTION_213_216_oPCAN_RADAR_cc38336c_Tx: ComBitPosition=423, ComBitSize=1, ComSignalInitValue=0, ComSignalType=BOOLEAN, ComHandleId=4542, ComSystemTemplateSystemSignalRef=DET_SUPER_RES_TARGET_216
            DET_RCS_216_oRDR_DETECTION_213_216_oPCAN_RADAR_200f4f0b_Tx: ComBitPosition=464, ComBitSize=8, ComSignalInitValue=128, ComSignalType=UINT8, ComHandleId=4534, ComSystemTemplateSystemSignalRef=DET_RCS_216
            DET_RANGE_ERR_213_oRDR_DETECTION_213_216_oPCAN_RADAR_d8e18c1f_Tx: ComBitPosition=40, ComBitSize=7, ComSignalInitValue=0, ComSignalType=UINT8, ComHandleId=4519, ComSystemTemplateSystemSignalRef=DET_RANGE_ERR_213
            DET_MH_CYCLE_COUNTER_213_216_oRDR_DETECTION_213_216_oPCAN_RADAR_8057dbe0_Tx: ComBitPosition=16, ComBitSize=8, ComSignalInitValue=0, ComSignalType=UINT8, ComHandleId=4505, ComSystemTemplateSystemSignalRef=DET_MH_CYCLE_COUNTER_213_216
            DET_RANGE_216_oRDR_DETECTION_213_216_oPCAN_RADAR_d229ba74_Tx: ComBitPosition=360, ComBitSize=15, ComSignalInitValue=0, ComSignalType=UINT16, ComHandleId=4518, ComSystemTemplateSystemSignalRef=DET_RANGE_216
            DET_AZIMUTH_214_oRDR_DETECTION_213_216_oPCAN_RADAR_332266a4_Tx: ComBitPosition=200, ComBitSize=13, ComSignalInitValue=0, ComSignalType=UINT16, ComHandleId=4461, ComSystemTemplateSystemSignalRef=DET_AZIMUTH_214
            DET_RCS_215_oRDR_DETECTION_213_216_oPCAN_RADAR_44ef34f5_Tx: ComBitPosition=352, ComBitSize=8, ComSignalInitValue=128, ComSignalType=UINT8, ComHandleId=4533, ComSystemTemplateSystemSignalRef=DET_RCS_215
            DET_HVC_FLAG_216_oRDR_DETECTION_213_216_oPCAN_RADAR_a7d3b8a9_Tx: ComBitPosition=422, ComBitSize=1, ComSignalInitValue=0, ComSignalType=BOOLEAN, ComHandleId=4499, ComSystemTemplateSystemSignalRef=DET_HVC_FLAG_216
            DET_CONFD_ELEVATION_215_oRDR_DETECTION_213_216_oPCAN_RADAR_a621b901_Tx: ComBitPosition=325, ComBitSize=2, ComSignalInitValue=0, ComSignalType=UINT8, ComHandleId=4482, ComSystemTemplateSystemSignalRef=DET_CONFD_ELEVATION_215
            DET_CONFD_AZIMUTH_215_oRDR_DETECTION_213_216_oPCAN_RADAR_a4b4b8fb_Tx: ComBitPosition=342, ComBitSize=2, ComSignalInitValue=0, ComSignalType=UINT8, ComHandleId=4478, ComSystemTemplateSystemSignalRef=DET_CONFD_AZIMUTH_215
            DET_SUPER_RES_TARGET_214_oRDR_DETECTION_213_216_oPCAN_RADAR_3da89c07_Tx: ComBitPosition=199, ComBitSize=1, ComSignalInitValue=0, ComSignalType=BOOLEAN, ComHandleId=4540, ComSystemTemplateSystemSignalRef=DET_SUPER_RES_TARGET_214
            DET_HVC_FLAG_214_oRDR_DETECTION_213_216_oPCAN_RADAR_564317c2_Tx: ComBitPosition=198, ComBitSize=1, ComSignalInitValue=0, ComSignalType=BOOLEAN, ComHandleId=4497, ComSystemTemplateSystemSignalRef=DET_HVC_FLAG_214
            DET_RCS_213_oRDR_DETECTION_213_216_oPCAN_RADAR_8d2fc309_Tx: ComBitPosition=128, ComBitSize=8, ComSignalInitValue=128, ComSignalType=UINT8, ComHandleId=4531, ComSystemTemplateSystemSignalRef=DET_RCS_213
            DET_CONFD_ELEVATION_216_oRDR_DETECTION_213_216_oPCAN_RADAR_c2c1c2ff_Tx: ComBitPosition=437, ComBitSize=2, ComSignalInitValue=0, ComSignalType=UINT8, ComHandleId=4483, ComSystemTemplateSystemSignalRef=DET_CONFD_ELEVATION_216
            DET_RANGE_VELOCITY_ERR_214_oRDR_DETECTION_213_216_oPCAN_RADAR_59a42c88_Tx: ComBitPosition=176, ComBitSize=8, ComSignalInitValue=0, ComSignalType=UINT8, ComHandleId=4528, ComSystemTemplateSystemSignalRef=DET_RANGE_VELOCITY_ERR_214
            DET_RCS_214_oRDR_DETECTION_213_216_oPCAN_RADAR_d19fe060_Tx: ComBitPosition=240, ComBitSize=8, ComSignalInitValue=128, ComSignalType=UINT8, ComHandleId=4532, ComSystemTemplateSystemSignalRef=DET_RCS_214
            DET_ELEVATION_213_oRDR_DETECTION_213_216_oPCAN_RADAR_be219ac1_Tx: ComBitPosition=72, ComBitSize=8, ComSignalInitValue=0, ComSignalType=UINT8, ComHandleId=4484, ComSystemTemplateSystemSignalRef=DET_ELEVATION_213
            DET_RANGE_ERR_216_oRDR_DETECTION_213_216_oPCAN_RADAR_75c1001d_Tx: ComBitPosition=376, ComBitSize=7, ComSignalInitValue=0, ComSignalType=UINT8, ComHandleId=4522, ComSystemTemplateSystemSignalRef=DET_RANGE_ERR_216
            DET_CONFD_ELEVATION_213_oRDR_DETECTION_213_216_oPCAN_RADAR_6fe14efd_Tx: ComBitPosition=101, ComBitSize=2, ComSignalInitValue=0, ComSignalType=UINT8, ComHandleId=4480, ComSystemTemplateSystemSignalRef=DET_CONFD_ELEVATION_213
            DET_MH_CRC16_213_216_oRDR_DETECTION_213_216_oPCAN_RADAR_04227ad7_Tx: ComBitPosition=0, ComBitSize=16, ComSignalInitValue=0, ComSignalType=UINT16, ComHandleId=4504, ComSystemTemplateSystemSignalRef=DET_MH_CRC16_213_216
            DET_HVC_FLAG_215_oRDR_DETECTION_213_216_oPCAN_RADAR_c333c357_Tx: ComBitPosition=310, ComBitSize=1, ComSignalInitValue=0, ComSignalType=BOOLEAN, ComHandleId=4498, ComSystemTemplateSystemSignalRef=DET_HVC_FLAG_215
            DET_SNR_216_oRDR_DETECTION_213_216_oPCAN_RADAR_fda11b09_Tx: ComBitPosition=456, ComBitSize=8, ComSignalInitValue=0, ComSignalType=UINT8, ComHandleId=4538, ComSystemTemplateSystemSignalRef=DET_SNR_216
            DET_AZIMUTH_215_oRDR_DETECTION_213_216_oPCAN_RADAR_a652b231_Tx: ComBitPosition=312, ComBitSize=13, ComSignalInitValue=0, ComSignalType=UINT16, ComHandleId=4462, ComSystemTemplateSystemSignalRef=DET_AZIMUTH_215
            DET_SNR_214_oRDR_DETECTION_213_216_oPCAN_RADAR_0c31b462_Tx: ComBitPosition=232, ComBitSize=8, ComSignalInitValue=0, ComSignalType=UINT8, ComHandleId=4536, ComSystemTemplateSystemSignalRef=DET_SNR_214
            DET_PROB_1STAZHYPO_214_oRDR_DETECTION_213_216_oPCAN_RADAR_2816f669_Tx: ComBitPosition=215, ComBitSize=1, ComSignalInitValue=0, ComSignalType=BOOLEAN, ComHandleId=4512, ComSystemTemplateSystemSignalRef=DET_PROB_1STAZHYPO_214
            DET_BELOW_RAIN_THOLD_214_oRDR_DETECTION_213_216_oPCAN_RADAR_e623f564_Tx: ComBitPosition=151, ComBitSize=1, ComSignalInitValue=0, ComSignalType=UINT8, ComHandleId=4469, ComSystemTemplateSystemSignalRef=DET_BELOW_RAIN_THOLD_214
            DET_IDM_215_oRDR_DETECTION_213_216_oPCAN_RADAR_4861f8ea_Tx: ComBitPosition=287, ComBitSize=1, ComSignalInitValue=0, ComSignalType=UINT8, ComHandleId=4502, ComSystemTemplateSystemSignalRef=DET_IDM_215
            DET_MTD_216_oRDR_DETECTION_213_216_oPCAN_RADAR_4a32b1cf_Tx: ComBitPosition=383, ComBitSize=1, ComSignalInitValue=0, ComSignalType=UINT8, ComHandleId=4510, ComSystemTemplateSystemSignalRef=DET_MTD_216
            DET_IDM_214_oRDR_DETECTION_213_216_oPCAN_RADAR_dd112c7f_Tx: ComBitPosition=175, ComBitSize=1, ComSignalInitValue=0, ComSignalType=UINT8, ComHandleId=4501, ComSystemTemplateSystemSignalRef=DET_IDM_214
            DET_MTD_213_oRDR_DETECTION_213_216_oPCAN_RADAR_e7123dcd_Tx: ComBitPosition=47, ComBitSize=1, ComSignalInitValue=0, ComSignalType=UINT8, ComHandleId=4507, ComSystemTemplateSystemSignalRef=DET_MTD_213
            DET_BELOW_RAIN_THOLD_213_oRDR_DETECTION_213_216_oPCAN_RADAR_ba93d60d_Tx: ComBitPosition=39, ComBitSize=1, ComSignalInitValue=0, ComSignalType=UINT8, ComHandleId=4468, ComSystemTemplateSystemSignalRef=DET_BELOW_RAIN_THOLD_213
            DET_IDM_213_oRDR_DETECTION_213_216_oPCAN_RADAR_81a10f16_Tx: ComBitPosition=63, ComBitSize=1, ComSignalInitValue=0, ComSignalType=UINT8, ComHandleId=4500, ComSystemTemplateSystemSignalRef=DET_IDM_213
            DET_PROB_1STAZHYPO_213_oRDR_DETECTION_213_216_oPCAN_RADAR_74a6d500_Tx: ComBitPosition=103, ComBitSize=1, ComSignalInitValue=0, ComSignalType=BOOLEAN, ComHandleId=4511, ComSystemTemplateSystemSignalRef=DET_PROB_1STAZHYPO_213
            DET_BELOW_RAIN_THOLD_215_oRDR_DETECTION_213_216_oPCAN_RADAR_735321f1_Tx: ComBitPosition=263, ComBitSize=1, ComSignalInitValue=0, ComSignalType=UINT8, ComHandleId=4470, ComSystemTemplateSystemSignalRef=DET_BELOW_RAIN_THOLD_215
            DET_BELOW_RAIN_THOLD_216_oRDR_DETECTION_213_216_oPCAN_RADAR_17b35a0f_Tx: ComBitPosition=375, ComBitSize=1, ComSignalInitValue=0, ComSignalType=UINT8, ComHandleId=4471, ComSystemTemplateSystemSignalRef=DET_BELOW_RAIN_THOLD_216
            DET_PROB_1STAZHYPO_215_oRDR_DETECTION_213_216_oPCAN_RADAR_bd6622fc_Tx: ComBitPosition=327, ComBitSize=1, ComSignalInitValue=0, ComSignalType=BOOLEAN, ComHandleId=4513, ComSystemTemplateSystemSignalRef=DET_PROB_1STAZHYPO_215
            DET_PROB_1STAZHYPO_216_oRDR_DETECTION_213_216_oPCAN_RADAR_d9865902_Tx: ComBitPosition=439, ComBitSize=1, ComSignalInitValue=0, ComSignalType=BOOLEAN, ComHandleId=4514, ComSystemTemplateSystemSignalRef=DET_PROB_1STAZHYPO_216
            DET_MTD_215_oRDR_DETECTION_213_216_oPCAN_RADAR_2ed2ca31_Tx: ComBitPosition=271, ComBitSize=1, ComSignalInitValue=0, ComSignalType=UINT8, ComHandleId=4509, ComSystemTemplateSystemSignalRef=DET_MTD_215
            DET_IDM_216_oRDR_DETECTION_213_216_oPCAN_RADAR_2c818314_Tx: ComBitPosition=399, ComBitSize=1, ComSignalInitValue=0, ComSignalType=UINT8, ComHandleId=4503, ComSystemTemplateSystemSignalRef=DET_IDM_216
            DET_MTD_214_oRDR_DETECTION_213_216_oPCAN_RADAR_bba21ea4_Tx: ComBitPosition=159, ComBitSize=1, ComSignalInitValue=0, ComSignalType=UINT8, ComHandleId=4508, ComSystemTemplateSystemSignalRef=DET_MTD_214
        SG_Detections_141_144_oRDR_DETECTION_141_144_oPCAN_RADAR_f70bf7bd_Tx: ComTransferProperty=TRIGGERED, ComHandleId=37, ComSystemTemplateSignalGroupRef=SG_Detections_141_144
          83 x ComGroupSignal, all with ComSignalEndianness=LITTLE_ENDIAN, ComTransferProperty=PENDING, ComSignalAccess=ACCESS_NEEDED_BY_SWC_OR_COM:
            DET_RCS_143_oRDR_DETECTION_141_144_oPCAN_RADAR_48764418_Tx: ComBitPosition=352, ComBitSize=8, ComSignalInitValue=128, ComSignalType=UINT8, ComHandleId=3039, ComSystemTemplateSystemSignalRef=DET_RCS_143
            DET_RANGE_ERR_143_oRDR_DETECTION_141_144_oPCAN_RADAR_1db80b0e_Tx: ComBitPosition=264, ComBitSize=7, ComSignalInitValue=0, ComSignalType=UINT8, ComHandleId=3027, ComSystemTemplateSystemSignalRef=DET_RANGE_ERR_143
            DET_BI_STATIC_FLAG_142_oRDR_DETECTION_141_144_oPCAN_RADAR_699756cc_Tx: ComBitPosition=216, ComBitSize=1, ComSignalInitValue=0, ComSignalType=BOOLEAN, ComHandleId=2979, ComSystemTemplateSystemSignalRef=DET_BI_STATIC_FLAG_142
            DET_ELEVATION_144_oRDR_DETECTION_141_144_oPCAN_RADAR_27c83eb9_Tx: ComBitPosition=408, ComBitSize=8, ComSignalInitValue=0, ComSignalType=UINT8, ComHandleId=2993, ComSystemTemplateSystemSignalRef=DET_ELEVATION_144
            DET_RANGE_VELOCITY_141_oRDR_DETECTION_141_144_oPCAN_RADAR_3e66dc29_Tx: ComBitPosition=48, ComBitSize=15, ComSignalInitValue=16384, ComSignalType=UINT16, ComHandleId=3029, ComSystemTemplateSystemSignalRef=DET_RANGE_VELOCITY_141
            DET_BI_STATIC_FLAG_141_oRDR_DETECTION_141_144_oPCAN_RADAR_0d772d32_Tx: ComBitPosition=104, ComBitSize=1, ComSignalInitValue=0, ComSignalType=BOOLEAN, ComHandleId=2978, ComSystemTemplateSystemSignalRef=DET_BI_STATIC_FLAG_141
            DET_CONFD_AZIMUTH_144_oRDR_DETECTION_141_144_oPCAN_RADAR_f49deb7f_Tx: ComBitPosition=454, ComBitSize=2, ComSignalInitValue=0, ComSignalType=UINT8, ComHandleId=2985, ComSystemTemplateSystemSignalRef=DET_CONFD_AZIMUTH_144
            DET_RCS_141_oRDR_DETECTION_141_144_oPCAN_RADAR_b9e6eb73_Tx: ComBitPosition=128, ComBitSize=8, ComSignalInitValue=128, ComSignalType=UINT8, ComHandleId=3037, ComSystemTemplateSystemSignalRef=DET_RCS_141
            DET_RANGE_VELOCITY_144_oRDR_DETECTION_141_144_oPCAN_RADAR_9346502b_Tx: ComBitPosition=384, ComBitSize=15, ComSignalInitValue=16384, ComSignalType=UINT16, ComHandleId=3032, ComSystemTemplateSystemSignalRef=DET_RANGE_VELOCITY_144
            DET_AZIMUTH_ERR_143_oRDR_DETECTION_141_144_oPCAN_RADAR_0e7e5729_Tx: ComBitPosition=329, ComBitSize=7, ComSignalInitValue=0, ComSignalType=UINT8, ComHandleId=2972, ComSystemTemplateSystemSignalRef=DET_AZIMUTH_ERR_143
            DET_CONFD_ELEVATION_144_oRDR_DETECTION_141_144_oPCAN_RADAR_f608ea85_Tx: ComBitPosition=437, ComBitSize=2, ComSignalInitValue=0, ComSignalType=UINT8, ComHandleId=2989, ComSystemTemplateSystemSignalRef=DET_CONFD_ELEVATION_144
            DET_AZIMUTH_144_oRDR_DETECTION_141_144_oPCAN_RADAR_f67be1b5_Tx: ComBitPosition=424, ComBitSize=13, ComSignalInitValue=0, ComSignalType=UINT16, ComHandleId=2969, ComSystemTemplateSystemSignalRef=DET_AZIMUTH_144
            DET_ELEVATION_141_oRDR_DETECTION_141_144_oPCAN_RADAR_8ae8b2bb_Tx: ComBitPosition=72, ComBitSize=8, ComSignalInitValue=0, ComSignalType=UINT8, ComHandleId=2990, ComSystemTemplateSystemSignalRef=DET_ELEVATION_141
            DET_HVC_FLAG_144_oRDR_DETECTION_141_144_oPCAN_RADAR_931a90d3_Tx: ComBitPosition=422, ComBitSize=1, ComSignalInitValue=0, ComSignalType=BOOLEAN, ComHandleId=3005, ComSystemTemplateSystemSignalRef=DET_HVC_FLAG_144
            DET_AZIMUTH_141_oRDR_DETECTION_141_144_oPCAN_RADAR_5b5b6db7_Tx: ComBitPosition=88, ComBitSize=13, ComSignalInitValue=0, ComSignalType=UINT16, ComHandleId=2966, ComSystemTemplateSystemSignalRef=DET_AZIMUTH_141
            DET_SNR_142_oRDR_DETECTION_141_144_oPCAN_RADAR_00a8c48f_Tx: ComBitPosition=232, ComBitSize=8, ComSignalInitValue=0, ComSignalType=UINT8, ComHandleId=3042, ComSystemTemplateSystemSignalRef=DET_SNR_142
            DET_CONFD_ELEVATION_142_oRDR_DETECTION_141_144_oPCAN_RADAR_3fc81d79_Tx: ComBitPosition=213, ComBitSize=2, ComSignalInitValue=0, ComSignalType=UINT8, ComHandleId=2987, ComSystemTemplateSystemSignalRef=DET_CONFD_ELEVATION_142
            DET_ELEVATION_143_oRDR_DETECTION_141_144_oPCAN_RADAR_7b781dd0_Tx: ComBitPosition=296, ComBitSize=8, ComSignalInitValue=0, ComSignalType=UINT8, ComHandleId=2992, ComSystemTemplateSystemSignalRef=DET_ELEVATION_143
            DET_RANGE_VELOCITY_ERR_144_oRDR_DETECTION_141_144_oPCAN_RADAR_9cfdab99_Tx: ComBitPosition=400, ComBitSize=8, ComSignalInitValue=0, ComSignalType=UINT8, ComHandleId=3036, ComSystemTemplateSystemSignalRef=DET_RANGE_VELOCITY_ERR_144
            DET_RANGE_141_oRDR_DETECTION_141_144_oPCAN_RADAR_4bc01e0c_Tx: ComBitPosition=24, ComBitSize=15, ComSignalInitValue=0, ComSignalType=UINT16, ComHandleId=3021, ComSystemTemplateSystemSignalRef=DET_RANGE_141
            DET_HVC_FLAG_141_oRDR_DETECTION_141_144_oPCAN_RADAR_3e3a1cd1_Tx: ComBitPosition=86, ComBitSize=1, ComSignalInitValue=0, ComSignalType=BOOLEAN, ComHandleId=3002, ComSystemTemplateSystemSignalRef=DET_HVC_FLAG_141
            DET_AZIMUTH_ERR_142_oRDR_DETECTION_141_144_oPCAN_RADAR_9b0e83bc_Tx: ComBitPosition=217, ComBitSize=7, ComSignalInitValue=0, ComSignalType=UINT8, ComHandleId=2971, ComSystemTemplateSystemSignalRef=DET_AZIMUTH_ERR_142
            DET_RANGE_VELOCITY_ERR_143_oRDR_DETECTION_141_144_oPCAN_RADAR_c04d88f0_Tx: ComBitPosition=288, ComBitSize=8, ComSignalInitValue=0, ComSignalType=UINT8, ComHandleId=3035, ComSystemTemplateSystemSignalRef=DET_RANGE_VELOCITY_ERR_143
            DET_SNR_141_oRDR_DETECTION_141_144_oPCAN_RADAR_6448bf71_Tx: ComBitPosition=120, ComBitSize=8, ComSignalInitValue=0, ComSignalType=UINT8, ComHandleId=3041, ComSystemTemplateSystemSignalRef=DET_SNR_141
            DET_BI_STATIC_FLAG_144_oRDR_DETECTION_141_144_oPCAN_RADAR_a057a130_Tx: ComBitPosition=440, ComBitSize=1, ComSignalInitValue=0, ComSignalType=BOOLEAN, ComHandleId=2981, ComSystemTemplateSystemSignalRef=DET_BI_STATIC_FLAG_144
            DET_RANGE_143_oRDR_DETECTION_141_144_oPCAN_RADAR_ba50b167_Tx: ComBitPosition=248, ComBitSize=15, ComSignalInitValue=0, ComSignalType=UINT16, ComHandleId=3023, ComSystemTemplateSystemSignalRef=DET_RANGE_143
            DET_SUPER_RES_TARGET_141_oRDR_DETECTION_141_144_oPCAN_RADAR_55d19714_Tx: ComBitPosition=87, ComBitSize=1, ComSignalInitValue=0, ComSignalType=BOOLEAN, ComHandleId=3045, ComSystemTemplateSystemSignalRef=DET_SUPER_RES_TARGET_141
            DET_ELEVATION_ERR_144_oRDR_DETECTION_141_144_oPCAN_RADAR_a0f1a6cc_Tx: ComBitPosition=416, ComBitSize=6, ComSignalInitValue=0, ComSignalType=UINT8, ComHandleId=2997, ComSystemTemplateSystemSignalRef=DET_ELEVATION_ERR_144
            DET_SUPER_RES_TARGET_144_oRDR_DETECTION_141_144_oPCAN_RADAR_f8f11b16_Tx: ComBitPosition=423, ComBitSize=1, ComSignalInitValue=0, ComSignalType=BOOLEAN, ComHandleId=3048, ComSystemTemplateSystemSignalRef=DET_SUPER_RES_TARGET_144
            DET_SNR_144_oRDR_DETECTION_141_144_oPCAN_RADAR_c9683373_Tx: ComBitPosition=456, ComBitSize=8, ComSignalInitValue=0, ComSignalType=UINT8, ComHandleId=3044, ComSystemTemplateSystemSignalRef=DET_SNR_144
            DET_EXISTENCE_PROB_141_oRDR_DETECTION_141_144_oPCAN_RADAR_df4e5fae_Tx: ComBitPosition=112, ComBitSize=6, ComSignalInitValue=0, ComSignalType=UINT8, ComHandleId=2998, ComSystemTemplateSystemSignalRef=DET_EXISTENCE_PROB_141
            DET_AZIMUTH_142_oRDR_DETECTION_141_144_oPCAN_RADAR_3fbb1649_Tx: ComBitPosition=200, ComBitSize=13, ComSignalInitValue=0, ComSignalType=UINT16, ComHandleId=2967, ComSystemTemplateSystemSignalRef=DET_AZIMUTH_142
            DET_AZIMUTH_143_oRDR_DETECTION_141_144_oPCAN_RADAR_aacbc2dc_Tx: ComBitPosition=312, ComBitSize=13, ComSignalInitValue=0, ComSignalType=UINT16, ComHandleId=2968, ComSystemTemplateSystemSignalRef=DET_AZIMUTH_143
            DET_AZIMUTH_ERR_144_oRDR_DETECTION_141_144_oPCAN_RADAR_52ce7440_Tx: ComBitPosition=441, ComBitSize=7, ComSignalInitValue=0, ComSignalType=UINT8, ComHandleId=2973, ComSystemTemplateSystemSignalRef=DET_AZIMUTH_ERR_144
            DET_EXISTENCE_PROB_144_oRDR_DETECTION_141_144_oPCAN_RADAR_726ed3ac_Tx: ComBitPosition=448, ComBitSize=6, ComSignalInitValue=0, ComSignalType=UINT8, ComHandleId=3001, ComSystemTemplateSystemSignalRef=DET_EXISTENCE_PROB_144
            DET_RANGE_VELOCITY_ERR_142_oRDR_DETECTION_141_144_oPCAN_RADAR_553d5c65_Tx: ComBitPosition=176, ComBitSize=8, ComSignalInitValue=0, ComSignalType=UINT8, ComHandleId=3034, ComSystemTemplateSystemSignalRef=DET_RANGE_VELOCITY_ERR_142
            DET_MH_CYCLE_COUNTER_141_144_oRDR_DETECTION_141_144_oPCAN_RADAR_f7f68481_Tx: ComBitPosition=16, ComBitSize=8, ComSignalInitValue=0, ComSignalType=UINT8, ComHandleId=3011, ComSystemTemplateSystemSignalRef=DET_MH_CYCLE_COUNTER_141_144
            DET_RANGE_ERR_142_oRDR_DETECTION_141_144_oPCAN_RADAR_88c8df9b_Tx: ComBitPosition=152, ComBitSize=7, ComSignalInitValue=0, ComSignalType=UINT8, ComHandleId=3026, ComSystemTemplateSystemSignalRef=DET_RANGE_ERR_142
            DET_RANGE_144_oRDR_DETECTION_141_144_oPCAN_RADAR_e6e0920e_Tx: ComBitPosition=360, ComBitSize=15, ComSignalInitValue=0, ComSignalType=UINT16, ComHandleId=3024, ComSystemTemplateSystemSignalRef=DET_RANGE_144
            DET_ELEVATION_ERR_142_oRDR_DETECTION_141_144_oPCAN_RADAR_69315130_Tx: ComBitPosition=192, ComBitSize=6, ComSignalInitValue=0, ComSignalType=UINT8, ComHandleId=2995, ComSystemTemplateSystemSignalRef=DET_ELEVATION_ERR_142
            DET_ELEVATION_ERR_143_oRDR_DETECTION_141_144_oPCAN_RADAR_fc4185a5_Tx: ComBitPosition=304, ComBitSize=6, ComSignalInitValue=0, ComSignalType=UINT8, ComHandleId=2996, ComSystemTemplateSystemSignalRef=DET_ELEVATION_ERR_143
            DET_SNR_143_oRDR_DETECTION_141_144_oPCAN_RADAR_95d8101a_Tx: ComBitPosition=344, ComBitSize=8, ComSignalInitValue=0, ComSignalType=UINT8, ComHandleId=3043, ComSystemTemplateSystemSignalRef=DET_SNR_143
            DET_BI_STATIC_FLAG_143_oRDR_DETECTION_141_144_oPCAN_RADAR_fce78259_Tx: ComBitPosition=328, ComBitSize=1, ComSignalInitValue=0, ComSignalType=BOOLEAN, ComHandleId=2980, ComSystemTemplateSystemSignalRef=DET_BI_STATIC_FLAG_143
            DET_RANGE_142_oRDR_DETECTION_141_144_oPCAN_RADAR_2f2065f2_Tx: ComBitPosition=136, ComBitSize=15, ComSignalInitValue=0, ComSignalType=UINT16, ComHandleId=3022, ComSystemTemplateSystemSignalRef=DET_RANGE_142
            DET_RCS_142_oRDR_DETECTION_141_144_oPCAN_RADAR_dd06908d_Tx: ComBitPosition=240, ComBitSize=8, ComSignalInitValue=128, ComSignalType=UINT8, ComHandleId=3038, ComSystemTemplateSystemSignalRef=DET_RCS_142
            DET_CONFD_ELEVATION_143_oRDR_DETECTION_141_144_oPCAN_RADAR_aab8c9ec_Tx: ComBitPosition=325, ComBitSize=2, ComSignalInitValue=0, ComSignalType=UINT8, ComHandleId=2988, ComSystemTemplateSystemSignalRef=DET_CONFD_ELEVATION_143
            DET_MH_SCAN_INDEX_4LSB_141_144_oRDR_DETECTION_141_144_oPCAN_RADAR_3bdca10d_Tx: ComBitPosition=476, ComBitSize=4, ComSignalInitValue=0, ComSignalType=UINT8, ComHandleId=3012, ComSystemTemplateSystemSignalRef=DET_MH_SCAN_INDEX_4LSB_141_144
            DET_RANGE_ERR_144_oRDR_DETECTION_141_144_oPCAN_RADAR_41082867_Tx: ComBitPosition=376, ComBitSize=7, ComSignalInitValue=0, ComSignalType=UINT8, ComHandleId=3028, ComSystemTemplateSystemSignalRef=DET_RANGE_ERR_144
            DET_RANGE_ERR_141_oRDR_DETECTION_141_144_oPCAN_RADAR_ec28a465_Tx: ComBitPosition=40, ComBitSize=7, ComSignalInitValue=0, ComSignalType=UINT8, ComHandleId=3025, ComSystemTemplateSystemSignalRef=DET_RANGE_ERR_141
            DET_ELEVATION_ERR_141_oRDR_DETECTION_141_144_oPCAN_RADAR_0dd12ace_Tx: ComBitPosition=80, ComBitSize=6, ComSignalInitValue=0, ComSignalType=UINT8, ComHandleId=2994, ComSystemTemplateSystemSignalRef=DET_ELEVATION_ERR_141
            DET_EXISTENCE_PROB_143_oRDR_DETECTION_141_144_oPCAN_RADAR_2edef0c5_Tx: ComBitPosition=336, ComBitSize=6, ComSignalInitValue=0, ComSignalType=UINT8, ComHandleId=3000, ComSystemTemplateSystemSignalRef=DET_EXISTENCE_PROB_143
            DET_CONFD_AZIMUTH_141_oRDR_DETECTION_141_144_oPCAN_RADAR_59bd677d_Tx: ComBitPosition=118, ComBitSize=2, ComSignalInitValue=0, ComSignalType=UINT8, ComHandleId=2982, ComSystemTemplateSystemSignalRef=DET_CONFD_AZIMUTH_141
            DET_SUPER_RES_TARGET_142_oRDR_DETECTION_141_144_oPCAN_RADAR_3131ecea_Tx: ComBitPosition=199, ComBitSize=1, ComSignalInitValue=0, ComSignalType=BOOLEAN, ComHandleId=3046, ComSystemTemplateSystemSignalRef=DET_SUPER_RES_TARGET_142
            DET_HVC_FLAG_143_oRDR_DETECTION_141_144_oPCAN_RADAR_cfaab3ba_Tx: ComBitPosition=310, ComBitSize=1, ComSignalInitValue=0, ComSignalType=BOOLEAN, ComHandleId=3004, ComSystemTemplateSystemSignalRef=DET_HVC_FLAG_143
            DET_RCS_144_oRDR_DETECTION_141_144_oPCAN_RADAR_14c66771_Tx: ComBitPosition=464, ComBitSize=8, ComSignalInitValue=128, ComSignalType=UINT8, ComHandleId=3040, ComSystemTemplateSystemSignalRef=DET_RCS_144
            DET_ELEVATION_142_oRDR_DETECTION_141_144_oPCAN_RADAR_ee08c945_Tx: ComBitPosition=184, ComBitSize=8, ComSignalInitValue=0, ComSignalType=UINT8, ComHandleId=2991, ComSystemTemplateSystemSignalRef=DET_ELEVATION_142
            DET_RANGE_VELOCITY_143_oRDR_DETECTION_141_144_oPCAN_RADAR_cff67342_Tx: ComBitPosition=272, ComBitSize=15, ComSignalInitValue=16384, ComSignalType=UINT16, ComHandleId=3031, ComSystemTemplateSystemSignalRef=DET_RANGE_VELOCITY_143
            DET_MH_CRC16_141_144_oRDR_DETECTION_141_144_oPCAN_RADAR_738325b6_Tx: ComBitPosition=0, ComBitSize=16, ComSignalInitValue=0, ComSignalType=UINT16, ComHandleId=3010, ComSystemTemplateSystemSignalRef=DET_MH_CRC16_141_144
            DET_CONFD_ELEVATION_141_oRDR_DETECTION_141_144_oPCAN_RADAR_5b286687_Tx: ComBitPosition=101, ComBitSize=2, ComSignalInitValue=0, ComSignalType=UINT8, ComHandleId=2986, ComSystemTemplateSystemSignalRef=DET_CONFD_ELEVATION_141
            DET_RANGE_VELOCITY_ERR_141_oRDR_DETECTION_141_144_oPCAN_RADAR_31dd279b_Tx: ComBitPosition=64, ComBitSize=8, ComSignalInitValue=0, ComSignalType=UINT8, ComHandleId=3033, ComSystemTemplateSystemSignalRef=DET_RANGE_VELOCITY_ERR_141
            DET_CONFD_AZIMUTH_143_oRDR_DETECTION_141_144_oPCAN_RADAR_a82dc816_Tx: ComBitPosition=342, ComBitSize=2, ComSignalInitValue=0, ComSignalType=UINT8, ComHandleId=2984, ComSystemTemplateSystemSignalRef=DET_CONFD_AZIMUTH_143
            DET_AZIMUTH_ERR_141_oRDR_DETECTION_141_144_oPCAN_RADAR_ffeef842_Tx: ComBitPosition=105, ComBitSize=7, ComSignalInitValue=0, ComSignalType=UINT8, ComHandleId=2970, ComSystemTemplateSystemSignalRef=DET_AZIMUTH_ERR_141
            DET_EXISTENCE_PROB_142_oRDR_DETECTION_141_144_oPCAN_RADAR_bbae2450_Tx: ComBitPosition=224, ComBitSize=6, ComSignalInitValue=0, ComSignalType=UINT8, ComHandleId=2999, ComSystemTemplateSystemSignalRef=DET_EXISTENCE_PROB_142
            DET_SUPER_RES_TARGET_143_oRDR_DETECTION_141_144_oPCAN_RADAR_a441387f_Tx: ComBitPosition=311, ComBitSize=1, ComSignalInitValue=0, ComSignalType=BOOLEAN, ComHandleId=3047, ComSystemTemplateSystemSignalRef=DET_SUPER_RES_TARGET_143
            DET_RANGE_VELOCITY_142_oRDR_DETECTION_141_144_oPCAN_RADAR_5a86a7d7_Tx: ComBitPosition=160, ComBitSize=15, ComSignalInitValue=16384, ComSignalType=UINT16, ComHandleId=3030, ComSystemTemplateSystemSignalRef=DET_RANGE_VELOCITY_142
            DET_CONFD_AZIMUTH_142_oRDR_DETECTION_141_144_oPCAN_RADAR_3d5d1c83_Tx: ComBitPosition=230, ComBitSize=2, ComSignalInitValue=0, ComSignalType=UINT8, ComHandleId=2983, ComSystemTemplateSystemSignalRef=DET_CONFD_AZIMUTH_142
            DET_HVC_FLAG_142_oRDR_DETECTION_141_144_oPCAN_RADAR_5ada672f_Tx: ComBitPosition=198, ComBitSize=1, ComSignalInitValue=0, ComSignalType=BOOLEAN, ComHandleId=3003, ComSystemTemplateSystemSignalRef=DET_HVC_FLAG_142
            DET_IDM_143_oRDR_DETECTION_141_144_oPCAN_RADAR_44f88807_Tx: ComBitPosition=287, ComBitSize=1, ComSignalInitValue=0, ComSignalType=UINT8, ComHandleId=3008, ComSystemTemplateSystemSignalRef=DET_IDM_143
            DET_MTD_141_oRDR_DETECTION_141_144_oPCAN_RADAR_d3db15b7_Tx: ComBitPosition=47, ComBitSize=1, ComSignalInitValue=0, ComSignalType=UINT8, ComHandleId=3013, ComSystemTemplateSystemSignalRef=DET_MTD_141
            DET_BELOW_RAIN_THOLD_143_oRDR_DETECTION_141_144_oPCAN_RADAR_7fca511c_Tx: ComBitPosition=263, ComBitSize=1, ComSignalInitValue=0, ComSignalType=UINT8, ComHandleId=2976, ComSystemTemplateSystemSignalRef=DET_BELOW_RAIN_THOLD_143
            DET_BELOW_RAIN_THOLD_144_oRDR_DETECTION_141_144_oPCAN_RADAR_237a7275_Tx: ComBitPosition=375, ComBitSize=1, ComSignalInitValue=0, ComSignalType=UINT8, ComHandleId=2977, ComSystemTemplateSystemSignalRef=DET_BELOW_RAIN_THOLD_144
            DET_MTD_143_oRDR_DETECTION_141_144_oPCAN_RADAR_224bbadc_Tx: ComBitPosition=271, ComBitSize=1, ComSignalInitValue=0, ComSignalType=UINT8, ComHandleId=3015, ComSystemTemplateSystemSignalRef=DET_MTD_143
            DET_PROB_1STAZHYPO_144_oRDR_DETECTION_141_144_oPCAN_RADAR_ed4f7178_Tx: ComBitPosition=439, ComBitSize=1, ComSignalInitValue=0, ComSignalType=BOOLEAN, ComHandleId=3020, ComSystemTemplateSystemSignalRef=DET_PROB_1STAZHYPO_144
            DET_IDM_141_oRDR_DETECTION_141_144_oPCAN_RADAR_b568276c_Tx: ComBitPosition=63, ComBitSize=1, ComSignalInitValue=0, ComSignalType=UINT8, ComHandleId=3006, ComSystemTemplateSystemSignalRef=DET_IDM_141
            DET_PROB_1STAZHYPO_142_oRDR_DETECTION_141_144_oPCAN_RADAR_248f8684_Tx: ComBitPosition=215, ComBitSize=1, ComSignalInitValue=0, ComSignalType=BOOLEAN, ComHandleId=3018, ComSystemTemplateSystemSignalRef=DET_PROB_1STAZHYPO_142
            DET_IDM_144_oRDR_DETECTION_141_144_oPCAN_RADAR_1848ab6e_Tx: ComBitPosition=399, ComBitSize=1, ComSignalInitValue=0, ComSignalType=UINT8, ComHandleId=3009, ComSystemTemplateSystemSignalRef=DET_IDM_144
            DET_IDM_142_oRDR_DETECTION_141_144_oPCAN_RADAR_d1885c92_Tx: ComBitPosition=175, ComBitSize=1, ComSignalInitValue=0, ComSignalType=UINT8, ComHandleId=3007, ComSystemTemplateSystemSignalRef=DET_IDM_142
            DET_MTD_144_oRDR_DETECTION_141_144_oPCAN_RADAR_7efb99b5_Tx: ComBitPosition=383, ComBitSize=1, ComSignalInitValue=0, ComSignalType=UINT8, ComHandleId=3016, ComSystemTemplateSystemSignalRef=DET_MTD_144
            DET_BELOW_RAIN_THOLD_141_oRDR_DETECTION_141_144_oPCAN_RADAR_8e5afe77_Tx: ComBitPosition=39, ComBitSize=1, ComSignalInitValue=0, ComSignalType=UINT8, ComHandleId=2974, ComSystemTemplateSystemSignalRef=DET_BELOW_RAIN_THOLD_141
            DET_PROB_1STAZHYPO_143_oRDR_DETECTION_141_144_oPCAN_RADAR_b1ff5211_Tx: ComBitPosition=327, ComBitSize=1, ComSignalInitValue=0, ComSignalType=BOOLEAN, ComHandleId=3019, ComSystemTemplateSystemSignalRef=DET_PROB_1STAZHYPO_143
            DET_MTD_142_oRDR_DETECTION_141_144_oPCAN_RADAR_b73b6e49_Tx: ComBitPosition=159, ComBitSize=1, ComSignalInitValue=0, ComSignalType=UINT8, ComHandleId=3014, ComSystemTemplateSystemSignalRef=DET_MTD_142
            DET_PROB_1STAZHYPO_141_oRDR_DETECTION_141_144_oPCAN_RADAR_406ffd7a_Tx: ComBitPosition=103, ComBitSize=1, ComSignalInitValue=0, ComSignalType=BOOLEAN, ComHandleId=3017, ComSystemTemplateSystemSignalRef=DET_PROB_1STAZHYPO_141
            DET_BELOW_RAIN_THOLD_142_oRDR_DETECTION_141_144_oPCAN_RADAR_eaba8589_Tx: ComBitPosition=151, ComBitSize=1, ComSignalInitValue=0, ComSignalType=UINT8, ComHandleId=2975, ComSystemTemplateSystemSignalRef=DET_BELOW_RAIN_THOLD_142
        SG_Detections_373_376_oRDR_DETECTION_373_376_oPCAN_RADAR_9d9c6a96_Tx: ComTransferProperty=TRIGGERED, ComHandleId=95, ComSystemTemplateSignalGroupRef=SG_Detections_373_376
          83 x ComGroupSignal, all with ComSignalEndianness=LITTLE_ENDIAN, ComTransferProperty=PENDING, ComSignalAccess=ACCESS_NEEDED_BY_SWC_OR_COM:
            DET_RANGE_ERR_373_oRDR_DETECTION_373_376_oPCAN_RADAR_790ca3be_Tx: ComBitPosition=40, ComBitSize=7, ComSignalInitValue=0, ComSignalType=UINT8, ComHandleId=7839, ComSystemTemplateSystemSignalRef=DET_RANGE_ERR_373
            DET_RANGE_ERR_376_oRDR_DETECTION_373_376_oPCAN_RADAR_d42c2fbc_Tx: ComBitPosition=376, ComBitSize=7, ComSignalInitValue=0, ComSignalType=UINT8, ComHandleId=7842, ComSystemTemplateSystemSignalRef=DET_RANGE_ERR_376
            DET_AZIMUTH_376_oRDR_DETECTION_373_376_oPCAN_RADAR_635fe66e_Tx: ComBitPosition=424, ComBitSize=13, ComSignalInitValue=0, ComSignalType=UINT16, ComHandleId=7783, ComSystemTemplateSystemSignalRef=DET_AZIMUTH_376
            DET_HVC_FLAG_374_oRDR_DETECTION_373_376_oPCAN_RADAR_f7ae3863_Tx: ComBitPosition=198, ComBitSize=1, ComSignalInitValue=0, ComSignalType=BOOLEAN, ComHandleId=7817, ComSystemTemplateSystemSignalRef=DET_HVC_FLAG_374
            DET_CONFD_AZIMUTH_374_oRDR_DETECTION_373_376_oPCAN_RADAR_902943cf_Tx: ComBitPosition=230, ComBitSize=2, ComSignalInitValue=0, ComSignalType=UINT8, ComHandleId=7797, ComSystemTemplateSystemSignalRef=DET_CONFD_AZIMUTH_374
            DET_MH_CRC16_373_376_oRDR_DETECTION_373_376_oPCAN_RADAR_1914b89d_Tx: ComBitPosition=0, ComBitSize=16, ComSignalInitValue=0, ComSignalType=UINT16, ComHandleId=7824, ComSystemTemplateSystemSignalRef=DET_MH_CRC16_373_376
            DET_RCS_373_oRDR_DETECTION_373_376_oPCAN_RADAR_2cc2eca8_Tx: ComBitPosition=128, ComBitSize=8, ComSignalInitValue=128, ComSignalType=UINT8, ComHandleId=7851, ComSystemTemplateSystemSignalRef=DET_RCS_373
            DET_EXISTENCE_PROB_374_oRDR_DETECTION_373_376_oPCAN_RADAR_16da7b1c_Tx: ComBitPosition=224, ComBitSize=6, ComSignalInitValue=0, ComSignalType=UINT8, ComHandleId=7813, ComSystemTemplateSystemSignalRef=DET_EXISTENCE_PROB_374
            DET_RCS_375_oRDR_DETECTION_373_376_oPCAN_RADAR_e5021b54_Tx: ComBitPosition=352, ComBitSize=8, ComSignalInitValue=128, ComSignalType=UINT8, ComHandleId=7853, ComSystemTemplateSystemSignalRef=DET_RCS_375
            DET_BI_STATIC_FLAG_374_oRDR_DETECTION_373_376_oPCAN_RADAR_c4e30980_Tx: ComBitPosition=216, ComBitSize=1, ComSignalInitValue=0, ComSignalType=BOOLEAN, ComHandleId=7793, ComSystemTemplateSystemSignalRef=DET_BI_STATIC_FLAG_374
            DET_AZIMUTH_375_oRDR_DETECTION_373_376_oPCAN_RADAR_07bf9d90_Tx: ComBitPosition=312, ComBitSize=13, ComSignalInitValue=0, ComSignalType=UINT16, ComHandleId=7782, ComSystemTemplateSystemSignalRef=DET_AZIMUTH_375
            DET_RANGE_VELOCITY_ERR_373_oRDR_DETECTION_373_376_oPCAN_RADAR_a4f92040_Tx: ComBitPosition=64, ComBitSize=8, ComSignalInitValue=0, ComSignalType=UINT8, ComHandleId=7847, ComSystemTemplateSystemSignalRef=DET_RANGE_VELOCITY_ERR_373
            DET_RANGE_ERR_375_oRDR_DETECTION_373_376_oPCAN_RADAR_b0cc5442_Tx: ComBitPosition=264, ComBitSize=7, ComSignalInitValue=0, ComSignalType=UINT8, ComHandleId=7841, ComSystemTemplateSystemSignalRef=DET_RANGE_ERR_375
            DET_AZIMUTH_ERR_375_oRDR_DETECTION_373_376_oPCAN_RADAR_a30a0865_Tx: ComBitPosition=329, ComBitSize=7, ComSignalInitValue=0, ComSignalType=UINT8, ComHandleId=7786, ComSystemTemplateSystemSignalRef=DET_AZIMUTH_ERR_375
            DET_CONFD_AZIMUTH_373_oRDR_DETECTION_373_376_oPCAN_RADAR_cc9960a6_Tx: ComBitPosition=118, ComBitSize=2, ComSignalInitValue=0, ComSignalType=UINT8, ComHandleId=7796, ComSystemTemplateSystemSignalRef=DET_CONFD_AZIMUTH_373
            DET_RANGE_374_oRDR_DETECTION_373_376_oPCAN_RADAR_82543abe_Tx: ComBitPosition=136, ComBitSize=15, ComSignalInitValue=0, ComSignalType=UINT16, ComHandleId=7836, ComSystemTemplateSystemSignalRef=DET_RANGE_374
            DET_RANGE_375_oRDR_DETECTION_373_376_oPCAN_RADAR_1724ee2b_Tx: ComBitPosition=248, ComBitSize=15, ComSignalInitValue=0, ComSignalType=UINT16, ComHandleId=7837, ComSystemTemplateSystemSignalRef=DET_RANGE_375
            DET_SNR_376_oRDR_DETECTION_373_376_oPCAN_RADAR_5c4c34a8_Tx: ComBitPosition=456, ComBitSize=8, ComSignalInitValue=0, ComSignalType=UINT8, ComHandleId=7858, ComSystemTemplateSystemSignalRef=DET_SNR_376
            DET_EXISTENCE_PROB_375_oRDR_DETECTION_373_376_oPCAN_RADAR_83aaaf89_Tx: ComBitPosition=336, ComBitSize=6, ComSignalInitValue=0, ComSignalType=UINT8, ComHandleId=7814, ComSystemTemplateSystemSignalRef=DET_EXISTENCE_PROB_375
            DET_MH_SCAN_INDEX_4LSB_373_376_oRDR_DETECTION_373_376_oPCAN_RADAR_514b3c26_Tx: ComBitPosition=476, ComBitSize=4, ComSignalInitValue=0, ComSignalType=UINT8, ComHandleId=7826, ComSystemTemplateSystemSignalRef=DET_MH_SCAN_INDEX_4LSB_373_376
            DET_CONFD_ELEVATION_373_oRDR_DETECTION_373_376_oPCAN_RADAR_ce0c615c_Tx: ComBitPosition=101, ComBitSize=2, ComSignalInitValue=0, ComSignalType=UINT8, ComHandleId=7800, ComSystemTemplateSystemSignalRef=DET_CONFD_ELEVATION_373
            DET_SUPER_RES_TARGET_376_oRDR_DETECTION_373_376_oPCAN_RADAR_6dd51ccd_Tx: ComBitPosition=423, ComBitSize=1, ComSignalInitValue=0, ComSignalType=BOOLEAN, ComHandleId=7862, ComSystemTemplateSystemSignalRef=DET_SUPER_RES_TARGET_376
            DET_AZIMUTH_ERR_374_oRDR_DETECTION_373_376_oPCAN_RADAR_367adcf0_Tx: ComBitPosition=217, ComBitSize=7, ComSignalInitValue=0, ComSignalType=UINT8, ComHandleId=7785, ComSystemTemplateSystemSignalRef=DET_AZIMUTH_ERR_374
            DET_BI_STATIC_FLAG_373_oRDR_DETECTION_373_376_oPCAN_RADAR_98532ae9_Tx: ComBitPosition=104, ComBitSize=1, ComSignalInitValue=0, ComSignalType=BOOLEAN, ComHandleId=7792, ComSystemTemplateSystemSignalRef=DET_BI_STATIC_FLAG_373
            DET_ELEVATION_ERR_376_oRDR_DETECTION_373_376_oPCAN_RADAR_35d5a117_Tx: ComBitPosition=416, ComBitSize=6, ComSignalInitValue=0, ComSignalType=UINT8, ComHandleId=7811, ComSystemTemplateSystemSignalRef=DET_ELEVATION_ERR_376
            DET_ELEVATION_373_oRDR_DETECTION_373_376_oPCAN_RADAR_1fccb560_Tx: ComBitPosition=72, ComBitSize=8, ComSignalInitValue=0, ComSignalType=UINT8, ComHandleId=7804, ComSystemTemplateSystemSignalRef=DET_ELEVATION_373
            DET_RANGE_VELOCITY_ERR_376_oRDR_DETECTION_373_376_oPCAN_RADAR_09d9ac42_Tx: ComBitPosition=400, ComBitSize=8, ComSignalInitValue=0, ComSignalType=UINT8, ComHandleId=7850, ComSystemTemplateSystemSignalRef=DET_RANGE_VELOCITY_ERR_376
            DET_CONFD_ELEVATION_374_oRDR_DETECTION_373_376_oPCAN_RADAR_92bc4235_Tx: ComBitPosition=213, ComBitSize=2, ComSignalInitValue=0, ComSignalType=UINT8, ComHandleId=7801, ComSystemTemplateSystemSignalRef=DET_CONFD_ELEVATION_374
            DET_RANGE_VELOCITY_ERR_375_oRDR_DETECTION_373_376_oPCAN_RADAR_6d39d7bc_Tx: ComBitPosition=288, ComBitSize=8, ComSignalInitValue=0, ComSignalType=UINT8, ComHandleId=7849, ComSystemTemplateSystemSignalRef=DET_RANGE_VELOCITY_ERR_375
            DET_SUPER_RES_TARGET_375_oRDR_DETECTION_373_376_oPCAN_RADAR_09356733_Tx: ComBitPosition=311, ComBitSize=1, ComSignalInitValue=0, ComSignalType=BOOLEAN, ComHandleId=7861, ComSystemTemplateSystemSignalRef=DET_SUPER_RES_TARGET_375
            DET_RANGE_VELOCITY_ERR_374_oRDR_DETECTION_373_376_oPCAN_RADAR_f8490329_Tx: ComBitPosition=176, ComBitSize=8, ComSignalInitValue=0, ComSignalType=UINT8, ComHandleId=7848, ComSystemTemplateSystemSignalRef=DET_RANGE_VELOCITY_ERR_374
            DET_RCS_376_oRDR_DETECTION_373_376_oPCAN_RADAR_81e260aa_Tx: ComBitPosition=464, ComBitSize=8, ComSignalInitValue=128, ComSignalType=UINT8, ComHandleId=7854, ComSystemTemplateSystemSignalRef=DET_RCS_376
            DET_HVC_FLAG_375_oRDR_DETECTION_373_376_oPCAN_RADAR_62deecf6_Tx: ComBitPosition=310, ComBitSize=1, ComSignalInitValue=0, ComSignalType=BOOLEAN, ComHandleId=7818, ComSystemTemplateSystemSignalRef=DET_HVC_FLAG_375
            DET_ELEVATION_375_oRDR_DETECTION_373_376_oPCAN_RADAR_d60c429c_Tx: ComBitPosition=296, ComBitSize=8, ComSignalInitValue=0, ComSignalType=UINT8, ComHandleId=7806, ComSystemTemplateSystemSignalRef=DET_ELEVATION_375
            DET_AZIMUTH_374_oRDR_DETECTION_373_376_oPCAN_RADAR_92cf4905_Tx: ComBitPosition=200, ComBitSize=13, ComSignalInitValue=0, ComSignalType=UINT16, ComHandleId=7781, ComSystemTemplateSystemSignalRef=DET_AZIMUTH_374
            DET_CONFD_ELEVATION_375_oRDR_DETECTION_373_376_oPCAN_RADAR_07cc96a0_Tx: ComBitPosition=325, ComBitSize=2, ComSignalInitValue=0, ComSignalType=UINT8, ComHandleId=7802, ComSystemTemplateSystemSignalRef=DET_CONFD_ELEVATION_375
            DET_HVC_FLAG_376_oRDR_DETECTION_373_376_oPCAN_RADAR_063e9708_Tx: ComBitPosition=422, ComBitSize=1, ComSignalInitValue=0, ComSignalType=BOOLEAN, ComHandleId=7819, ComSystemTemplateSystemSignalRef=DET_HVC_FLAG_376
            DET_RANGE_VELOCITY_373_oRDR_DETECTION_373_376_oPCAN_RADAR_ab42dbf2_Tx: ComBitPosition=48, ComBitSize=15, ComSignalInitValue=16384, ComSignalType=UINT16, ComHandleId=7843, ComSystemTemplateSystemSignalRef=DET_RANGE_VELOCITY_373
            DET_RANGE_VELOCITY_375_oRDR_DETECTION_373_376_oPCAN_RADAR_62822c0e_Tx: ComBitPosition=272, ComBitSize=15, ComSignalInitValue=16384, ComSignalType=UINT16, ComHandleId=7845, ComSystemTemplateSystemSignalRef=DET_RANGE_VELOCITY_375
            DET_ELEVATION_ERR_373_oRDR_DETECTION_373_376_oPCAN_RADAR_98f52d15_Tx: ComBitPosition=80, ComBitSize=6, ComSignalInitValue=0, ComSignalType=UINT8, ComHandleId=7808, ComSystemTemplateSystemSignalRef=DET_ELEVATION_ERR_373
            DET_AZIMUTH_ERR_373_oRDR_DETECTION_373_376_oPCAN_RADAR_6acaff99_Tx: ComBitPosition=105, ComBitSize=7, ComSignalInitValue=0, ComSignalType=UINT8, ComHandleId=7784, ComSystemTemplateSystemSignalRef=DET_AZIMUTH_ERR_373
            DET_EXISTENCE_PROB_376_oRDR_DETECTION_373_376_oPCAN_RADAR_e74ad477_Tx: ComBitPosition=448, ComBitSize=6, ComSignalInitValue=0, ComSignalType=UINT8, ComHandleId=7815, ComSystemTemplateSystemSignalRef=DET_EXISTENCE_PROB_376
            DET_CONFD_AZIMUTH_376_oRDR_DETECTION_373_376_oPCAN_RADAR_61b9eca4_Tx: ComBitPosition=454, ComBitSize=2, ComSignalInitValue=0, ComSignalType=UINT8, ComHandleId=7799, ComSystemTemplateSystemSignalRef=DET_CONFD_AZIMUTH_376
            DET_SNR_375_oRDR_DETECTION_373_376_oPCAN_RADAR_38ac4f56_Tx: ComBitPosition=344, ComBitSize=8, ComSignalInitValue=0, ComSignalType=UINT8, ComHandleId=7857, ComSystemTemplateSystemSignalRef=DET_SNR_375
            DET_RANGE_376_oRDR_DETECTION_373_376_oPCAN_RADAR_73c495d5_Tx: ComBitPosition=360, ComBitSize=15, ComSignalInitValue=0, ComSignalType=UINT16, ComHandleId=7838, ComSystemTemplateSystemSignalRef=DET_RANGE_376
            DET_RANGE_VELOCITY_376_oRDR_DETECTION_373_376_oPCAN_RADAR_066257f0_Tx: ComBitPosition=384, ComBitSize=15, ComSignalInitValue=16384, ComSignalType=UINT16, ComHandleId=7846, ComSystemTemplateSystemSignalRef=DET_RANGE_VELOCITY_376
            DET_CONFD_ELEVATION_376_oRDR_DETECTION_373_376_oPCAN_RADAR_632ced5e_Tx: ComBitPosition=437, ComBitSize=2, ComSignalInitValue=0, ComSignalType=UINT8, ComHandleId=7803, ComSystemTemplateSystemSignalRef=DET_CONFD_ELEVATION_376
            DET_ELEVATION_374_oRDR_DETECTION_373_376_oPCAN_RADAR_437c9609_Tx: ComBitPosition=184, ComBitSize=8, ComSignalInitValue=0, ComSignalType=UINT8, ComHandleId=7805, ComSystemTemplateSystemSignalRef=DET_ELEVATION_374
            DET_CONFD_AZIMUTH_375_oRDR_DETECTION_373_376_oPCAN_RADAR_0559975a_Tx: ComBitPosition=342, ComBitSize=2, ComSignalInitValue=0, ComSignalType=UINT8, ComHandleId=7798, ComSystemTemplateSystemSignalRef=DET_CONFD_AZIMUTH_375
            DET_BI_STATIC_FLAG_376_oRDR_DETECTION_373_376_oPCAN_RADAR_3573a6eb_Tx: ComBitPosition=440, ComBitSize=1, ComSignalInitValue=0, ComSignalType=BOOLEAN, ComHandleId=7795, ComSystemTemplateSystemSignalRef=DET_BI_STATIC_FLAG_376
            DET_RCS_374_oRDR_DETECTION_373_376_oPCAN_RADAR_7072cfc1_Tx: ComBitPosition=240, ComBitSize=8, ComSignalInitValue=128, ComSignalType=UINT8, ComHandleId=7852, ComSystemTemplateSystemSignalRef=DET_RCS_374
            DET_BI_STATIC_FLAG_375_oRDR_DETECTION_373_376_oPCAN_RADAR_5193dd15_Tx: ComBitPosition=328, ComBitSize=1, ComSignalInitValue=0, ComSignalType=BOOLEAN, ComHandleId=7794, ComSystemTemplateSystemSignalRef=DET_BI_STATIC_FLAG_375
            DET_SNR_374_oRDR_DETECTION_373_376_oPCAN_RADAR_addc9bc3_Tx: ComBitPosition=232, ComBitSize=8, ComSignalInitValue=0, ComSignalType=UINT8, ComHandleId=7856, ComSystemTemplateSystemSignalRef=DET_SNR_374
            DET_RANGE_VELOCITY_374_oRDR_DETECTION_373_376_oPCAN_RADAR_f7f2f89b_Tx: ComBitPosition=160, ComBitSize=15, ComSignalInitValue=16384, ComSignalType=UINT16, ComHandleId=7844, ComSystemTemplateSystemSignalRef=DET_RANGE_VELOCITY_374
            DET_ELEVATION_ERR_375_oRDR_DETECTION_373_376_oPCAN_RADAR_5135dae9_Tx: ComBitPosition=304, ComBitSize=6, ComSignalInitValue=0, ComSignalType=UINT8, ComHandleId=7810, ComSystemTemplateSystemSignalRef=DET_ELEVATION_ERR_375
            DET_HVC_FLAG_373_oRDR_DETECTION_373_376_oPCAN_RADAR_ab1e1b0a_Tx: ComBitPosition=86, ComBitSize=1, ComSignalInitValue=0, ComSignalType=BOOLEAN, ComHandleId=7816, ComSystemTemplateSystemSignalRef=DET_HVC_FLAG_373
            DET_AZIMUTH_373_oRDR_DETECTION_373_376_oPCAN_RADAR_ce7f6a6c_Tx: ComBitPosition=88, ComBitSize=13, ComSignalInitValue=0, ComSignalType=UINT16, ComHandleId=7780, ComSystemTemplateSystemSignalRef=DET_AZIMUTH_373
            DET_ELEVATION_376_oRDR_DETECTION_373_376_oPCAN_RADAR_b2ec3962_Tx: ComBitPosition=408, ComBitSize=8, ComSignalInitValue=0, ComSignalType=UINT8, ComHandleId=7807, ComSystemTemplateSystemSignalRef=DET_ELEVATION_376
            DET_RANGE_373_oRDR_DETECTION_373_376_oPCAN_RADAR_dee419d7_Tx: ComBitPosition=24, ComBitSize=15, ComSignalInitValue=0, ComSignalType=UINT16, ComHandleId=7835, ComSystemTemplateSystemSignalRef=DET_RANGE_373
            DET_ELEVATION_ERR_374_oRDR_DETECTION_373_376_oPCAN_RADAR_c4450e7c_Tx: ComBitPosition=192, ComBitSize=6, ComSignalInitValue=0, ComSignalType=UINT8, ComHandleId=7809, ComSystemTemplateSystemSignalRef=DET_ELEVATION_ERR_374
            DET_EXISTENCE_PROB_373_oRDR_DETECTION_373_376_oPCAN_RADAR_4a6a5875_Tx: ComBitPosition=112, ComBitSize=6, ComSignalInitValue=0, ComSignalType=UINT8, ComHandleId=7812, ComSystemTemplateSystemSignalRef=DET_EXISTENCE_PROB_373
            DET_SUPER_RES_TARGET_373_oRDR_DETECTION_373_376_oPCAN_RADAR_c0f590cf_Tx: ComBitPosition=87, ComBitSize=1, ComSignalInitValue=0, ComSignalType=BOOLEAN, ComHandleId=7859, ComSystemTemplateSystemSignalRef=DET_SUPER_RES_TARGET_373
            DET_SUPER_RES_TARGET_374_oRDR_DETECTION_373_376_oPCAN_RADAR_9c45b3a6_Tx: ComBitPosition=199, ComBitSize=1, ComSignalInitValue=0, ComSignalType=BOOLEAN, ComHandleId=7860, ComSystemTemplateSystemSignalRef=DET_SUPER_RES_TARGET_374
            DET_MH_CYCLE_COUNTER_373_376_oRDR_DETECTION_373_376_oPCAN_RADAR_9d6119aa_Tx: ComBitPosition=16, ComBitSize=8, ComSignalInitValue=0, ComSignalType=UINT8, ComHandleId=7825, ComSystemTemplateSystemSignalRef=DET_MH_CYCLE_COUNTER_373_376
            DET_SNR_373_oRDR_DETECTION_373_376_oPCAN_RADAR_f16cb8aa_Tx: ComBitPosition=120, ComBitSize=8, ComSignalInitValue=0, ComSignalType=UINT8, ComHandleId=7855, ComSystemTemplateSystemSignalRef=DET_SNR_373
            DET_AZIMUTH_ERR_376_oRDR_DETECTION_373_376_oPCAN_RADAR_c7ea739b_Tx: ComBitPosition=441, ComBitSize=7, ComSignalInitValue=0, ComSignalType=UINT8, ComHandleId=7787, ComSystemTemplateSystemSignalRef=DET_AZIMUTH_ERR_376
            DET_RANGE_ERR_374_oRDR_DETECTION_373_376_oPCAN_RADAR_25bc80d7_Tx: ComBitPosition=152, ComBitSize=7, ComSignalInitValue=0, ComSignalType=UINT8, ComHandleId=7840, ComSystemTemplateSystemSignalRef=DET_RANGE_ERR_374
            DET_BELOW_RAIN_THOLD_375_oRDR_DETECTION_373_376_oPCAN_RADAR_d2be0e50_Tx: ComBitPosition=263, ComBitSize=1, ComSignalInitValue=0, ComSignalType=UINT8, ComHandleId=7790, ComSystemTemplateSystemSignalRef=DET_BELOW_RAIN_THOLD_375
            DET_IDM_374_oRDR_DETECTION_373_376_oPCAN_RADAR_7cfc03de_Tx: ComBitPosition=175, ComBitSize=1, ComSignalInitValue=0, ComSignalType=UINT8, ComHandleId=7821, ComSystemTemplateSystemSignalRef=DET_IDM_374
            DET_BELOW_RAIN_THOLD_376_oRDR_DETECTION_373_376_oPCAN_RADAR_b65e75ae_Tx: ComBitPosition=375, ComBitSize=1, ComSignalInitValue=0, ComSignalType=UINT8, ComHandleId=7791, ComSystemTemplateSystemSignalRef=DET_BELOW_RAIN_THOLD_376
            DET_MTD_373_oRDR_DETECTION_373_376_oPCAN_RADAR_46ff126c_Tx: ComBitPosition=47, ComBitSize=1, ComSignalInitValue=0, ComSignalType=UINT8, ComHandleId=7827, ComSystemTemplateSystemSignalRef=DET_MTD_373
            DET_PROB_1STAZHYPO_376_oRDR_DETECTION_373_376_oPCAN_RADAR_786b76a3_Tx: ComBitPosition=439, ComBitSize=1, ComSignalInitValue=0, ComSignalType=BOOLEAN, ComHandleId=7834, ComSystemTemplateSystemSignalRef=DET_PROB_1STAZHYPO_376
            DET_PROB_1STAZHYPO_374_oRDR_DETECTION_373_376_oPCAN_RADAR_89fbd9c8_Tx: ComBitPosition=215, ComBitSize=1, ComSignalInitValue=0, ComSignalType=BOOLEAN, ComHandleId=7832, ComSystemTemplateSystemSignalRef=DET_PROB_1STAZHYPO_374
            DET_PROB_1STAZHYPO_375_oRDR_DETECTION_373_376_oPCAN_RADAR_1c8b0d5d_Tx: ComBitPosition=327, ComBitSize=1, ComSignalInitValue=0, ComSignalType=BOOLEAN, ComHandleId=7833, ComSystemTemplateSystemSignalRef=DET_PROB_1STAZHYPO_375
            DET_MTD_374_oRDR_DETECTION_373_376_oPCAN_RADAR_1a4f3105_Tx: ComBitPosition=159, ComBitSize=1, ComSignalInitValue=0, ComSignalType=UINT8, ComHandleId=7828, ComSystemTemplateSystemSignalRef=DET_MTD_374
            DET_BELOW_RAIN_THOLD_373_oRDR_DETECTION_373_376_oPCAN_RADAR_1b7ef9ac_Tx: ComBitPosition=39, ComBitSize=1, ComSignalInitValue=0, ComSignalType=UINT8, ComHandleId=7788, ComSystemTemplateSystemSignalRef=DET_BELOW_RAIN_THOLD_373
            DET_IDM_373_oRDR_DETECTION_373_376_oPCAN_RADAR_204c20b7_Tx: ComBitPosition=63, ComBitSize=1, ComSignalInitValue=0, ComSignalType=UINT8, ComHandleId=7820, ComSystemTemplateSystemSignalRef=DET_IDM_373
            DET_MTD_375_oRDR_DETECTION_373_376_oPCAN_RADAR_8f3fe590_Tx: ComBitPosition=271, ComBitSize=1, ComSignalInitValue=0, ComSignalType=UINT8, ComHandleId=7829, ComSystemTemplateSystemSignalRef=DET_MTD_375
            DET_BELOW_RAIN_THOLD_374_oRDR_DETECTION_373_376_oPCAN_RADAR_47cedac5_Tx: ComBitPosition=151, ComBitSize=1, ComSignalInitValue=0, ComSignalType=UINT8, ComHandleId=7789, ComSystemTemplateSystemSignalRef=DET_BELOW_RAIN_THOLD_374
            DET_IDM_376_oRDR_DETECTION_373_376_oPCAN_RADAR_8d6cacb5_Tx: ComBitPosition=399, ComBitSize=1, ComSignalInitValue=0, ComSignalType=UINT8, ComHandleId=7823, ComSystemTemplateSystemSignalRef=DET_IDM_376
            DET_MTD_376_oRDR_DETECTION_373_376_oPCAN_RADAR_ebdf9e6e_Tx: ComBitPosition=383, ComBitSize=1, ComSignalInitValue=0, ComSignalType=UINT8, ComHandleId=7830, ComSystemTemplateSystemSignalRef=DET_MTD_376
            DET_PROB_1STAZHYPO_373_oRDR_DETECTION_373_376_oPCAN_RADAR_d54bfaa1_Tx: ComBitPosition=103, ComBitSize=1, ComSignalInitValue=0, ComSignalType=BOOLEAN, ComHandleId=7831, ComSystemTemplateSystemSignalRef=DET_PROB_1STAZHYPO_373
            DET_IDM_375_oRDR_DETECTION_373_376_oPCAN_RADAR_e98cd74b_Tx: ComBitPosition=287, ComBitSize=1, ComSignalInitValue=0, ComSignalType=UINT8, ComHandleId=7822, ComSystemTemplateSystemSignalRef=DET_IDM_375
        SG_Detections_261_264_oRDR_DETECTION_261_264_oPCAN_RADAR_0586302b_Tx: ComTransferProperty=TRIGGERED, ComHandleId=67, ComSystemTemplateSignalGroupRef=SG_Detections_261_264
          83 x ComGroupSignal, all with ComSignalEndianness=LITTLE_ENDIAN, ComTransferProperty=PENDING, ComSignalAccess=ACCESS_NEEDED_BY_SWC_OR_COM:
            DET_CONFD_ELEVATION_263_oRDR_DETECTION_261_264_oPCAN_RADAR_6b50a20a_Tx: ComBitPosition=325, ComBitSize=2, ComSignalInitValue=0, ComSignalType=UINT8, ComHandleId=5478, ComSystemTemplateSystemSignalRef=DET_CONFD_ELEVATION_263
            DET_RANGE_ERR_261_oRDR_DETECTION_261_264_oPCAN_RADAR_2dc0cf83_Tx: ComBitPosition=40, ComBitSize=7, ComSignalInitValue=0, ComSignalType=UINT8, ComHandleId=5515, ComSystemTemplateSystemSignalRef=DET_RANGE_ERR_261
            DET_CONFD_AZIMUTH_264_oRDR_DETECTION_261_264_oPCAN_RADAR_35758099_Tx: ComBitPosition=454, ComBitSize=2, ComSignalInitValue=0, ComSignalType=UINT8, ComHandleId=5475, ComSystemTemplateSystemSignalRef=DET_CONFD_AZIMUTH_264
            DET_CONFD_AZIMUTH_262_oRDR_DETECTION_261_264_oPCAN_RADAR_fcb57765_Tx: ComBitPosition=230, ComBitSize=2, ComSignalInitValue=0, ComSignalType=UINT8, ComHandleId=5473, ComSystemTemplateSystemSignalRef=DET_CONFD_AZIMUTH_262
            DET_MH_CYCLE_COUNTER_261_264_oRDR_DETECTION_261_264_oPCAN_RADAR_057b4317_Tx: ComBitPosition=16, ComBitSize=8, ComSignalInitValue=0, ComSignalType=UINT8, ComHandleId=5501, ComSystemTemplateSystemSignalRef=DET_MH_CYCLE_COUNTER_261_264
            DET_EXISTENCE_PROB_263_oRDR_DETECTION_261_264_oPCAN_RADAR_ef369b23_Tx: ComBitPosition=336, ComBitSize=6, ComSignalInitValue=0, ComSignalType=UINT8, ComHandleId=5490, ComSystemTemplateSystemSignalRef=DET_EXISTENCE_PROB_263
            DET_ELEVATION_ERR_263_oRDR_DETECTION_261_264_oPCAN_RADAR_3da9ee43_Tx: ComBitPosition=304, ComBitSize=6, ComSignalInitValue=0, ComSignalType=UINT8, ComHandleId=5486, ComSystemTemplateSystemSignalRef=DET_ELEVATION_ERR_263
            DET_SNR_264_oRDR_DETECTION_261_264_oPCAN_RADAR_08805895_Tx: ComBitPosition=456, ComBitSize=8, ComSignalInitValue=0, ComSignalType=UINT8, ComHandleId=5534, ComSystemTemplateSystemSignalRef=DET_SNR_264
            DET_RANGE_ERR_264_oRDR_DETECTION_261_264_oPCAN_RADAR_80e04381_Tx: ComBitPosition=376, ComBitSize=7, ComSignalInitValue=0, ComSignalType=UINT8, ComHandleId=5518, ComSystemTemplateSystemSignalRef=DET_RANGE_ERR_264
            DET_BI_STATIC_FLAG_262_oRDR_DETECTION_261_264_oPCAN_RADAR_a87f3d2a_Tx: ComBitPosition=216, ComBitSize=1, ComSignalInitValue=0, ComSignalType=BOOLEAN, ComHandleId=5469, ComSystemTemplateSystemSignalRef=DET_BI_STATIC_FLAG_262
            DET_SUPER_RES_TARGET_264_oRDR_DETECTION_261_264_oPCAN_RADAR_391970f0_Tx: ComBitPosition=423, ComBitSize=1, ComSignalInitValue=0, ComSignalType=BOOLEAN, ComHandleId=5538, ComSystemTemplateSystemSignalRef=DET_SUPER_RES_TARGET_264
            DET_CONFD_AZIMUTH_263_oRDR_DETECTION_261_264_oPCAN_RADAR_69c5a3f0_Tx: ComBitPosition=342, ComBitSize=2, ComSignalInitValue=0, ComSignalType=UINT8, ComHandleId=5474, ComSystemTemplateSystemSignalRef=DET_CONFD_AZIMUTH_263
            DET_RANGE_VELOCITY_261_oRDR_DETECTION_261_264_oPCAN_RADAR_ff8eb7cf_Tx: ComBitPosition=48, ComBitSize=15, ComSignalInitValue=16384, ComSignalType=UINT16, ComHandleId=5519, ComSystemTemplateSystemSignalRef=DET_RANGE_VELOCITY_261
            DET_RANGE_VELOCITY_ERR_263_oRDR_DETECTION_261_264_oPCAN_RADAR_01a5e316_Tx: ComBitPosition=288, ComBitSize=8, ComSignalInitValue=0, ComSignalType=UINT8, ComHandleId=5525, ComSystemTemplateSystemSignalRef=DET_RANGE_VELOCITY_ERR_263
            DET_MH_SCAN_INDEX_4LSB_261_264_oRDR_DETECTION_261_264_oPCAN_RADAR_c951669b_Tx: ComBitPosition=476, ComBitSize=4, ComSignalInitValue=0, ComSignalType=UINT8, ComHandleId=5502, ComSystemTemplateSystemSignalRef=DET_MH_SCAN_INDEX_4LSB_261_264
            DET_AZIMUTH_264_oRDR_DETECTION_261_264_oPCAN_RADAR_37938a53_Tx: ComBitPosition=424, ComBitSize=13, ComSignalInitValue=0, ComSignalType=UINT16, ComHandleId=5459, ComSystemTemplateSystemSignalRef=DET_AZIMUTH_264
            DET_AZIMUTH_ERR_264_oRDR_DETECTION_261_264_oPCAN_RADAR_93261fa6_Tx: ComBitPosition=441, ComBitSize=7, ComSignalInitValue=0, ComSignalType=UINT8, ComHandleId=5463, ComSystemTemplateSystemSignalRef=DET_AZIMUTH_ERR_264
            DET_RCS_263_oRDR_DETECTION_261_264_oPCAN_RADAR_899e2ffe_Tx: ComBitPosition=352, ComBitSize=8, ComSignalInitValue=128, ComSignalType=UINT8, ComHandleId=5529, ComSystemTemplateSystemSignalRef=DET_RCS_263
            DET_BI_STATIC_FLAG_264_oRDR_DETECTION_261_264_oPCAN_RADAR_61bfcad6_Tx: ComBitPosition=440, ComBitSize=1, ComSignalInitValue=0, ComSignalType=BOOLEAN, ComHandleId=5471, ComSystemTemplateSystemSignalRef=DET_BI_STATIC_FLAG_264
            DET_HVC_FLAG_263_oRDR_DETECTION_261_264_oPCAN_RADAR_0e42d85c_Tx: ComBitPosition=310, ComBitSize=1, ComSignalInitValue=0, ComSignalType=BOOLEAN, ComHandleId=5494, ComSystemTemplateSystemSignalRef=DET_HVC_FLAG_263
            DET_BI_STATIC_FLAG_263_oRDR_DETECTION_261_264_oPCAN_RADAR_3d0fe9bf_Tx: ComBitPosition=328, ComBitSize=1, ComSignalInitValue=0, ComSignalType=BOOLEAN, ComHandleId=5470, ComSystemTemplateSystemSignalRef=DET_BI_STATIC_FLAG_263
            DET_RANGE_262_oRDR_DETECTION_261_264_oPCAN_RADAR_eec80e14_Tx: ComBitPosition=136, ComBitSize=15, ComSignalInitValue=0, ComSignalType=UINT16, ComHandleId=5512, ComSystemTemplateSystemSignalRef=DET_RANGE_262
            DET_RANGE_ERR_262_oRDR_DETECTION_261_264_oPCAN_RADAR_4920b47d_Tx: ComBitPosition=152, ComBitSize=7, ComSignalInitValue=0, ComSignalType=UINT8, ComHandleId=5516, ComSystemTemplateSystemSignalRef=DET_RANGE_ERR_262
            DET_ELEVATION_264_oRDR_DETECTION_261_264_oPCAN_RADAR_e620555f_Tx: ComBitPosition=408, ComBitSize=8, ComSignalInitValue=0, ComSignalType=UINT8, ComHandleId=5483, ComSystemTemplateSystemSignalRef=DET_ELEVATION_264
            DET_RANGE_261_oRDR_DETECTION_261_264_oPCAN_RADAR_8a2875ea_Tx: ComBitPosition=24, ComBitSize=15, ComSignalInitValue=0, ComSignalType=UINT16, ComHandleId=5511, ComSystemTemplateSystemSignalRef=DET_RANGE_261
            DET_EXISTENCE_PROB_264_oRDR_DETECTION_261_264_oPCAN_RADAR_b386b84a_Tx: ComBitPosition=448, ComBitSize=6, ComSignalInitValue=0, ComSignalType=UINT8, ComHandleId=5491, ComSystemTemplateSystemSignalRef=DET_EXISTENCE_PROB_264
            DET_RANGE_VELOCITY_263_oRDR_DETECTION_261_264_oPCAN_RADAR_0e1e18a4_Tx: ComBitPosition=272, ComBitSize=15, ComSignalInitValue=16384, ComSignalType=UINT16, ComHandleId=5521, ComSystemTemplateSystemSignalRef=DET_RANGE_VELOCITY_263
            DET_MH_CRC16_261_264_oRDR_DETECTION_261_264_oPCAN_RADAR_810ee220_Tx: ComBitPosition=0, ComBitSize=16, ComSignalInitValue=0, ComSignalType=UINT16, ComHandleId=5500, ComSystemTemplateSystemSignalRef=DET_MH_CRC16_261_264
            DET_RANGE_ERR_263_oRDR_DETECTION_261_264_oPCAN_RADAR_dc5060e8_Tx: ComBitPosition=264, ComBitSize=7, ComSignalInitValue=0, ComSignalType=UINT8, ComHandleId=5517, ComSystemTemplateSystemSignalRef=DET_RANGE_ERR_263
            DET_CONFD_ELEVATION_264_oRDR_DETECTION_261_264_oPCAN_RADAR_37e08163_Tx: ComBitPosition=437, ComBitSize=2, ComSignalInitValue=0, ComSignalType=UINT8, ComHandleId=5479, ComSystemTemplateSystemSignalRef=DET_CONFD_ELEVATION_264
            DET_ELEVATION_ERR_261_oRDR_DETECTION_261_264_oPCAN_RADAR_cc394128_Tx: ComBitPosition=80, ComBitSize=6, ComSignalInitValue=0, ComSignalType=UINT8, ComHandleId=5484, ComSystemTemplateSystemSignalRef=DET_ELEVATION_ERR_261
            DET_RANGE_VELOCITY_ERR_264_oRDR_DETECTION_261_264_oPCAN_RADAR_5d15c07f_Tx: ComBitPosition=400, ComBitSize=8, ComSignalInitValue=0, ComSignalType=UINT8, ComHandleId=5526, ComSystemTemplateSystemSignalRef=DET_RANGE_VELOCITY_ERR_264
            DET_RANGE_VELOCITY_ERR_262_oRDR_DETECTION_261_264_oPCAN_RADAR_94d53783_Tx: ComBitPosition=176, ComBitSize=8, ComSignalInitValue=0, ComSignalType=UINT8, ComHandleId=5524, ComSystemTemplateSystemSignalRef=DET_RANGE_VELOCITY_ERR_262
            DET_SNR_263_oRDR_DETECTION_261_264_oPCAN_RADAR_54307bfc_Tx: ComBitPosition=344, ComBitSize=8, ComSignalInitValue=0, ComSignalType=UINT8, ComHandleId=5533, ComSystemTemplateSystemSignalRef=DET_SNR_263
            DET_AZIMUTH_263_oRDR_DETECTION_261_264_oPCAN_RADAR_6b23a93a_Tx: ComBitPosition=312, ComBitSize=13, ComSignalInitValue=0, ComSignalType=UINT16, ComHandleId=5458, ComSystemTemplateSystemSignalRef=DET_AZIMUTH_263
            DET_ELEVATION_ERR_262_oRDR_DETECTION_261_264_oPCAN_RADAR_a8d93ad6_Tx: ComBitPosition=192, ComBitSize=6, ComSignalInitValue=0, ComSignalType=UINT8, ComHandleId=5485, ComSystemTemplateSystemSignalRef=DET_ELEVATION_ERR_262
            DET_AZIMUTH_261_oRDR_DETECTION_261_264_oPCAN_RADAR_9ab30651_Tx: ComBitPosition=88, ComBitSize=13, ComSignalInitValue=0, ComSignalType=UINT16, ComHandleId=5456, ComSystemTemplateSystemSignalRef=DET_AZIMUTH_261
            DET_HVC_FLAG_264_oRDR_DETECTION_261_264_oPCAN_RADAR_52f2fb35_Tx: ComBitPosition=422, ComBitSize=1, ComSignalInitValue=0, ComSignalType=BOOLEAN, ComHandleId=5495, ComSystemTemplateSystemSignalRef=DET_HVC_FLAG_264
            DET_ELEVATION_261_oRDR_DETECTION_261_264_oPCAN_RADAR_4b00d95d_Tx: ComBitPosition=72, ComBitSize=8, ComSignalInitValue=0, ComSignalType=UINT8, ComHandleId=5480, ComSystemTemplateSystemSignalRef=DET_ELEVATION_261
            DET_SUPER_RES_TARGET_262_oRDR_DETECTION_261_264_oPCAN_RADAR_f0d9870c_Tx: ComBitPosition=199, ComBitSize=1, ComSignalInitValue=0, ComSignalType=BOOLEAN, ComHandleId=5536, ComSystemTemplateSystemSignalRef=DET_SUPER_RES_TARGET_262
            DET_AZIMUTH_ERR_262_oRDR_DETECTION_261_264_oPCAN_RADAR_5ae6e85a_Tx: ComBitPosition=217, ComBitSize=7, ComSignalInitValue=0, ComSignalType=UINT8, ComHandleId=5461, ComSystemTemplateSystemSignalRef=DET_AZIMUTH_ERR_262
            DET_AZIMUTH_ERR_263_oRDR_DETECTION_261_264_oPCAN_RADAR_cf963ccf_Tx: ComBitPosition=329, ComBitSize=7, ComSignalInitValue=0, ComSignalType=UINT8, ComHandleId=5462, ComSystemTemplateSystemSignalRef=DET_AZIMUTH_ERR_263
            DET_EXISTENCE_PROB_261_oRDR_DETECTION_261_264_oPCAN_RADAR_1ea63448_Tx: ComBitPosition=112, ComBitSize=6, ComSignalInitValue=0, ComSignalType=UINT8, ComHandleId=5488, ComSystemTemplateSystemSignalRef=DET_EXISTENCE_PROB_261
            DET_RCS_261_oRDR_DETECTION_261_264_oPCAN_RADAR_780e8095_Tx: ComBitPosition=128, ComBitSize=8, ComSignalInitValue=128, ComSignalType=UINT8, ComHandleId=5527, ComSystemTemplateSystemSignalRef=DET_RCS_261
            DET_RANGE_264_oRDR_DETECTION_261_264_oPCAN_RADAR_2708f9e8_Tx: ComBitPosition=360, ComBitSize=15, ComSignalInitValue=0, ComSignalType=UINT16, ComHandleId=5514, ComSystemTemplateSystemSignalRef=DET_RANGE_264
            DET_ELEVATION_263_oRDR_DETECTION_261_264_oPCAN_RADAR_ba907636_Tx: ComBitPosition=296, ComBitSize=8, ComSignalInitValue=0, ComSignalType=UINT8, ComHandleId=5482, ComSystemTemplateSystemSignalRef=DET_ELEVATION_263
            DET_SNR_262_oRDR_DETECTION_261_264_oPCAN_RADAR_c140af69_Tx: ComBitPosition=232, ComBitSize=8, ComSignalInitValue=0, ComSignalType=UINT8, ComHandleId=5532, ComSystemTemplateSystemSignalRef=DET_SNR_262
            DET_HVC_FLAG_262_oRDR_DETECTION_261_264_oPCAN_RADAR_9b320cc9_Tx: ComBitPosition=198, ComBitSize=1, ComSignalInitValue=0, ComSignalType=BOOLEAN, ComHandleId=5493, ComSystemTemplateSystemSignalRef=DET_HVC_FLAG_262
            DET_ELEVATION_262_oRDR_DETECTION_261_264_oPCAN_RADAR_2fe0a2a3_Tx: ComBitPosition=184, ComBitSize=8, ComSignalInitValue=0, ComSignalType=UINT8, ComHandleId=5481, ComSystemTemplateSystemSignalRef=DET_ELEVATION_262
            DET_SUPER_RES_TARGET_263_oRDR_DETECTION_261_264_oPCAN_RADAR_65a95399_Tx: ComBitPosition=311, ComBitSize=1, ComSignalInitValue=0, ComSignalType=BOOLEAN, ComHandleId=5537, ComSystemTemplateSystemSignalRef=DET_SUPER_RES_TARGET_263
            DET_AZIMUTH_ERR_261_oRDR_DETECTION_261_264_oPCAN_RADAR_3e0693a4_Tx: ComBitPosition=105, ComBitSize=7, ComSignalInitValue=0, ComSignalType=UINT8, ComHandleId=5460, ComSystemTemplateSystemSignalRef=DET_AZIMUTH_ERR_261
            DET_RANGE_263_oRDR_DETECTION_261_264_oPCAN_RADAR_7bb8da81_Tx: ComBitPosition=248, ComBitSize=15, ComSignalInitValue=0, ComSignalType=UINT16, ComHandleId=5513, ComSystemTemplateSystemSignalRef=DET_RANGE_263
            DET_RCS_264_oRDR_DETECTION_261_264_oPCAN_RADAR_d52e0c97_Tx: ComBitPosition=464, ComBitSize=8, ComSignalInitValue=128, ComSignalType=UINT8, ComHandleId=5530, ComSystemTemplateSystemSignalRef=DET_RCS_264
            DET_HVC_FLAG_261_oRDR_DETECTION_261_264_oPCAN_RADAR_ffd27737_Tx: ComBitPosition=86, ComBitSize=1, ComSignalInitValue=0, ComSignalType=BOOLEAN, ComHandleId=5492, ComSystemTemplateSystemSignalRef=DET_HVC_FLAG_261
            DET_ELEVATION_ERR_264_oRDR_DETECTION_261_264_oPCAN_RADAR_6119cd2a_Tx: ComBitPosition=416, ComBitSize=6, ComSignalInitValue=0, ComSignalType=UINT8, ComHandleId=5487, ComSystemTemplateSystemSignalRef=DET_ELEVATION_ERR_264
            DET_SUPER_RES_TARGET_261_oRDR_DETECTION_261_264_oPCAN_RADAR_9439fcf2_Tx: ComBitPosition=87, ComBitSize=1, ComSignalInitValue=0, ComSignalType=BOOLEAN, ComHandleId=5535, ComSystemTemplateSystemSignalRef=DET_SUPER_RES_TARGET_261
            DET_RANGE_VELOCITY_262_oRDR_DETECTION_261_264_oPCAN_RADAR_9b6ecc31_Tx: ComBitPosition=160, ComBitSize=15, ComSignalInitValue=16384, ComSignalType=UINT16, ComHandleId=5520, ComSystemTemplateSystemSignalRef=DET_RANGE_VELOCITY_262
            DET_RANGE_VELOCITY_264_oRDR_DETECTION_261_264_oPCAN_RADAR_52ae3bcd_Tx: ComBitPosition=384, ComBitSize=15, ComSignalInitValue=16384, ComSignalType=UINT16, ComHandleId=5522, ComSystemTemplateSystemSignalRef=DET_RANGE_VELOCITY_264
            DET_RANGE_VELOCITY_ERR_261_oRDR_DETECTION_261_264_oPCAN_RADAR_f0354c7d_Tx: ComBitPosition=64, ComBitSize=8, ComSignalInitValue=0, ComSignalType=UINT8, ComHandleId=5523, ComSystemTemplateSystemSignalRef=DET_RANGE_VELOCITY_ERR_261
            DET_SNR_261_oRDR_DETECTION_261_264_oPCAN_RADAR_a5a0d497_Tx: ComBitPosition=120, ComBitSize=8, ComSignalInitValue=0, ComSignalType=UINT8, ComHandleId=5531, ComSystemTemplateSystemSignalRef=DET_SNR_261
            DET_CONFD_AZIMUTH_261_oRDR_DETECTION_261_264_oPCAN_RADAR_98550c9b_Tx: ComBitPosition=118, ComBitSize=2, ComSignalInitValue=0, ComSignalType=UINT8, ComHandleId=5472, ComSystemTemplateSystemSignalRef=DET_CONFD_AZIMUTH_261
            DET_RCS_262_oRDR_DETECTION_261_264_oPCAN_RADAR_1ceefb6b_Tx: ComBitPosition=240, ComBitSize=8, ComSignalInitValue=128, ComSignalType=UINT8, ComHandleId=5528, ComSystemTemplateSystemSignalRef=DET_RCS_262
            DET_AZIMUTH_262_oRDR_DETECTION_261_264_oPCAN_RADAR_fe537daf_Tx: ComBitPosition=200, ComBitSize=13, ComSignalInitValue=0, ComSignalType=UINT16, ComHandleId=5457, ComSystemTemplateSystemSignalRef=DET_AZIMUTH_262
            DET_BI_STATIC_FLAG_261_oRDR_DETECTION_261_264_oPCAN_RADAR_cc9f46d4_Tx: ComBitPosition=104, ComBitSize=1, ComSignalInitValue=0, ComSignalType=BOOLEAN, ComHandleId=5468, ComSystemTemplateSystemSignalRef=DET_BI_STATIC_FLAG_261
            DET_CONFD_ELEVATION_262_oRDR_DETECTION_261_264_oPCAN_RADAR_fe20769f_Tx: ComBitPosition=213, ComBitSize=2, ComSignalInitValue=0, ComSignalType=UINT8, ComHandleId=5477, ComSystemTemplateSystemSignalRef=DET_CONFD_ELEVATION_262
            DET_CONFD_ELEVATION_261_oRDR_DETECTION_261_264_oPCAN_RADAR_9ac00d61_Tx: ComBitPosition=101, ComBitSize=2, ComSignalInitValue=0, ComSignalType=UINT8, ComHandleId=5476, ComSystemTemplateSystemSignalRef=DET_CONFD_ELEVATION_261
            DET_EXISTENCE_PROB_262_oRDR_DETECTION_261_264_oPCAN_RADAR_7a464fb6_Tx: ComBitPosition=224, ComBitSize=6, ComSignalInitValue=0, ComSignalType=UINT8, ComHandleId=5489, ComSystemTemplateSystemSignalRef=DET_EXISTENCE_PROB_262
            DET_PROB_1STAZHYPO_262_oRDR_DETECTION_261_264_oPCAN_RADAR_e567ed62_Tx: ComBitPosition=215, ComBitSize=1, ComSignalInitValue=0, ComSignalType=BOOLEAN, ComHandleId=5508, ComSystemTemplateSystemSignalRef=DET_PROB_1STAZHYPO_262
            DET_PROB_1STAZHYPO_261_oRDR_DETECTION_261_264_oPCAN_RADAR_8187969c_Tx: ComBitPosition=103, ComBitSize=1, ComSignalInitValue=0, ComSignalType=BOOLEAN, ComHandleId=5507, ComSystemTemplateSystemSignalRef=DET_PROB_1STAZHYPO_261
            DET_MTD_262_oRDR_DETECTION_261_264_oPCAN_RADAR_76d305af_Tx: ComBitPosition=159, ComBitSize=1, ComSignalInitValue=0, ComSignalType=UINT8, ComHandleId=5504, ComSystemTemplateSystemSignalRef=DET_MTD_262
            DET_MTD_263_oRDR_DETECTION_261_264_oPCAN_RADAR_e3a3d13a_Tx: ComBitPosition=271, ComBitSize=1, ComSignalInitValue=0, ComSignalType=UINT8, ComHandleId=5505, ComSystemTemplateSystemSignalRef=DET_MTD_263
            DET_MTD_264_oRDR_DETECTION_261_264_oPCAN_RADAR_bf13f253_Tx: ComBitPosition=383, ComBitSize=1, ComSignalInitValue=0, ComSignalType=UINT8, ComHandleId=5506, ComSystemTemplateSystemSignalRef=DET_MTD_264
            DET_IDM_263_oRDR_DETECTION_261_264_oPCAN_RADAR_8510e3e1_Tx: ComBitPosition=287, ComBitSize=1, ComSignalInitValue=0, ComSignalType=UINT8, ComHandleId=5498, ComSystemTemplateSystemSignalRef=DET_IDM_263
            DET_BELOW_RAIN_THOLD_262_oRDR_DETECTION_261_264_oPCAN_RADAR_2b52ee6f_Tx: ComBitPosition=151, ComBitSize=1, ComSignalInitValue=0, ComSignalType=UINT8, ComHandleId=5465, ComSystemTemplateSystemSignalRef=DET_BELOW_RAIN_THOLD_262
            DET_BELOW_RAIN_THOLD_261_oRDR_DETECTION_261_264_oPCAN_RADAR_4fb29591_Tx: ComBitPosition=39, ComBitSize=1, ComSignalInitValue=0, ComSignalType=UINT8, ComHandleId=5464, ComSystemTemplateSystemSignalRef=DET_BELOW_RAIN_THOLD_261
            DET_IDM_264_oRDR_DETECTION_261_264_oPCAN_RADAR_d9a0c088_Tx: ComBitPosition=399, ComBitSize=1, ComSignalInitValue=0, ComSignalType=UINT8, ComHandleId=5499, ComSystemTemplateSystemSignalRef=DET_IDM_264
            DET_MTD_261_oRDR_DETECTION_261_264_oPCAN_RADAR_12337e51_Tx: ComBitPosition=47, ComBitSize=1, ComSignalInitValue=0, ComSignalType=UINT8, ComHandleId=5503, ComSystemTemplateSystemSignalRef=DET_MTD_261
            DET_IDM_261_oRDR_DETECTION_261_264_oPCAN_RADAR_74804c8a_Tx: ComBitPosition=63, ComBitSize=1, ComSignalInitValue=0, ComSignalType=UINT8, ComHandleId=5496, ComSystemTemplateSystemSignalRef=DET_IDM_261
            DET_PROB_1STAZHYPO_264_oRDR_DETECTION_261_264_oPCAN_RADAR_2ca71a9e_Tx: ComBitPosition=439, ComBitSize=1, ComSignalInitValue=0, ComSignalType=BOOLEAN, ComHandleId=5510, ComSystemTemplateSystemSignalRef=DET_PROB_1STAZHYPO_264
            DET_BELOW_RAIN_THOLD_263_oRDR_DETECTION_261_264_oPCAN_RADAR_be223afa_Tx: ComBitPosition=263, ComBitSize=1, ComSignalInitValue=0, ComSignalType=UINT8, ComHandleId=5466, ComSystemTemplateSystemSignalRef=DET_BELOW_RAIN_THOLD_263
            DET_BELOW_RAIN_THOLD_264_oRDR_DETECTION_261_264_oPCAN_RADAR_e2921993_Tx: ComBitPosition=375, ComBitSize=1, ComSignalInitValue=0, ComSignalType=UINT8, ComHandleId=5467, ComSystemTemplateSystemSignalRef=DET_BELOW_RAIN_THOLD_264
            DET_IDM_262_oRDR_DETECTION_261_264_oPCAN_RADAR_10603774_Tx: ComBitPosition=175, ComBitSize=1, ComSignalInitValue=0, ComSignalType=UINT8, ComHandleId=5497, ComSystemTemplateSystemSignalRef=DET_IDM_262
            DET_PROB_1STAZHYPO_263_oRDR_DETECTION_261_264_oPCAN_RADAR_701739f7_Tx: ComBitPosition=327, ComBitSize=1, ComSignalInitValue=0, ComSignalType=BOOLEAN, ComHandleId=5509, ComSystemTemplateSystemSignalRef=DET_PROB_1STAZHYPO_263
        SG_Detections_281_284_oRDR_DETECTION_281_284_oPCAN_RADAR_8fce5195_Tx: ComTransferProperty=TRIGGERED, ComHandleId=72, ComSystemTemplateSignalGroupRef=SG_Detections_281_284
          83 x ComGroupSignal, all with ComSignalEndianness=LITTLE_ENDIAN, ComTransferProperty=PENDING, ComSignalAccess=ACCESS_NEEDED_BY_SWC_OR_COM:
            DET_ELEVATION_283_oRDR_DETECTION_281_284_oPCAN_RADAR_0042e281_Tx: ComBitPosition=296, ComBitSize=8, ComSignalInitValue=0, ComSignalType=UINT8, ComHandleId=5897, ComSystemTemplateSystemSignalRef=DET_ELEVATION_283
            DET_SNR_281_oRDR_DETECTION_281_284_oPCAN_RADAR_1f724020_Tx: ComBitPosition=120, ComBitSize=8, ComSignalInitValue=0, ComSignalType=UINT8, ComHandleId=5946, ComSystemTemplateSystemSignalRef=DET_SNR_281
            DET_ELEVATION_282_oRDR_DETECTION_281_284_oPCAN_RADAR_95323614_Tx: ComBitPosition=184, ComBitSize=8, ComSignalInitValue=0, ComSignalType=UINT8, ComHandleId=5896, ComSystemTemplateSystemSignalRef=DET_ELEVATION_282
            DET_CONFD_AZIMUTH_283_oRDR_DETECTION_281_284_oPCAN_RADAR_d3173747_Tx: ComBitPosition=342, ComBitSize=2, ComSignalInitValue=0, ComSignalType=UINT8, ComHandleId=5889, ComSystemTemplateSystemSignalRef=DET_CONFD_AZIMUTH_283
            DET_AZIMUTH_283_oRDR_DETECTION_281_284_oPCAN_RADAR_d1f13d8d_Tx: ComBitPosition=312, ComBitSize=13, ComSignalInitValue=0, ComSignalType=UINT16, ComHandleId=5873, ComSystemTemplateSystemSignalRef=DET_AZIMUTH_283
            DET_MH_CRC16_281_284_oRDR_DETECTION_281_284_oPCAN_RADAR_0b46839e_Tx: ComBitPosition=0, ComBitSize=16, ComSignalInitValue=0, ComSignalType=UINT16, ComHandleId=5915, ComSystemTemplateSystemSignalRef=DET_MH_CRC16_281_284
            DET_HVC_FLAG_282_oRDR_DETECTION_281_284_oPCAN_RADAR_21e0987e_Tx: ComBitPosition=198, ComBitSize=1, ComSignalInitValue=0, ComSignalType=BOOLEAN, ComHandleId=5908, ComSystemTemplateSystemSignalRef=DET_HVC_FLAG_282
            DET_AZIMUTH_ERR_284_oRDR_DETECTION_281_284_oPCAN_RADAR_29f48b11_Tx: ComBitPosition=441, ComBitSize=7, ComSignalInitValue=0, ComSignalType=UINT8, ComHandleId=5878, ComSystemTemplateSystemSignalRef=DET_AZIMUTH_ERR_284
            DET_AZIMUTH_ERR_283_oRDR_DETECTION_281_284_oPCAN_RADAR_7544a878_Tx: ComBitPosition=329, ComBitSize=7, ComSignalInitValue=0, ComSignalType=UINT8, ComHandleId=5877, ComSystemTemplateSystemSignalRef=DET_AZIMUTH_ERR_283
            DET_CONFD_ELEVATION_282_oRDR_DETECTION_281_284_oPCAN_RADAR_44f2e228_Tx: ComBitPosition=213, ComBitSize=2, ComSignalInitValue=0, ComSignalType=UINT8, ComHandleId=5892, ComSystemTemplateSystemSignalRef=DET_CONFD_ELEVATION_282
            DET_RANGE_VELOCITY_281_oRDR_DETECTION_281_284_oPCAN_RADAR_455c2378_Tx: ComBitPosition=48, ComBitSize=15, ComSignalInitValue=16384, ComSignalType=UINT16, ComHandleId=5934, ComSystemTemplateSystemSignalRef=DET_RANGE_VELOCITY_281
            DET_RANGE_283_oRDR_DETECTION_281_284_oPCAN_RADAR_c16a4e36_Tx: ComBitPosition=248, ComBitSize=15, ComSignalInitValue=0, ComSignalType=UINT16, ComHandleId=5928, ComSystemTemplateSystemSignalRef=DET_RANGE_283
            DET_BI_STATIC_FLAG_283_oRDR_DETECTION_281_284_oPCAN_RADAR_87dd7d08_Tx: ComBitPosition=328, ComBitSize=1, ComSignalInitValue=0, ComSignalType=BOOLEAN, ComHandleId=5885, ComSystemTemplateSystemSignalRef=DET_BI_STATIC_FLAG_283
            DET_CONFD_AZIMUTH_282_oRDR_DETECTION_281_284_oPCAN_RADAR_4667e3d2_Tx: ComBitPosition=230, ComBitSize=2, ComSignalInitValue=0, ComSignalType=UINT8, ComHandleId=5888, ComSystemTemplateSystemSignalRef=DET_CONFD_AZIMUTH_282
            DET_HVC_FLAG_283_oRDR_DETECTION_281_284_oPCAN_RADAR_b4904ceb_Tx: ComBitPosition=310, ComBitSize=1, ComSignalInitValue=0, ComSignalType=BOOLEAN, ComHandleId=5909, ComSystemTemplateSystemSignalRef=DET_HVC_FLAG_283
            DET_SNR_284_oRDR_DETECTION_281_284_oPCAN_RADAR_b252cc22_Tx: ComBitPosition=456, ComBitSize=8, ComSignalInitValue=0, ComSignalType=UINT8, ComHandleId=5949, ComSystemTemplateSystemSignalRef=DET_SNR_284
            DET_RCS_283_oRDR_DETECTION_281_284_oPCAN_RADAR_334cbb49_Tx: ComBitPosition=352, ComBitSize=8, ComSignalInitValue=128, ComSignalType=UINT8, ComHandleId=5944, ComSystemTemplateSystemSignalRef=DET_RCS_283
            DET_ELEVATION_284_oRDR_DETECTION_281_284_oPCAN_RADAR_5cf2c1e8_Tx: ComBitPosition=408, ComBitSize=8, ComSignalInitValue=0, ComSignalType=UINT8, ComHandleId=5898, ComSystemTemplateSystemSignalRef=DET_ELEVATION_284
            DET_ELEVATION_ERR_282_oRDR_DETECTION_281_284_oPCAN_RADAR_120bae61_Tx: ComBitPosition=192, ComBitSize=6, ComSignalInitValue=0, ComSignalType=UINT8, ComHandleId=5900, ComSystemTemplateSystemSignalRef=DET_ELEVATION_ERR_282
            DET_RANGE_VELOCITY_ERR_284_oRDR_DETECTION_281_284_oPCAN_RADAR_e7c754c8_Tx: ComBitPosition=400, ComBitSize=8, ComSignalInitValue=0, ComSignalType=UINT8, ComHandleId=5941, ComSystemTemplateSystemSignalRef=DET_RANGE_VELOCITY_ERR_284
            DET_EXISTENCE_PROB_282_oRDR_DETECTION_281_284_oPCAN_RADAR_c094db01_Tx: ComBitPosition=224, ComBitSize=6, ComSignalInitValue=0, ComSignalType=UINT8, ComHandleId=5904, ComSystemTemplateSystemSignalRef=DET_EXISTENCE_PROB_282
            DET_HVC_FLAG_281_oRDR_DETECTION_281_284_oPCAN_RADAR_4500e380_Tx: ComBitPosition=86, ComBitSize=1, ComSignalInitValue=0, ComSignalType=BOOLEAN, ComHandleId=5907, ComSystemTemplateSystemSignalRef=DET_HVC_FLAG_281
            DET_MH_CYCLE_COUNTER_281_284_oRDR_DETECTION_281_284_oPCAN_RADAR_8f3322a9_Tx: ComBitPosition=16, ComBitSize=8, ComSignalInitValue=0, ComSignalType=UINT8, ComHandleId=5916, ComSystemTemplateSystemSignalRef=DET_MH_CYCLE_COUNTER_281_284
            DET_RANGE_ERR_282_oRDR_DETECTION_281_284_oPCAN_RADAR_f3f220ca_Tx: ComBitPosition=152, ComBitSize=7, ComSignalInitValue=0, ComSignalType=UINT8, ComHandleId=5931, ComSystemTemplateSystemSignalRef=DET_RANGE_ERR_282
            DET_CONFD_ELEVATION_284_oRDR_DETECTION_281_284_oPCAN_RADAR_8d3215d4_Tx: ComBitPosition=437, ComBitSize=2, ComSignalInitValue=0, ComSignalType=UINT8, ComHandleId=5894, ComSystemTemplateSystemSignalRef=DET_CONFD_ELEVATION_284
            DET_RCS_282_oRDR_DETECTION_281_284_oPCAN_RADAR_a63c6fdc_Tx: ComBitPosition=240, ComBitSize=8, ComSignalInitValue=128, ComSignalType=UINT8, ComHandleId=5943, ComSystemTemplateSystemSignalRef=DET_RCS_282
            DET_RANGE_VELOCITY_283_oRDR_DETECTION_281_284_oPCAN_RADAR_b4cc8c13_Tx: ComBitPosition=272, ComBitSize=15, ComSignalInitValue=16384, ComSignalType=UINT16, ComHandleId=5936, ComSystemTemplateSystemSignalRef=DET_RANGE_VELOCITY_283
            DET_AZIMUTH_ERR_282_oRDR_DETECTION_281_284_oPCAN_RADAR_e0347ced_Tx: ComBitPosition=217, ComBitSize=7, ComSignalInitValue=0, ComSignalType=UINT8, ComHandleId=5876, ComSystemTemplateSystemSignalRef=DET_AZIMUTH_ERR_282
            DET_CONFD_AZIMUTH_281_oRDR_DETECTION_281_284_oPCAN_RADAR_2287982c_Tx: ComBitPosition=118, ComBitSize=2, ComSignalInitValue=0, ComSignalType=UINT8, ComHandleId=5887, ComSystemTemplateSystemSignalRef=DET_CONFD_AZIMUTH_281
            DET_AZIMUTH_281_oRDR_DETECTION_281_284_oPCAN_RADAR_206192e6_Tx: ComBitPosition=88, ComBitSize=13, ComSignalInitValue=0, ComSignalType=UINT16, ComHandleId=5871, ComSystemTemplateSystemSignalRef=DET_AZIMUTH_281
            DET_CONFD_AZIMUTH_284_oRDR_DETECTION_281_284_oPCAN_RADAR_8fa7142e_Tx: ComBitPosition=454, ComBitSize=2, ComSignalInitValue=0, ComSignalType=UINT8, ComHandleId=5890, ComSystemTemplateSystemSignalRef=DET_CONFD_AZIMUTH_284
            DET_SNR_282_oRDR_DETECTION_281_284_oPCAN_RADAR_7b923bde_Tx: ComBitPosition=232, ComBitSize=8, ComSignalInitValue=0, ComSignalType=UINT8, ComHandleId=5947, ComSystemTemplateSystemSignalRef=DET_SNR_282
            DET_SUPER_RES_TARGET_282_oRDR_DETECTION_281_284_oPCAN_RADAR_4a0b13bb_Tx: ComBitPosition=199, ComBitSize=1, ComSignalInitValue=0, ComSignalType=BOOLEAN, ComHandleId=5951, ComSystemTemplateSystemSignalRef=DET_SUPER_RES_TARGET_282
            DET_RANGE_VELOCITY_284_oRDR_DETECTION_281_284_oPCAN_RADAR_e87caf7a_Tx: ComBitPosition=384, ComBitSize=15, ComSignalInitValue=16384, ComSignalType=UINT16, ComHandleId=5937, ComSystemTemplateSystemSignalRef=DET_RANGE_VELOCITY_284
            DET_RANGE_ERR_283_oRDR_DETECTION_281_284_oPCAN_RADAR_6682f45f_Tx: ComBitPosition=264, ComBitSize=7, ComSignalInitValue=0, ComSignalType=UINT8, ComHandleId=5932, ComSystemTemplateSystemSignalRef=DET_RANGE_ERR_283
            DET_ELEVATION_281_oRDR_DETECTION_281_284_oPCAN_RADAR_f1d24dea_Tx: ComBitPosition=72, ComBitSize=8, ComSignalInitValue=0, ComSignalType=UINT8, ComHandleId=5895, ComSystemTemplateSystemSignalRef=DET_ELEVATION_281
            DET_BI_STATIC_FLAG_284_oRDR_DETECTION_281_284_oPCAN_RADAR_db6d5e61_Tx: ComBitPosition=440, ComBitSize=1, ComSignalInitValue=0, ComSignalType=BOOLEAN, ComHandleId=5886, ComSystemTemplateSystemSignalRef=DET_BI_STATIC_FLAG_284
            DET_RANGE_281_oRDR_DETECTION_281_284_oPCAN_RADAR_30fae15d_Tx: ComBitPosition=24, ComBitSize=15, ComSignalInitValue=0, ComSignalType=UINT16, ComHandleId=5926, ComSystemTemplateSystemSignalRef=DET_RANGE_281
            DET_EXISTENCE_PROB_281_oRDR_DETECTION_281_284_oPCAN_RADAR_a474a0ff_Tx: ComBitPosition=112, ComBitSize=6, ComSignalInitValue=0, ComSignalType=UINT8, ComHandleId=5903, ComSystemTemplateSystemSignalRef=DET_EXISTENCE_PROB_281
            DET_BI_STATIC_FLAG_282_oRDR_DETECTION_281_284_oPCAN_RADAR_12ada99d_Tx: ComBitPosition=216, ComBitSize=1, ComSignalInitValue=0, ComSignalType=BOOLEAN, ComHandleId=5884, ComSystemTemplateSystemSignalRef=DET_BI_STATIC_FLAG_282
            DET_RCS_281_oRDR_DETECTION_281_284_oPCAN_RADAR_c2dc1422_Tx: ComBitPosition=128, ComBitSize=8, ComSignalInitValue=128, ComSignalType=UINT8, ComHandleId=5942, ComSystemTemplateSystemSignalRef=DET_RCS_281
            DET_ELEVATION_ERR_281_oRDR_DETECTION_281_284_oPCAN_RADAR_76ebd59f_Tx: ComBitPosition=80, ComBitSize=6, ComSignalInitValue=0, ComSignalType=UINT8, ComHandleId=5899, ComSystemTemplateSystemSignalRef=DET_ELEVATION_ERR_281
            DET_RCS_284_oRDR_DETECTION_281_284_oPCAN_RADAR_6ffc9820_Tx: ComBitPosition=464, ComBitSize=8, ComSignalInitValue=128, ComSignalType=UINT8, ComHandleId=5945, ComSystemTemplateSystemSignalRef=DET_RCS_284
            DET_RANGE_284_oRDR_DETECTION_281_284_oPCAN_RADAR_9dda6d5f_Tx: ComBitPosition=360, ComBitSize=15, ComSignalInitValue=0, ComSignalType=UINT16, ComHandleId=5929, ComSystemTemplateSystemSignalRef=DET_RANGE_284
            DET_RANGE_ERR_284_oRDR_DETECTION_281_284_oPCAN_RADAR_3a32d736_Tx: ComBitPosition=376, ComBitSize=7, ComSignalInitValue=0, ComSignalType=UINT8, ComHandleId=5933, ComSystemTemplateSystemSignalRef=DET_RANGE_ERR_284
            DET_RANGE_VELOCITY_ERR_281_oRDR_DETECTION_281_284_oPCAN_RADAR_4ae7d8ca_Tx: ComBitPosition=64, ComBitSize=8, ComSignalInitValue=0, ComSignalType=UINT8, ComHandleId=5938, ComSystemTemplateSystemSignalRef=DET_RANGE_VELOCITY_ERR_281
            DET_SUPER_RES_TARGET_284_oRDR_DETECTION_281_284_oPCAN_RADAR_83cbe447_Tx: ComBitPosition=423, ComBitSize=1, ComSignalInitValue=0, ComSignalType=BOOLEAN, ComHandleId=5953, ComSystemTemplateSystemSignalRef=DET_SUPER_RES_TARGET_284
            DET_CONFD_ELEVATION_281_oRDR_DETECTION_281_284_oPCAN_RADAR_201299d6_Tx: ComBitPosition=101, ComBitSize=2, ComSignalInitValue=0, ComSignalType=UINT8, ComHandleId=5891, ComSystemTemplateSystemSignalRef=DET_CONFD_ELEVATION_281
            DET_AZIMUTH_284_oRDR_DETECTION_281_284_oPCAN_RADAR_8d411ee4_Tx: ComBitPosition=424, ComBitSize=13, ComSignalInitValue=0, ComSignalType=UINT16, ComHandleId=5874, ComSystemTemplateSystemSignalRef=DET_AZIMUTH_284
            DET_ELEVATION_ERR_284_oRDR_DETECTION_281_284_oPCAN_RADAR_dbcb599d_Tx: ComBitPosition=416, ComBitSize=6, ComSignalInitValue=0, ComSignalType=UINT8, ComHandleId=5902, ComSystemTemplateSystemSignalRef=DET_ELEVATION_ERR_284
            DET_MH_SCAN_INDEX_4LSB_281_284_oRDR_DETECTION_281_284_oPCAN_RADAR_43190725_Tx: ComBitPosition=476, ComBitSize=4, ComSignalInitValue=0, ComSignalType=UINT8, ComHandleId=5917, ComSystemTemplateSystemSignalRef=DET_MH_SCAN_INDEX_4LSB_281_284
            DET_AZIMUTH_ERR_281_oRDR_DETECTION_281_284_oPCAN_RADAR_84d40713_Tx: ComBitPosition=105, ComBitSize=7, ComSignalInitValue=0, ComSignalType=UINT8, ComHandleId=5875, ComSystemTemplateSystemSignalRef=DET_AZIMUTH_ERR_281
            DET_RANGE_282_oRDR_DETECTION_281_284_oPCAN_RADAR_541a9aa3_Tx: ComBitPosition=136, ComBitSize=15, ComSignalInitValue=0, ComSignalType=UINT16, ComHandleId=5927, ComSystemTemplateSystemSignalRef=DET_RANGE_282
            DET_RANGE_VELOCITY_ERR_283_oRDR_DETECTION_281_284_oPCAN_RADAR_bb7777a1_Tx: ComBitPosition=288, ComBitSize=8, ComSignalInitValue=0, ComSignalType=UINT8, ComHandleId=5940, ComSystemTemplateSystemSignalRef=DET_RANGE_VELOCITY_ERR_283
            DET_HVC_FLAG_284_oRDR_DETECTION_281_284_oPCAN_RADAR_e8206f82_Tx: ComBitPosition=422, ComBitSize=1, ComSignalInitValue=0, ComSignalType=BOOLEAN, ComHandleId=5910, ComSystemTemplateSystemSignalRef=DET_HVC_FLAG_284
            DET_SUPER_RES_TARGET_281_oRDR_DETECTION_281_284_oPCAN_RADAR_2eeb6845_Tx: ComBitPosition=87, ComBitSize=1, ComSignalInitValue=0, ComSignalType=BOOLEAN, ComHandleId=5950, ComSystemTemplateSystemSignalRef=DET_SUPER_RES_TARGET_281
            DET_BI_STATIC_FLAG_281_oRDR_DETECTION_281_284_oPCAN_RADAR_764dd263_Tx: ComBitPosition=104, ComBitSize=1, ComSignalInitValue=0, ComSignalType=BOOLEAN, ComHandleId=5883, ComSystemTemplateSystemSignalRef=DET_BI_STATIC_FLAG_281
            DET_RANGE_VELOCITY_ERR_282_oRDR_DETECTION_281_284_oPCAN_RADAR_2e07a334_Tx: ComBitPosition=176, ComBitSize=8, ComSignalInitValue=0, ComSignalType=UINT8, ComHandleId=5939, ComSystemTemplateSystemSignalRef=DET_RANGE_VELOCITY_ERR_282
            DET_EXISTENCE_PROB_284_oRDR_DETECTION_281_284_oPCAN_RADAR_09542cfd_Tx: ComBitPosition=448, ComBitSize=6, ComSignalInitValue=0, ComSignalType=UINT8, ComHandleId=5906, ComSystemTemplateSystemSignalRef=DET_EXISTENCE_PROB_284
            DET_ELEVATION_ERR_283_oRDR_DETECTION_281_284_oPCAN_RADAR_877b7af4_Tx: ComBitPosition=304, ComBitSize=6, ComSignalInitValue=0, ComSignalType=UINT8, ComHandleId=5901, ComSystemTemplateSystemSignalRef=DET_ELEVATION_ERR_283
            DET_EXISTENCE_PROB_283_oRDR_DETECTION_281_284_oPCAN_RADAR_55e40f94_Tx: ComBitPosition=336, ComBitSize=6, ComSignalInitValue=0, ComSignalType=UINT8, ComHandleId=5905, ComSystemTemplateSystemSignalRef=DET_EXISTENCE_PROB_283
            DET_SNR_283_oRDR_DETECTION_281_284_oPCAN_RADAR_eee2ef4b_Tx: ComBitPosition=344, ComBitSize=8, ComSignalInitValue=0, ComSignalType=UINT8, ComHandleId=5948, ComSystemTemplateSystemSignalRef=DET_SNR_283
            DET_RANGE_ERR_281_oRDR_DETECTION_281_284_oPCAN_RADAR_97125b34_Tx: ComBitPosition=40, ComBitSize=7, ComSignalInitValue=0, ComSignalType=UINT8, ComHandleId=5930, ComSystemTemplateSystemSignalRef=DET_RANGE_ERR_281
            DET_RANGE_VELOCITY_282_oRDR_DETECTION_281_284_oPCAN_RADAR_21bc5886_Tx: ComBitPosition=160, ComBitSize=15, ComSignalInitValue=16384, ComSignalType=UINT16, ComHandleId=5935, ComSystemTemplateSystemSignalRef=DET_RANGE_VELOCITY_282
            DET_SUPER_RES_TARGET_283_oRDR_DETECTION_281_284_oPCAN_RADAR_df7bc72e_Tx: ComBitPosition=311, ComBitSize=1, ComSignalInitValue=0, ComSignalType=BOOLEAN, ComHandleId=5952, ComSystemTemplateSystemSignalRef=DET_SUPER_RES_TARGET_283
            DET_AZIMUTH_282_oRDR_DETECTION_281_284_oPCAN_RADAR_4481e918_Tx: ComBitPosition=200, ComBitSize=13, ComSignalInitValue=0, ComSignalType=UINT16, ComHandleId=5872, ComSystemTemplateSystemSignalRef=DET_AZIMUTH_282
            DET_CONFD_ELEVATION_283_oRDR_DETECTION_281_284_oPCAN_RADAR_d18236bd_Tx: ComBitPosition=325, ComBitSize=2, ComSignalInitValue=0, ComSignalType=UINT8, ComHandleId=5893, ComSystemTemplateSystemSignalRef=DET_CONFD_ELEVATION_283
            DET_BELOW_RAIN_THOLD_284_oRDR_DETECTION_281_284_oPCAN_RADAR_58408d24_Tx: ComBitPosition=375, ComBitSize=1, ComSignalInitValue=0, ComSignalType=UINT8, ComHandleId=5882, ComSystemTemplateSystemSignalRef=DET_BELOW_RAIN_THOLD_284
            DET_PROB_1STAZHYPO_281_oRDR_DETECTION_281_284_oPCAN_RADAR_3b55022b_Tx: ComBitPosition=103, ComBitSize=1, ComSignalInitValue=0, ComSignalType=BOOLEAN, ComHandleId=5922, ComSystemTemplateSystemSignalRef=DET_PROB_1STAZHYPO_281
            DET_IDM_284_oRDR_DETECTION_281_284_oPCAN_RADAR_6372543f_Tx: ComBitPosition=399, ComBitSize=1, ComSignalInitValue=0, ComSignalType=UINT8, ComHandleId=5914, ComSystemTemplateSystemSignalRef=DET_IDM_284
            DET_MTD_281_oRDR_DETECTION_281_284_oPCAN_RADAR_a8e1eae6_Tx: ComBitPosition=47, ComBitSize=1, ComSignalInitValue=0, ComSignalType=UINT8, ComHandleId=5918, ComSystemTemplateSystemSignalRef=DET_MTD_281
            DET_MTD_282_oRDR_DETECTION_281_284_oPCAN_RADAR_cc019118_Tx: ComBitPosition=159, ComBitSize=1, ComSignalInitValue=0, ComSignalType=UINT8, ComHandleId=5919, ComSystemTemplateSystemSignalRef=DET_MTD_282
            DET_MTD_284_oRDR_DETECTION_281_284_oPCAN_RADAR_05c166e4_Tx: ComBitPosition=383, ComBitSize=1, ComSignalInitValue=0, ComSignalType=UINT8, ComHandleId=5921, ComSystemTemplateSystemSignalRef=DET_MTD_284
            DET_PROB_1STAZHYPO_283_oRDR_DETECTION_281_284_oPCAN_RADAR_cac5ad40_Tx: ComBitPosition=327, ComBitSize=1, ComSignalInitValue=0, ComSignalType=BOOLEAN, ComHandleId=5924, ComSystemTemplateSystemSignalRef=DET_PROB_1STAZHYPO_283
            DET_PROB_1STAZHYPO_282_oRDR_DETECTION_281_284_oPCAN_RADAR_5fb579d5_Tx: ComBitPosition=215, ComBitSize=1, ComSignalInitValue=0, ComSignalType=BOOLEAN, ComHandleId=5923, ComSystemTemplateSystemSignalRef=DET_PROB_1STAZHYPO_282
            DET_MTD_283_oRDR_DETECTION_281_284_oPCAN_RADAR_5971458d_Tx: ComBitPosition=271, ComBitSize=1, ComSignalInitValue=0, ComSignalType=UINT8, ComHandleId=5920, ComSystemTemplateSystemSignalRef=DET_MTD_283
            DET_BELOW_RAIN_THOLD_282_oRDR_DETECTION_281_284_oPCAN_RADAR_91807ad8_Tx: ComBitPosition=151, ComBitSize=1, ComSignalInitValue=0, ComSignalType=UINT8, ComHandleId=5880, ComSystemTemplateSystemSignalRef=DET_BELOW_RAIN_THOLD_282
            DET_BELOW_RAIN_THOLD_283_oRDR_DETECTION_281_284_oPCAN_RADAR_04f0ae4d_Tx: ComBitPosition=263, ComBitSize=1, ComSignalInitValue=0, ComSignalType=UINT8, ComHandleId=5881, ComSystemTemplateSystemSignalRef=DET_BELOW_RAIN_THOLD_283
            DET_IDM_281_oRDR_DETECTION_281_284_oPCAN_RADAR_ce52d83d_Tx: ComBitPosition=63, ComBitSize=1, ComSignalInitValue=0, ComSignalType=UINT8, ComHandleId=5911, ComSystemTemplateSystemSignalRef=DET_IDM_281
            DET_IDM_282_oRDR_DETECTION_281_284_oPCAN_RADAR_aab2a3c3_Tx: ComBitPosition=175, ComBitSize=1, ComSignalInitValue=0, ComSignalType=UINT8, ComHandleId=5912, ComSystemTemplateSystemSignalRef=DET_IDM_282
            DET_BELOW_RAIN_THOLD_281_oRDR_DETECTION_281_284_oPCAN_RADAR_f5600126_Tx: ComBitPosition=39, ComBitSize=1, ComSignalInitValue=0, ComSignalType=UINT8, ComHandleId=5879, ComSystemTemplateSystemSignalRef=DET_BELOW_RAIN_THOLD_281
            DET_PROB_1STAZHYPO_284_oRDR_DETECTION_281_284_oPCAN_RADAR_96758e29_Tx: ComBitPosition=439, ComBitSize=1, ComSignalInitValue=0, ComSignalType=BOOLEAN, ComHandleId=5925, ComSystemTemplateSystemSignalRef=DET_PROB_1STAZHYPO_284
            DET_IDM_283_oRDR_DETECTION_281_284_oPCAN_RADAR_3fc27756_Tx: ComBitPosition=287, ComBitSize=1, ComSignalInitValue=0, ComSignalType=UINT8, ComHandleId=5913, ComSystemTemplateSystemSignalRef=DET_IDM_283
        SG_Detections_301_304_oRDR_DETECTION_301_304_oPCAN_RADAR_18b0f261_Tx: ComTransferProperty=TRIGGERED, ComHandleId=77, ComSystemTemplateSignalGroupRef=SG_Detections_301_304
          83 x ComGroupSignal, all with ComSignalEndianness=LITTLE_ENDIAN, ComTransferProperty=PENDING, ComSignalAccess=ACCESS_NEEDED_BY_SWC_OR_COM:
            DET_BI_STATIC_FLAG_301_oRDR_DETECTION_301_304_oPCAN_RADAR_6d726975_Tx: ComBitPosition=104, ComBitSize=1, ComSignalInitValue=0, ComSignalType=BOOLEAN, ComHandleId=6298, ComSystemTemplateSystemSignalRef=DET_BI_STATIC_FLAG_301
            DET_SNR_304_oRDR_DETECTION_301_304_oPCAN_RADAR_a96d7734_Tx: ComBitPosition=456, ComBitSize=8, ComSignalInitValue=0, ComSignalType=UINT8, ComHandleId=6364, ComSystemTemplateSystemSignalRef=DET_SNR_304
            DET_AZIMUTH_ERR_304_oRDR_DETECTION_301_304_oPCAN_RADAR_32cb3007_Tx: ComBitPosition=441, ComBitSize=7, ComSignalInitValue=0, ComSignalType=UINT8, ComHandleId=6293, ComSystemTemplateSystemSignalRef=DET_AZIMUTH_ERR_304
            DET_AZIMUTH_304_oRDR_DETECTION_301_304_oPCAN_RADAR_967ea5f2_Tx: ComBitPosition=424, ComBitSize=13, ComSignalInitValue=0, ComSignalType=UINT16, ComHandleId=6289, ComSystemTemplateSystemSignalRef=DET_AZIMUTH_304
            DET_AZIMUTH_301_oRDR_DETECTION_301_304_oPCAN_RADAR_3b5e29f0_Tx: ComBitPosition=88, ComBitSize=13, ComSignalInitValue=0, ComSignalType=UINT16, ComHandleId=6286, ComSystemTemplateSystemSignalRef=DET_AZIMUTH_301
            DET_EXISTENCE_PROB_301_oRDR_DETECTION_301_304_oPCAN_RADAR_bf4b1be9_Tx: ComBitPosition=112, ComBitSize=6, ComSignalInitValue=0, ComSignalType=UINT8, ComHandleId=6318, ComSystemTemplateSystemSignalRef=DET_EXISTENCE_PROB_301
            DET_HVC_FLAG_304_oRDR_DETECTION_301_304_oPCAN_RADAR_f31fd494_Tx: ComBitPosition=422, ComBitSize=1, ComSignalInitValue=0, ComSignalType=BOOLEAN, ComHandleId=6325, ComSystemTemplateSystemSignalRef=DET_HVC_FLAG_304
            DET_HVC_FLAG_301_oRDR_DETECTION_301_304_oPCAN_RADAR_5e3f5896_Tx: ComBitPosition=86, ComBitSize=1, ComSignalInitValue=0, ComSignalType=BOOLEAN, ComHandleId=6322, ComSystemTemplateSystemSignalRef=DET_HVC_FLAG_301
            DET_CONFD_AZIMUTH_303_oRDR_DETECTION_301_304_oPCAN_RADAR_c8288c51_Tx: ComBitPosition=342, ComBitSize=2, ComSignalInitValue=0, ComSignalType=UINT8, ComHandleId=6304, ComSystemTemplateSystemSignalRef=DET_CONFD_AZIMUTH_303
            DET_SUPER_RES_TARGET_301_oRDR_DETECTION_301_304_oPCAN_RADAR_35d4d353_Tx: ComBitPosition=87, ComBitSize=1, ComSignalInitValue=0, ComSignalType=BOOLEAN, ComHandleId=6365, ComSystemTemplateSystemSignalRef=DET_SUPER_RES_TARGET_301
            DET_RCS_304_oRDR_DETECTION_301_304_oPCAN_RADAR_74c32336_Tx: ComBitPosition=464, ComBitSize=8, ComSignalInitValue=128, ComSignalType=UINT8, ComHandleId=6360, ComSystemTemplateSystemSignalRef=DET_RCS_304
            DET_SNR_302_oRDR_DETECTION_301_304_oPCAN_RADAR_60ad80c8_Tx: ComBitPosition=232, ComBitSize=8, ComSignalInitValue=0, ComSignalType=UINT8, ComHandleId=6362, ComSystemTemplateSystemSignalRef=DET_SNR_302
            DET_RANGE_VELOCITY_301_oRDR_DETECTION_301_304_oPCAN_RADAR_5e63986e_Tx: ComBitPosition=48, ComBitSize=15, ComSignalInitValue=16384, ComSignalType=UINT16, ComHandleId=6349, ComSystemTemplateSystemSignalRef=DET_RANGE_VELOCITY_301
            DET_RANGE_VELOCITY_ERR_304_oRDR_DETECTION_301_304_oPCAN_RADAR_fcf8efde_Tx: ComBitPosition=400, ComBitSize=8, ComSignalInitValue=0, ComSignalType=UINT8, ComHandleId=6356, ComSystemTemplateSystemSignalRef=DET_RANGE_VELOCITY_ERR_304
            DET_RANGE_VELOCITY_304_oRDR_DETECTION_301_304_oPCAN_RADAR_f343146c_Tx: ComBitPosition=384, ComBitSize=15, ComSignalInitValue=16384, ComSignalType=UINT16, ComHandleId=6352, ComSystemTemplateSystemSignalRef=DET_RANGE_VELOCITY_304
            DET_ELEVATION_ERR_301_oRDR_DETECTION_301_304_oPCAN_RADAR_6dd46e89_Tx: ComBitPosition=80, ComBitSize=6, ComSignalInitValue=0, ComSignalType=UINT8, ComHandleId=6314, ComSystemTemplateSystemSignalRef=DET_ELEVATION_ERR_301
            DET_MH_SCAN_INDEX_4LSB_301_304_oRDR_DETECTION_301_304_oPCAN_RADAR_d467a4d1_Tx: ComBitPosition=476, ComBitSize=4, ComSignalInitValue=0, ComSignalType=UINT8, ComHandleId=6332, ComSystemTemplateSystemSignalRef=DET_MH_SCAN_INDEX_4LSB_301_304
            DET_RANGE_ERR_302_oRDR_DETECTION_301_304_oPCAN_RADAR_e8cd9bdc_Tx: ComBitPosition=152, ComBitSize=7, ComSignalInitValue=0, ComSignalType=UINT8, ComHandleId=6346, ComSystemTemplateSystemSignalRef=DET_RANGE_ERR_302
            DET_CONFD_ELEVATION_304_oRDR_DETECTION_301_304_oPCAN_RADAR_960daec2_Tx: ComBitPosition=437, ComBitSize=2, ComSignalInitValue=0, ComSignalType=UINT8, ComHandleId=6309, ComSystemTemplateSystemSignalRef=DET_CONFD_ELEVATION_304
            DET_RANGE_302_oRDR_DETECTION_301_304_oPCAN_RADAR_4f2521b5_Tx: ComBitPosition=136, ComBitSize=15, ComSignalInitValue=0, ComSignalType=UINT16, ComHandleId=6342, ComSystemTemplateSystemSignalRef=DET_RANGE_302
            DET_RANGE_VELOCITY_ERR_301_oRDR_DETECTION_301_304_oPCAN_RADAR_51d863dc_Tx: ComBitPosition=64, ComBitSize=8, ComSignalInitValue=0, ComSignalType=UINT8, ComHandleId=6353, ComSystemTemplateSystemSignalRef=DET_RANGE_VELOCITY_ERR_301
            DET_RANGE_ERR_303_oRDR_DETECTION_301_304_oPCAN_RADAR_7dbd4f49_Tx: ComBitPosition=264, ComBitSize=7, ComSignalInitValue=0, ComSignalType=UINT8, ComHandleId=6347, ComSystemTemplateSystemSignalRef=DET_RANGE_ERR_303
            DET_RANGE_ERR_301_oRDR_DETECTION_301_304_oPCAN_RADAR_8c2de022_Tx: ComBitPosition=40, ComBitSize=7, ComSignalInitValue=0, ComSignalType=UINT8, ComHandleId=6345, ComSystemTemplateSystemSignalRef=DET_RANGE_ERR_301
            DET_CONFD_ELEVATION_302_oRDR_DETECTION_301_304_oPCAN_RADAR_5fcd593e_Tx: ComBitPosition=213, ComBitSize=2, ComSignalInitValue=0, ComSignalType=UINT8, ComHandleId=6307, ComSystemTemplateSystemSignalRef=DET_CONFD_ELEVATION_302
            DET_RANGE_VELOCITY_ERR_303_oRDR_DETECTION_301_304_oPCAN_RADAR_a048ccb7_Tx: ComBitPosition=288, ComBitSize=8, ComSignalInitValue=0, ComSignalType=UINT8, ComHandleId=6355, ComSystemTemplateSystemSignalRef=DET_RANGE_VELOCITY_ERR_303
            DET_AZIMUTH_ERR_303_oRDR_DETECTION_301_304_oPCAN_RADAR_6e7b136e_Tx: ComBitPosition=329, ComBitSize=7, ComSignalInitValue=0, ComSignalType=UINT8, ComHandleId=6292, ComSystemTemplateSystemSignalRef=DET_AZIMUTH_ERR_303
            DET_RANGE_ERR_304_oRDR_DETECTION_301_304_oPCAN_RADAR_210d6c20_Tx: ComBitPosition=376, ComBitSize=7, ComSignalInitValue=0, ComSignalType=UINT8, ComHandleId=6348, ComSystemTemplateSystemSignalRef=DET_RANGE_ERR_304
            DET_EXISTENCE_PROB_303_oRDR_DETECTION_301_304_oPCAN_RADAR_4edbb482_Tx: ComBitPosition=336, ComBitSize=6, ComSignalInitValue=0, ComSignalType=UINT8, ComHandleId=6320, ComSystemTemplateSystemSignalRef=DET_EXISTENCE_PROB_303
            DET_BI_STATIC_FLAG_303_oRDR_DETECTION_301_304_oPCAN_RADAR_9ce2c61e_Tx: ComBitPosition=328, ComBitSize=1, ComSignalInitValue=0, ComSignalType=BOOLEAN, ComHandleId=6300, ComSystemTemplateSystemSignalRef=DET_BI_STATIC_FLAG_303
            DET_ELEVATION_302_oRDR_DETECTION_301_304_oPCAN_RADAR_8e0d8d02_Tx: ComBitPosition=184, ComBitSize=8, ComSignalInitValue=0, ComSignalType=UINT8, ComHandleId=6311, ComSystemTemplateSystemSignalRef=DET_ELEVATION_302
            DET_AZIMUTH_ERR_302_oRDR_DETECTION_301_304_oPCAN_RADAR_fb0bc7fb_Tx: ComBitPosition=217, ComBitSize=7, ComSignalInitValue=0, ComSignalType=UINT8, ComHandleId=6291, ComSystemTemplateSystemSignalRef=DET_AZIMUTH_ERR_302
            DET_RANGE_303_oRDR_DETECTION_301_304_oPCAN_RADAR_da55f520_Tx: ComBitPosition=248, ComBitSize=15, ComSignalInitValue=0, ComSignalType=UINT16, ComHandleId=6343, ComSystemTemplateSystemSignalRef=DET_RANGE_303
            DET_RCS_302_oRDR_DETECTION_301_304_oPCAN_RADAR_bd03d4ca_Tx: ComBitPosition=240, ComBitSize=8, ComSignalInitValue=128, ComSignalType=UINT8, ComHandleId=6358, ComSystemTemplateSystemSignalRef=DET_RCS_302
            DET_AZIMUTH_ERR_301_oRDR_DETECTION_301_304_oPCAN_RADAR_9febbc05_Tx: ComBitPosition=105, ComBitSize=7, ComSignalInitValue=0, ComSignalType=UINT8, ComHandleId=6290, ComSystemTemplateSystemSignalRef=DET_AZIMUTH_ERR_301
            DET_RCS_303_oRDR_DETECTION_301_304_oPCAN_RADAR_2873005f_Tx: ComBitPosition=352, ComBitSize=8, ComSignalInitValue=128, ComSignalType=UINT8, ComHandleId=6359, ComSystemTemplateSystemSignalRef=DET_RCS_303
            DET_SUPER_RES_TARGET_303_oRDR_DETECTION_301_304_oPCAN_RADAR_c4447c38_Tx: ComBitPosition=311, ComBitSize=1, ComSignalInitValue=0, ComSignalType=BOOLEAN, ComHandleId=6367, ComSystemTemplateSystemSignalRef=DET_SUPER_RES_TARGET_303
            DET_CONFD_ELEVATION_303_oRDR_DETECTION_301_304_oPCAN_RADAR_cabd8dab_Tx: ComBitPosition=325, ComBitSize=2, ComSignalInitValue=0, ComSignalType=UINT8, ComHandleId=6308, ComSystemTemplateSystemSignalRef=DET_CONFD_ELEVATION_303
            DET_AZIMUTH_303_oRDR_DETECTION_301_304_oPCAN_RADAR_cace869b_Tx: ComBitPosition=312, ComBitSize=13, ComSignalInitValue=0, ComSignalType=UINT16, ComHandleId=6288, ComSystemTemplateSystemSignalRef=DET_AZIMUTH_303
            DET_RANGE_VELOCITY_ERR_302_oRDR_DETECTION_301_304_oPCAN_RADAR_35381822_Tx: ComBitPosition=176, ComBitSize=8, ComSignalInitValue=0, ComSignalType=UINT8, ComHandleId=6354, ComSystemTemplateSystemSignalRef=DET_RANGE_VELOCITY_ERR_302
            DET_RANGE_VELOCITY_302_oRDR_DETECTION_301_304_oPCAN_RADAR_3a83e390_Tx: ComBitPosition=160, ComBitSize=15, ComSignalInitValue=16384, ComSignalType=UINT16, ComHandleId=6350, ComSystemTemplateSystemSignalRef=DET_RANGE_VELOCITY_302
            DET_ELEVATION_ERR_303_oRDR_DETECTION_301_304_oPCAN_RADAR_9c44c1e2_Tx: ComBitPosition=304, ComBitSize=6, ComSignalInitValue=0, ComSignalType=UINT8, ComHandleId=6316, ComSystemTemplateSystemSignalRef=DET_ELEVATION_ERR_303
            DET_HVC_FLAG_302_oRDR_DETECTION_301_304_oPCAN_RADAR_3adf2368_Tx: ComBitPosition=198, ComBitSize=1, ComSignalInitValue=0, ComSignalType=BOOLEAN, ComHandleId=6323, ComSystemTemplateSystemSignalRef=DET_HVC_FLAG_302
            DET_SUPER_RES_TARGET_302_oRDR_DETECTION_301_304_oPCAN_RADAR_5134a8ad_Tx: ComBitPosition=199, ComBitSize=1, ComSignalInitValue=0, ComSignalType=BOOLEAN, ComHandleId=6366, ComSystemTemplateSystemSignalRef=DET_SUPER_RES_TARGET_302
            DET_ELEVATION_303_oRDR_DETECTION_301_304_oPCAN_RADAR_1b7d5997_Tx: ComBitPosition=296, ComBitSize=8, ComSignalInitValue=0, ComSignalType=UINT8, ComHandleId=6312, ComSystemTemplateSystemSignalRef=DET_ELEVATION_303
            DET_MH_CRC16_301_304_oRDR_DETECTION_301_304_oPCAN_RADAR_9c38206a_Tx: ComBitPosition=0, ComBitSize=16, ComSignalInitValue=0, ComSignalType=UINT16, ComHandleId=6330, ComSystemTemplateSystemSignalRef=DET_MH_CRC16_301_304
            DET_SNR_301_oRDR_DETECTION_301_304_oPCAN_RADAR_044dfb36_Tx: ComBitPosition=120, ComBitSize=8, ComSignalInitValue=0, ComSignalType=UINT8, ComHandleId=6361, ComSystemTemplateSystemSignalRef=DET_SNR_301
            DET_AZIMUTH_302_oRDR_DETECTION_301_304_oPCAN_RADAR_5fbe520e_Tx: ComBitPosition=200, ComBitSize=13, ComSignalInitValue=0, ComSignalType=UINT16, ComHandleId=6287, ComSystemTemplateSystemSignalRef=DET_AZIMUTH_302
            DET_HVC_FLAG_303_oRDR_DETECTION_301_304_oPCAN_RADAR_afaff7fd_Tx: ComBitPosition=310, ComBitSize=1, ComSignalInitValue=0, ComSignalType=BOOLEAN, ComHandleId=6324, ComSystemTemplateSystemSignalRef=DET_HVC_FLAG_303
            DET_CONFD_AZIMUTH_304_oRDR_DETECTION_301_304_oPCAN_RADAR_9498af38_Tx: ComBitPosition=454, ComBitSize=2, ComSignalInitValue=0, ComSignalType=UINT8, ComHandleId=6305, ComSystemTemplateSystemSignalRef=DET_CONFD_AZIMUTH_304
            DET_RANGE_301_oRDR_DETECTION_301_304_oPCAN_RADAR_2bc55a4b_Tx: ComBitPosition=24, ComBitSize=15, ComSignalInitValue=0, ComSignalType=UINT16, ComHandleId=6341, ComSystemTemplateSystemSignalRef=DET_RANGE_301
            DET_RANGE_VELOCITY_303_oRDR_DETECTION_301_304_oPCAN_RADAR_aff33705_Tx: ComBitPosition=272, ComBitSize=15, ComSignalInitValue=16384, ComSignalType=UINT16, ComHandleId=6351, ComSystemTemplateSystemSignalRef=DET_RANGE_VELOCITY_303
            DET_CONFD_ELEVATION_301_oRDR_DETECTION_301_304_oPCAN_RADAR_3b2d22c0_Tx: ComBitPosition=101, ComBitSize=2, ComSignalInitValue=0, ComSignalType=UINT8, ComHandleId=6306, ComSystemTemplateSystemSignalRef=DET_CONFD_ELEVATION_301
            DET_ELEVATION_304_oRDR_DETECTION_301_304_oPCAN_RADAR_47cd7afe_Tx: ComBitPosition=408, ComBitSize=8, ComSignalInitValue=0, ComSignalType=UINT8, ComHandleId=6313, ComSystemTemplateSystemSignalRef=DET_ELEVATION_304
            DET_EXISTENCE_PROB_302_oRDR_DETECTION_301_304_oPCAN_RADAR_dbab6017_Tx: ComBitPosition=224, ComBitSize=6, ComSignalInitValue=0, ComSignalType=UINT8, ComHandleId=6319, ComSystemTemplateSystemSignalRef=DET_EXISTENCE_PROB_302
            DET_ELEVATION_301_oRDR_DETECTION_301_304_oPCAN_RADAR_eaedf6fc_Tx: ComBitPosition=72, ComBitSize=8, ComSignalInitValue=0, ComSignalType=UINT8, ComHandleId=6310, ComSystemTemplateSystemSignalRef=DET_ELEVATION_301
            DET_RANGE_304_oRDR_DETECTION_301_304_oPCAN_RADAR_86e5d649_Tx: ComBitPosition=360, ComBitSize=15, ComSignalInitValue=0, ComSignalType=UINT16, ComHandleId=6344, ComSystemTemplateSystemSignalRef=DET_RANGE_304
            DET_EXISTENCE_PROB_304_oRDR_DETECTION_301_304_oPCAN_RADAR_126b97eb_Tx: ComBitPosition=448, ComBitSize=6, ComSignalInitValue=0, ComSignalType=UINT8, ComHandleId=6321, ComSystemTemplateSystemSignalRef=DET_EXISTENCE_PROB_304
            DET_ELEVATION_ERR_304_oRDR_DETECTION_301_304_oPCAN_RADAR_c0f4e28b_Tx: ComBitPosition=416, ComBitSize=6, ComSignalInitValue=0, ComSignalType=UINT8, ComHandleId=6317, ComSystemTemplateSystemSignalRef=DET_ELEVATION_ERR_304
            DET_BI_STATIC_FLAG_304_oRDR_DETECTION_301_304_oPCAN_RADAR_c052e577_Tx: ComBitPosition=440, ComBitSize=1, ComSignalInitValue=0, ComSignalType=BOOLEAN, ComHandleId=6301, ComSystemTemplateSystemSignalRef=DET_BI_STATIC_FLAG_304
            DET_CONFD_AZIMUTH_301_oRDR_DETECTION_301_304_oPCAN_RADAR_39b8233a_Tx: ComBitPosition=118, ComBitSize=2, ComSignalInitValue=0, ComSignalType=UINT8, ComHandleId=6302, ComSystemTemplateSystemSignalRef=DET_CONFD_AZIMUTH_301
            DET_SNR_303_oRDR_DETECTION_301_304_oPCAN_RADAR_f5dd545d_Tx: ComBitPosition=344, ComBitSize=8, ComSignalInitValue=0, ComSignalType=UINT8, ComHandleId=6363, ComSystemTemplateSystemSignalRef=DET_SNR_303
            DET_SUPER_RES_TARGET_304_oRDR_DETECTION_301_304_oPCAN_RADAR_98f45f51_Tx: ComBitPosition=423, ComBitSize=1, ComSignalInitValue=0, ComSignalType=BOOLEAN, ComHandleId=6368, ComSystemTemplateSystemSignalRef=DET_SUPER_RES_TARGET_304
            DET_ELEVATION_ERR_302_oRDR_DETECTION_301_304_oPCAN_RADAR_09341577_Tx: ComBitPosition=192, ComBitSize=6, ComSignalInitValue=0, ComSignalType=UINT8, ComHandleId=6315, ComSystemTemplateSystemSignalRef=DET_ELEVATION_ERR_302
            DET_BI_STATIC_FLAG_302_oRDR_DETECTION_301_304_oPCAN_RADAR_0992128b_Tx: ComBitPosition=216, ComBitSize=1, ComSignalInitValue=0, ComSignalType=BOOLEAN, ComHandleId=6299, ComSystemTemplateSystemSignalRef=DET_BI_STATIC_FLAG_302
            DET_CONFD_AZIMUTH_302_oRDR_DETECTION_301_304_oPCAN_RADAR_5d5858c4_Tx: ComBitPosition=230, ComBitSize=2, ComSignalInitValue=0, ComSignalType=UINT8, ComHandleId=6303, ComSystemTemplateSystemSignalRef=DET_CONFD_AZIMUTH_302
            DET_RCS_301_oRDR_DETECTION_301_304_oPCAN_RADAR_d9e3af34_Tx: ComBitPosition=128, ComBitSize=8, ComSignalInitValue=128, ComSignalType=UINT8, ComHandleId=6357, ComSystemTemplateSystemSignalRef=DET_RCS_301
            DET_MH_CYCLE_COUNTER_301_304_oRDR_DETECTION_301_304_oPCAN_RADAR_184d815d_Tx: ComBitPosition=16, ComBitSize=8, ComSignalInitValue=0, ComSignalType=UINT8, ComHandleId=6331, ComSystemTemplateSystemSignalRef=DET_MH_CYCLE_COUNTER_301_304
            DET_MTD_303_oRDR_DETECTION_301_304_oPCAN_RADAR_424efe9b_Tx: ComBitPosition=271, ComBitSize=1, ComSignalInitValue=0, ComSignalType=UINT8, ComHandleId=6335, ComSystemTemplateSystemSignalRef=DET_MTD_303
            DET_IDM_301_oRDR_DETECTION_301_304_oPCAN_RADAR_d56d632b_Tx: ComBitPosition=63, ComBitSize=1, ComSignalInitValue=0, ComSignalType=UINT8, ComHandleId=6326, ComSystemTemplateSystemSignalRef=DET_IDM_301
            DET_PROB_1STAZHYPO_303_oRDR_DETECTION_301_304_oPCAN_RADAR_d1fa1656_Tx: ComBitPosition=327, ComBitSize=1, ComSignalInitValue=0, ComSignalType=BOOLEAN, ComHandleId=6339, ComSystemTemplateSystemSignalRef=DET_PROB_1STAZHYPO_303
            DET_BELOW_RAIN_THOLD_302_oRDR_DETECTION_301_304_oPCAN_RADAR_8abfc1ce_Tx: ComBitPosition=151, ComBitSize=1, ComSignalInitValue=0, ComSignalType=UINT8, ComHandleId=6295, ComSystemTemplateSystemSignalRef=DET_BELOW_RAIN_THOLD_302
            DET_BELOW_RAIN_THOLD_304_oRDR_DETECTION_301_304_oPCAN_RADAR_437f3632_Tx: ComBitPosition=375, ComBitSize=1, ComSignalInitValue=0, ComSignalType=UINT8, ComHandleId=6297, ComSystemTemplateSystemSignalRef=DET_BELOW_RAIN_THOLD_304
            DET_MTD_302_oRDR_DETECTION_301_304_oPCAN_RADAR_d73e2a0e_Tx: ComBitPosition=159, ComBitSize=1, ComSignalInitValue=0, ComSignalType=UINT8, ComHandleId=6334, ComSystemTemplateSystemSignalRef=DET_MTD_302
            DET_PROB_1STAZHYPO_304_oRDR_DETECTION_301_304_oPCAN_RADAR_8d4a353f_Tx: ComBitPosition=439, ComBitSize=1, ComSignalInitValue=0, ComSignalType=BOOLEAN, ComHandleId=6340, ComSystemTemplateSystemSignalRef=DET_PROB_1STAZHYPO_304
            DET_IDM_304_oRDR_DETECTION_301_304_oPCAN_RADAR_784def29_Tx: ComBitPosition=399, ComBitSize=1, ComSignalInitValue=0, ComSignalType=UINT8, ComHandleId=6329, ComSystemTemplateSystemSignalRef=DET_IDM_304
            DET_IDM_303_oRDR_DETECTION_301_304_oPCAN_RADAR_24fdcc40_Tx: ComBitPosition=287, ComBitSize=1, ComSignalInitValue=0, ComSignalType=UINT8, ComHandleId=6328, ComSystemTemplateSystemSignalRef=DET_IDM_303
            DET_MTD_304_oRDR_DETECTION_301_304_oPCAN_RADAR_1efeddf2_Tx: ComBitPosition=383, ComBitSize=1, ComSignalInitValue=0, ComSignalType=UINT8, ComHandleId=6336, ComSystemTemplateSystemSignalRef=DET_MTD_304
            DET_BELOW_RAIN_THOLD_303_oRDR_DETECTION_301_304_oPCAN_RADAR_1fcf155b_Tx: ComBitPosition=263, ComBitSize=1, ComSignalInitValue=0, ComSignalType=UINT8, ComHandleId=6296, ComSystemTemplateSystemSignalRef=DET_BELOW_RAIN_THOLD_303
            DET_IDM_302_oRDR_DETECTION_301_304_oPCAN_RADAR_b18d18d5_Tx: ComBitPosition=175, ComBitSize=1, ComSignalInitValue=0, ComSignalType=UINT8, ComHandleId=6327, ComSystemTemplateSystemSignalRef=DET_IDM_302
            DET_PROB_1STAZHYPO_302_oRDR_DETECTION_301_304_oPCAN_RADAR_448ac2c3_Tx: ComBitPosition=215, ComBitSize=1, ComSignalInitValue=0, ComSignalType=BOOLEAN, ComHandleId=6338, ComSystemTemplateSystemSignalRef=DET_PROB_1STAZHYPO_302
            DET_MTD_301_oRDR_DETECTION_301_304_oPCAN_RADAR_b3de51f0_Tx: ComBitPosition=47, ComBitSize=1, ComSignalInitValue=0, ComSignalType=UINT8, ComHandleId=6333, ComSystemTemplateSystemSignalRef=DET_MTD_301
            DET_BELOW_RAIN_THOLD_301_oRDR_DETECTION_301_304_oPCAN_RADAR_ee5fba30_Tx: ComBitPosition=39, ComBitSize=1, ComSignalInitValue=0, ComSignalType=UINT8, ComHandleId=6294, ComSystemTemplateSystemSignalRef=DET_BELOW_RAIN_THOLD_301
            DET_PROB_1STAZHYPO_301_oRDR_DETECTION_301_304_oPCAN_RADAR_206ab93d_Tx: ComBitPosition=103, ComBitSize=1, ComSignalInitValue=0, ComSignalType=BOOLEAN, ComHandleId=6337, ComSystemTemplateSystemSignalRef=DET_PROB_1STAZHYPO_301
        SG_Detections_057_060_oRDR_DETECTION_057_060_oPCAN_RADAR_83bdfb8a_Tx: ComTransferProperty=TRIGGERED, ComHandleId=16, ComSystemTemplateSignalGroupRef=SG_Detections_057_060
          83 x ComGroupSignal, all with ComSignalEndianness=LITTLE_ENDIAN, ComTransferProperty=PENDING, ComSignalAccess=ACCESS_NEEDED_BY_SWC_OR_COM:
            DET_HVC_FLAG_057_oRDR_DETECTION_057_060_oPCAN_RADAR_fd2af5b2_Tx: ComBitPosition=86, ComBitSize=1, ComSignalInitValue=0, ComSignalType=BOOLEAN, ComHandleId=1259, ComSystemTemplateSystemSignalRef=DET_HVC_FLAG_057
            DET_CONFD_ELEVATION_057_oRDR_DETECTION_057_060_oPCAN_RADAR_98388fe4_Tx: ComBitPosition=101, ComBitSize=2, ComSignalInitValue=0, ComSignalType=UINT8, ComHandleId=1243, ComSystemTemplateSystemSignalRef=DET_CONFD_ELEVATION_057
            DET_BI_STATIC_FLAG_060_oRDR_DETECTION_057_060_oPCAN_RADAR_c8b6d858_Tx: ComBitPosition=440, ComBitSize=1, ComSignalInitValue=0, ComSignalType=BOOLEAN, ComHandleId=1238, ComSystemTemplateSystemSignalRef=DET_BI_STATIC_FLAG_060
            DET_AZIMUTH_ERR_057_oRDR_DETECTION_057_060_oPCAN_RADAR_3cfe1121_Tx: ComBitPosition=105, ComBitSize=7, ComSignalInitValue=0, ComSignalType=UINT8, ComHandleId=1227, ComSystemTemplateSystemSignalRef=DET_AZIMUTH_ERR_057
            DET_RANGE_VELOCITY_ERR_058_oRDR_DETECTION_057_060_oPCAN_RADAR_dedd5cbf_Tx: ComBitPosition=176, ComBitSize=8, ComSignalInitValue=0, ComSignalType=UINT8, ComHandleId=1291, ComSystemTemplateSystemSignalRef=DET_RANGE_VELOCITY_ERR_058
            DET_RANGE_058_oRDR_DETECTION_057_060_oPCAN_RADAR_a4c06528_Tx: ComBitPosition=136, ComBitSize=15, ComSignalInitValue=0, ComSignalType=UINT16, ComHandleId=1279, ComSystemTemplateSystemSignalRef=DET_RANGE_058
            DET_AZIMUTH_ERR_059_oRDR_DETECTION_057_060_oPCAN_RADAR_859e57f3_Tx: ComBitPosition=329, ComBitSize=7, ComSignalInitValue=0, ComSignalType=UINT8, ComHandleId=1229, ComSystemTemplateSystemSignalRef=DET_AZIMUTH_ERR_059
            DET_MH_SCAN_INDEX_4LSB_057_060_oRDR_DETECTION_057_060_oPCAN_RADAR_4f6aad3a_Tx: ComBitPosition=476, ComBitSize=4, ComSignalInitValue=0, ComSignalType=UINT8, ComHandleId=1269, ComSystemTemplateSystemSignalRef=DET_MH_SCAN_INDEX_4LSB_057_060
            DET_AZIMUTH_ERR_058_oRDR_DETECTION_057_060_oPCAN_RADAR_10ee8366_Tx: ComBitPosition=217, ComBitSize=7, ComSignalInitValue=0, ComSignalType=UINT8, ComHandleId=1228, ComSystemTemplateSystemSignalRef=DET_AZIMUTH_ERR_058
            DET_RCS_059_oRDR_DETECTION_057_060_oPCAN_RADAR_c39644c2_Tx: ComBitPosition=352, ComBitSize=8, ComSignalInitValue=128, ComSignalType=UINT8, ComHandleId=1296, ComSystemTemplateSystemSignalRef=DET_RCS_059
            DET_EXISTENCE_PROB_057_oRDR_DETECTION_057_060_oPCAN_RADAR_1c5eb6cd_Tx: ComBitPosition=112, ComBitSize=6, ComSignalInitValue=0, ComSignalType=UINT8, ComHandleId=1255, ComSystemTemplateSystemSignalRef=DET_EXISTENCE_PROB_057
            DET_SNR_060_oRDR_DETECTION_057_060_oPCAN_RADAR_a1894a1b_Tx: ComBitPosition=456, ComBitSize=8, ComSignalInitValue=0, ComSignalType=UINT8, ComHandleId=1301, ComSystemTemplateSystemSignalRef=DET_SNR_060
            DET_EXISTENCE_PROB_059_oRDR_DETECTION_057_060_oPCAN_RADAR_a53ef01f_Tx: ComBitPosition=336, ComBitSize=6, ComSignalInitValue=0, ComSignalType=UINT8, ComHandleId=1257, ComSystemTemplateSystemSignalRef=DET_EXISTENCE_PROB_059
            DET_ELEVATION_058_oRDR_DETECTION_057_060_oPCAN_RADAR_65e8c99f_Tx: ComBitPosition=184, ComBitSize=8, ComSignalInitValue=0, ComSignalType=UINT8, ComHandleId=1248, ComSystemTemplateSystemSignalRef=DET_ELEVATION_058
            DET_RCS_057_oRDR_DETECTION_057_060_oPCAN_RADAR_7af60210_Tx: ComBitPosition=128, ComBitSize=8, ComSignalInitValue=128, ComSignalType=UINT8, ComHandleId=1294, ComSystemTemplateSystemSignalRef=DET_RCS_057
            DET_BI_STATIC_FLAG_057_oRDR_DETECTION_057_060_oPCAN_RADAR_ce67c451_Tx: ComBitPosition=104, ComBitSize=1, ComSignalInitValue=0, ComSignalType=BOOLEAN, ComHandleId=1235, ComSystemTemplateSystemSignalRef=DET_BI_STATIC_FLAG_057
            DET_RANGE_057_oRDR_DETECTION_057_060_oPCAN_RADAR_88d0f76f_Tx: ComBitPosition=24, ComBitSize=15, ComSignalInitValue=0, ComSignalType=UINT16, ComHandleId=1278, ComSystemTemplateSystemSignalRef=DET_RANGE_057
            DET_SUPER_RES_TARGET_059_oRDR_DETECTION_057_060_oPCAN_RADAR_2fa138a5_Tx: ComBitPosition=311, ComBitSize=1, ComSignalInitValue=0, ComSignalType=BOOLEAN, ComHandleId=1304, ComSystemTemplateSystemSignalRef=DET_SUPER_RES_TARGET_059
            DET_BI_STATIC_FLAG_059_oRDR_DETECTION_057_060_oPCAN_RADAR_77078283_Tx: ComBitPosition=328, ComBitSize=1, ComSignalInitValue=0, ComSignalType=BOOLEAN, ComHandleId=1237, ComSystemTemplateSystemSignalRef=DET_BI_STATIC_FLAG_059
            DET_ELEVATION_ERR_058_oRDR_DETECTION_057_060_oPCAN_RADAR_e2d151ea_Tx: ComBitPosition=192, ComBitSize=6, ComSignalInitValue=0, ComSignalType=UINT8, ComHandleId=1252, ComSystemTemplateSystemSignalRef=DET_ELEVATION_ERR_058
            DET_CONFD_ELEVATION_058_oRDR_DETECTION_057_060_oPCAN_RADAR_b4281da3_Tx: ComBitPosition=213, ComBitSize=2, ComSignalInitValue=0, ComSignalType=UINT8, ComHandleId=1244, ComSystemTemplateSystemSignalRef=DET_CONFD_ELEVATION_058
            DET_EXISTENCE_PROB_058_oRDR_DETECTION_057_060_oPCAN_RADAR_304e248a_Tx: ComBitPosition=224, ComBitSize=6, ComSignalInitValue=0, ComSignalType=UINT8, ComHandleId=1256, ComSystemTemplateSystemSignalRef=DET_EXISTENCE_PROB_058
            DET_AZIMUTH_060_oRDR_DETECTION_057_060_oPCAN_RADAR_9e9a98dd_Tx: ComBitPosition=424, ComBitSize=13, ComSignalInitValue=0, ComSignalType=UINT16, ComHandleId=1226, ComSystemTemplateSystemSignalRef=DET_AZIMUTH_060
            DET_HVC_FLAG_060_oRDR_DETECTION_057_060_oPCAN_RADAR_fbfbe9bb_Tx: ComBitPosition=422, ComBitSize=1, ComSignalInitValue=0, ComSignalType=BOOLEAN, ComHandleId=1262, ComSystemTemplateSystemSignalRef=DET_HVC_FLAG_060
            DET_SNR_057_oRDR_DETECTION_057_060_oPCAN_RADAR_a7585612_Tx: ComBitPosition=120, ComBitSize=8, ComSignalInitValue=0, ComSignalType=UINT8, ComHandleId=1298, ComSystemTemplateSystemSignalRef=DET_SNR_057
            DET_RANGE_ERR_059_oRDR_DETECTION_057_060_oPCAN_RADAR_96580bd4_Tx: ComBitPosition=264, ComBitSize=7, ComSignalInitValue=0, ComSignalType=UINT8, ComHandleId=1284, ComSystemTemplateSystemSignalRef=DET_RANGE_ERR_059
            DET_RANGE_VELOCITY_059_oRDR_DETECTION_057_060_oPCAN_RADAR_44167398_Tx: ComBitPosition=272, ComBitSize=15, ComSignalInitValue=16384, ComSignalType=UINT16, ComHandleId=1288, ComSystemTemplateSystemSignalRef=DET_RANGE_VELOCITY_059
            DET_RANGE_059_oRDR_DETECTION_057_060_oPCAN_RADAR_31b0b1bd_Tx: ComBitPosition=248, ComBitSize=15, ComSignalInitValue=0, ComSignalType=UINT16, ComHandleId=1280, ComSystemTemplateSystemSignalRef=DET_RANGE_059
            DET_CONFD_AZIMUTH_057_oRDR_DETECTION_057_060_oPCAN_RADAR_9aad8e1e_Tx: ComBitPosition=118, ComBitSize=2, ComSignalInitValue=0, ComSignalType=UINT8, ComHandleId=1239, ComSystemTemplateSystemSignalRef=DET_CONFD_AZIMUTH_057
            DET_MH_CRC16_057_060_oRDR_DETECTION_057_060_oPCAN_RADAR_07352981_Tx: ComBitPosition=0, ComBitSize=16, ComSignalInitValue=0, ComSignalType=UINT16, ComHandleId=1267, ComSystemTemplateSystemSignalRef=DET_MH_CRC16_057_060
            DET_RANGE_VELOCITY_060_oRDR_DETECTION_057_060_oPCAN_RADAR_fba72943_Tx: ComBitPosition=384, ComBitSize=15, ComSignalInitValue=16384, ComSignalType=UINT16, ComHandleId=1289, ComSystemTemplateSystemSignalRef=DET_RANGE_VELOCITY_060
            DET_RCS_058_oRDR_DETECTION_057_060_oPCAN_RADAR_56e69057_Tx: ComBitPosition=240, ComBitSize=8, ComSignalInitValue=128, ComSignalType=UINT8, ComHandleId=1295, ComSystemTemplateSystemSignalRef=DET_RCS_058
            DET_CONFD_AZIMUTH_058_oRDR_DETECTION_057_060_oPCAN_RADAR_b6bd1c59_Tx: ComBitPosition=230, ComBitSize=2, ComSignalInitValue=0, ComSignalType=UINT8, ComHandleId=1240, ComSystemTemplateSystemSignalRef=DET_CONFD_AZIMUTH_058
            DET_ELEVATION_ERR_059_oRDR_DETECTION_057_060_oPCAN_RADAR_77a1857f_Tx: ComBitPosition=304, ComBitSize=6, ComSignalInitValue=0, ComSignalType=UINT8, ComHandleId=1253, ComSystemTemplateSystemSignalRef=DET_ELEVATION_ERR_059
            DET_EXISTENCE_PROB_060_oRDR_DETECTION_057_060_oPCAN_RADAR_1a8faac4_Tx: ComBitPosition=448, ComBitSize=6, ComSignalInitValue=0, ComSignalType=UINT8, ComHandleId=1258, ComSystemTemplateSystemSignalRef=DET_EXISTENCE_PROB_060
            DET_RANGE_060_oRDR_DETECTION_057_060_oPCAN_RADAR_8e01eb66_Tx: ComBitPosition=360, ComBitSize=15, ComSignalInitValue=0, ComSignalType=UINT16, ComHandleId=1281, ComSystemTemplateSystemSignalRef=DET_RANGE_060
            DET_HVC_FLAG_058_oRDR_DETECTION_057_060_oPCAN_RADAR_d13a67f5_Tx: ComBitPosition=198, ComBitSize=1, ComSignalInitValue=0, ComSignalType=BOOLEAN, ComHandleId=1260, ComSystemTemplateSystemSignalRef=DET_HVC_FLAG_058
            DET_ELEVATION_060_oRDR_DETECTION_057_060_oPCAN_RADAR_4f2947d1_Tx: ComBitPosition=408, ComBitSize=8, ComSignalInitValue=0, ComSignalType=UINT8, ComHandleId=1250, ComSystemTemplateSystemSignalRef=DET_ELEVATION_060
            DET_RANGE_ERR_057_oRDR_DETECTION_057_060_oPCAN_RADAR_2f384d06_Tx: ComBitPosition=40, ComBitSize=7, ComSignalInitValue=0, ComSignalType=UINT8, ComHandleId=1282, ComSystemTemplateSystemSignalRef=DET_RANGE_ERR_057
            DET_RCS_060_oRDR_DETECTION_057_060_oPCAN_RADAR_7c271e19_Tx: ComBitPosition=464, ComBitSize=8, ComSignalInitValue=128, ComSignalType=UINT8, ComHandleId=1297, ComSystemTemplateSystemSignalRef=DET_RCS_060
            DET_CONFD_AZIMUTH_059_oRDR_DETECTION_057_060_oPCAN_RADAR_23cdc8cc_Tx: ComBitPosition=342, ComBitSize=2, ComSignalInitValue=0, ComSignalType=UINT8, ComHandleId=1241, ComSystemTemplateSystemSignalRef=DET_CONFD_AZIMUTH_059
            DET_BI_STATIC_FLAG_058_oRDR_DETECTION_057_060_oPCAN_RADAR_e2775616_Tx: ComBitPosition=216, ComBitSize=1, ComSignalInitValue=0, ComSignalType=BOOLEAN, ComHandleId=1236, ComSystemTemplateSystemSignalRef=DET_BI_STATIC_FLAG_058
            DET_ELEVATION_ERR_057_oRDR_DETECTION_057_060_oPCAN_RADAR_cec1c3ad_Tx: ComBitPosition=80, ComBitSize=6, ComSignalInitValue=0, ComSignalType=UINT8, ComHandleId=1251, ComSystemTemplateSystemSignalRef=DET_ELEVATION_ERR_057
            DET_AZIMUTH_ERR_060_oRDR_DETECTION_057_060_oPCAN_RADAR_3a2f0d28_Tx: ComBitPosition=441, ComBitSize=7, ComSignalInitValue=0, ComSignalType=UINT8, ComHandleId=1230, ComSystemTemplateSystemSignalRef=DET_AZIMUTH_ERR_060
            DET_CONFD_AZIMUTH_060_oRDR_DETECTION_057_060_oPCAN_RADAR_9c7c9217_Tx: ComBitPosition=454, ComBitSize=2, ComSignalInitValue=0, ComSignalType=UINT8, ComHandleId=1242, ComSystemTemplateSystemSignalRef=DET_CONFD_AZIMUTH_060
            DET_CONFD_ELEVATION_060_oRDR_DETECTION_057_060_oPCAN_RADAR_9ee993ed_Tx: ComBitPosition=437, ComBitSize=2, ComSignalInitValue=0, ComSignalType=UINT8, ComHandleId=1246, ComSystemTemplateSystemSignalRef=DET_CONFD_ELEVATION_060
            DET_RANGE_VELOCITY_ERR_057_oRDR_DETECTION_057_060_oPCAN_RADAR_f2cdcef8_Tx: ComBitPosition=64, ComBitSize=8, ComSignalInitValue=0, ComSignalType=UINT8, ComHandleId=1290, ComSystemTemplateSystemSignalRef=DET_RANGE_VELOCITY_ERR_057
            DET_CONFD_ELEVATION_059_oRDR_DETECTION_057_060_oPCAN_RADAR_2158c936_Tx: ComBitPosition=325, ComBitSize=2, ComSignalInitValue=0, ComSignalType=UINT8, ComHandleId=1245, ComSystemTemplateSystemSignalRef=DET_CONFD_ELEVATION_059
            DET_SNR_059_oRDR_DETECTION_057_060_oPCAN_RADAR_1e3810c0_Tx: ComBitPosition=344, ComBitSize=8, ComSignalInitValue=0, ComSignalType=UINT8, ComHandleId=1300, ComSystemTemplateSystemSignalRef=DET_SNR_059
            DET_RANGE_VELOCITY_058_oRDR_DETECTION_057_060_oPCAN_RADAR_d166a70d_Tx: ComBitPosition=160, ComBitSize=15, ComSignalInitValue=16384, ComSignalType=UINT16, ComHandleId=1287, ComSystemTemplateSystemSignalRef=DET_RANGE_VELOCITY_058
            DET_RANGE_VELOCITY_ERR_060_oRDR_DETECTION_057_060_oPCAN_RADAR_f41cd2f1_Tx: ComBitPosition=400, ComBitSize=8, ComSignalInitValue=0, ComSignalType=UINT8, ComHandleId=1293, ComSystemTemplateSystemSignalRef=DET_RANGE_VELOCITY_ERR_060
            DET_AZIMUTH_058_oRDR_DETECTION_057_060_oPCAN_RADAR_b45b1693_Tx: ComBitPosition=200, ComBitSize=13, ComSignalInitValue=0, ComSignalType=UINT16, ComHandleId=1224, ComSystemTemplateSystemSignalRef=DET_AZIMUTH_058
            DET_RANGE_ERR_058_oRDR_DETECTION_057_060_oPCAN_RADAR_0328df41_Tx: ComBitPosition=152, ComBitSize=7, ComSignalInitValue=0, ComSignalType=UINT8, ComHandleId=1283, ComSystemTemplateSystemSignalRef=DET_RANGE_ERR_058
            DET_RANGE_ERR_060_oRDR_DETECTION_057_060_oPCAN_RADAR_29e9510f_Tx: ComBitPosition=376, ComBitSize=7, ComSignalInitValue=0, ComSignalType=UINT8, ComHandleId=1285, ComSystemTemplateSystemSignalRef=DET_RANGE_ERR_060
            DET_RANGE_VELOCITY_057_oRDR_DETECTION_057_060_oPCAN_RADAR_fd76354a_Tx: ComBitPosition=48, ComBitSize=15, ComSignalInitValue=16384, ComSignalType=UINT16, ComHandleId=1286, ComSystemTemplateSystemSignalRef=DET_RANGE_VELOCITY_057
            DET_RANGE_VELOCITY_ERR_059_oRDR_DETECTION_057_060_oPCAN_RADAR_4bad882a_Tx: ComBitPosition=288, ComBitSize=8, ComSignalInitValue=0, ComSignalType=UINT8, ComHandleId=1292, ComSystemTemplateSystemSignalRef=DET_RANGE_VELOCITY_ERR_059
            DET_ELEVATION_057_oRDR_DETECTION_057_060_oPCAN_RADAR_49f85bd8_Tx: ComBitPosition=72, ComBitSize=8, ComSignalInitValue=0, ComSignalType=UINT8, ComHandleId=1247, ComSystemTemplateSystemSignalRef=DET_ELEVATION_057
            DET_ELEVATION_ERR_060_oRDR_DETECTION_057_060_oPCAN_RADAR_c810dfa4_Tx: ComBitPosition=416, ComBitSize=6, ComSignalInitValue=0, ComSignalType=UINT8, ComHandleId=1254, ComSystemTemplateSystemSignalRef=DET_ELEVATION_ERR_060
            DET_SUPER_RES_TARGET_058_oRDR_DETECTION_057_060_oPCAN_RADAR_bad1ec30_Tx: ComBitPosition=199, ComBitSize=1, ComSignalInitValue=0, ComSignalType=BOOLEAN, ComHandleId=1303, ComSystemTemplateSystemSignalRef=DET_SUPER_RES_TARGET_058
            DET_SUPER_RES_TARGET_060_oRDR_DETECTION_057_060_oPCAN_RADAR_9010627e_Tx: ComBitPosition=423, ComBitSize=1, ComSignalInitValue=0, ComSignalType=BOOLEAN, ComHandleId=1305, ComSystemTemplateSystemSignalRef=DET_SUPER_RES_TARGET_060
            DET_SNR_058_oRDR_DETECTION_057_060_oPCAN_RADAR_8b48c455_Tx: ComBitPosition=232, ComBitSize=8, ComSignalInitValue=0, ComSignalType=UINT8, ComHandleId=1299, ComSystemTemplateSystemSignalRef=DET_SNR_058
            DET_HVC_FLAG_059_oRDR_DETECTION_057_060_oPCAN_RADAR_444ab360_Tx: ComBitPosition=310, ComBitSize=1, ComSignalInitValue=0, ComSignalType=BOOLEAN, ComHandleId=1261, ComSystemTemplateSystemSignalRef=DET_HVC_FLAG_059
            DET_MH_CYCLE_COUNTER_057_060_oRDR_DETECTION_057_060_oPCAN_RADAR_834088b6_Tx: ComBitPosition=16, ComBitSize=8, ComSignalInitValue=0, ComSignalType=UINT8, ComHandleId=1268, ComSystemTemplateSystemSignalRef=DET_MH_CYCLE_COUNTER_057_060
            DET_AZIMUTH_059_oRDR_DETECTION_057_060_oPCAN_RADAR_212bc206_Tx: ComBitPosition=312, ComBitSize=13, ComSignalInitValue=0, ComSignalType=UINT16, ComHandleId=1225, ComSystemTemplateSystemSignalRef=DET_AZIMUTH_059
            DET_ELEVATION_059_oRDR_DETECTION_057_060_oPCAN_RADAR_f0981d0a_Tx: ComBitPosition=296, ComBitSize=8, ComSignalInitValue=0, ComSignalType=UINT8, ComHandleId=1249, ComSystemTemplateSystemSignalRef=DET_ELEVATION_059
            DET_SUPER_RES_TARGET_057_oRDR_DETECTION_057_060_oPCAN_RADAR_96c17e77_Tx: ComBitPosition=87, ComBitSize=1, ComSignalInitValue=0, ComSignalType=BOOLEAN, ComHandleId=1302, ComSystemTemplateSystemSignalRef=DET_SUPER_RES_TARGET_057
            DET_AZIMUTH_057_oRDR_DETECTION_057_060_oPCAN_RADAR_984b84d4_Tx: ComBitPosition=88, ComBitSize=13, ComSignalInitValue=0, ComSignalType=UINT16, ComHandleId=1223, ComSystemTemplateSystemSignalRef=DET_AZIMUTH_057
            DET_IDM_058_oRDR_DETECTION_057_060_oPCAN_RADAR_5a685c48_Tx: ComBitPosition=175, ComBitSize=1, ComSignalInitValue=0, ComSignalType=UINT8, ComHandleId=1264, ComSystemTemplateSystemSignalRef=DET_IDM_058
            DET_BELOW_RAIN_THOLD_059_oRDR_DETECTION_057_060_oPCAN_RADAR_f42a51c6_Tx: ComBitPosition=263, ComBitSize=1, ComSignalInitValue=0, ComSignalType=UINT8, ComHandleId=1233, ComSystemTemplateSystemSignalRef=DET_BELOW_RAIN_THOLD_059
            DET_MTD_057_oRDR_DETECTION_057_060_oPCAN_RADAR_10cbfcd4_Tx: ComBitPosition=47, ComBitSize=1, ComSignalInitValue=0, ComSignalType=UINT8, ComHandleId=1270, ComSystemTemplateSystemSignalRef=DET_MTD_057
            DET_IDM_057_oRDR_DETECTION_057_060_oPCAN_RADAR_7678ce0f_Tx: ComBitPosition=63, ComBitSize=1, ComSignalInitValue=0, ComSignalType=UINT8, ComHandleId=1263, ComSystemTemplateSystemSignalRef=DET_IDM_057
            DET_BELOW_RAIN_THOLD_058_oRDR_DETECTION_057_060_oPCAN_RADAR_615a8553_Tx: ComBitPosition=151, ComBitSize=1, ComSignalInitValue=0, ComSignalType=UINT8, ComHandleId=1232, ComSystemTemplateSystemSignalRef=DET_BELOW_RAIN_THOLD_058
            DET_MTD_058_oRDR_DETECTION_057_060_oPCAN_RADAR_3cdb6e93_Tx: ComBitPosition=159, ComBitSize=1, ComSignalInitValue=0, ComSignalType=UINT8, ComHandleId=1271, ComSystemTemplateSystemSignalRef=DET_MTD_058
            DET_MTD_059_oRDR_DETECTION_057_060_oPCAN_RADAR_a9abba06_Tx: ComBitPosition=271, ComBitSize=1, ComSignalInitValue=0, ComSignalType=UINT8, ComHandleId=1272, ComSystemTemplateSystemSignalRef=DET_MTD_059
            DET_PROB_1STAZHYPO_060_oRDR_DETECTION_057_060_oPCAN_RADAR_85ae0810_Tx: ComBitPosition=439, ComBitSize=1, ComSignalInitValue=0, ComSignalType=BOOLEAN, ComHandleId=1277, ComSystemTemplateSystemSignalRef=DET_PROB_1STAZHYPO_060
            DET_PROB_1STAZHYPO_059_oRDR_DETECTION_057_060_oPCAN_RADAR_3a1f52cb_Tx: ComBitPosition=327, ComBitSize=1, ComSignalInitValue=0, ComSignalType=BOOLEAN, ComHandleId=1276, ComSystemTemplateSystemSignalRef=DET_PROB_1STAZHYPO_059
            DET_PROB_1STAZHYPO_057_oRDR_DETECTION_057_060_oPCAN_RADAR_837f1419_Tx: ComBitPosition=103, ComBitSize=1, ComSignalInitValue=0, ComSignalType=BOOLEAN, ComHandleId=1274, ComSystemTemplateSystemSignalRef=DET_PROB_1STAZHYPO_057
            DET_BELOW_RAIN_THOLD_060_oRDR_DETECTION_057_060_oPCAN_RADAR_4b9b0b1d_Tx: ComBitPosition=375, ComBitSize=1, ComSignalInitValue=0, ComSignalType=UINT8, ComHandleId=1234, ComSystemTemplateSystemSignalRef=DET_BELOW_RAIN_THOLD_060
            DET_IDM_060_oRDR_DETECTION_057_060_oPCAN_RADAR_70a9d206_Tx: ComBitPosition=399, ComBitSize=1, ComSignalInitValue=0, ComSignalType=UINT8, ComHandleId=1266, ComSystemTemplateSystemSignalRef=DET_IDM_060
            DET_MTD_060_oRDR_DETECTION_057_060_oPCAN_RADAR_161ae0dd_Tx: ComBitPosition=383, ComBitSize=1, ComSignalInitValue=0, ComSignalType=UINT8, ComHandleId=1273, ComSystemTemplateSystemSignalRef=DET_MTD_060
            DET_IDM_059_oRDR_DETECTION_057_060_oPCAN_RADAR_cf1888dd_Tx: ComBitPosition=287, ComBitSize=1, ComSignalInitValue=0, ComSignalType=UINT8, ComHandleId=1265, ComSystemTemplateSystemSignalRef=DET_IDM_059
            DET_PROB_1STAZHYPO_058_oRDR_DETECTION_057_060_oPCAN_RADAR_af6f865e_Tx: ComBitPosition=215, ComBitSize=1, ComSignalInitValue=0, ComSignalType=BOOLEAN, ComHandleId=1275, ComSystemTemplateSystemSignalRef=DET_PROB_1STAZHYPO_058
            DET_BELOW_RAIN_THOLD_057_oRDR_DETECTION_057_060_oPCAN_RADAR_4d4a1714_Tx: ComBitPosition=39, ComBitSize=1, ComSignalInitValue=0, ComSignalType=UINT8, ComHandleId=1231, ComSystemTemplateSystemSignalRef=DET_BELOW_RAIN_THOLD_057
        SG_Detections_157_160_oRDR_DETECTION_157_160_oPCAN_RADAR_c115d936_Tx: ComTransferProperty=TRIGGERED, ComHandleId=41, ComSystemTemplateSignalGroupRef=SG_Detections_157_160
          83 x ComGroupSignal, all with ComSignalEndianness=LITTLE_ENDIAN, ComTransferProperty=PENDING, ComSignalAccess=ACCESS_NEEDED_BY_SWC_OR_COM:
            DET_HVC_FLAG_158_oRDR_DETECTION_157_160_oPCAN_RADAR_32abc1a7_Tx: ComBitPosition=198, ComBitSize=1, ComSignalInitValue=0, ComSignalType=BOOLEAN, ComHandleId=3335, ComSystemTemplateSystemSignalRef=DET_HVC_FLAG_158
            DET_EXISTENCE_PROB_158_oRDR_DETECTION_157_160_oPCAN_RADAR_d3df82d8_Tx: ComBitPosition=224, ComBitSize=6, ComSignalInitValue=0, ComSignalType=UINT8, ComHandleId=3331, ComSystemTemplateSystemSignalRef=DET_EXISTENCE_PROB_158
            DET_SUPER_RES_TARGET_157_oRDR_DETECTION_157_160_oPCAN_RADAR_7550d825_Tx: ComBitPosition=87, ComBitSize=1, ComSignalInitValue=0, ComSignalType=BOOLEAN, ComHandleId=3377, ComSystemTemplateSystemSignalRef=DET_SUPER_RES_TARGET_157
            DET_CONFD_AZIMUTH_158_oRDR_DETECTION_157_160_oPCAN_RADAR_552cba0b_Tx: ComBitPosition=230, ComBitSize=2, ComSignalInitValue=0, ComSignalType=UINT8, ComHandleId=3315, ComSystemTemplateSystemSignalRef=DET_CONFD_AZIMUTH_158
            DET_SNR_159_oRDR_DETECTION_157_160_oPCAN_RADAR_fda9b692_Tx: ComBitPosition=344, ComBitSize=8, ComSignalInitValue=0, ComSignalType=UINT8, ComHandleId=3375, ComSystemTemplateSystemSignalRef=DET_SNR_159
            DET_RANGE_ERR_159_oRDR_DETECTION_157_160_oPCAN_RADAR_75c9ad86_Tx: ComBitPosition=264, ComBitSize=7, ComSignalInitValue=0, ComSignalType=UINT8, ComHandleId=3359, ComSystemTemplateSystemSignalRef=DET_RANGE_ERR_159
            DET_RANGE_VELOCITY_160_oRDR_DETECTION_157_160_oPCAN_RADAR_18368f11_Tx: ComBitPosition=384, ComBitSize=15, ComSignalInitValue=16384, ComSignalType=UINT16, ComHandleId=3364, ComSystemTemplateSystemSignalRef=DET_RANGE_VELOCITY_160
            DET_RANGE_VELOCITY_ERR_158_oRDR_DETECTION_157_160_oPCAN_RADAR_3d4cfaed_Tx: ComBitPosition=176, ComBitSize=8, ComSignalInitValue=0, ComSignalType=UINT8, ComHandleId=3366, ComSystemTemplateSystemSignalRef=DET_RANGE_VELOCITY_ERR_158
            DET_ELEVATION_ERR_157_oRDR_DETECTION_157_160_oPCAN_RADAR_2d5065ff_Tx: ComBitPosition=80, ComBitSize=6, ComSignalInitValue=0, ComSignalType=UINT8, ComHandleId=3326, ComSystemTemplateSystemSignalRef=DET_ELEVATION_ERR_157
            DET_RANGE_VELOCITY_ERR_157_oRDR_DETECTION_157_160_oPCAN_RADAR_115c68aa_Tx: ComBitPosition=64, ComBitSize=8, ComSignalInitValue=0, ComSignalType=UINT8, ComHandleId=3365, ComSystemTemplateSystemSignalRef=DET_RANGE_VELOCITY_ERR_157
            DET_RANGE_VELOCITY_158_oRDR_DETECTION_157_160_oPCAN_RADAR_32f7015f_Tx: ComBitPosition=160, ComBitSize=15, ComSignalInitValue=16384, ComSignalType=UINT16, ComHandleId=3362, ComSystemTemplateSystemSignalRef=DET_RANGE_VELOCITY_158
            DET_RCS_159_oRDR_DETECTION_157_160_oPCAN_RADAR_2007e290_Tx: ComBitPosition=352, ComBitSize=8, ComSignalInitValue=128, ComSignalType=UINT8, ComHandleId=3371, ComSystemTemplateSystemSignalRef=DET_RCS_159
            DET_RANGE_VELOCITY_ERR_159_oRDR_DETECTION_157_160_oPCAN_RADAR_a83c2e78_Tx: ComBitPosition=288, ComBitSize=8, ComSignalInitValue=0, ComSignalType=UINT8, ComHandleId=3367, ComSystemTemplateSystemSignalRef=DET_RANGE_VELOCITY_ERR_159
            DET_BI_STATIC_FLAG_159_oRDR_DETECTION_157_160_oPCAN_RADAR_949624d1_Tx: ComBitPosition=328, ComBitSize=1, ComSignalInitValue=0, ComSignalType=BOOLEAN, ComHandleId=3312, ComSystemTemplateSystemSignalRef=DET_BI_STATIC_FLAG_159
            DET_AZIMUTH_ERR_157_oRDR_DETECTION_157_160_oPCAN_RADAR_df6fb773_Tx: ComBitPosition=105, ComBitSize=7, ComSignalInitValue=0, ComSignalType=UINT8, ComHandleId=3302, ComSystemTemplateSystemSignalRef=DET_AZIMUTH_ERR_157
            DET_HVC_FLAG_159_oRDR_DETECTION_157_160_oPCAN_RADAR_a7db1532_Tx: ComBitPosition=310, ComBitSize=1, ComSignalInitValue=0, ComSignalType=BOOLEAN, ComHandleId=3336, ComSystemTemplateSystemSignalRef=DET_HVC_FLAG_159
            DET_ELEVATION_160_oRDR_DETECTION_157_160_oPCAN_RADAR_acb8e183_Tx: ComBitPosition=408, ComBitSize=8, ComSignalInitValue=0, ComSignalType=UINT8, ComHandleId=3325, ComSystemTemplateSystemSignalRef=DET_ELEVATION_160
            DET_SUPER_RES_TARGET_158_oRDR_DETECTION_157_160_oPCAN_RADAR_59404a62_Tx: ComBitPosition=199, ComBitSize=1, ComSignalInitValue=0, ComSignalType=BOOLEAN, ComHandleId=3378, ComSystemTemplateSystemSignalRef=DET_SUPER_RES_TARGET_158
            DET_AZIMUTH_ERR_159_oRDR_DETECTION_157_160_oPCAN_RADAR_660ff1a1_Tx: ComBitPosition=329, ComBitSize=7, ComSignalInitValue=0, ComSignalType=UINT8, ComHandleId=3304, ComSystemTemplateSystemSignalRef=DET_AZIMUTH_ERR_159
            DET_AZIMUTH_ERR_158_oRDR_DETECTION_157_160_oPCAN_RADAR_f37f2534_Tx: ComBitPosition=217, ComBitSize=7, ComSignalInitValue=0, ComSignalType=UINT8, ComHandleId=3303, ComSystemTemplateSystemSignalRef=DET_AZIMUTH_ERR_158
            DET_CONFD_AZIMUTH_157_oRDR_DETECTION_157_160_oPCAN_RADAR_793c284c_Tx: ComBitPosition=118, ComBitSize=2, ComSignalInitValue=0, ComSignalType=UINT8, ComHandleId=3314, ComSystemTemplateSystemSignalRef=DET_CONFD_AZIMUTH_157
            DET_BI_STATIC_FLAG_158_oRDR_DETECTION_157_160_oPCAN_RADAR_01e6f044_Tx: ComBitPosition=216, ComBitSize=1, ComSignalInitValue=0, ComSignalType=BOOLEAN, ComHandleId=3311, ComSystemTemplateSystemSignalRef=DET_BI_STATIC_FLAG_158
            DET_MH_CYCLE_COUNTER_157_160_oRDR_DETECTION_157_160_oPCAN_RADAR_c1e8aa0a_Tx: ComBitPosition=16, ComBitSize=8, ComSignalInitValue=0, ComSignalType=UINT8, ComHandleId=3343, ComSystemTemplateSystemSignalRef=DET_MH_CYCLE_COUNTER_157_160
            DET_SNR_158_oRDR_DETECTION_157_160_oPCAN_RADAR_68d96207_Tx: ComBitPosition=232, ComBitSize=8, ComSignalInitValue=0, ComSignalType=UINT8, ComHandleId=3374, ComSystemTemplateSystemSignalRef=DET_SNR_158
            DET_RANGE_ERR_158_oRDR_DETECTION_157_160_oPCAN_RADAR_e0b97913_Tx: ComBitPosition=152, ComBitSize=7, ComSignalInitValue=0, ComSignalType=UINT8, ComHandleId=3358, ComSystemTemplateSystemSignalRef=DET_RANGE_ERR_158
            DET_SUPER_RES_TARGET_159_oRDR_DETECTION_157_160_oPCAN_RADAR_cc309ef7_Tx: ComBitPosition=311, ComBitSize=1, ComSignalInitValue=0, ComSignalType=BOOLEAN, ComHandleId=3379, ComSystemTemplateSystemSignalRef=DET_SUPER_RES_TARGET_159
            DET_AZIMUTH_157_oRDR_DETECTION_157_160_oPCAN_RADAR_7bda2286_Tx: ComBitPosition=88, ComBitSize=13, ComSignalInitValue=0, ComSignalType=UINT16, ComHandleId=3298, ComSystemTemplateSystemSignalRef=DET_AZIMUTH_157
            DET_AZIMUTH_160_oRDR_DETECTION_157_160_oPCAN_RADAR_7d0b3e8f_Tx: ComBitPosition=424, ComBitSize=13, ComSignalInitValue=0, ComSignalType=UINT16, ComHandleId=3301, ComSystemTemplateSystemSignalRef=DET_AZIMUTH_160
            DET_AZIMUTH_159_oRDR_DETECTION_157_160_oPCAN_RADAR_c2ba6454_Tx: ComBitPosition=312, ComBitSize=13, ComSignalInitValue=0, ComSignalType=UINT16, ComHandleId=3300, ComSystemTemplateSystemSignalRef=DET_AZIMUTH_159
            DET_BI_STATIC_FLAG_157_oRDR_DETECTION_157_160_oPCAN_RADAR_2df66203_Tx: ComBitPosition=104, ComBitSize=1, ComSignalInitValue=0, ComSignalType=BOOLEAN, ComHandleId=3310, ComSystemTemplateSystemSignalRef=DET_BI_STATIC_FLAG_157
            DET_CONFD_AZIMUTH_159_oRDR_DETECTION_157_160_oPCAN_RADAR_c05c6e9e_Tx: ComBitPosition=342, ComBitSize=2, ComSignalInitValue=0, ComSignalType=UINT8, ComHandleId=3316, ComSystemTemplateSystemSignalRef=DET_CONFD_AZIMUTH_159
            DET_ELEVATION_ERR_158_oRDR_DETECTION_157_160_oPCAN_RADAR_0140f7b8_Tx: ComBitPosition=192, ComBitSize=6, ComSignalInitValue=0, ComSignalType=UINT8, ComHandleId=3327, ComSystemTemplateSystemSignalRef=DET_ELEVATION_ERR_158
            DET_CONFD_ELEVATION_157_oRDR_DETECTION_157_160_oPCAN_RADAR_7ba929b6_Tx: ComBitPosition=101, ComBitSize=2, ComSignalInitValue=0, ComSignalType=UINT8, ComHandleId=3318, ComSystemTemplateSystemSignalRef=DET_CONFD_ELEVATION_157
            DET_ELEVATION_158_oRDR_DETECTION_157_160_oPCAN_RADAR_86796fcd_Tx: ComBitPosition=184, ComBitSize=8, ComSignalInitValue=0, ComSignalType=UINT8, ComHandleId=3323, ComSystemTemplateSystemSignalRef=DET_ELEVATION_158
            DET_RCS_160_oRDR_DETECTION_157_160_oPCAN_RADAR_9fb6b84b_Tx: ComBitPosition=464, ComBitSize=8, ComSignalInitValue=128, ComSignalType=UINT8, ComHandleId=3372, ComSystemTemplateSystemSignalRef=DET_RCS_160
            DET_RANGE_VELOCITY_157_oRDR_DETECTION_157_160_oPCAN_RADAR_1ee79318_Tx: ComBitPosition=48, ComBitSize=15, ComSignalInitValue=16384, ComSignalType=UINT16, ComHandleId=3361, ComSystemTemplateSystemSignalRef=DET_RANGE_VELOCITY_157
            DET_RCS_158_oRDR_DETECTION_157_160_oPCAN_RADAR_b5773605_Tx: ComBitPosition=240, ComBitSize=8, ComSignalInitValue=128, ComSignalType=UINT8, ComHandleId=3370, ComSystemTemplateSystemSignalRef=DET_RCS_158
            DET_CONFD_ELEVATION_158_oRDR_DETECTION_157_160_oPCAN_RADAR_57b9bbf1_Tx: ComBitPosition=213, ComBitSize=2, ComSignalInitValue=0, ComSignalType=UINT8, ComHandleId=3319, ComSystemTemplateSystemSignalRef=DET_CONFD_ELEVATION_158
            DET_SNR_160_oRDR_DETECTION_157_160_oPCAN_RADAR_4218ec49_Tx: ComBitPosition=456, ComBitSize=8, ComSignalInitValue=0, ComSignalType=UINT8, ComHandleId=3376, ComSystemTemplateSystemSignalRef=DET_SNR_160
            DET_ELEVATION_ERR_160_oRDR_DETECTION_157_160_oPCAN_RADAR_2b8179f6_Tx: ComBitPosition=416, ComBitSize=6, ComSignalInitValue=0, ComSignalType=UINT8, ComHandleId=3329, ComSystemTemplateSystemSignalRef=DET_ELEVATION_ERR_160
            DET_RANGE_VELOCITY_ERR_160_oRDR_DETECTION_157_160_oPCAN_RADAR_178d74a3_Tx: ComBitPosition=400, ComBitSize=8, ComSignalInitValue=0, ComSignalType=UINT8, ComHandleId=3368, ComSystemTemplateSystemSignalRef=DET_RANGE_VELOCITY_ERR_160
            DET_ELEVATION_159_oRDR_DETECTION_157_160_oPCAN_RADAR_1309bb58_Tx: ComBitPosition=296, ComBitSize=8, ComSignalInitValue=0, ComSignalType=UINT8, ComHandleId=3324, ComSystemTemplateSystemSignalRef=DET_ELEVATION_159
            DET_EXISTENCE_PROB_157_oRDR_DETECTION_157_160_oPCAN_RADAR_ffcf109f_Tx: ComBitPosition=112, ComBitSize=6, ComSignalInitValue=0, ComSignalType=UINT8, ComHandleId=3330, ComSystemTemplateSystemSignalRef=DET_EXISTENCE_PROB_157
            DET_SNR_157_oRDR_DETECTION_157_160_oPCAN_RADAR_44c9f040_Tx: ComBitPosition=120, ComBitSize=8, ComSignalInitValue=0, ComSignalType=UINT8, ComHandleId=3373, ComSystemTemplateSystemSignalRef=DET_SNR_157
            DET_RANGE_158_oRDR_DETECTION_157_160_oPCAN_RADAR_4751c37a_Tx: ComBitPosition=136, ComBitSize=15, ComSignalInitValue=0, ComSignalType=UINT16, ComHandleId=3354, ComSystemTemplateSystemSignalRef=DET_RANGE_158
            DET_HVC_FLAG_160_oRDR_DETECTION_157_160_oPCAN_RADAR_186a4fe9_Tx: ComBitPosition=422, ComBitSize=1, ComSignalInitValue=0, ComSignalType=BOOLEAN, ComHandleId=3337, ComSystemTemplateSystemSignalRef=DET_HVC_FLAG_160
            DET_AZIMUTH_158_oRDR_DETECTION_157_160_oPCAN_RADAR_57cab0c1_Tx: ComBitPosition=200, ComBitSize=13, ComSignalInitValue=0, ComSignalType=UINT16, ComHandleId=3299, ComSystemTemplateSystemSignalRef=DET_AZIMUTH_158
            DET_HVC_FLAG_157_oRDR_DETECTION_157_160_oPCAN_RADAR_1ebb53e0_Tx: ComBitPosition=86, ComBitSize=1, ComSignalInitValue=0, ComSignalType=BOOLEAN, ComHandleId=3334, ComSystemTemplateSystemSignalRef=DET_HVC_FLAG_157
            DET_CONFD_ELEVATION_160_oRDR_DETECTION_157_160_oPCAN_RADAR_7d7835bf_Tx: ComBitPosition=437, ComBitSize=2, ComSignalInitValue=0, ComSignalType=UINT8, ComHandleId=3321, ComSystemTemplateSystemSignalRef=DET_CONFD_ELEVATION_160
            DET_ELEVATION_ERR_159_oRDR_DETECTION_157_160_oPCAN_RADAR_9430232d_Tx: ComBitPosition=304, ComBitSize=6, ComSignalInitValue=0, ComSignalType=UINT8, ComHandleId=3328, ComSystemTemplateSystemSignalRef=DET_ELEVATION_ERR_159
            DET_RANGE_157_oRDR_DETECTION_157_160_oPCAN_RADAR_6b41513d_Tx: ComBitPosition=24, ComBitSize=15, ComSignalInitValue=0, ComSignalType=UINT16, ComHandleId=3353, ComSystemTemplateSystemSignalRef=DET_RANGE_157
            DET_CONFD_AZIMUTH_160_oRDR_DETECTION_157_160_oPCAN_RADAR_7fed3445_Tx: ComBitPosition=454, ComBitSize=2, ComSignalInitValue=0, ComSignalType=UINT8, ComHandleId=3317, ComSystemTemplateSystemSignalRef=DET_CONFD_AZIMUTH_160
            DET_RANGE_ERR_160_oRDR_DETECTION_157_160_oPCAN_RADAR_ca78f75d_Tx: ComBitPosition=376, ComBitSize=7, ComSignalInitValue=0, ComSignalType=UINT8, ComHandleId=3360, ComSystemTemplateSystemSignalRef=DET_RANGE_ERR_160
            DET_BI_STATIC_FLAG_160_oRDR_DETECTION_157_160_oPCAN_RADAR_2b277e0a_Tx: ComBitPosition=440, ComBitSize=1, ComSignalInitValue=0, ComSignalType=BOOLEAN, ComHandleId=3313, ComSystemTemplateSystemSignalRef=DET_BI_STATIC_FLAG_160
            DET_EXISTENCE_PROB_159_oRDR_DETECTION_157_160_oPCAN_RADAR_46af564d_Tx: ComBitPosition=336, ComBitSize=6, ComSignalInitValue=0, ComSignalType=UINT8, ComHandleId=3332, ComSystemTemplateSystemSignalRef=DET_EXISTENCE_PROB_159
            DET_MH_SCAN_INDEX_4LSB_157_160_oRDR_DETECTION_157_160_oPCAN_RADAR_0dc28f86_Tx: ComBitPosition=476, ComBitSize=4, ComSignalInitValue=0, ComSignalType=UINT8, ComHandleId=3344, ComSystemTemplateSystemSignalRef=DET_MH_SCAN_INDEX_4LSB_157_160
            DET_SUPER_RES_TARGET_160_oRDR_DETECTION_157_160_oPCAN_RADAR_7381c42c_Tx: ComBitPosition=423, ComBitSize=1, ComSignalInitValue=0, ComSignalType=BOOLEAN, ComHandleId=3380, ComSystemTemplateSystemSignalRef=DET_SUPER_RES_TARGET_160
            DET_RCS_157_oRDR_DETECTION_157_160_oPCAN_RADAR_9967a442_Tx: ComBitPosition=128, ComBitSize=8, ComSignalInitValue=128, ComSignalType=UINT8, ComHandleId=3369, ComSystemTemplateSystemSignalRef=DET_RCS_157
            DET_RANGE_VELOCITY_159_oRDR_DETECTION_157_160_oPCAN_RADAR_a787d5ca_Tx: ComBitPosition=272, ComBitSize=15, ComSignalInitValue=16384, ComSignalType=UINT16, ComHandleId=3363, ComSystemTemplateSystemSignalRef=DET_RANGE_VELOCITY_159
            DET_RANGE_160_oRDR_DETECTION_157_160_oPCAN_RADAR_6d904d34_Tx: ComBitPosition=360, ComBitSize=15, ComSignalInitValue=0, ComSignalType=UINT16, ComHandleId=3356, ComSystemTemplateSystemSignalRef=DET_RANGE_160
            DET_RANGE_ERR_157_oRDR_DETECTION_157_160_oPCAN_RADAR_cca9eb54_Tx: ComBitPosition=40, ComBitSize=7, ComSignalInitValue=0, ComSignalType=UINT8, ComHandleId=3357, ComSystemTemplateSystemSignalRef=DET_RANGE_ERR_157
            DET_EXISTENCE_PROB_160_oRDR_DETECTION_157_160_oPCAN_RADAR_f91e0c96_Tx: ComBitPosition=448, ComBitSize=6, ComSignalInitValue=0, ComSignalType=UINT8, ComHandleId=3333, ComSystemTemplateSystemSignalRef=DET_EXISTENCE_PROB_160
            DET_MH_CRC16_157_160_oRDR_DETECTION_157_160_oPCAN_RADAR_459d0b3d_Tx: ComBitPosition=0, ComBitSize=16, ComSignalInitValue=0, ComSignalType=UINT16, ComHandleId=3342, ComSystemTemplateSystemSignalRef=DET_MH_CRC16_157_160
            DET_AZIMUTH_ERR_160_oRDR_DETECTION_157_160_oPCAN_RADAR_d9beab7a_Tx: ComBitPosition=441, ComBitSize=7, ComSignalInitValue=0, ComSignalType=UINT8, ComHandleId=3305, ComSystemTemplateSystemSignalRef=DET_AZIMUTH_ERR_160
            DET_ELEVATION_157_oRDR_DETECTION_157_160_oPCAN_RADAR_aa69fd8a_Tx: ComBitPosition=72, ComBitSize=8, ComSignalInitValue=0, ComSignalType=UINT8, ComHandleId=3322, ComSystemTemplateSystemSignalRef=DET_ELEVATION_157
            DET_CONFD_ELEVATION_159_oRDR_DETECTION_157_160_oPCAN_RADAR_c2c96f64_Tx: ComBitPosition=325, ComBitSize=2, ComSignalInitValue=0, ComSignalType=UINT8, ComHandleId=3320, ComSystemTemplateSystemSignalRef=DET_CONFD_ELEVATION_159
            DET_RANGE_159_oRDR_DETECTION_157_160_oPCAN_RADAR_d22117ef_Tx: ComBitPosition=248, ComBitSize=15, ComSignalInitValue=0, ComSignalType=UINT16, ComHandleId=3355, ComSystemTemplateSystemSignalRef=DET_RANGE_159
            DET_BELOW_RAIN_THOLD_158_oRDR_DETECTION_157_160_oPCAN_RADAR_82cb2301_Tx: ComBitPosition=151, ComBitSize=1, ComSignalInitValue=0, ComSignalType=UINT8, ComHandleId=3307, ComSystemTemplateSystemSignalRef=DET_BELOW_RAIN_THOLD_158
            DET_BELOW_RAIN_THOLD_160_oRDR_DETECTION_157_160_oPCAN_RADAR_a80aad4f_Tx: ComBitPosition=375, ComBitSize=1, ComSignalInitValue=0, ComSignalType=UINT8, ComHandleId=3309, ComSystemTemplateSystemSignalRef=DET_BELOW_RAIN_THOLD_160
            DET_BELOW_RAIN_THOLD_157_oRDR_DETECTION_157_160_oPCAN_RADAR_aedbb146_Tx: ComBitPosition=39, ComBitSize=1, ComSignalInitValue=0, ComSignalType=UINT8, ComHandleId=3306, ComSystemTemplateSystemSignalRef=DET_BELOW_RAIN_THOLD_157
            DET_PROB_1STAZHYPO_159_oRDR_DETECTION_157_160_oPCAN_RADAR_d98ef499_Tx: ComBitPosition=327, ComBitSize=1, ComSignalInitValue=0, ComSignalType=BOOLEAN, ComHandleId=3351, ComSystemTemplateSystemSignalRef=DET_PROB_1STAZHYPO_159
            DET_IDM_159_oRDR_DETECTION_157_160_oPCAN_RADAR_2c892e8f_Tx: ComBitPosition=287, ComBitSize=1, ComSignalInitValue=0, ComSignalType=UINT8, ComHandleId=3340, ComSystemTemplateSystemSignalRef=DET_IDM_159
            DET_MTD_158_oRDR_DETECTION_157_160_oPCAN_RADAR_df4ac8c1_Tx: ComBitPosition=159, ComBitSize=1, ComSignalInitValue=0, ComSignalType=UINT8, ComHandleId=3346, ComSystemTemplateSystemSignalRef=DET_MTD_158
            DET_IDM_157_oRDR_DETECTION_157_160_oPCAN_RADAR_95e9685d_Tx: ComBitPosition=63, ComBitSize=1, ComSignalInitValue=0, ComSignalType=UINT8, ComHandleId=3338, ComSystemTemplateSystemSignalRef=DET_IDM_157
            DET_PROB_1STAZHYPO_157_oRDR_DETECTION_157_160_oPCAN_RADAR_60eeb24b_Tx: ComBitPosition=103, ComBitSize=1, ComSignalInitValue=0, ComSignalType=BOOLEAN, ComHandleId=3349, ComSystemTemplateSystemSignalRef=DET_PROB_1STAZHYPO_157
            DET_MTD_157_oRDR_DETECTION_157_160_oPCAN_RADAR_f35a5a86_Tx: ComBitPosition=47, ComBitSize=1, ComSignalInitValue=0, ComSignalType=UINT8, ComHandleId=3345, ComSystemTemplateSystemSignalRef=DET_MTD_157
            DET_IDM_158_oRDR_DETECTION_157_160_oPCAN_RADAR_b9f9fa1a_Tx: ComBitPosition=175, ComBitSize=1, ComSignalInitValue=0, ComSignalType=UINT8, ComHandleId=3339, ComSystemTemplateSystemSignalRef=DET_IDM_158
            DET_MTD_160_oRDR_DETECTION_157_160_oPCAN_RADAR_f58b468f_Tx: ComBitPosition=383, ComBitSize=1, ComSignalInitValue=0, ComSignalType=UINT8, ComHandleId=3348, ComSystemTemplateSystemSignalRef=DET_MTD_160
            DET_BELOW_RAIN_THOLD_159_oRDR_DETECTION_157_160_oPCAN_RADAR_17bbf794_Tx: ComBitPosition=263, ComBitSize=1, ComSignalInitValue=0, ComSignalType=UINT8, ComHandleId=3308, ComSystemTemplateSystemSignalRef=DET_BELOW_RAIN_THOLD_159
            DET_PROB_1STAZHYPO_160_oRDR_DETECTION_157_160_oPCAN_RADAR_663fae42_Tx: ComBitPosition=439, ComBitSize=1, ComSignalInitValue=0, ComSignalType=BOOLEAN, ComHandleId=3352, ComSystemTemplateSystemSignalRef=DET_PROB_1STAZHYPO_160
            DET_IDM_160_oRDR_DETECTION_157_160_oPCAN_RADAR_93387454_Tx: ComBitPosition=399, ComBitSize=1, ComSignalInitValue=0, ComSignalType=UINT8, ComHandleId=3341, ComSystemTemplateSystemSignalRef=DET_IDM_160
            DET_MTD_159_oRDR_DETECTION_157_160_oPCAN_RADAR_4a3a1c54_Tx: ComBitPosition=271, ComBitSize=1, ComSignalInitValue=0, ComSignalType=UINT8, ComHandleId=3347, ComSystemTemplateSystemSignalRef=DET_MTD_159
            DET_PROB_1STAZHYPO_158_oRDR_DETECTION_157_160_oPCAN_RADAR_4cfe200c_Tx: ComBitPosition=215, ComBitSize=1, ComSignalInitValue=0, ComSignalType=BOOLEAN, ComHandleId=3350, ComSystemTemplateSystemSignalRef=DET_PROB_1STAZHYPO_158
        SG_Detections_297_300_oRDR_DETECTION_297_300_oPCAN_RADAR_59a3068e_Tx: ComTransferProperty=TRIGGERED, ComHandleId=76, ComSystemTemplateSignalGroupRef=SG_Detections_297_300
          83 x ComGroupSignal, all with ComSignalEndianness=LITTLE_ENDIAN, ComTransferProperty=PENDING, ComSignalAccess=ACCESS_NEEDED_BY_SWC_OR_COM:
            DET_ELEVATION_ERR_298_oRDR_DETECTION_297_300_oPCAN_RADAR_11b6099a_Tx: ComBitPosition=192, ComBitSize=6, ComSignalInitValue=0, ComSignalType=UINT8, ComHandleId=6232, ComSystemTemplateSystemSignalRef=DET_ELEVATION_ERR_298
            DET_RANGE_VELOCITY_ERR_299_oRDR_DETECTION_297_300_oPCAN_RADAR_b8cad05a_Tx: ComBitPosition=288, ComBitSize=8, ComSignalInitValue=0, ComSignalType=UINT8, ComHandleId=6272, ComSystemTemplateSystemSignalRef=DET_RANGE_VELOCITY_ERR_299
            DET_CONFD_AZIMUTH_298_oRDR_DETECTION_297_300_oPCAN_RADAR_45da4429_Tx: ComBitPosition=230, ComBitSize=2, ComSignalInitValue=0, ComSignalType=UINT8, ComHandleId=6220, ComSystemTemplateSystemSignalRef=DET_CONFD_AZIMUTH_298
            DET_SUPER_RES_TARGET_300_oRDR_DETECTION_297_300_oPCAN_RADAR_e8c842ed_Tx: ComBitPosition=423, ComBitSize=1, ComSignalInitValue=0, ComSignalType=BOOLEAN, ComHandleId=6285, ComSystemTemplateSystemSignalRef=DET_SUPER_RES_TARGET_300
            DET_MH_CYCLE_COUNTER_297_300_oRDR_DETECTION_297_300_oPCAN_RADAR_595e75b2_Tx: ComBitPosition=16, ComBitSize=8, ComSignalInitValue=0, ComSignalType=UINT8, ComHandleId=6248, ComSystemTemplateSystemSignalRef=DET_MH_CYCLE_COUNTER_297_300
            DET_ELEVATION_298_oRDR_DETECTION_297_300_oPCAN_RADAR_968f91ef_Tx: ComBitPosition=184, ComBitSize=8, ComSignalInitValue=0, ComSignalType=UINT8, ComHandleId=6228, ComSystemTemplateSystemSignalRef=DET_ELEVATION_298
            DET_SNR_298_oRDR_DETECTION_297_300_oPCAN_RADAR_782f9c25_Tx: ComBitPosition=232, ComBitSize=8, ComSignalInitValue=0, ComSignalType=UINT8, ComHandleId=6279, ComSystemTemplateSystemSignalRef=DET_SNR_298
            DET_SUPER_RES_TARGET_297_oRDR_DETECTION_297_300_oPCAN_RADAR_65a62607_Tx: ComBitPosition=87, ComBitSize=1, ComSignalInitValue=0, ComSignalType=BOOLEAN, ComHandleId=6282, ComSystemTemplateSystemSignalRef=DET_SUPER_RES_TARGET_297
            DET_RANGE_300_oRDR_DETECTION_297_300_oPCAN_RADAR_f6d9cbf5_Tx: ComBitPosition=360, ComBitSize=15, ComSignalInitValue=0, ComSignalType=UINT16, ComHandleId=6261, ComSystemTemplateSystemSignalRef=DET_RANGE_300
            DET_RANGE_VELOCITY_ERR_297_oRDR_DETECTION_297_300_oPCAN_RADAR_01aa9688_Tx: ComBitPosition=64, ComBitSize=8, ComSignalInitValue=0, ComSignalType=UINT8, ComHandleId=6270, ComSystemTemplateSystemSignalRef=DET_RANGE_VELOCITY_ERR_297
            DET_AZIMUTH_ERR_299_oRDR_DETECTION_297_300_oPCAN_RADAR_76f90f83_Tx: ComBitPosition=329, ComBitSize=7, ComSignalInitValue=0, ComSignalType=UINT8, ComHandleId=6209, ComSystemTemplateSystemSignalRef=DET_AZIMUTH_ERR_299
            DET_ELEVATION_ERR_297_oRDR_DETECTION_297_300_oPCAN_RADAR_3da69bdd_Tx: ComBitPosition=80, ComBitSize=6, ComSignalInitValue=0, ComSignalType=UINT8, ComHandleId=6231, ComSystemTemplateSystemSignalRef=DET_ELEVATION_ERR_297
            DET_RCS_297_oRDR_DETECTION_297_300_oPCAN_RADAR_89915a60_Tx: ComBitPosition=128, ComBitSize=8, ComSignalInitValue=128, ComSignalType=UINT8, ComHandleId=6274, ComSystemTemplateSystemSignalRef=DET_RCS_297
            DET_RANGE_VELOCITY_300_oRDR_DETECTION_297_300_oPCAN_RADAR_837f09d0_Tx: ComBitPosition=384, ComBitSize=15, ComSignalInitValue=16384, ComSignalType=UINT16, ComHandleId=6269, ComSystemTemplateSystemSignalRef=DET_RANGE_VELOCITY_300
            DET_EXISTENCE_PROB_299_oRDR_DETECTION_297_300_oPCAN_RADAR_5659a86f_Tx: ComBitPosition=336, ComBitSize=6, ComSignalInitValue=0, ComSignalType=UINT8, ComHandleId=6237, ComSystemTemplateSystemSignalRef=DET_EXISTENCE_PROB_299
            DET_SNR_297_oRDR_DETECTION_297_300_oPCAN_RADAR_543f0e62_Tx: ComBitPosition=120, ComBitSize=8, ComSignalInitValue=0, ComSignalType=UINT8, ComHandleId=6278, ComSystemTemplateSystemSignalRef=DET_SNR_297
            DET_ELEVATION_299_oRDR_DETECTION_297_300_oPCAN_RADAR_03ff457a_Tx: ComBitPosition=296, ComBitSize=8, ComSignalInitValue=0, ComSignalType=UINT8, ComHandleId=6229, ComSystemTemplateSystemSignalRef=DET_ELEVATION_299
            DET_CONFD_AZIMUTH_300_oRDR_DETECTION_297_300_oPCAN_RADAR_e4a4b284_Tx: ComBitPosition=454, ComBitSize=2, ComSignalInitValue=0, ComSignalType=UINT8, ComHandleId=6222, ComSystemTemplateSystemSignalRef=DET_CONFD_AZIMUTH_300
            DET_RANGE_ERR_300_oRDR_DETECTION_297_300_oPCAN_RADAR_5131719c_Tx: ComBitPosition=376, ComBitSize=7, ComSignalInitValue=0, ComSignalType=UINT8, ComHandleId=6265, ComSystemTemplateSystemSignalRef=DET_RANGE_ERR_300
            DET_RANGE_ERR_297_oRDR_DETECTION_297_300_oPCAN_RADAR_dc5f1576_Tx: ComBitPosition=40, ComBitSize=7, ComSignalInitValue=0, ComSignalType=UINT8, ComHandleId=6262, ComSystemTemplateSystemSignalRef=DET_RANGE_ERR_297
            DET_HVC_FLAG_297_oRDR_DETECTION_297_300_oPCAN_RADAR_0e4dadc2_Tx: ComBitPosition=86, ComBitSize=1, ComSignalInitValue=0, ComSignalType=BOOLEAN, ComHandleId=6239, ComSystemTemplateSystemSignalRef=DET_HVC_FLAG_297
            DET_CONFD_ELEVATION_300_oRDR_DETECTION_297_300_oPCAN_RADAR_e631b37e_Tx: ComBitPosition=437, ComBitSize=2, ComSignalInitValue=0, ComSignalType=UINT8, ComHandleId=6226, ComSystemTemplateSystemSignalRef=DET_CONFD_ELEVATION_300
            DET_RANGE_299_oRDR_DETECTION_297_300_oPCAN_RADAR_c2d7e9cd_Tx: ComBitPosition=248, ComBitSize=15, ComSignalInitValue=0, ComSignalType=UINT16, ComHandleId=6260, ComSystemTemplateSystemSignalRef=DET_RANGE_299
            DET_ELEVATION_ERR_299_oRDR_DETECTION_297_300_oPCAN_RADAR_84c6dd0f_Tx: ComBitPosition=304, ComBitSize=6, ComSignalInitValue=0, ComSignalType=UINT8, ComHandleId=6233, ComSystemTemplateSystemSignalRef=DET_ELEVATION_ERR_299
            DET_SUPER_RES_TARGET_299_oRDR_DETECTION_297_300_oPCAN_RADAR_dcc660d5_Tx: ComBitPosition=311, ComBitSize=1, ComSignalInitValue=0, ComSignalType=BOOLEAN, ComHandleId=6284, ComSystemTemplateSystemSignalRef=DET_SUPER_RES_TARGET_299
            DET_AZIMUTH_ERR_298_oRDR_DETECTION_297_300_oPCAN_RADAR_e389db16_Tx: ComBitPosition=217, ComBitSize=7, ComSignalInitValue=0, ComSignalType=UINT8, ComHandleId=6208, ComSystemTemplateSystemSignalRef=DET_AZIMUTH_ERR_298
            DET_RANGE_ERR_298_oRDR_DETECTION_297_300_oPCAN_RADAR_f04f8731_Tx: ComBitPosition=152, ComBitSize=7, ComSignalInitValue=0, ComSignalType=UINT8, ComHandleId=6263, ComSystemTemplateSystemSignalRef=DET_RANGE_ERR_298
            DET_AZIMUTH_300_oRDR_DETECTION_297_300_oPCAN_RADAR_e642b84e_Tx: ComBitPosition=424, ComBitSize=13, ComSignalInitValue=0, ComSignalType=UINT16, ComHandleId=6206, ComSystemTemplateSystemSignalRef=DET_AZIMUTH_300
            DET_BI_STATIC_FLAG_297_oRDR_DETECTION_297_300_oPCAN_RADAR_3d009c21_Tx: ComBitPosition=104, ComBitSize=1, ComSignalInitValue=0, ComSignalType=BOOLEAN, ComHandleId=6215, ComSystemTemplateSystemSignalRef=DET_BI_STATIC_FLAG_297
            DET_RANGE_VELOCITY_298_oRDR_DETECTION_297_300_oPCAN_RADAR_2201ff7d_Tx: ComBitPosition=160, ComBitSize=15, ComSignalInitValue=16384, ComSignalType=UINT16, ComHandleId=6267, ComSystemTemplateSystemSignalRef=DET_RANGE_VELOCITY_298
            DET_CONFD_AZIMUTH_299_oRDR_DETECTION_297_300_oPCAN_RADAR_d0aa90bc_Tx: ComBitPosition=342, ComBitSize=2, ComSignalInitValue=0, ComSignalType=UINT8, ComHandleId=6221, ComSystemTemplateSystemSignalRef=DET_CONFD_AZIMUTH_299
            DET_RANGE_VELOCITY_ERR_298_oRDR_DETECTION_297_300_oPCAN_RADAR_2dba04cf_Tx: ComBitPosition=176, ComBitSize=8, ComSignalInitValue=0, ComSignalType=UINT8, ComHandleId=6271, ComSystemTemplateSystemSignalRef=DET_RANGE_VELOCITY_ERR_298
            DET_CONFD_ELEVATION_299_oRDR_DETECTION_297_300_oPCAN_RADAR_d23f9146_Tx: ComBitPosition=325, ComBitSize=2, ComSignalInitValue=0, ComSignalType=UINT8, ComHandleId=6225, ComSystemTemplateSystemSignalRef=DET_CONFD_ELEVATION_299
            DET_AZIMUTH_298_oRDR_DETECTION_297_300_oPCAN_RADAR_473c4ee3_Tx: ComBitPosition=200, ComBitSize=13, ComSignalInitValue=0, ComSignalType=UINT16, ComHandleId=6204, ComSystemTemplateSystemSignalRef=DET_AZIMUTH_298
            DET_RCS_300_oRDR_DETECTION_297_300_oPCAN_RADAR_04ff3e8a_Tx: ComBitPosition=464, ComBitSize=8, ComSignalInitValue=128, ComSignalType=UINT8, ComHandleId=6277, ComSystemTemplateSystemSignalRef=DET_RCS_300
            DET_EXISTENCE_PROB_297_oRDR_DETECTION_297_300_oPCAN_RADAR_ef39eebd_Tx: ComBitPosition=112, ComBitSize=6, ComSignalInitValue=0, ComSignalType=UINT8, ComHandleId=6235, ComSystemTemplateSystemSignalRef=DET_EXISTENCE_PROB_297
            DET_BI_STATIC_FLAG_300_oRDR_DETECTION_297_300_oPCAN_RADAR_b06ef8cb_Tx: ComBitPosition=440, ComBitSize=1, ComSignalInitValue=0, ComSignalType=BOOLEAN, ComHandleId=6218, ComSystemTemplateSystemSignalRef=DET_BI_STATIC_FLAG_300
            DET_AZIMUTH_ERR_297_oRDR_DETECTION_297_300_oPCAN_RADAR_cf994951_Tx: ComBitPosition=105, ComBitSize=7, ComSignalInitValue=0, ComSignalType=UINT8, ComHandleId=6207, ComSystemTemplateSystemSignalRef=DET_AZIMUTH_ERR_297
            DET_ELEVATION_ERR_300_oRDR_DETECTION_297_300_oPCAN_RADAR_b0c8ff37_Tx: ComBitPosition=416, ComBitSize=6, ComSignalInitValue=0, ComSignalType=UINT8, ComHandleId=6234, ComSystemTemplateSystemSignalRef=DET_ELEVATION_ERR_300
            DET_MH_SCAN_INDEX_4LSB_297_300_oRDR_DETECTION_297_300_oPCAN_RADAR_9574503e_Tx: ComBitPosition=476, ComBitSize=4, ComSignalInitValue=0, ComSignalType=UINT8, ComHandleId=6249, ComSystemTemplateSystemSignalRef=DET_MH_SCAN_INDEX_4LSB_297_300
            DET_RANGE_VELOCITY_ERR_300_oRDR_DETECTION_297_300_oPCAN_RADAR_8cc4f262_Tx: ComBitPosition=400, ComBitSize=8, ComSignalInitValue=0, ComSignalType=UINT8, ComHandleId=6273, ComSystemTemplateSystemSignalRef=DET_RANGE_VELOCITY_ERR_300
            DET_RANGE_ERR_299_oRDR_DETECTION_297_300_oPCAN_RADAR_653f53a4_Tx: ComBitPosition=264, ComBitSize=7, ComSignalInitValue=0, ComSignalType=UINT8, ComHandleId=6264, ComSystemTemplateSystemSignalRef=DET_RANGE_ERR_299
            DET_EXISTENCE_PROB_300_oRDR_DETECTION_297_300_oPCAN_RADAR_62578a57_Tx: ComBitPosition=448, ComBitSize=6, ComSignalInitValue=0, ComSignalType=UINT8, ComHandleId=6238, ComSystemTemplateSystemSignalRef=DET_EXISTENCE_PROB_300
            DET_MH_CRC16_297_300_oRDR_DETECTION_297_300_oPCAN_RADAR_dd2bd485_Tx: ComBitPosition=0, ComBitSize=16, ComSignalInitValue=0, ComSignalType=UINT16, ComHandleId=6247, ComSystemTemplateSystemSignalRef=DET_MH_CRC16_297_300
            DET_HVC_FLAG_300_oRDR_DETECTION_297_300_oPCAN_RADAR_8323c928_Tx: ComBitPosition=422, ComBitSize=1, ComSignalInitValue=0, ComSignalType=BOOLEAN, ComHandleId=6242, ComSystemTemplateSystemSignalRef=DET_HVC_FLAG_300
            DET_SNR_300_oRDR_DETECTION_297_300_oPCAN_RADAR_d9516a88_Tx: ComBitPosition=456, ComBitSize=8, ComSignalInitValue=0, ComSignalType=UINT8, ComHandleId=6281, ComSystemTemplateSystemSignalRef=DET_SNR_300
            DET_CONFD_ELEVATION_298_oRDR_DETECTION_297_300_oPCAN_RADAR_474f45d3_Tx: ComBitPosition=213, ComBitSize=2, ComSignalInitValue=0, ComSignalType=UINT8, ComHandleId=6224, ComSystemTemplateSystemSignalRef=DET_CONFD_ELEVATION_298
            DET_RCS_298_oRDR_DETECTION_297_300_oPCAN_RADAR_a581c827_Tx: ComBitPosition=240, ComBitSize=8, ComSignalInitValue=128, ComSignalType=UINT8, ComHandleId=6275, ComSystemTemplateSystemSignalRef=DET_RCS_298
            DET_SNR_299_oRDR_DETECTION_297_300_oPCAN_RADAR_ed5f48b0_Tx: ComBitPosition=344, ComBitSize=8, ComSignalInitValue=0, ComSignalType=UINT8, ComHandleId=6280, ComSystemTemplateSystemSignalRef=DET_SNR_299
            DET_CONFD_ELEVATION_297_oRDR_DETECTION_297_300_oPCAN_RADAR_6b5fd794_Tx: ComBitPosition=101, ComBitSize=2, ComSignalInitValue=0, ComSignalType=UINT8, ComHandleId=6223, ComSystemTemplateSystemSignalRef=DET_CONFD_ELEVATION_297
            DET_HVC_FLAG_298_oRDR_DETECTION_297_300_oPCAN_RADAR_225d3f85_Tx: ComBitPosition=198, ComBitSize=1, ComSignalInitValue=0, ComSignalType=BOOLEAN, ComHandleId=6240, ComSystemTemplateSystemSignalRef=DET_HVC_FLAG_298
            DET_ELEVATION_300_oRDR_DETECTION_297_300_oPCAN_RADAR_37f16742_Tx: ComBitPosition=408, ComBitSize=8, ComSignalInitValue=0, ComSignalType=UINT8, ComHandleId=6230, ComSystemTemplateSystemSignalRef=DET_ELEVATION_300
            DET_RANGE_298_oRDR_DETECTION_297_300_oPCAN_RADAR_57a73d58_Tx: ComBitPosition=136, ComBitSize=15, ComSignalInitValue=0, ComSignalType=UINT16, ComHandleId=6259, ComSystemTemplateSystemSignalRef=DET_RANGE_298
            DET_ELEVATION_297_oRDR_DETECTION_297_300_oPCAN_RADAR_ba9f03a8_Tx: ComBitPosition=72, ComBitSize=8, ComSignalInitValue=0, ComSignalType=UINT8, ComHandleId=6227, ComSystemTemplateSystemSignalRef=DET_ELEVATION_297
            DET_CONFD_AZIMUTH_297_oRDR_DETECTION_297_300_oPCAN_RADAR_69cad66e_Tx: ComBitPosition=118, ComBitSize=2, ComSignalInitValue=0, ComSignalType=UINT8, ComHandleId=6219, ComSystemTemplateSystemSignalRef=DET_CONFD_AZIMUTH_297
            DET_RCS_299_oRDR_DETECTION_297_300_oPCAN_RADAR_30f11cb2_Tx: ComBitPosition=352, ComBitSize=8, ComSignalInitValue=128, ComSignalType=UINT8, ComHandleId=6276, ComSystemTemplateSystemSignalRef=DET_RCS_299
            DET_EXISTENCE_PROB_298_oRDR_DETECTION_297_300_oPCAN_RADAR_c3297cfa_Tx: ComBitPosition=224, ComBitSize=6, ComSignalInitValue=0, ComSignalType=UINT8, ComHandleId=6236, ComSystemTemplateSystemSignalRef=DET_EXISTENCE_PROB_298
            DET_BI_STATIC_FLAG_299_oRDR_DETECTION_297_300_oPCAN_RADAR_8460daf3_Tx: ComBitPosition=328, ComBitSize=1, ComSignalInitValue=0, ComSignalType=BOOLEAN, ComHandleId=6217, ComSystemTemplateSystemSignalRef=DET_BI_STATIC_FLAG_299
            DET_AZIMUTH_299_oRDR_DETECTION_297_300_oPCAN_RADAR_d24c9a76_Tx: ComBitPosition=312, ComBitSize=13, ComSignalInitValue=0, ComSignalType=UINT16, ComHandleId=6205, ComSystemTemplateSystemSignalRef=DET_AZIMUTH_299
            DET_RANGE_297_oRDR_DETECTION_297_300_oPCAN_RADAR_7bb7af1f_Tx: ComBitPosition=24, ComBitSize=15, ComSignalInitValue=0, ComSignalType=UINT16, ComHandleId=6258, ComSystemTemplateSystemSignalRef=DET_RANGE_297
            DET_HVC_FLAG_299_oRDR_DETECTION_297_300_oPCAN_RADAR_b72deb10_Tx: ComBitPosition=310, ComBitSize=1, ComSignalInitValue=0, ComSignalType=BOOLEAN, ComHandleId=6241, ComSystemTemplateSystemSignalRef=DET_HVC_FLAG_299
            DET_BI_STATIC_FLAG_298_oRDR_DETECTION_297_300_oPCAN_RADAR_11100e66_Tx: ComBitPosition=216, ComBitSize=1, ComSignalInitValue=0, ComSignalType=BOOLEAN, ComHandleId=6216, ComSystemTemplateSystemSignalRef=DET_BI_STATIC_FLAG_298
            DET_AZIMUTH_ERR_300_oRDR_DETECTION_297_300_oPCAN_RADAR_42f72dbb_Tx: ComBitPosition=441, ComBitSize=7, ComSignalInitValue=0, ComSignalType=UINT8, ComHandleId=6210, ComSystemTemplateSystemSignalRef=DET_AZIMUTH_ERR_300
            DET_RANGE_VELOCITY_299_oRDR_DETECTION_297_300_oPCAN_RADAR_b7712be8_Tx: ComBitPosition=272, ComBitSize=15, ComSignalInitValue=16384, ComSignalType=UINT16, ComHandleId=6268, ComSystemTemplateSystemSignalRef=DET_RANGE_VELOCITY_299
            DET_SUPER_RES_TARGET_298_oRDR_DETECTION_297_300_oPCAN_RADAR_49b6b440_Tx: ComBitPosition=199, ComBitSize=1, ComSignalInitValue=0, ComSignalType=BOOLEAN, ComHandleId=6283, ComSystemTemplateSystemSignalRef=DET_SUPER_RES_TARGET_298
            DET_AZIMUTH_297_oRDR_DETECTION_297_300_oPCAN_RADAR_6b2cdca4_Tx: ComBitPosition=88, ComBitSize=13, ComSignalInitValue=0, ComSignalType=UINT16, ComHandleId=6203, ComSystemTemplateSystemSignalRef=DET_AZIMUTH_297
            DET_RANGE_VELOCITY_297_oRDR_DETECTION_297_300_oPCAN_RADAR_0e116d3a_Tx: ComBitPosition=48, ComBitSize=15, ComSignalInitValue=16384, ComSignalType=UINT16, ComHandleId=6266, ComSystemTemplateSystemSignalRef=DET_RANGE_VELOCITY_297
            DET_BELOW_RAIN_THOLD_300_oRDR_DETECTION_297_300_oPCAN_RADAR_33432b8e_Tx: ComBitPosition=375, ComBitSize=1, ComSignalInitValue=0, ComSignalType=UINT8, ComHandleId=6214, ComSystemTemplateSystemSignalRef=DET_BELOW_RAIN_THOLD_300
            DET_BELOW_RAIN_THOLD_299_oRDR_DETECTION_297_300_oPCAN_RADAR_074d09b6_Tx: ComBitPosition=263, ComBitSize=1, ComSignalInitValue=0, ComSignalType=UINT8, ComHandleId=6213, ComSystemTemplateSystemSignalRef=DET_BELOW_RAIN_THOLD_299
            DET_BELOW_RAIN_THOLD_298_oRDR_DETECTION_297_300_oPCAN_RADAR_923ddd23_Tx: ComBitPosition=151, ComBitSize=1, ComSignalInitValue=0, ComSignalType=UINT8, ComHandleId=6212, ComSystemTemplateSystemSignalRef=DET_BELOW_RAIN_THOLD_298
            DET_MTD_300_oRDR_DETECTION_297_300_oPCAN_RADAR_6ec2c04e_Tx: ComBitPosition=383, ComBitSize=1, ComSignalInitValue=0, ComSignalType=UINT8, ComHandleId=6253, ComSystemTemplateSystemSignalRef=DET_MTD_300
            DET_PROB_1STAZHYPO_297_oRDR_DETECTION_297_300_oPCAN_RADAR_70184c69_Tx: ComBitPosition=103, ComBitSize=1, ComSignalInitValue=0, ComSignalType=BOOLEAN, ComHandleId=6254, ComSystemTemplateSystemSignalRef=DET_PROB_1STAZHYPO_297
            DET_BELOW_RAIN_THOLD_297_oRDR_DETECTION_297_300_oPCAN_RADAR_be2d4f64_Tx: ComBitPosition=39, ComBitSize=1, ComSignalInitValue=0, ComSignalType=UINT8, ComHandleId=6211, ComSystemTemplateSystemSignalRef=DET_BELOW_RAIN_THOLD_297
            DET_IDM_298_oRDR_DETECTION_297_300_oPCAN_RADAR_a90f0438_Tx: ComBitPosition=175, ComBitSize=1, ComSignalInitValue=0, ComSignalType=UINT8, ComHandleId=6244, ComSystemTemplateSystemSignalRef=DET_IDM_298
            DET_PROB_1STAZHYPO_298_oRDR_DETECTION_297_300_oPCAN_RADAR_5c08de2e_Tx: ComBitPosition=215, ComBitSize=1, ComSignalInitValue=0, ComSignalType=BOOLEAN, ComHandleId=6255, ComSystemTemplateSystemSignalRef=DET_PROB_1STAZHYPO_298
            DET_MTD_297_oRDR_DETECTION_297_300_oPCAN_RADAR_e3aca4a4_Tx: ComBitPosition=47, ComBitSize=1, ComSignalInitValue=0, ComSignalType=UINT8, ComHandleId=6250, ComSystemTemplateSystemSignalRef=DET_MTD_297
            DET_IDM_300_oRDR_DETECTION_297_300_oPCAN_RADAR_0871f295_Tx: ComBitPosition=399, ComBitSize=1, ComSignalInitValue=0, ComSignalType=UINT8, ComHandleId=6246, ComSystemTemplateSystemSignalRef=DET_IDM_300
            DET_IDM_297_oRDR_DETECTION_297_300_oPCAN_RADAR_851f967f_Tx: ComBitPosition=63, ComBitSize=1, ComSignalInitValue=0, ComSignalType=UINT8, ComHandleId=6243, ComSystemTemplateSystemSignalRef=DET_IDM_297
            DET_PROB_1STAZHYPO_300_oRDR_DETECTION_297_300_oPCAN_RADAR_fd762883_Tx: ComBitPosition=439, ComBitSize=1, ComSignalInitValue=0, ComSignalType=BOOLEAN, ComHandleId=6257, ComSystemTemplateSystemSignalRef=DET_PROB_1STAZHYPO_300
            DET_MTD_298_oRDR_DETECTION_297_300_oPCAN_RADAR_cfbc36e3_Tx: ComBitPosition=159, ComBitSize=1, ComSignalInitValue=0, ComSignalType=UINT8, ComHandleId=6251, ComSystemTemplateSystemSignalRef=DET_MTD_298
            DET_PROB_1STAZHYPO_299_oRDR_DETECTION_297_300_oPCAN_RADAR_c9780abb_Tx: ComBitPosition=327, ComBitSize=1, ComSignalInitValue=0, ComSignalType=BOOLEAN, ComHandleId=6256, ComSystemTemplateSystemSignalRef=DET_PROB_1STAZHYPO_299
            DET_MTD_299_oRDR_DETECTION_297_300_oPCAN_RADAR_5acce276_Tx: ComBitPosition=271, ComBitSize=1, ComSignalInitValue=0, ComSignalType=UINT8, ComHandleId=6252, ComSystemTemplateSystemSignalRef=DET_MTD_299
            DET_IDM_299_oRDR_DETECTION_297_300_oPCAN_RADAR_3c7fd0ad_Tx: ComBitPosition=287, ComBitSize=1, ComSignalInitValue=0, ComSignalType=UINT8, ComHandleId=6245, ComSystemTemplateSystemSignalRef=DET_IDM_299
        SG_RadarStatus2_oRDR_STATUS_002_oPCAN_RADAR_51f7b61a_Tx: ComTransferProperty=TRIGGERED, ComHandleId=108, ComSystemTemplateSignalGroupRef=SG_RadarStatus2
          38 x ComGroupSignal, all with ComSignalEndianness=LITTLE_ENDIAN, ComSignalInitValue=0, ComTransferProperty=PENDING, ComSignalAccess=ACCESS_NEEDED_BY_SWC_OR_COM:
            STS_MMIC_TEMP_TX0_oRDR_STATUS_002_oPCAN_RADAR_3a566f10_Tx: ComBitPosition=168, ComBitSize=8, ComSignalType=UINT8, ComHandleId=8498, ComSystemTemplateSystemSignalRef=STS_MMIC_TEMP_TX0
            STS_YAW_RATE_BIAS_oRDR_STATUS_002_oPCAN_RADAR_9d7c088d_Tx: ComBitPosition=28, ComBitSize=4, ComSignalType=UINT8, ComHandleId=8516, ComSystemTemplateSystemSignalRef=STS_YAW_RATE_BIAS
            STS_MMIC_RE_INIT_COUNT_oRDR_STATUS_002_oPCAN_RADAR_0f504994_Tx: ComBitPosition=44, ComBitSize=4, ComSignalType=UINT8, ComHandleId=8496, ComSystemTemplateSystemSignalRef=STS_MMIC_RE_INIT_COUNT
            STS_RDD_CORE_THROUGHPUT_oRDR_STATUS_002_oPCAN_RADAR_2585d773_Tx: ComBitPosition=136, ComBitSize=6, ComSignalType=UINT8, ComHandleId=8504, ComSystemTemplateSystemSignalRef=STS_RDD_CORE_THROUGHPUT
            STS_TIME_SYNC_OFFSET_oRDR_STATUS_002_oPCAN_RADAR_0c9d43da_Tx: ComBitPosition=152, ComBitSize=16, ComSignalType=SINT16, ComHandleId=8508, ComSystemTemplateSystemSignalRef=STS_TIME_SYNC_OFFSET
            STS_MMIC_TEMP_TX3_4_oRDR_STATUS_002_oPCAN_RADAR_390d4f51_Tx: ComBitPosition=80, ComBitSize=8, ComSignalType=UINT8, ComHandleId=8500, ComSystemTemplateSystemSignalRef=STS_MMIC_TEMP_TX3_4
            STS_MH_002_CRC16_oRDR_STATUS_002_oPCAN_RADAR_39e26d91_Tx: ComBitPosition=0, ComBitSize=16, ComSignalType=UINT16, ComHandleId=8494, ComSystemTemplateSystemSignalRef=STS_MH_002_CRC16
            STS_MMIC_TEMP_TX1_2_oRDR_STATUS_002_oPCAN_RADAR_b5a34e6a_Tx: ComBitPosition=72, ComBitSize=8, ComSignalType=UINT8, ComHandleId=8499, ComSystemTemplateSystemSignalRef=STS_MMIC_TEMP_TX1_2
            STS_POINT_OF_TRIGGER_oRDR_STATUS_002_oPCAN_RADAR_4dfeaf3a_Tx: ComBitPosition=48, ComBitSize=10, ComSignalType=UINT16, ComHandleId=8502, ComSystemTemplateSystemSignalRef=STS_POINT_OF_TRIGGER
            STS_SCAN_TYPE_oRDR_STATUS_002_oPCAN_RADAR_e74f40f7_Tx: ComBitPosition=58, ComBitSize=1, ComSignalType=UINT8, ComHandleId=8505, ComSystemTemplateSystemSignalRef=STS_SCAN_TYPE
            STS_STEERING_ANGLE_oRDR_STATUS_002_oPCAN_RADAR_23b55571_Tx: ComBitPosition=32, ComBitSize=8, ComSignalType=UINT8, ComHandleId=8507, ComSystemTemplateSystemSignalRef=STS_STEERING_ANGLE
            STS_VEHICLE_SUPPLY_VOLTAGE_oRDR_STATUS_002_oPCAN_RADAR_2e0227b4_Tx: ComBitPosition=24, ComBitSize=4, ComSignalType=UINT8, ComHandleId=8512, ComSystemTemplateSystemSignalRef=STS_VEHICLE_SUPPLY_VOLTAGE
            STS_MCU_TEMP_oRDR_STATUS_002_oPCAN_RADAR_c6a456e4_Tx: ComBitPosition=88, ComBitSize=8, ComSignalType=UINT8, ComHandleId=8493, ComSystemTemplateSystemSignalRef=STS_MCU_TEMP
            STS_MMIC_TEMP_RX_oRDR_STATUS_002_oPCAN_RADAR_57120d5e_Tx: ComBitPosition=144, ComBitSize=8, ComSignalType=UINT8, ComHandleId=8497, ComSystemTemplateSystemSignalRef=STS_MMIC_TEMP_RX
            STS_BRR_STATUS_oRDR_STATUS_002_oPCAN_RADAR_b18213d9_Tx: ComBitPosition=41, ComBitSize=2, ComSignalType=UINT8, ComHandleId=8481, ComSystemTemplateSystemSignalRef=STS_BRR_STATUS
            STS_VEH_SPEED_DIRECTION_oRDR_STATUS_002_oPCAN_RADAR_ab672289_Tx: ComBitPosition=177, ComBitSize=1, ComSignalType=BOOLEAN, ComHandleId=8513, ComSystemTemplateSystemSignalRef=STS_VEH_SPEED_DIRECTION
            STS_XCVR_OPERATIONAL_oRDR_STATUS_002_oPCAN_RADAR_0ef02f62_Tx: ComBitPosition=43, ComBitSize=1, ComSignalType=BOOLEAN, ComHandleId=8515, ComSystemTemplateSystemSignalRef=STS_XCVR_OPERATIONAL
            STS_NO_TSYN_ERROR_oRDR_STATUS_002_oPCAN_RADAR_20da0af2_Tx: ComBitPosition=40, ComBitSize=1, ComSignalType=BOOLEAN, ComHandleId=8501, ComSystemTemplateSystemSignalRef=STS_NO_TSYN_ERROR
            STS_AF_CORE_THROUGHPUT_oRDR_STATUS_002_oPCAN_RADAR_176d9e73_Tx: ComBitPosition=128, ComBitSize=6, ComSignalType=UINT8, ComHandleId=8480, ComSystemTemplateSystemSignalRef=STS_AF_CORE_THROUGHPUT
            STS_VEHICLE_SPEED_CALC_oRDR_STATUS_002_oPCAN_RADAR_b07702fe_Tx: ComBitPosition=178, ComBitSize=14, ComSignalType=UINT16, ComHandleId=8511, ComSystemTemplateSystemSignalRef=STS_VEHICLE_SPEED_CALC
            STS_MH_002_CYCLE_COUNTER_oRDR_STATUS_002_oPCAN_RADAR_24569cf4_Tx: ComBitPosition=16, ComBitSize=8, ComSignalType=UINT8, ComHandleId=8495, ComSystemTemplateSystemSignalRef=STS_MH_002_CYCLE_COUNTER
            STS_STEERING_ANGLE_SIGN_oRDR_STATUS_002_oPCAN_RADAR_d05788d3_Tx: ComBitPosition=176, ComBitSize=1, ComSignalType=BOOLEAN, ComHandleId=8506, ComSystemTemplateSystemSignalRef=STS_STEERING_ANGLE_SIGN
            STS_First_CAN_Det_Inst_Latency_oRDR_STATUS_002_oPCAN_RADAR_1df78923_Tx: ComBitPosition=348, ComBitSize=12, ComSignalType=UINT16, ComHandleId=8487, ComSystemTemplateSystemSignalRef=STS_First_CAN_Det_Inst_Latency
            STS_CORE_ACTV_FLT_BYTE_8_to_11_oRDR_STATUS_002_oPCAN_RADAR_4e4fcb1f_Tx: ComBitPosition=224, ComBitSize=32, ComSignalType=UINT32, ComHandleId=8485, ComSystemTemplateSystemSignalRef=STS_CORE_ACTV_FLT_BYTE_8_to_11
            STS_INTRFC_VERSION_ID_MAJOR_oRDR_STATUS_002_oPCAN_RADAR_2dc9e305_Tx: ComBitPosition=376, ComBitSize=8, ComSignalType=UINT8, ComHandleId=8489, ComSystemTemplateSystemSignalRef=STS_INTRFC_VERSION_ID_MAJOR
            STS_Vehicle_Speed_Calc_QF_oRDR_STATUS_002_oPCAN_RADAR_18f9a51b_Tx: ComBitPosition=134, ComBitSize=2, ComSignalType=UINT8, ComHandleId=8514, ComSystemTemplateSystemSignalRef=STS_Vehicle_Speed_Calc_QF
            STS_CORE_ACTV_FLT_BYTE_4_to_7_oRDR_STATUS_002_oPCAN_RADAR_8b983440_Tx: ComBitPosition=96, ComBitSize=32, ComSignalType=UINT32, ComHandleId=8484, ComSystemTemplateSystemSignalRef=STS_CORE_ACTV_FLT_BYTE_4_to_7
            STS_INTRFC_VERSION_ID_MINOR_oRDR_STATUS_002_oPCAN_RADAR_f5427415_Tx: ComBitPosition=384, ComBitSize=8, ComSignalType=UINT8, ComHandleId=8490, ComSystemTemplateSystemSignalRef=STS_INTRFC_VERSION_ID_MINOR
            STS_CORE_ACTV_FLT_BYTE_11_to_15_oRDR_STATUS_002_oPCAN_RADAR_f8237490_Tx: ComBitPosition=256, ComBitSize=32, ComSignalType=UINT32, ComHandleId=8486, ComSystemTemplateSystemSignalRef=STS_CORE_ACTV_FLT_BYTE_11_to_15
            STS_RAIN_COUNT_oRDR_STATUS_002_oPCAN_RADAR_27958738_Tx: ComBitPosition=360, ComBitSize=9, ComSignalType=UINT16, ComHandleId=8503, ComSystemTemplateSystemSignalRef=STS_RAIN_COUNT
            STS_TKEY_ACTV_FLT_BYTE_4_to_5_oRDR_STATUS_002_oPCAN_RADAR_b5eaae7a_Tx: ComBitPosition=320, ComBitSize=16, ComSignalType=UINT16, ComHandleId=8510, ComSystemTemplateSystemSignalRef=STS_TKEY_ACTV_FLT_BYTE_4_to_5
            STS_INTRFC_VERSION_ID_PATCH_oRDR_STATUS_002_oPCAN_RADAR_ed2063e1_Tx: ComBitPosition=392, ComBitSize=8, ComSignalType=UINT8, ComHandleId=8491, ComSystemTemplateSystemSignalRef=STS_INTRFC_VERSION_ID_PATCH
            STS_Gear_Position_oRDR_STATUS_002_oPCAN_RADAR_7ad98da4_Tx: ComBitPosition=59, ComBitSize=4, ComSignalType=UINT8, ComHandleId=8488, ComSystemTemplateSystemSignalRef=STS_Gear_Position
            STS_CAN_NM_State_oRDR_STATUS_002_oPCAN_RADAR_b965e775_Tx: ComBitPosition=64, ComBitSize=8, ComSignalType=UINT8, ComHandleId=8482, ComSystemTemplateSystemSignalRef=STS_CAN_NM_State
            STS_Yaw_Rate_Calc_QF_oRDR_STATUS_002_oPCAN_RADAR_cd68faf6_Tx: ComBitPosition=142, ComBitSize=2, ComSignalType=UINT8, ComHandleId=8517, ComSystemTemplateSystemSignalRef=STS_Yaw_Rate_Calc_QF
            STS_TKEY_ACTV_FLT_BYTE_0_to_3_oRDR_STATUS_002_oPCAN_RADAR_b6823a3b_Tx: ComBitPosition=288, ComBitSize=32, ComSignalType=UINT32, ComHandleId=8509, ComSystemTemplateSystemSignalRef=STS_TKEY_ACTV_FLT_BYTE_0_to_3
            STS_Last_CAN_Det_Inst_Latency_oRDR_STATUS_002_oPCAN_RADAR_f3b34cfa_Tx: ComBitPosition=336, ComBitSize=12, ComSignalType=UINT16, ComHandleId=8492, ComSystemTemplateSystemSignalRef=STS_Last_CAN_Det_Inst_Latency
            STS_CORE_ACTV_FLT_BYTE_0_to_3_oRDR_STATUS_002_oPCAN_RADAR_4eff1249_Tx: ComBitPosition=192, ComBitSize=32, ComSignalType=UINT32, ComHandleId=8483, ComSystemTemplateSystemSignalRef=STS_CORE_ACTV_FLT_BYTE_0_to_3
