[part 19 of 20: package /ActiveEcuC]
AUTOSAR XML (schema 00053)
package /ActiveEcuC  (continued)
  module config Com: implementation-config-variant=VARIANT-PRE-COMPILE, module-description=Com_Impl  (continued)
    ComConfig: ComConfigurationId=0, ComRxImmediateNotificationCacheSize=0, ComRxDeferredNotificationCacheSize=1  (continued)
      SG_Fusion_Detections_113_116_oRDR_FUSION_DET_113_116_oPCAN_RADAR_16b82f16_Rx (ComSignalGroup):
        ComTimeout = 0
        ComTransferProperty = PENDING
        ComSignalGroupAccess = ACCESS_NEEDED_BY_SWC_OR_COM
        ComHandleId = 36
        ComSignalGroupArrayAccess = true
        ComSystemTemplateSignalGroupRef = SG_Fusion_Detections_113_116
        83 x ComGroupSignal, all with ComSignalEndianness=LITTLE_ENDIAN, ComSignalInitValue=0, ComSignalAccess=ACCESS_NEEDED_BY_SWC_OR_COM:
          DET_PROB_1STAZHYPO_115_Rx_oRDR_FUSION_DET_113_116_oPCAN_RADAR_2063711a_Rx: ComBitPosition=327, ComBitSize=1, ComSignalType=BOOLEAN, ComHandleId=2451, ComSystemTemplateSystemSignalRef=DET_PROB_1STAZHYPO_115_Rx
          DET_RANGE_115_Rx_oRDR_FUSION_DET_113_116_oPCAN_RADAR_7bde990d_Rx: ComBitPosition=248, ComBitSize=15, ComSignalType=UINT16, ComHandleId=2455, ComSystemTemplateSystemSignalRef=DET_RANGE_115_Rx
          DET_SUPER_RES_TARGET_116_Rx_oRDR_FUSION_DET_113_116_oPCAN_RADAR_83fd6889_Rx: ComBitPosition=423, ComBitSize=1, ComSignalType=BOOLEAN, ComHandleId=2480, ComSystemTemplateSystemSignalRef=DET_SUPER_RES_TARGET_116_Rx
          DET_AZIMUTH_113_Rx_oRDR_FUSION_DET_113_116_oPCAN_RADAR_3d61a43a_Rx: ComBitPosition=88, ComBitSize=13, ComSignalType=UINT16, ComHandleId=2398, ComSystemTemplateSystemSignalRef=DET_AZIMUTH_113_Rx
          DET_CONFD_ELEVATION_113_Rx_oRDR_FUSION_DET_113_116_oPCAN_RADAR_c50d994f_Rx: ComBitPosition=101, ComBitSize=2, ComSignalType=UINT8, ComHandleId=2418, ComSystemTemplateSystemSignalRef=DET_CONFD_ELEVATION_113_Rx
          DET_RANGE_VELOCITY_ERR_114_Rx_oRDR_FUSION_DET_113_116_oPCAN_RADAR_900bf876_Rx: ComBitPosition=176, ComBitSize=8, ComSignalType=UINT8, ComHandleId=2466, ComSystemTemplateSystemSignalRef=DET_RANGE_VELOCITY_ERR_114_Rx
          DET_ELEVATION_113_Rx_oRDR_FUSION_DET_113_116_oPCAN_RADAR_cf5e76b6_Rx: ComBitPosition=72, ComBitSize=8, ComSignalType=UINT8, ComHandleId=2422, ComSystemTemplateSystemSignalRef=DET_ELEVATION_113_Rx
          DET_ELEVATION_ERR_115_Rx_oRDR_FUSION_DET_113_116_oPCAN_RADAR_489e3579_Rx: ComBitPosition=304, ComBitSize=6, ComSignalType=UINT8, ComHandleId=2428, ComSystemTemplateSystemSignalRef=DET_ELEVATION_ERR_115_Rx
          DET_PROB_1STAZHYPO_116_Rx_oRDR_FUSION_DET_113_116_oPCAN_RADAR_0adfc192_Rx: ComBitPosition=439, ComBitSize=1, ComSignalType=BOOLEAN, ComHandleId=2452, ComSystemTemplateSystemSignalRef=DET_PROB_1STAZHYPO_116_Rx
          DET_CONFD_ELEVATION_114_Rx_oRDR_FUSION_DET_113_116_oPCAN_RADAR_3f306a18_Rx: ComBitPosition=213, ComBitSize=2, ComSignalType=UINT8, ComHandleId=2419, ComSystemTemplateSystemSignalRef=DET_CONFD_ELEVATION_114_Rx
          DET_RCS_114_Rx_oRDR_FUSION_DET_113_116_oPCAN_RADAR_c4a41aaf_Rx: ComBitPosition=240, ComBitSize=8, ComSignalType=UINT8, ComHandleId=2470, ComSystemTemplateSystemSignalRef=DET_RCS_114_Rx
          DET_RANGE_VELOCITY_ERR_113_Rx_oRDR_FUSION_DET_113_116_oPCAN_RADAR_6a360b21_Rx: ComBitPosition=64, ComBitSize=8, ComSignalType=UINT8, ComHandleId=2465, ComSystemTemplateSystemSignalRef=DET_RANGE_VELOCITY_ERR_113_Rx
          DET_MTD_113_Rx_oRDR_FUSION_DET_113_116_oPCAN_RADAR_bf630e8b_Rx: ComBitPosition=47, ComBitSize=1, ComSignalType=BOOLEAN, ComHandleId=2445, ComSystemTemplateSystemSignalRef=DET_MTD_113_Rx
          DET_SNR_113_Rx_oRDR_FUSION_DET_113_116_oPCAN_RADAR_37c39811_Rx: ComBitPosition=120, ComBitSize=8, ComSignalType=UINT8, ComHandleId=2473, ComSystemTemplateSystemSignalRef=DET_SNR_113_Rx
          DET_CONFD_AZIMUTH_116_Rx_oRDR_FUSION_DET_113_116_oPCAN_RADAR_b0e9cb50_Rx: ComBitPosition=454, ComBitSize=2, ComSignalType=UINT8, ComHandleId=2417, ComSystemTemplateSystemSignalRef=DET_CONFD_AZIMUTH_116_Rx
          DET_IDM_116_Rx_oRDR_FUSION_DET_113_116_oPCAN_RADAR_7d25e963_Rx: ComBitPosition=399, ComBitSize=1, ComSignalType=BOOLEAN, ComHandleId=2441, ComSystemTemplateSystemSignalRef=DET_IDM_116_Rx
          DET_AZIMUTH_ERR_116_Rx_oRDR_FUSION_DET_113_116_oPCAN_RADAR_40cdd420_Rx: ComBitPosition=441, ComBitSize=7, ComSignalType=UINT8, ComHandleId=2405, ComSystemTemplateSystemSignalRef=DET_AZIMUTH_ERR_116_Rx
          DET_EXISTENCE_PROB_115_Rx_oRDR_FUSION_DET_113_116_oPCAN_RADAR_bf864dec_Rx: ComBitPosition=336, ComBitSize=6, ComSignalType=UINT8, ComHandleId=2432, ComSystemTemplateSystemSignalRef=DET_EXISTENCE_PROB_115_Rx
          DET_BELOW_RAIN_THOLD_115_Rx_oRDR_FUSION_DET_113_116_oPCAN_RADAR_0ea23a9f_Rx: ComBitPosition=263, ComBitSize=1, ComSignalType=BOOLEAN, ComHandleId=2408, ComSystemTemplateSystemSignalRef=DET_BELOW_RAIN_THOLD_115_Rx
          DET_AZIMUTH_ERR_114_Rx_oRDR_FUSION_DET_113_116_oPCAN_RADAR_c535f6ef_Rx: ComBitPosition=217, ComBitSize=7, ComSignalType=UINT8, ComHandleId=2403, ComSystemTemplateSystemSignalRef=DET_AZIMUTH_ERR_114_Rx
          DET_RCS_115_Rx_oRDR_FUSION_DET_113_116_oPCAN_RADAR_6be088e8_Rx: ComBitPosition=352, ComBitSize=8, ComSignalType=UINT8, ComHandleId=2471, ComSystemTemplateSystemSignalRef=DET_RCS_115_Rx
          DET_BELOW_RAIN_THOLD_113_Rx_oRDR_FUSION_DET_113_116_oPCAN_RADAR_5bdb5b8f_Rx: ComBitPosition=39, ComBitSize=1, ComSignalType=BOOLEAN, ComHandleId=2406, ComSystemTemplateSystemSignalRef=DET_BELOW_RAIN_THOLD_113_Rx
          DET_HVC_FLAG_114_Rx_oRDR_FUSION_DET_113_116_oPCAN_RADAR_cd1c32e4_Rx: ComBitPosition=198, ComBitSize=1, ComSignalType=BOOLEAN, ComHandleId=2435, ComSystemTemplateSystemSignalRef=DET_HVC_FLAG_114_Rx
          DET_BI_STATIC_FLAG_113_Rx_oRDR_FUSION_DET_113_116_oPCAN_RADAR_2c45f09c_Rx: ComBitPosition=104, ComBitSize=1, ComSignalType=BOOLEAN, ComHandleId=2410, ComSystemTemplateSystemSignalRef=DET_BI_STATIC_FLAG_113_Rx
          DET_CONFD_AZIMUTH_113_Rx_oRDR_FUSION_DET_113_116_oPCAN_RADAR_cf2c1ac8_Rx: ComBitPosition=118, ComBitSize=2, ComSignalType=UINT8, ComHandleId=2414, ComSystemTemplateSystemSignalRef=DET_CONFD_AZIMUTH_113_Rx
          DET_HVC_FLAG_116_Rx_oRDR_FUSION_DET_113_116_oPCAN_RADAR_48e4102b_Rx: ComBitPosition=422, ComBitSize=1, ComSignalType=BOOLEAN, ComHandleId=2437, ComSystemTemplateSystemSignalRef=DET_HVC_FLAG_116_Rx
          DET_RANGE_VELOCITY_114_Rx_oRDR_FUSION_DET_113_116_oPCAN_RADAR_096f88b4_Rx: ComBitPosition=160, ComBitSize=15, ComSignalType=UINT16, ComHandleId=2462, ComSystemTemplateSystemSignalRef=DET_RANGE_VELOCITY_114_Rx
          DET_MH_SCAN_INDEX_4LSB_113_116_Rx_oRDR_FUSION_DET_113_116_oPCAN_RADAR_fa66f94f_Rx: ComBitPosition=476, ComBitSize=4, ComSignalType=UINT8, ComHandleId=2444, ComSystemTemplateSystemSignalRef=DET_MH_SCAN_INDEX_4LSB_113_116_Rx
          DET_HVC_FLAG_113_Rx_oRDR_FUSION_DET_113_116_oPCAN_RADAR_3721c1b3_Rx: ComBitPosition=86, ComBitSize=1, ComSignalType=BOOLEAN, ComHandleId=2434, ComSystemTemplateSystemSignalRef=DET_HVC_FLAG_113_Rx
          DET_ELEVATION_ERR_116_Rx_oRDR_FUSION_DET_113_116_oPCAN_RADAR_622285f1_Rx: ComBitPosition=416, ComBitSize=6, ComSignalType=UINT8, ComHandleId=2429, ComSystemTemplateSystemSignalRef=DET_ELEVATION_ERR_116_Rx
          DET_CONFD_AZIMUTH_114_Rx_oRDR_FUSION_DET_113_116_oPCAN_RADAR_3511e99f_Rx: ComBitPosition=230, ComBitSize=2, ComSignalType=UINT8, ComHandleId=2415, ComSystemTemplateSystemSignalRef=DET_CONFD_AZIMUTH_114_Rx
          DET_RCS_113_Rx_oRDR_FUSION_DET_113_116_oPCAN_RADAR_3e99e9f8_Rx: ComBitPosition=128, ComBitSize=8, ComSignalType=UINT8, ComHandleId=2469, ComSystemTemplateSystemSignalRef=DET_RCS_113_Rx
          DET_BELOW_RAIN_THOLD_116_Rx_oRDR_FUSION_DET_113_116_oPCAN_RADAR_241e8a17_Rx: ComBitPosition=375, ComBitSize=1, ComSignalType=BOOLEAN, ComHandleId=2409, ComSystemTemplateSystemSignalRef=DET_BELOW_RAIN_THOLD_116_Rx
          DET_AZIMUTH_116_Rx_oRDR_FUSION_DET_113_116_oPCAN_RADAR_42a475a2_Rx: ComBitPosition=424, ComBitSize=13, ComSignalType=UINT16, ComHandleId=2401, ComSystemTemplateSystemSignalRef=DET_AZIMUTH_116_Rx
          DET_AZIMUTH_115_Rx_oRDR_FUSION_DET_113_116_oPCAN_RADAR_6818c52a_Rx: ComBitPosition=312, ComBitSize=13, ComSignalType=UINT16, ComHandleId=2400, ComSystemTemplateSystemSignalRef=DET_AZIMUTH_115_Rx
          DET_ELEVATION_114_Rx_oRDR_FUSION_DET_113_116_oPCAN_RADAR_356385e1_Rx: ComBitPosition=184, ComBitSize=8, ComSignalType=UINT8, ComHandleId=2423, ComSystemTemplateSystemSignalRef=DET_ELEVATION_114_Rx
          DET_SNR_114_Rx_oRDR_FUSION_DET_113_116_oPCAN_RADAR_cdfe6b46_Rx: ComBitPosition=232, ComBitSize=8, ComSignalType=UINT8, ComHandleId=2474, ComSystemTemplateSystemSignalRef=DET_SNR_114_Rx
          DET_PROB_1STAZHYPO_114_Rx_oRDR_FUSION_DET_113_116_oPCAN_RADAR_8f27e35d_Rx: ComBitPosition=215, ComBitSize=1, ComSignalType=BOOLEAN, ComHandleId=2450, ComSystemTemplateSystemSignalRef=DET_PROB_1STAZHYPO_114_Rx
          DET_EXISTENCE_PROB_113_Rx_oRDR_FUSION_DET_113_116_oPCAN_RADAR_eaff2cfc_Rx: ComBitPosition=112, ComBitSize=6, ComSignalType=UINT8, ComHandleId=2430, ComSystemTemplateSystemSignalRef=DET_EXISTENCE_PROB_113_Rx
          DET_IDM_115_Rx_oRDR_FUSION_DET_113_116_oPCAN_RADAR_579959eb_Rx: ComBitPosition=287, ComBitSize=1, ComSignalType=BOOLEAN, ComHandleId=2440, ComSystemTemplateSystemSignalRef=DET_IDM_115_Rx
          DET_RANGE_ERR_113_Rx_oRDR_FUSION_DET_113_116_oPCAN_RADAR_7e5574fd_Rx: ComBitPosition=40, ComBitSize=7, ComSignalType=UINT8, ComHandleId=2457, ComSystemTemplateSystemSignalRef=DET_RANGE_ERR_113_Rx
          DET_RANGE_VELOCITY_116_Rx_oRDR_FUSION_DET_113_116_oPCAN_RADAR_8c97aa7b_Rx: ComBitPosition=384, ComBitSize=15, ComSignalType=UINT16, ComHandleId=2464, ComSystemTemplateSystemSignalRef=DET_RANGE_VELOCITY_116_Rx
          DET_EXISTENCE_PROB_114_Rx_oRDR_FUSION_DET_113_116_oPCAN_RADAR_10c2dfab_Rx: ComBitPosition=224, ComBitSize=6, ComSignalType=UINT8, ComHandleId=2431, ComSystemTemplateSystemSignalRef=DET_EXISTENCE_PROB_114_Rx
          DET_BI_STATIC_FLAG_116_Rx_oRDR_FUSION_DET_113_116_oPCAN_RADAR_53802104_Rx: ComBitPosition=440, ComBitSize=1, ComSignalType=BOOLEAN, ComHandleId=2413, ComSystemTemplateSystemSignalRef=DET_BI_STATIC_FLAG_116_Rx
          DET_RANGE_ERR_115_Rx_oRDR_FUSION_DET_113_116_oPCAN_RADAR_2b2c15ed_Rx: ComBitPosition=264, ComBitSize=7, ComSignalType=UINT8, ComHandleId=2459, ComSystemTemplateSystemSignalRef=DET_RANGE_ERR_115_Rx
          DET_RANGE_VELOCITY_ERR_116_Rx_oRDR_FUSION_DET_113_116_oPCAN_RADAR_15f3dab9_Rx: ComBitPosition=400, ComBitSize=8, ComSignalType=UINT8, ComHandleId=2468, ComSystemTemplateSystemSignalRef=DET_RANGE_VELOCITY_ERR_116_Rx
          DET_MTD_115_Rx_oRDR_FUSION_DET_113_116_oPCAN_RADAR_ea1a6f9b_Rx: ComBitPosition=271, ComBitSize=1, ComSignalType=BOOLEAN, ComHandleId=2447, ComSystemTemplateSystemSignalRef=DET_MTD_115_Rx
          DET_AZIMUTH_ERR_113_Rx_oRDR_FUSION_DET_113_116_oPCAN_RADAR_3f0805b8_Rx: ComBitPosition=105, ComBitSize=7, ComSignalType=UINT8, ComHandleId=2402, ComSystemTemplateSystemSignalRef=DET_AZIMUTH_ERR_113_Rx
          DET_AZIMUTH_ERR_115_Rx_oRDR_FUSION_DET_113_116_oPCAN_RADAR_6a7164a8_Rx: ComBitPosition=329, ComBitSize=7, ComSignalType=UINT8, ComHandleId=2404, ComSystemTemplateSystemSignalRef=DET_AZIMUTH_ERR_115_Rx
          DET_SNR_115_Rx_oRDR_FUSION_DET_113_116_oPCAN_RADAR_62baf901_Rx: ComBitPosition=344, ComBitSize=8, ComSignalType=UINT8, ComHandleId=2475, ComSystemTemplateSystemSignalRef=DET_SNR_115_Rx
          DET_CONFD_ELEVATION_115_Rx_oRDR_FUSION_DET_113_116_oPCAN_RADAR_9074f85f_Rx: ComBitPosition=325, ComBitSize=2, ComSignalType=UINT8, ComHandleId=2420, ComSystemTemplateSystemSignalRef=DET_CONFD_ELEVATION_115_Rx
          DET_MTD_116_Rx_oRDR_FUSION_DET_113_116_oPCAN_RADAR_c0a6df13_Rx: ComBitPosition=383, ComBitSize=1, ComSignalType=BOOLEAN, ComHandleId=2448, ComSystemTemplateSystemSignalRef=DET_MTD_116_Rx
          DET_RANGE_ERR_114_Rx_oRDR_FUSION_DET_113_116_oPCAN_RADAR_846887aa_Rx: ComBitPosition=152, ComBitSize=7, ComSignalType=UINT8, ComHandleId=2458, ComSystemTemplateSystemSignalRef=DET_RANGE_ERR_114_Rx
          DET_RCS_116_Rx_oRDR_FUSION_DET_113_116_oPCAN_RADAR_415c3860_Rx: ComBitPosition=464, ComBitSize=8, ComSignalType=UINT8, ComHandleId=2472, ComSystemTemplateSystemSignalRef=DET_RCS_116_Rx
          DET_RANGE_116_Rx_oRDR_FUSION_DET_113_116_oPCAN_RADAR_51622985_Rx: ComBitPosition=360, ComBitSize=15, ComSignalType=UINT16, ComHandleId=2456, ComSystemTemplateSystemSignalRef=DET_RANGE_116_Rx
          DET_AZIMUTH_114_Rx_oRDR_FUSION_DET_113_116_oPCAN_RADAR_c75c576d_Rx: ComBitPosition=200, ComBitSize=13, ComSignalType=UINT16, ComHandleId=2399, ComSystemTemplateSystemSignalRef=DET_AZIMUTH_114_Rx
          DET_ELEVATION_ERR_113_Rx_oRDR_FUSION_DET_113_116_oPCAN_RADAR_1de75469_Rx: ComBitPosition=80, ComBitSize=6, ComSignalType=UINT8, ComHandleId=2426, ComSystemTemplateSystemSignalRef=DET_ELEVATION_ERR_113_Rx
          DET_RANGE_VELOCITY_ERR_115_Rx_oRDR_FUSION_DET_113_116_oPCAN_RADAR_3f4f6a31_Rx: ComBitPosition=288, ComBitSize=8, ComSignalType=UINT8, ComHandleId=2467, ComSystemTemplateSystemSignalRef=DET_RANGE_VELOCITY_ERR_115_Rx
          DET_EXISTENCE_PROB_116_Rx_oRDR_FUSION_DET_113_116_oPCAN_RADAR_953afd64_Rx: ComBitPosition=448, ComBitSize=6, ComSignalType=UINT8, ComHandleId=2433, ComSystemTemplateSystemSignalRef=DET_EXISTENCE_PROB_116_Rx
          DET_RANGE_114_Rx_oRDR_FUSION_DET_113_116_oPCAN_RADAR_d49a0b4a_Rx: ComBitPosition=136, ComBitSize=15, ComSignalType=UINT16, ComHandleId=2454, ComSystemTemplateSystemSignalRef=DET_RANGE_114_Rx
          DET_RANGE_113_Rx_oRDR_FUSION_DET_113_116_oPCAN_RADAR_2ea7f81d_Rx: ComBitPosition=24, ComBitSize=15, ComSignalType=UINT16, ComHandleId=2453, ComSystemTemplateSystemSignalRef=DET_RANGE_113_Rx
          DET_RANGE_ERR_116_Rx_oRDR_FUSION_DET_113_116_oPCAN_RADAR_0190a565_Rx: ComBitPosition=376, ComBitSize=7, ComSignalType=UINT8, ComHandleId=2460, ComSystemTemplateSystemSignalRef=DET_RANGE_ERR_116_Rx
          DET_ELEVATION_115_Rx_oRDR_FUSION_DET_113_116_oPCAN_RADAR_9a2717a6_Rx: ComBitPosition=296, ComBitSize=8, ComSignalType=UINT8, ComHandleId=2424, ComSystemTemplateSystemSignalRef=DET_ELEVATION_115_Rx
          DET_MH_CYCLE_COUNTER_113_116_Rx_oRDR_FUSION_DET_113_116_oPCAN_RADAR_9ed63674_Rx: ComBitPosition=16, ComBitSize=8, ComSignalType=UINT8, ComHandleId=2443, ComSystemTemplateSystemSignalRef=DET_MH_CYCLE_COUNTER_113_116_Rx
          DET_CONFD_AZIMUTH_115_Rx_oRDR_FUSION_DET_113_116_oPCAN_RADAR_9a557bd8_Rx: ComBitPosition=342, ComBitSize=2, ComSignalType=UINT8, ComHandleId=2416, ComSystemTemplateSystemSignalRef=DET_CONFD_AZIMUTH_115_Rx
          DET_MH_CRC16_113_116_Rx_oRDR_FUSION_DET_113_116_oPCAN_RADAR_930d0bb1_Rx: ComBitPosition=0, ComBitSize=16, ComSignalType=UINT16, ComHandleId=2442, ComSystemTemplateSystemSignalRef=DET_MH_CRC16_113_116_Rx
          DET_SUPER_RES_TARGET_113_Rx_oRDR_FUSION_DET_113_116_oPCAN_RADAR_fc38b911_Rx: ComBitPosition=87, ComBitSize=1, ComSignalType=BOOLEAN, ComHandleId=2477, ComSystemTemplateSystemSignalRef=DET_SUPER_RES_TARGET_113_Rx
          DET_SUPER_RES_TARGET_115_Rx_oRDR_FUSION_DET_113_116_oPCAN_RADAR_a941d801_Rx: ComBitPosition=311, ComBitSize=1, ComSignalType=BOOLEAN, ComHandleId=2479, ComSystemTemplateSystemSignalRef=DET_SUPER_RES_TARGET_115_Rx
          DET_ELEVATION_ERR_114_Rx_oRDR_FUSION_DET_113_116_oPCAN_RADAR_e7daa73e_Rx: ComBitPosition=192, ComBitSize=6, ComSignalType=UINT8, ComHandleId=2427, ComSystemTemplateSystemSignalRef=DET_ELEVATION_ERR_114_Rx
          DET_RANGE_VELOCITY_113_Rx_oRDR_FUSION_DET_113_116_oPCAN_RADAR_f3527be3_Rx: ComBitPosition=48, ComBitSize=15, ComSignalType=UINT16, ComHandleId=2461, ComSystemTemplateSystemSignalRef=DET_RANGE_VELOCITY_113_Rx
          DET_BI_STATIC_FLAG_114_Rx_oRDR_FUSION_DET_113_116_oPCAN_RADAR_d67803cb_Rx: ComBitPosition=216, ComBitSize=1, ComSignalType=BOOLEAN, ComHandleId=2411, ComSystemTemplateSystemSignalRef=DET_BI_STATIC_FLAG_114_Rx
          DET_PROB_1STAZHYPO_113_Rx_oRDR_FUSION_DET_113_116_oPCAN_RADAR_751a100a_Rx: ComBitPosition=103, ComBitSize=1, ComSignalType=BOOLEAN, ComHandleId=2449, ComSystemTemplateSystemSignalRef=DET_PROB_1STAZHYPO_113_Rx
          DET_RANGE_VELOCITY_115_Rx_oRDR_FUSION_DET_113_116_oPCAN_RADAR_a62b1af3_Rx: ComBitPosition=272, ComBitSize=15, ComSignalType=UINT16, ComHandleId=2463, ComSystemTemplateSystemSignalRef=DET_RANGE_VELOCITY_115_Rx
          DET_IDM_114_Rx_oRDR_FUSION_DET_113_116_oPCAN_RADAR_f8ddcbac_Rx: ComBitPosition=175, ComBitSize=1, ComSignalType=BOOLEAN, ComHandleId=2439, ComSystemTemplateSystemSignalRef=DET_IDM_114_Rx
          DET_HVC_FLAG_115_Rx_oRDR_FUSION_DET_113_116_oPCAN_RADAR_6258a0a3_Rx: ComBitPosition=310, ComBitSize=1, ComSignalType=BOOLEAN, ComHandleId=2436, ComSystemTemplateSystemSignalRef=DET_HVC_FLAG_115_Rx
          DET_SUPER_RES_TARGET_114_Rx_oRDR_FUSION_DET_113_116_oPCAN_RADAR_06054a46_Rx: ComBitPosition=199, ComBitSize=1, ComSignalType=BOOLEAN, ComHandleId=2478, ComSystemTemplateSystemSignalRef=DET_SUPER_RES_TARGET_114_Rx
          DET_CONFD_ELEVATION_116_Rx_oRDR_FUSION_DET_113_116_oPCAN_RADAR_bac848d7_Rx: ComBitPosition=437, ComBitSize=2, ComSignalType=UINT8, ComHandleId=2421, ComSystemTemplateSystemSignalRef=DET_CONFD_ELEVATION_116_Rx
          DET_BELOW_RAIN_THOLD_114_Rx_oRDR_FUSION_DET_113_116_oPCAN_RADAR_a1e6a8d8_Rx: ComBitPosition=151, ComBitSize=1, ComSignalType=BOOLEAN, ComHandleId=2407, ComSystemTemplateSystemSignalRef=DET_BELOW_RAIN_THOLD_114_Rx
          DET_SNR_116_Rx_oRDR_FUSION_DET_113_116_oPCAN_RADAR_48064989_Rx: ComBitPosition=456, ComBitSize=8, ComSignalType=UINT8, ComHandleId=2476, ComSystemTemplateSystemSignalRef=DET_SNR_116_Rx
          DET_ELEVATION_116_Rx_oRDR_FUSION_DET_113_116_oPCAN_RADAR_b09ba72e_Rx: ComBitPosition=408, ComBitSize=8, ComSignalType=UINT8, ComHandleId=2425, ComSystemTemplateSystemSignalRef=DET_ELEVATION_116_Rx
          DET_MTD_114_Rx_oRDR_FUSION_DET_113_116_oPCAN_RADAR_455efddc_Rx: ComBitPosition=159, ComBitSize=1, ComSignalType=BOOLEAN, ComHandleId=2446, ComSystemTemplateSystemSignalRef=DET_MTD_114_Rx
          DET_BI_STATIC_FLAG_115_Rx_oRDR_FUSION_DET_113_116_oPCAN_RADAR_793c918c_Rx: ComBitPosition=328, ComBitSize=1, ComSignalType=BOOLEAN, ComHandleId=2412, ComSystemTemplateSystemSignalRef=DET_BI_STATIC_FLAG_115_Rx
          DET_IDM_113_Rx_oRDR_FUSION_DET_113_116_oPCAN_RADAR_02e038fb_Rx: ComBitPosition=63, ComBitSize=1, ComSignalType=BOOLEAN, ComHandleId=2438, ComSystemTemplateSystemSignalRef=DET_IDM_113_Rx
      SG_Fusion_Detections_073_076_oRDR_FUSION_DET_073_076_oPCAN_RADAR_6c2268ef_Rx (ComSignalGroup):
        ComTimeout = 0
        ComTransferProperty = PENDING
        ComSignalGroupAccess = ACCESS_NEEDED_BY_SWC_OR_COM
        ComHandleId = 26
        ComSignalGroupArrayAccess = true
        ComSystemTemplateSignalGroupRef = SG_Fusion_Detections_073_076
        83 x ComGroupSignal, all with ComSignalEndianness=LITTLE_ENDIAN, ComSignalInitValue=0, ComSignalAccess=ACCESS_NEEDED_BY_SWC_OR_COM:
          DET_BI_STATIC_FLAG_076_Rx_oRDR_FUSION_DET_073_076_oPCAN_RADAR_77fc606c_Rx: ComBitPosition=440, ComBitSize=1, ComSignalType=BOOLEAN, ComHandleId=1583, ComSystemTemplateSystemSignalRef=DET_BI_STATIC_FLAG_076_Rx
          DET_MTD_073_Rx_oRDR_FUSION_DET_073_076_oPCAN_RADAR_9b1f4fe3_Rx: ComBitPosition=47, ComBitSize=1, ComSignalType=BOOLEAN, ComHandleId=1615, ComSystemTemplateSystemSignalRef=DET_MTD_073_Rx
          DET_RANGE_VELOCITY_ERR_074_Rx_oRDR_FUSION_DET_073_076_oPCAN_RADAR_b477b91e_Rx: ComBitPosition=176, ComBitSize=8, ComSignalType=UINT8, ComHandleId=1636, ComSystemTemplateSystemSignalRef=DET_RANGE_VELOCITY_ERR_074_Rx
          DET_AZIMUTH_076_Rx_oRDR_FUSION_DET_073_076_oPCAN_RADAR_66d834ca_Rx: ComBitPosition=424, ComBitSize=13, ComSignalType=UINT16, ComHandleId=1571, ComSystemTemplateSystemSignalRef=DET_AZIMUTH_076_Rx
          DET_BELOW_RAIN_THOLD_073_Rx_oRDR_FUSION_DET_073_076_oPCAN_RADAR_7fa71ae7_Rx: ComBitPosition=39, ComBitSize=1, ComSignalType=BOOLEAN, ComHandleId=1576, ComSystemTemplateSystemSignalRef=DET_BELOW_RAIN_THOLD_073_Rx
          DET_AZIMUTH_ERR_073_Rx_oRDR_FUSION_DET_073_076_oPCAN_RADAR_1b7444d0_Rx: ComBitPosition=105, ComBitSize=7, ComSignalType=UINT8, ComHandleId=1572, ComSystemTemplateSystemSignalRef=DET_AZIMUTH_ERR_073_Rx
          DET_HVC_FLAG_074_Rx_oRDR_FUSION_DET_073_076_oPCAN_RADAR_e960738c_Rx: ComBitPosition=198, ComBitSize=1, ComSignalType=BOOLEAN, ComHandleId=1605, ComSystemTemplateSystemSignalRef=DET_HVC_FLAG_074_Rx
          DET_SNR_075_Rx_oRDR_FUSION_DET_073_076_oPCAN_RADAR_46c6b869_Rx: ComBitPosition=344, ComBitSize=8, ComSignalType=UINT8, ComHandleId=1645, ComSystemTemplateSystemSignalRef=DET_SNR_075_Rx
          DET_ELEVATION_073_Rx_oRDR_FUSION_DET_073_076_oPCAN_RADAR_eb2237de_Rx: ComBitPosition=72, ComBitSize=8, ComSignalType=UINT8, ComHandleId=1592, ComSystemTemplateSystemSignalRef=DET_ELEVATION_073_Rx
          DET_BI_STATIC_FLAG_075_Rx_oRDR_FUSION_DET_073_076_oPCAN_RADAR_5d40d0e4_Rx: ComBitPosition=328, ComBitSize=1, ComSignalType=BOOLEAN, ComHandleId=1582, ComSystemTemplateSystemSignalRef=DET_BI_STATIC_FLAG_075_Rx
          DET_CONFD_AZIMUTH_073_Rx_oRDR_FUSION_DET_073_076_oPCAN_RADAR_eb505ba0_Rx: ComBitPosition=118, ComBitSize=2, ComSignalType=UINT8, ComHandleId=1584, ComSystemTemplateSystemSignalRef=DET_CONFD_AZIMUTH_073_Rx
          DET_IDM_076_Rx_oRDR_FUSION_DET_073_076_oPCAN_RADAR_5959a80b_Rx: ComBitPosition=399, ComBitSize=1, ComSignalType=BOOLEAN, ComHandleId=1611, ComSystemTemplateSystemSignalRef=DET_IDM_076_Rx
          DET_SUPER_RES_TARGET_076_Rx_oRDR_FUSION_DET_073_076_oPCAN_RADAR_a78129e1_Rx: ComBitPosition=423, ComBitSize=1, ComSignalType=BOOLEAN, ComHandleId=1650, ComSystemTemplateSystemSignalRef=DET_SUPER_RES_TARGET_076_Rx
          DET_ELEVATION_074_Rx_oRDR_FUSION_DET_073_076_oPCAN_RADAR_111fc489_Rx: ComBitPosition=184, ComBitSize=8, ComSignalType=UINT8, ComHandleId=1593, ComSystemTemplateSystemSignalRef=DET_ELEVATION_074_Rx
          DET_HVC_FLAG_073_Rx_oRDR_FUSION_DET_073_076_oPCAN_RADAR_135d80db_Rx: ComBitPosition=86, ComBitSize=1, ComSignalType=BOOLEAN, ComHandleId=1604, ComSystemTemplateSystemSignalRef=DET_HVC_FLAG_073_Rx
          DET_BELOW_RAIN_THOLD_074_Rx_oRDR_FUSION_DET_073_076_oPCAN_RADAR_859ae9b0_Rx: ComBitPosition=151, ComBitSize=1, ComSignalType=BOOLEAN, ComHandleId=1577, ComSystemTemplateSystemSignalRef=DET_BELOW_RAIN_THOLD_074_Rx
          DET_BI_STATIC_FLAG_074_Rx_oRDR_FUSION_DET_073_076_oPCAN_RADAR_f20442a3_Rx: ComBitPosition=216, ComBitSize=1, ComSignalType=BOOLEAN, ComHandleId=1581, ComSystemTemplateSystemSignalRef=DET_BI_STATIC_FLAG_074_Rx
          DET_RCS_074_Rx_oRDR_FUSION_DET_073_076_oPCAN_RADAR_e0d85bc7_Rx: ComBitPosition=240, ComBitSize=8, ComSignalType=UINT8, ComHandleId=1640, ComSystemTemplateSystemSignalRef=DET_RCS_074_Rx
          DET_RANGE_VELOCITY_073_Rx_oRDR_FUSION_DET_073_076_oPCAN_RADAR_d72e3a8b_Rx: ComBitPosition=48, ComBitSize=15, ComSignalType=UINT16, ComHandleId=1631, ComSystemTemplateSystemSignalRef=DET_RANGE_VELOCITY_073_Rx
          DET_CONFD_ELEVATION_075_Rx_oRDR_FUSION_DET_073_076_oPCAN_RADAR_b408b937_Rx: ComBitPosition=325, ComBitSize=2, ComSignalType=UINT8, ComHandleId=1590, ComSystemTemplateSystemSignalRef=DET_CONFD_ELEVATION_075_Rx
          DET_MTD_075_Rx_oRDR_FUSION_DET_073_076_oPCAN_RADAR_ce662ef3_Rx: ComBitPosition=271, ComBitSize=1, ComSignalType=BOOLEAN, ComHandleId=1617, ComSystemTemplateSystemSignalRef=DET_MTD_075_Rx
          DET_ELEVATION_ERR_076_Rx_oRDR_FUSION_DET_073_076_oPCAN_RADAR_465ec499_Rx: ComBitPosition=416, ComBitSize=6, ComSignalType=UINT8, ComHandleId=1599, ComSystemTemplateSystemSignalRef=DET_ELEVATION_ERR_076_Rx
          DET_AZIMUTH_074_Rx_oRDR_FUSION_DET_073_076_oPCAN_RADAR_e3201605_Rx: ComBitPosition=200, ComBitSize=13, ComSignalType=UINT16, ComHandleId=1569, ComSystemTemplateSystemSignalRef=DET_AZIMUTH_074_Rx
          DET_RCS_073_Rx_oRDR_FUSION_DET_073_076_oPCAN_RADAR_1ae5a890_Rx: ComBitPosition=128, ComBitSize=8, ComSignalType=UINT8, ComHandleId=1639, ComSystemTemplateSystemSignalRef=DET_RCS_073_Rx
          DET_ELEVATION_ERR_073_Rx_oRDR_FUSION_DET_073_076_oPCAN_RADAR_399b1501_Rx: ComBitPosition=80, ComBitSize=6, ComSignalType=UINT8, ComHandleId=1596, ComSystemTemplateSystemSignalRef=DET_ELEVATION_ERR_073_Rx
          DET_AZIMUTH_ERR_074_Rx_oRDR_FUSION_DET_073_076_oPCAN_RADAR_e149b787_Rx: ComBitPosition=217, ComBitSize=7, ComSignalType=UINT8, ComHandleId=1573, ComSystemTemplateSystemSignalRef=DET_AZIMUTH_ERR_074_Rx
          DET_ELEVATION_ERR_074_Rx_oRDR_FUSION_DET_073_076_oPCAN_RADAR_c3a6e656_Rx: ComBitPosition=192, ComBitSize=6, ComSignalType=UINT8, ComHandleId=1597, ComSystemTemplateSystemSignalRef=DET_ELEVATION_ERR_074_Rx
          DET_PROB_1STAZHYPO_076_Rx_oRDR_FUSION_DET_073_076_oPCAN_RADAR_2ea380fa_Rx: ComBitPosition=439, ComBitSize=1, ComSignalType=BOOLEAN, ComHandleId=1622, ComSystemTemplateSystemSignalRef=DET_PROB_1STAZHYPO_076_Rx
          DET_RANGE_VELOCITY_ERR_073_Rx_oRDR_FUSION_DET_073_076_oPCAN_RADAR_4e4a4a49_Rx: ComBitPosition=64, ComBitSize=8, ComSignalType=UINT8, ComHandleId=1635, ComSystemTemplateSystemSignalRef=DET_RANGE_VELOCITY_ERR_073_Rx
          DET_RCS_075_Rx_oRDR_FUSION_DET_073_076_oPCAN_RADAR_4f9cc980_Rx: ComBitPosition=352, ComBitSize=8, ComSignalType=UINT8, ComHandleId=1641, ComSystemTemplateSystemSignalRef=DET_RCS_075_Rx
          DET_SUPER_RES_TARGET_074_Rx_oRDR_FUSION_DET_073_076_oPCAN_RADAR_22790b2e_Rx: ComBitPosition=199, ComBitSize=1, ComSignalType=BOOLEAN, ComHandleId=1648, ComSystemTemplateSystemSignalRef=DET_SUPER_RES_TARGET_074_Rx
          DET_RANGE_ERR_074_Rx_oRDR_FUSION_DET_073_076_oPCAN_RADAR_a014c6c2_Rx: ComBitPosition=152, ComBitSize=7, ComSignalType=UINT8, ComHandleId=1628, ComSystemTemplateSystemSignalRef=DET_RANGE_ERR_074_Rx
          DET_RANGE_VELOCITY_ERR_076_Rx_oRDR_FUSION_DET_073_076_oPCAN_RADAR_318f9bd1_Rx: ComBitPosition=400, ComBitSize=8, ComSignalType=UINT8, ComHandleId=1638, ComSystemTemplateSystemSignalRef=DET_RANGE_VELOCITY_ERR_076_Rx
          DET_SNR_074_Rx_oRDR_FUSION_DET_073_076_oPCAN_RADAR_e9822a2e_Rx: ComBitPosition=232, ComBitSize=8, ComSignalType=UINT8, ComHandleId=1644, ComSystemTemplateSystemSignalRef=DET_SNR_074_Rx
          DET_MH_SCAN_INDEX_4LSB_073_076_Rx_oRDR_FUSION_DET_073_076_oPCAN_RADAR_de45de9e_Rx: ComBitPosition=476, ComBitSize=4, ComSignalType=UINT8, ComHandleId=1614, ComSystemTemplateSystemSignalRef=DET_MH_SCAN_INDEX_4LSB_073_076_Rx
          DET_RANGE_ERR_075_Rx_oRDR_FUSION_DET_073_076_oPCAN_RADAR_0f505485_Rx: ComBitPosition=264, ComBitSize=7, ComSignalType=UINT8, ComHandleId=1629, ComSystemTemplateSystemSignalRef=DET_RANGE_ERR_075_Rx
          DET_SNR_076_Rx_oRDR_FUSION_DET_073_076_oPCAN_RADAR_6c7a08e1_Rx: ComBitPosition=456, ComBitSize=8, ComSignalType=UINT8, ComHandleId=1646, ComSystemTemplateSystemSignalRef=DET_SNR_076_Rx
          DET_RANGE_VELOCITY_ERR_075_Rx_oRDR_FUSION_DET_073_076_oPCAN_RADAR_1b332b59_Rx: ComBitPosition=288, ComBitSize=8, ComSignalType=UINT8, ComHandleId=1637, ComSystemTemplateSystemSignalRef=DET_RANGE_VELOCITY_ERR_075_Rx
          DET_SNR_073_Rx_oRDR_FUSION_DET_073_076_oPCAN_RADAR_13bfd979_Rx: ComBitPosition=120, ComBitSize=8, ComSignalType=UINT8, ComHandleId=1643, ComSystemTemplateSystemSignalRef=DET_SNR_073_Rx
          DET_EXISTENCE_PROB_076_Rx_oRDR_FUSION_DET_073_076_oPCAN_RADAR_b146bc0c_Rx: ComBitPosition=448, ComBitSize=6, ComSignalType=UINT8, ComHandleId=1603, ComSystemTemplateSystemSignalRef=DET_EXISTENCE_PROB_076_Rx
          DET_ELEVATION_ERR_075_Rx_oRDR_FUSION_DET_073_076_oPCAN_RADAR_6ce27411_Rx: ComBitPosition=304, ComBitSize=6, ComSignalType=UINT8, ComHandleId=1598, ComSystemTemplateSystemSignalRef=DET_ELEVATION_ERR_075_Rx
          DET_SUPER_RES_TARGET_075_Rx_oRDR_FUSION_DET_073_076_oPCAN_RADAR_8d3d9969_Rx: ComBitPosition=311, ComBitSize=1, ComSignalType=BOOLEAN, ComHandleId=1649, ComSystemTemplateSystemSignalRef=DET_SUPER_RES_TARGET_075_Rx
          DET_AZIMUTH_075_Rx_oRDR_FUSION_DET_073_076_oPCAN_RADAR_4c648442_Rx: ComBitPosition=312, ComBitSize=13, ComSignalType=UINT16, ComHandleId=1570, ComSystemTemplateSystemSignalRef=DET_AZIMUTH_075_Rx
          DET_MTD_076_Rx_oRDR_FUSION_DET_073_076_oPCAN_RADAR_e4da9e7b_Rx: ComBitPosition=383, ComBitSize=1, ComSignalType=BOOLEAN, ComHandleId=1618, ComSystemTemplateSystemSignalRef=DET_MTD_076_Rx
          DET_HVC_FLAG_076_Rx_oRDR_FUSION_DET_073_076_oPCAN_RADAR_6c985143_Rx: ComBitPosition=422, ComBitSize=1, ComSignalType=BOOLEAN, ComHandleId=1607, ComSystemTemplateSystemSignalRef=DET_HVC_FLAG_076_Rx
          DET_RANGE_VELOCITY_075_Rx_oRDR_FUSION_DET_073_076_oPCAN_RADAR_82575b9b_Rx: ComBitPosition=272, ComBitSize=15, ComSignalType=UINT16, ComHandleId=1633, ComSystemTemplateSystemSignalRef=DET_RANGE_VELOCITY_075_Rx
          DET_CONFD_AZIMUTH_074_Rx_oRDR_FUSION_DET_073_076_oPCAN_RADAR_116da8f7_Rx: ComBitPosition=230, ComBitSize=2, ComSignalType=UINT8, ComHandleId=1585, ComSystemTemplateSystemSignalRef=DET_CONFD_AZIMUTH_074_Rx
          DET_BI_STATIC_FLAG_073_Rx_oRDR_FUSION_DET_073_076_oPCAN_RADAR_0839b1f4_Rx: ComBitPosition=104, ComBitSize=1, ComSignalType=BOOLEAN, ComHandleId=1580, ComSystemTemplateSystemSignalRef=DET_BI_STATIC_FLAG_073_Rx
          DET_CONFD_AZIMUTH_076_Rx_oRDR_FUSION_DET_073_076_oPCAN_RADAR_94958a38_Rx: ComBitPosition=454, ComBitSize=2, ComSignalType=UINT8, ComHandleId=1587, ComSystemTemplateSystemSignalRef=DET_CONFD_AZIMUTH_076_Rx
          DET_RANGE_074_Rx_oRDR_FUSION_DET_073_076_oPCAN_RADAR_f0e64a22_Rx: ComBitPosition=136, ComBitSize=15, ComSignalType=UINT16, ComHandleId=1624, ComSystemTemplateSystemSignalRef=DET_RANGE_074_Rx
          DET_BELOW_RAIN_THOLD_076_Rx_oRDR_FUSION_DET_073_076_oPCAN_RADAR_0062cb7f_Rx: ComBitPosition=375, ComBitSize=1, ComSignalType=BOOLEAN, ComHandleId=1579, ComSystemTemplateSystemSignalRef=DET_BELOW_RAIN_THOLD_076_Rx
          DET_SUPER_RES_TARGET_073_Rx_oRDR_FUSION_DET_073_076_oPCAN_RADAR_d844f879_Rx: ComBitPosition=87, ComBitSize=1, ComSignalType=BOOLEAN, ComHandleId=1647, ComSystemTemplateSystemSignalRef=DET_SUPER_RES_TARGET_073_Rx
          DET_ELEVATION_075_Rx_oRDR_FUSION_DET_073_076_oPCAN_RADAR_be5b56ce_Rx: ComBitPosition=296, ComBitSize=8, ComSignalType=UINT8, ComHandleId=1594, ComSystemTemplateSystemSignalRef=DET_ELEVATION_075_Rx
          DET_HVC_FLAG_075_Rx_oRDR_FUSION_DET_073_076_oPCAN_RADAR_4624e1cb_Rx: ComBitPosition=310, ComBitSize=1, ComSignalType=BOOLEAN, ComHandleId=1606, ComSystemTemplateSystemSignalRef=DET_HVC_FLAG_075_Rx
          DET_IDM_074_Rx_oRDR_FUSION_DET_073_076_oPCAN_RADAR_dca18ac4_Rx: ComBitPosition=175, ComBitSize=1, ComSignalType=BOOLEAN, ComHandleId=1609, ComSystemTemplateSystemSignalRef=DET_IDM_074_Rx
          DET_AZIMUTH_ERR_076_Rx_oRDR_FUSION_DET_073_076_oPCAN_RADAR_64b19548_Rx: ComBitPosition=441, ComBitSize=7, ComSignalType=UINT8, ComHandleId=1575, ComSystemTemplateSystemSignalRef=DET_AZIMUTH_ERR_076_Rx
          DET_EXISTENCE_PROB_075_Rx_oRDR_FUSION_DET_073_076_oPCAN_RADAR_9bfa0c84_Rx: ComBitPosition=336, ComBitSize=6, ComSignalType=UINT8, ComHandleId=1602, ComSystemTemplateSystemSignalRef=DET_EXISTENCE_PROB_075_Rx
          DET_EXISTENCE_PROB_074_Rx_oRDR_FUSION_DET_073_076_oPCAN_RADAR_34be9ec3_Rx: ComBitPosition=224, ComBitSize=6, ComSignalType=UINT8, ComHandleId=1601, ComSystemTemplateSystemSignalRef=DET_EXISTENCE_PROB_074_Rx
          DET_RANGE_075_Rx_oRDR_FUSION_DET_073_076_oPCAN_RADAR_5fa2d865_Rx: ComBitPosition=248, ComBitSize=15, ComSignalType=UINT16, ComHandleId=1625, ComSystemTemplateSystemSignalRef=DET_RANGE_075_Rx
          DET_RANGE_VELOCITY_076_Rx_oRDR_FUSION_DET_073_076_oPCAN_RADAR_a8ebeb13_Rx: ComBitPosition=384, ComBitSize=15, ComSignalType=UINT16, ComHandleId=1634, ComSystemTemplateSystemSignalRef=DET_RANGE_VELOCITY_076_Rx
          DET_ELEVATION_076_Rx_oRDR_FUSION_DET_073_076_oPCAN_RADAR_94e7e646_Rx: ComBitPosition=408, ComBitSize=8, ComSignalType=UINT8, ComHandleId=1595, ComSystemTemplateSystemSignalRef=DET_ELEVATION_076_Rx
          DET_RCS_076_Rx_oRDR_FUSION_DET_073_076_oPCAN_RADAR_65207908_Rx: ComBitPosition=464, ComBitSize=8, ComSignalType=UINT8, ComHandleId=1642, ComSystemTemplateSystemSignalRef=DET_RCS_076_Rx
          DET_PROB_1STAZHYPO_074_Rx_oRDR_FUSION_DET_073_076_oPCAN_RADAR_ab5ba235_Rx: ComBitPosition=215, ComBitSize=1, ComSignalType=BOOLEAN, ComHandleId=1620, ComSystemTemplateSystemSignalRef=DET_PROB_1STAZHYPO_074_Rx
          DET_EXISTENCE_PROB_073_Rx_oRDR_FUSION_DET_073_076_oPCAN_RADAR_ce836d94_Rx: ComBitPosition=112, ComBitSize=6, ComSignalType=UINT8, ComHandleId=1600, ComSystemTemplateSystemSignalRef=DET_EXISTENCE_PROB_073_Rx
          DET_RANGE_076_Rx_oRDR_FUSION_DET_073_076_oPCAN_RADAR_751e68ed_Rx: ComBitPosition=360, ComBitSize=15, ComSignalType=UINT16, ComHandleId=1626, ComSystemTemplateSystemSignalRef=DET_RANGE_076_Rx
          DET_IDM_075_Rx_oRDR_FUSION_DET_073_076_oPCAN_RADAR_73e51883_Rx: ComBitPosition=287, ComBitSize=1, ComSignalType=BOOLEAN, ComHandleId=1610, ComSystemTemplateSystemSignalRef=DET_IDM_075_Rx
          DET_RANGE_073_Rx_oRDR_FUSION_DET_073_076_oPCAN_RADAR_0adbb975_Rx: ComBitPosition=24, ComBitSize=15, ComSignalType=UINT16, ComHandleId=1623, ComSystemTemplateSystemSignalRef=DET_RANGE_073_Rx
          DET_AZIMUTH_ERR_075_Rx_oRDR_FUSION_DET_073_076_oPCAN_RADAR_4e0d25c0_Rx: ComBitPosition=329, ComBitSize=7, ComSignalType=UINT8, ComHandleId=1574, ComSystemTemplateSystemSignalRef=DET_AZIMUTH_ERR_075_Rx
          DET_BELOW_RAIN_THOLD_075_Rx_oRDR_FUSION_DET_073_076_oPCAN_RADAR_2ade7bf7_Rx: ComBitPosition=263, ComBitSize=1, ComSignalType=BOOLEAN, ComHandleId=1578, ComSystemTemplateSystemSignalRef=DET_BELOW_RAIN_THOLD_075_Rx
          DET_CONFD_ELEVATION_074_Rx_oRDR_FUSION_DET_073_076_oPCAN_RADAR_1b4c2b70_Rx: ComBitPosition=213, ComBitSize=2, ComSignalType=UINT8, ComHandleId=1589, ComSystemTemplateSystemSignalRef=DET_CONFD_ELEVATION_074_Rx
          DET_AZIMUTH_073_Rx_oRDR_FUSION_DET_073_076_oPCAN_RADAR_191de552_Rx: ComBitPosition=88, ComBitSize=13, ComSignalType=UINT16, ComHandleId=1568, ComSystemTemplateSystemSignalRef=DET_AZIMUTH_073_Rx
          DET_MH_CYCLE_COUNTER_073_076_Rx_oRDR_FUSION_DET_073_076_oPCAN_RADAR_baf511a5_Rx: ComBitPosition=16, ComBitSize=8, ComSignalType=UINT8, ComHandleId=1613, ComSystemTemplateSystemSignalRef=DET_MH_CYCLE_COUNTER_073_076_Rx
          DET_IDM_073_Rx_oRDR_FUSION_DET_073_076_oPCAN_RADAR_269c7993_Rx: ComBitPosition=63, ComBitSize=1, ComSignalType=BOOLEAN, ComHandleId=1608, ComSystemTemplateSystemSignalRef=DET_IDM_073_Rx
          DET_RANGE_ERR_076_Rx_oRDR_FUSION_DET_073_076_oPCAN_RADAR_25ece40d_Rx: ComBitPosition=376, ComBitSize=7, ComSignalType=UINT8, ComHandleId=1630, ComSystemTemplateSystemSignalRef=DET_RANGE_ERR_076_Rx
          DET_CONFD_AZIMUTH_075_Rx_oRDR_FUSION_DET_073_076_oPCAN_RADAR_be293ab0_Rx: ComBitPosition=342, ComBitSize=2, ComSignalType=UINT8, ComHandleId=1586, ComSystemTemplateSystemSignalRef=DET_CONFD_AZIMUTH_075_Rx
          DET_CONFD_ELEVATION_076_Rx_oRDR_FUSION_DET_073_076_oPCAN_RADAR_9eb409bf_Rx: ComBitPosition=437, ComBitSize=2, ComSignalType=UINT8, ComHandleId=1591, ComSystemTemplateSystemSignalRef=DET_CONFD_ELEVATION_076_Rx
          DET_PROB_1STAZHYPO_073_Rx_oRDR_FUSION_DET_073_076_oPCAN_RADAR_51665162_Rx: ComBitPosition=103, ComBitSize=1, ComSignalType=BOOLEAN, ComHandleId=1619, ComSystemTemplateSystemSignalRef=DET_PROB_1STAZHYPO_073_Rx
          DET_MH_CRC16_073_076_Rx_oRDR_FUSION_DET_073_076_oPCAN_RADAR_b72e2c60_Rx: ComBitPosition=0, ComBitSize=16, ComSignalType=UINT16, ComHandleId=1612, ComSystemTemplateSystemSignalRef=DET_MH_CRC16_073_076_Rx
          DET_MTD_074_Rx_oRDR_FUSION_DET_073_076_oPCAN_RADAR_6122bcb4_Rx: ComBitPosition=159, ComBitSize=1, ComSignalType=BOOLEAN, ComHandleId=1616, ComSystemTemplateSystemSignalRef=DET_MTD_074_Rx
          DET_CONFD_ELEVATION_073_Rx_oRDR_FUSION_DET_073_076_oPCAN_RADAR_e171d827_Rx: ComBitPosition=101, ComBitSize=2, ComSignalType=UINT8, ComHandleId=1588, ComSystemTemplateSystemSignalRef=DET_CONFD_ELEVATION_073_Rx
          DET_RANGE_VELOCITY_074_Rx_oRDR_FUSION_DET_073_076_oPCAN_RADAR_2d13c9dc_Rx: ComBitPosition=160, ComBitSize=15, ComSignalType=UINT16, ComHandleId=1632, ComSystemTemplateSystemSignalRef=DET_RANGE_VELOCITY_074_Rx
          DET_PROB_1STAZHYPO_075_Rx_oRDR_FUSION_DET_073_076_oPCAN_RADAR_041f3072_Rx: ComBitPosition=327, ComBitSize=1, ComSignalType=BOOLEAN, ComHandleId=1621, ComSystemTemplateSystemSignalRef=DET_PROB_1STAZHYPO_075_Rx
          DET_RANGE_ERR_073_Rx_oRDR_FUSION_DET_073_076_oPCAN_RADAR_5a293595_Rx: ComBitPosition=40, ComBitSize=7, ComSignalType=UINT8, ComHandleId=1627, ComSystemTemplateSystemSignalRef=DET_RANGE_ERR_073_Rx
      4 x ComIPdu, all with ComIPduDirection=RECEIVE, ComIPduType=NORMAL, ComIPduCancellationSupport=false, ComIPduSignalProcessing=DEFERRED, ComIPduChannelRef=CN_PCAN_RADAR_458ff0f1, ComIPduGroupRef=RDR01_oPCAN_RADAR_Rx_e0e717e1 if post-build-variant-condition{matching-criterion=RDR_POS, value=0}, ComIPduMainFunctionRef=ComMainFunctionRx, ComIPduGroupRef=RDR02_oPCAN_RADAR_Rx_c92fa313 if post-build-variant-condition{matching-criterion=RDR_POS, value=1}, ComIPduGroupRef=RDR03_oPCAN_RADAR_Rx_67473282 if post-build-variant-condition{matching-criterion=RDR_POS, value=2}, ComIPduGroupRef=RDR04_oPCAN_RADAR_Rx_9abecaf7 if post-build-variant-condition{matching-criterion=RDR_POS, value=3}, ComIPduGroupRef=RDR05_oPCAN_RADAR_Rx_34d65b66 if post-build-variant-condition{matching-criterion=RDR_POS, value=4}, ComIPduGroupRef=RDR06_oPCAN_RADAR_Rx_1d1eef94 if post-build-variant-condition{matching-criterion=RDR_POS, value=5}, ComIPduGroupRef=RDR07_oPCAN_RADAR_Rx_b3767e05 if post-build-variant-condition{matching-criterion=RDR_POS, value=6}, ComIPduGroupRef=RDR08_oPCAN_RADAR_Rx_3d9c193f if post-build-variant-condition{matching-criterion=RDR_POS, value=7}:
        RDR_FUSION_DET_013_016_oPCAN_RADAR_15a3dfae_Rx: ComIPduHandleId=25, ComIPduSignalGroupRef=SG_Fusion_Detections_013_016_oRDR_FUSION_DET_013_016_oPCAN_RADAR_713b89f4_Rx, ComPduIdRef=RDR_FUSION_DET_013_016_oPCAN_RADAR_15a3dfae_Rx
        RDR_FUSION_DET_061_064_oPCAN_RADAR_25205a86_Rx: ComIPduHandleId=37, ComIPduSignalGroupRef=SG_Fusion_Detections_061_064_oRDR_FUSION_DET_061_064_oPCAN_RADAR_57616c84_Rx, ComPduIdRef=RDR_FUSION_DET_061_064_oPCAN_RADAR_25205a86_Rx
        RDR_FUSION_HEADER_001_oPCAN_RADAR_cc468fbf_Rx: ComIPduHandleId=54, ComIPduSignalGroupRef=SG_Fusion_RadarHeader_oRDR_FUSION_HEADER_001_oPCAN_RADAR_cad756d0_Rx, ComPduIdRef=RDR_FUSION_HEADER_001_oPCAN_RADAR_cc468fbf_Rx
        RDR_FUSION_DET_093_096_oPCAN_RADAR_31ab6f94_Rx: ComIPduHandleId=45, ComIPduSignalGroupRef=SG_Fusion_Detections_093_096_oRDR_FUSION_DET_093_096_oPCAN_RADAR_ebc9f7ef_Rx, ComPduIdRef=RDR_FUSION_DET_093_096_oPCAN_RADAR_31ab6f94_Rx
      SG_Fusion_Detections_121_124_oRDR_FUSION_DET_121_124_oPCAN_RADAR_9023764b_Rx (ComSignalGroup):
        ComTimeout = 0
        ComTransferProperty = PENDING
        ComSignalGroupAccess = ACCESS_NEEDED_BY_SWC_OR_COM
        ComHandleId = 38
        ComSignalGroupArrayAccess = true
        ComSystemTemplateSignalGroupRef = SG_Fusion_Detections_121_124
        83 x ComGroupSignal, all with ComSignalEndianness=LITTLE_ENDIAN, ComSignalInitValue=0, ComSignalAccess=ACCESS_NEEDED_BY_SWC_OR_COM:
          DET_SUPER_RES_TARGET_123_Rx_oRDR_FUSION_DET_121_124_oPCAN_RADAR_3df6d386_Rx: ComBitPosition=311, ComBitSize=1, ComSignalType=BOOLEAN, ComHandleId=2645, ComSystemTemplateSystemSignalRef=DET_SUPER_RES_TARGET_123_Rx
          DET_BI_STATIC_FLAG_122_Rx_oRDR_FUSION_DET_121_124_oPCAN_RADAR_42cf084c_Rx: ComBitPosition=216, ComBitSize=1, ComSignalType=BOOLEAN, ComHandleId=2577, ComSystemTemplateSystemSignalRef=DET_BI_STATIC_FLAG_122_Rx
          DET_RCS_124_Rx_oRDR_FUSION_DET_121_124_oPCAN_RADAR_056a7038_Rx: ComBitPosition=464, ComBitSize=8, ComSignalType=UINT8, ComHandleId=2638, ComSystemTemplateSystemSignalRef=DET_RCS_124_Rx
          DET_SNR_121_Rx_oRDR_FUSION_DET_121_124_oPCAN_RADAR_73f5d049_Rx: ComBitPosition=120, ComBitSize=8, ComSignalType=UINT8, ComHandleId=2639, ComSystemTemplateSystemSignalRef=DET_SNR_121_Rx
          DET_MTD_121_Rx_oRDR_FUSION_DET_121_124_oPCAN_RADAR_fb5546d3_Rx: ComBitPosition=47, ComBitSize=1, ComSignalType=BOOLEAN, ComHandleId=2611, ComSystemTemplateSystemSignalRef=DET_MTD_121_Rx
          DET_ELEVATION_ERR_124_Rx_oRDR_FUSION_DET_121_124_oPCAN_RADAR_2614cda9_Rx: ComBitPosition=416, ComBitSize=6, ComSignalType=UINT8, ComHandleId=2595, ComSystemTemplateSystemSignalRef=DET_ELEVATION_ERR_124_Rx
          DET_RANGE_ERR_122_Rx_oRDR_FUSION_DET_121_124_oPCAN_RADAR_10df8c2d_Rx: ComBitPosition=152, ComBitSize=7, ComSignalType=UINT8, ComHandleId=2624, ComSystemTemplateSystemSignalRef=DET_RANGE_ERR_122_Rx
          DET_AZIMUTH_123_Rx_oRDR_FUSION_DET_121_124_oPCAN_RADAR_fcafcead_Rx: ComBitPosition=312, ComBitSize=13, ComSignalType=UINT16, ComHandleId=2566, ComSystemTemplateSystemSignalRef=DET_AZIMUTH_123_Rx
          DET_EXISTENCE_PROB_121_Rx_oRDR_FUSION_DET_121_124_oPCAN_RADAR_aec964a4_Rx: ComBitPosition=112, ComBitSize=6, ComSignalType=UINT8, ComHandleId=2596, ComSystemTemplateSystemSignalRef=DET_EXISTENCE_PROB_121_Rx
          DET_IDM_121_Rx_oRDR_FUSION_DET_121_124_oPCAN_RADAR_46d670a3_Rx: ComBitPosition=63, ComBitSize=1, ComSignalType=BOOLEAN, ComHandleId=2604, ComSystemTemplateSystemSignalRef=DET_IDM_121_Rx
          DET_AZIMUTH_ERR_122_Rx_oRDR_FUSION_DET_121_124_oPCAN_RADAR_5182fd68_Rx: ComBitPosition=217, ComBitSize=7, ComSignalType=UINT8, ComHandleId=2569, ComSystemTemplateSystemSignalRef=DET_AZIMUTH_ERR_122_Rx
          DET_PROB_1STAZHYPO_123_Rx_oRDR_FUSION_DET_121_124_oPCAN_RADAR_b4d47a9d_Rx: ComBitPosition=327, ComBitSize=1, ComSignalType=BOOLEAN, ComHandleId=2617, ComSystemTemplateSystemSignalRef=DET_PROB_1STAZHYPO_123_Rx
          DET_RANGE_VELOCITY_ERR_122_Rx_oRDR_FUSION_DET_121_124_oPCAN_RADAR_04bcf3f1_Rx: ComBitPosition=176, ComBitSize=8, ComSignalType=UINT8, ComHandleId=2632, ComSystemTemplateSystemSignalRef=DET_RANGE_VELOCITY_ERR_122_Rx
          DET_BELOW_RAIN_THOLD_124_Rx_oRDR_FUSION_DET_121_124_oPCAN_RADAR_6028c24f_Rx: ComBitPosition=375, ComBitSize=1, ComSignalType=BOOLEAN, ComHandleId=2575, ComSystemTemplateSystemSignalRef=DET_BELOW_RAIN_THOLD_124_Rx
          DET_SNR_123_Rx_oRDR_FUSION_DET_121_124_oPCAN_RADAR_f60df286_Rx: ComBitPosition=344, ComBitSize=8, ComSignalType=UINT8, ComHandleId=2641, ComSystemTemplateSystemSignalRef=DET_SNR_123_Rx
          DET_MTD_124_Rx_oRDR_FUSION_DET_121_124_oPCAN_RADAR_8490974b_Rx: ComBitPosition=383, ComBitSize=1, ComSignalType=BOOLEAN, ComHandleId=2614, ComSystemTemplateSystemSignalRef=DET_MTD_124_Rx
          DET_CONFD_AZIMUTH_124_Rx_oRDR_FUSION_DET_121_124_oPCAN_RADAR_f4df8308_Rx: ComBitPosition=454, ComBitSize=2, ComSignalType=UINT8, ComHandleId=2583, ComSystemTemplateSystemSignalRef=DET_CONFD_AZIMUTH_124_Rx
          DET_SNR_124_Rx_oRDR_FUSION_DET_121_124_oPCAN_RADAR_0c3001d1_Rx: ComBitPosition=456, ComBitSize=8, ComSignalType=UINT8, ComHandleId=2642, ComSystemTemplateSystemSignalRef=DET_SNR_124_Rx
          DET_SUPER_RES_TARGET_124_Rx_oRDR_FUSION_DET_121_124_oPCAN_RADAR_c7cb20d1_Rx: ComBitPosition=423, ComBitSize=1, ComSignalType=BOOLEAN, ComHandleId=2646, ComSystemTemplateSystemSignalRef=DET_SUPER_RES_TARGET_124_Rx
          DET_AZIMUTH_ERR_124_Rx_oRDR_FUSION_DET_121_124_oPCAN_RADAR_04fb9c78_Rx: ComBitPosition=441, ComBitSize=7, ComSignalType=UINT8, ComHandleId=2571, ComSystemTemplateSystemSignalRef=DET_AZIMUTH_ERR_124_Rx
          DET_RANGE_ERR_121_Rx_oRDR_FUSION_DET_121_124_oPCAN_RADAR_3a633ca5_Rx: ComBitPosition=40, ComBitSize=7, ComSignalType=UINT8, ComHandleId=2623, ComSystemTemplateSystemSignalRef=DET_RANGE_ERR_121_Rx
          DET_RCS_122_Rx_oRDR_FUSION_DET_121_124_oPCAN_RADAR_50131128_Rx: ComBitPosition=240, ComBitSize=8, ComSignalType=UINT8, ComHandleId=2636, ComSystemTemplateSystemSignalRef=DET_RCS_122_Rx
          DET_SUPER_RES_TARGET_122_Rx_oRDR_FUSION_DET_121_124_oPCAN_RADAR_92b241c1_Rx: ComBitPosition=199, ComBitSize=1, ComSignalType=BOOLEAN, ComHandleId=2644, ComSystemTemplateSystemSignalRef=DET_SUPER_RES_TARGET_122_Rx
          DET_RANGE_ERR_124_Rx_oRDR_FUSION_DET_121_124_oPCAN_RADAR_45a6ed3d_Rx: ComBitPosition=376, ComBitSize=7, ComSignalType=UINT8, ComHandleId=2626, ComSystemTemplateSystemSignalRef=DET_RANGE_ERR_124_Rx
          DET_AZIMUTH_121_Rx_oRDR_FUSION_DET_121_124_oPCAN_RADAR_7957ec62_Rx: ComBitPosition=88, ComBitSize=13, ComSignalType=UINT16, ComHandleId=2564, ComSystemTemplateSystemSignalRef=DET_AZIMUTH_121_Rx
          DET_HVC_FLAG_121_Rx_oRDR_FUSION_DET_121_124_oPCAN_RADAR_731789eb_Rx: ComBitPosition=86, ComBitSize=1, ComSignalType=BOOLEAN, ComHandleId=2600, ComSystemTemplateSystemSignalRef=DET_HVC_FLAG_121_Rx
          DET_IDM_122_Rx_oRDR_FUSION_DET_121_124_oPCAN_RADAR_6c6ac02b_Rx: ComBitPosition=175, ComBitSize=1, ComSignalType=BOOLEAN, ComHandleId=2605, ComSystemTemplateSystemSignalRef=DET_IDM_122_Rx
          DET_RANGE_VELOCITY_ERR_121_Rx_oRDR_FUSION_DET_121_124_oPCAN_RADAR_2e004379_Rx: ComBitPosition=64, ComBitSize=8, ComSignalType=UINT8, ComHandleId=2631, ComSystemTemplateSystemSignalRef=DET_RANGE_VELOCITY_ERR_121_Rx
          DET_BELOW_RAIN_THOLD_123_Rx_oRDR_FUSION_DET_121_124_oPCAN_RADAR_9a153118_Rx: ComBitPosition=263, ComBitSize=1, ComSignalType=BOOLEAN, ComHandleId=2574, ComSystemTemplateSystemSignalRef=DET_BELOW_RAIN_THOLD_123_Rx
          DET_PROB_1STAZHYPO_122_Rx_oRDR_FUSION_DET_121_124_oPCAN_RADAR_1b90e8da_Rx: ComBitPosition=215, ComBitSize=1, ComSignalType=BOOLEAN, ComHandleId=2616, ComSystemTemplateSystemSignalRef=DET_PROB_1STAZHYPO_122_Rx
          DET_HVC_FLAG_122_Rx_oRDR_FUSION_DET_121_124_oPCAN_RADAR_59ab3963_Rx: ComBitPosition=198, ComBitSize=1, ComSignalType=BOOLEAN, ComHandleId=2601, ComSystemTemplateSystemSignalRef=DET_HVC_FLAG_122_Rx
          DET_ELEVATION_123_Rx_oRDR_FUSION_DET_121_124_oPCAN_RADAR_0e901c21_Rx: ComBitPosition=296, ComBitSize=8, ComSignalType=UINT8, ComHandleId=2590, ComSystemTemplateSystemSignalRef=DET_ELEVATION_123_Rx
          DET_RANGE_VELOCITY_123_Rx_oRDR_FUSION_DET_121_124_oPCAN_RADAR_329c1174_Rx: ComBitPosition=272, ComBitSize=15, ComSignalType=UINT16, ComHandleId=2629, ComSystemTemplateSystemSignalRef=DET_RANGE_VELOCITY_123_Rx
          DET_AZIMUTH_ERR_121_Rx_oRDR_FUSION_DET_121_124_oPCAN_RADAR_7b3e4de0_Rx: ComBitPosition=105, ComBitSize=7, ComSignalType=UINT8, ComHandleId=2568, ComSystemTemplateSystemSignalRef=DET_AZIMUTH_ERR_121_Rx
          DET_HVC_FLAG_123_Rx_oRDR_FUSION_DET_121_124_oPCAN_RADAR_f6efab24_Rx: ComBitPosition=310, ComBitSize=1, ComSignalType=BOOLEAN, ComHandleId=2602, ComSystemTemplateSystemSignalRef=DET_HVC_FLAG_123_Rx
          DET_CONFD_AZIMUTH_123_Rx_oRDR_FUSION_DET_121_124_oPCAN_RADAR_0ee2705f_Rx: ComBitPosition=342, ComBitSize=2, ComSignalType=UINT8, ComHandleId=2582, ComSystemTemplateSystemSignalRef=DET_CONFD_AZIMUTH_123_Rx
          DET_CONFD_AZIMUTH_122_Rx_oRDR_FUSION_DET_121_124_oPCAN_RADAR_a1a6e218_Rx: ComBitPosition=230, ComBitSize=2, ComSignalType=UINT8, ComHandleId=2581, ComSystemTemplateSystemSignalRef=DET_CONFD_AZIMUTH_122_Rx
          DET_CONFD_ELEVATION_121_Rx_oRDR_FUSION_DET_121_124_oPCAN_RADAR_813bd117_Rx: ComBitPosition=101, ComBitSize=2, ComSignalType=UINT8, ComHandleId=2584, ComSystemTemplateSystemSignalRef=DET_CONFD_ELEVATION_121_Rx
          DET_ELEVATION_121_Rx_oRDR_FUSION_DET_121_124_oPCAN_RADAR_8b683eee_Rx: ComBitPosition=72, ComBitSize=8, ComSignalType=UINT8, ComHandleId=2588, ComSystemTemplateSystemSignalRef=DET_ELEVATION_121_Rx
          DET_MH_CYCLE_COUNTER_121_124_Rx_oRDR_FUSION_DET_121_124_oPCAN_RADAR_b17b707d_Rx: ComBitPosition=16, ComBitSize=8, ComSignalType=UINT8, ComHandleId=2609, ComSystemTemplateSystemSignalRef=DET_MH_CYCLE_COUNTER_121_124_Rx
          DET_MTD_122_Rx_oRDR_FUSION_DET_121_124_oPCAN_RADAR_d1e9f65b_Rx: ComBitPosition=159, ComBitSize=1, ComSignalType=BOOLEAN, ComHandleId=2612, ComSystemTemplateSystemSignalRef=DET_MTD_122_Rx
          DET_ELEVATION_124_Rx_oRDR_FUSION_DET_121_124_oPCAN_RADAR_f4adef76_Rx: ComBitPosition=408, ComBitSize=8, ComSignalType=UINT8, ComHandleId=2591, ComSystemTemplateSystemSignalRef=DET_ELEVATION_124_Rx
          DET_IDM_123_Rx_oRDR_FUSION_DET_121_124_oPCAN_RADAR_c32e526c_Rx: ComBitPosition=287, ComBitSize=1, ComSignalType=BOOLEAN, ComHandleId=2606, ComSystemTemplateSystemSignalRef=DET_IDM_123_Rx
          DET_SNR_122_Rx_oRDR_FUSION_DET_121_124_oPCAN_RADAR_594960c1_Rx: ComBitPosition=232, ComBitSize=8, ComSignalType=UINT8, ComHandleId=2640, ComSystemTemplateSystemSignalRef=DET_SNR_122_Rx
          DET_RCS_121_Rx_oRDR_FUSION_DET_121_124_oPCAN_RADAR_7aafa1a0_Rx: ComBitPosition=128, ComBitSize=8, ComSignalType=UINT8, ComHandleId=2635, ComSystemTemplateSystemSignalRef=DET_RCS_121_Rx
          DET_AZIMUTH_124_Rx_oRDR_FUSION_DET_121_124_oPCAN_RADAR_06923dfa_Rx: ComBitPosition=424, ComBitSize=13, ComSignalType=UINT16, ComHandleId=2567, ComSystemTemplateSystemSignalRef=DET_AZIMUTH_124_Rx
          DET_RANGE_VELOCITY_122_Rx_oRDR_FUSION_DET_121_124_oPCAN_RADAR_9dd88333_Rx: ComBitPosition=160, ComBitSize=15, ComSignalType=UINT16, ComHandleId=2628, ComSystemTemplateSystemSignalRef=DET_RANGE_VELOCITY_122_Rx
          DET_RANGE_VELOCITY_121_Rx_oRDR_FUSION_DET_121_124_oPCAN_RADAR_b76433bb_Rx: ComBitPosition=48, ComBitSize=15, ComSignalType=UINT16, ComHandleId=2627, ComSystemTemplateSystemSignalRef=DET_RANGE_VELOCITY_121_Rx
          DET_RANGE_VELOCITY_ERR_124_Rx_oRDR_FUSION_DET_121_124_oPCAN_RADAR_51c592e1_Rx: ComBitPosition=400, ComBitSize=8, ComSignalType=UINT8, ComHandleId=2634, ComSystemTemplateSystemSignalRef=DET_RANGE_VELOCITY_ERR_124_Rx
          DET_BI_STATIC_FLAG_121_Rx_oRDR_FUSION_DET_121_124_oPCAN_RADAR_6873b8c4_Rx: ComBitPosition=104, ComBitSize=1, ComSignalType=BOOLEAN, ComHandleId=2576, ComSystemTemplateSystemSignalRef=DET_BI_STATIC_FLAG_121_Rx
          DET_CONFD_ELEVATION_123_Rx_oRDR_FUSION_DET_121_124_oPCAN_RADAR_04c3f3d8_Rx: ComBitPosition=325, ComBitSize=2, ComSignalType=UINT8, ComHandleId=2586, ComSystemTemplateSystemSignalRef=DET_CONFD_ELEVATION_123_Rx
          DET_RANGE_121_Rx_oRDR_FUSION_DET_121_124_oPCAN_RADAR_6a91b045_Rx: ComBitPosition=24, ComBitSize=15, ComSignalType=UINT16, ComHandleId=2619, ComSystemTemplateSystemSignalRef=DET_RANGE_121_Rx
          DET_ELEVATION_ERR_122_Rx_oRDR_FUSION_DET_121_124_oPCAN_RADAR_736dacb9_Rx: ComBitPosition=192, ComBitSize=6, ComSignalType=UINT8, ComHandleId=2593, ComSystemTemplateSystemSignalRef=DET_ELEVATION_ERR_122_Rx
          DET_BI_STATIC_FLAG_123_Rx_oRDR_FUSION_DET_121_124_oPCAN_RADAR_ed8b9a0b_Rx: ComBitPosition=328, ComBitSize=1, ComSignalType=BOOLEAN, ComHandleId=2578, ComSystemTemplateSystemSignalRef=DET_BI_STATIC_FLAG_123_Rx
          DET_EXISTENCE_PROB_123_Rx_oRDR_FUSION_DET_121_124_oPCAN_RADAR_2b31466b_Rx: ComBitPosition=336, ComBitSize=6, ComSignalType=UINT8, ComHandleId=2598, ComSystemTemplateSystemSignalRef=DET_EXISTENCE_PROB_123_Rx
          DET_SUPER_RES_TARGET_121_Rx_oRDR_FUSION_DET_121_124_oPCAN_RADAR_b80ef149_Rx: ComBitPosition=87, ComBitSize=1, ComSignalType=BOOLEAN, ComHandleId=2643, ComSystemTemplateSystemSignalRef=DET_SUPER_RES_TARGET_121_Rx
          DET_EXISTENCE_PROB_124_Rx_oRDR_FUSION_DET_121_124_oPCAN_RADAR_d10cb53c_Rx: ComBitPosition=448, ComBitSize=6, ComSignalType=UINT8, ComHandleId=2599, ComSystemTemplateSystemSignalRef=DET_EXISTENCE_PROB_124_Rx
          DET_MTD_123_Rx_oRDR_FUSION_DET_121_124_oPCAN_RADAR_7ead641c_Rx: ComBitPosition=271, ComBitSize=1, ComSignalType=BOOLEAN, ComHandleId=2613, ComSystemTemplateSystemSignalRef=DET_MTD_123_Rx
          DET_CONFD_ELEVATION_124_Rx_oRDR_FUSION_DET_121_124_oPCAN_RADAR_fefe008f_Rx: ComBitPosition=437, ComBitSize=2, ComSignalType=UINT8, ComHandleId=2587, ComSystemTemplateSystemSignalRef=DET_CONFD_ELEVATION_124_Rx
          DET_ELEVATION_ERR_121_Rx_oRDR_FUSION_DET_121_124_oPCAN_RADAR_59d11c31_Rx: ComBitPosition=80, ComBitSize=6, ComSignalType=UINT8, ComHandleId=2592, ComSystemTemplateSystemSignalRef=DET_ELEVATION_ERR_121_Rx
          DET_AZIMUTH_ERR_123_Rx_oRDR_FUSION_DET_121_124_oPCAN_RADAR_fec66f2f_Rx: ComBitPosition=329, ComBitSize=7, ComSignalType=UINT8, ComHandleId=2570, ComSystemTemplateSystemSignalRef=DET_AZIMUTH_ERR_123_Rx
          DET_IDM_124_Rx_oRDR_FUSION_DET_121_124_oPCAN_RADAR_3913a13b_Rx: ComBitPosition=399, ComBitSize=1, ComSignalType=BOOLEAN, ComHandleId=2607, ComSystemTemplateSystemSignalRef=DET_IDM_124_Rx
          DET_PROB_1STAZHYPO_121_Rx_oRDR_FUSION_DET_121_124_oPCAN_RADAR_312c5852_Rx: ComBitPosition=103, ComBitSize=1, ComSignalType=BOOLEAN, ComHandleId=2615, ComSystemTemplateSystemSignalRef=DET_PROB_1STAZHYPO_121_Rx
          DET_RANGE_122_Rx_oRDR_FUSION_DET_121_124_oPCAN_RADAR_402d00cd_Rx: ComBitPosition=136, ComBitSize=15, ComSignalType=UINT16, ComHandleId=2620, ComSystemTemplateSystemSignalRef=DET_RANGE_122_Rx
          DET_RANGE_VELOCITY_ERR_123_Rx_oRDR_FUSION_DET_121_124_oPCAN_RADAR_abf861b6_Rx: ComBitPosition=288, ComBitSize=8, ComSignalType=UINT8, ComHandleId=2633, ComSystemTemplateSystemSignalRef=DET_RANGE_VELOCITY_ERR_123_Rx
          DET_CONFD_AZIMUTH_121_Rx_oRDR_FUSION_DET_121_124_oPCAN_RADAR_8b1a5290_Rx: ComBitPosition=118, ComBitSize=2, ComSignalType=UINT8, ComHandleId=2580, ComSystemTemplateSystemSignalRef=DET_CONFD_AZIMUTH_121_Rx
          DET_BELOW_RAIN_THOLD_122_Rx_oRDR_FUSION_DET_121_124_oPCAN_RADAR_3551a35f_Rx: ComBitPosition=151, ComBitSize=1, ComSignalType=BOOLEAN, ComHandleId=2573, ComSystemTemplateSystemSignalRef=DET_BELOW_RAIN_THOLD_122_Rx
          DET_EXISTENCE_PROB_122_Rx_oRDR_FUSION_DET_121_124_oPCAN_RADAR_8475d42c_Rx: ComBitPosition=224, ComBitSize=6, ComSignalType=UINT8, ComHandleId=2597, ComSystemTemplateSystemSignalRef=DET_EXISTENCE_PROB_122_Rx
          DET_RANGE_VELOCITY_124_Rx_oRDR_FUSION_DET_121_124_oPCAN_RADAR_c8a1e223_Rx: ComBitPosition=384, ComBitSize=15, ComSignalType=UINT16, ComHandleId=2630, ComSystemTemplateSystemSignalRef=DET_RANGE_VELOCITY_124_Rx
          DET_BELOW_RAIN_THOLD_121_Rx_oRDR_FUSION_DET_121_124_oPCAN_RADAR_1fed13d7_Rx: ComBitPosition=39, ComBitSize=1, ComSignalType=BOOLEAN, ComHandleId=2572, ComSystemTemplateSystemSignalRef=DET_BELOW_RAIN_THOLD_121_Rx
          DET_MH_SCAN_INDEX_4LSB_121_124_Rx_oRDR_FUSION_DET_121_124_oPCAN_RADAR_d5cbbf46_Rx: ComBitPosition=476, ComBitSize=4, ComSignalType=UINT8, ComHandleId=2610, ComSystemTemplateSystemSignalRef=DET_MH_SCAN_INDEX_4LSB_121_124_Rx
          DET_RANGE_ERR_123_Rx_oRDR_FUSION_DET_121_124_oPCAN_RADAR_bf9b1e6a_Rx: ComBitPosition=264, ComBitSize=7, ComSignalType=UINT8, ComHandleId=2625, ComSystemTemplateSystemSignalRef=DET_RANGE_ERR_123_Rx
          DET_MH_CRC16_121_124_Rx_oRDR_FUSION_DET_121_124_oPCAN_RADAR_bca04db8_Rx: ComBitPosition=0, ComBitSize=16, ComSignalType=UINT16, ComHandleId=2608, ComSystemTemplateSystemSignalRef=DET_MH_CRC16_121_124_Rx
          DET_ELEVATION_ERR_123_Rx_oRDR_FUSION_DET_121_124_oPCAN_RADAR_dc293efe_Rx: ComBitPosition=304, ComBitSize=6, ComSignalType=UINT8, ComHandleId=2594, ComSystemTemplateSystemSignalRef=DET_ELEVATION_ERR_123_Rx
          DET_AZIMUTH_122_Rx_oRDR_FUSION_DET_121_124_oPCAN_RADAR_53eb5cea_Rx: ComBitPosition=200, ComBitSize=13, ComSignalType=UINT16, ComHandleId=2565, ComSystemTemplateSystemSignalRef=DET_AZIMUTH_122_Rx
          DET_ELEVATION_122_Rx_oRDR_FUSION_DET_121_124_oPCAN_RADAR_a1d48e66_Rx: ComBitPosition=184, ComBitSize=8, ComSignalType=UINT8, ComHandleId=2589, ComSystemTemplateSystemSignalRef=DET_ELEVATION_122_Rx
          DET_BI_STATIC_FLAG_124_Rx_oRDR_FUSION_DET_121_124_oPCAN_RADAR_17b6695c_Rx: ComBitPosition=440, ComBitSize=1, ComSignalType=BOOLEAN, ComHandleId=2579, ComSystemTemplateSystemSignalRef=DET_BI_STATIC_FLAG_124_Rx
          DET_HVC_FLAG_124_Rx_oRDR_FUSION_DET_121_124_oPCAN_RADAR_0cd25873_Rx: ComBitPosition=422, ComBitSize=1, ComSignalType=BOOLEAN, ComHandleId=2603, ComSystemTemplateSystemSignalRef=DET_HVC_FLAG_124_Rx
          DET_RANGE_123_Rx_oRDR_FUSION_DET_121_124_oPCAN_RADAR_ef69928a_Rx: ComBitPosition=248, ComBitSize=15, ComSignalType=UINT16, ComHandleId=2621, ComSystemTemplateSystemSignalRef=DET_RANGE_123_Rx
          DET_PROB_1STAZHYPO_124_Rx_oRDR_FUSION_DET_121_124_oPCAN_RADAR_4ee989ca_Rx: ComBitPosition=439, ComBitSize=1, ComSignalType=BOOLEAN, ComHandleId=2618, ComSystemTemplateSystemSignalRef=DET_PROB_1STAZHYPO_124_Rx
          DET_CONFD_ELEVATION_122_Rx_oRDR_FUSION_DET_121_124_oPCAN_RADAR_ab87619f_Rx: ComBitPosition=213, ComBitSize=2, ComSignalType=UINT8, ComHandleId=2585, ComSystemTemplateSystemSignalRef=DET_CONFD_ELEVATION_122_Rx
          DET_RCS_123_Rx_oRDR_FUSION_DET_121_124_oPCAN_RADAR_ff57836f_Rx: ComBitPosition=352, ComBitSize=8, ComSignalType=UINT8, ComHandleId=2637, ComSystemTemplateSystemSignalRef=DET_RCS_123_Rx
          DET_RANGE_124_Rx_oRDR_FUSION_DET_121_124_oPCAN_RADAR_155461dd_Rx: ComBitPosition=360, ComBitSize=15, ComSignalType=UINT16, ComHandleId=2622, ComSystemTemplateSystemSignalRef=DET_RANGE_124_Rx
      SG_Fusion_Detections_025_028_oRDR_FUSION_DET_025_028_oPCAN_RADAR_ba5bfb5a_Rx (ComSignalGroup):
        ComTimeout = 0
        ComTransferProperty = PENDING
        ComSignalGroupAccess = ACCESS_NEEDED_BY_SWC_OR_COM
        ComHandleId = 14
        ComSignalGroupArrayAccess = true
        ComSystemTemplateSignalGroupRef = SG_Fusion_Detections_025_028
        83 x ComGroupSignal, all with ComSignalEndianness=LITTLE_ENDIAN, ComSignalInitValue=0, ComSignalAccess=ACCESS_NEEDED_BY_SWC_OR_COM:
          DET_SUPER_RES_TARGET_026_Rx_oRDR_FUSION_DET_025_028_oPCAN_RADAR_64a14374_Rx: ComBitPosition=199, ComBitSize=1, ComSignalType=BOOLEAN, ComHandleId=652, ComSystemTemplateSystemSignalRef=DET_SUPER_RES_TARGET_026_Rx
          DET_ELEVATION_ERR_025_Rx_oRDR_FUSION_DET_025_028_oPCAN_RADAR_afc21e84_Rx: ComBitPosition=80, ComBitSize=6, ComSignalType=UINT8, ComHandleId=600, ComSystemTemplateSystemSignalRef=DET_ELEVATION_ERR_025_Rx
          DET_SUPER_RES_TARGET_025_Rx_oRDR_FUSION_DET_025_028_oPCAN_RADAR_4e1df3fc_Rx: ComBitPosition=87, ComBitSize=1, ComSignalType=BOOLEAN, ComHandleId=651, ComSystemTemplateSystemSignalRef=DET_SUPER_RES_TARGET_025_Rx
          DET_IDM_025_Rx_oRDR_FUSION_DET_025_028_oPCAN_RADAR_b0c57216_Rx: ComBitPosition=63, ComBitSize=1, ComSignalType=BOOLEAN, ComHandleId=612, ComSystemTemplateSystemSignalRef=DET_IDM_025_Rx
          DET_PROB_1STAZHYPO_027_Rx_oRDR_FUSION_DET_025_028_oPCAN_RADAR_42c77828_Rx: ComBitPosition=327, ComBitSize=1, ComSignalType=BOOLEAN, ComHandleId=625, ComSystemTemplateSystemSignalRef=DET_PROB_1STAZHYPO_027_Rx
          DET_RCS_025_Rx_oRDR_FUSION_DET_025_028_oPCAN_RADAR_8cbca315_Rx: ComBitPosition=128, ComBitSize=8, ComSignalType=UINT8, ComHandleId=643, ComSystemTemplateSystemSignalRef=DET_RCS_025_Rx
          DET_HVC_FLAG_028_Rx_oRDR_FUSION_DET_025_028_oPCAN_RADAR_80b2db39_Rx: ComBitPosition=422, ComBitSize=1, ComSignalType=BOOLEAN, ComHandleId=611, ComSystemTemplateSystemSignalRef=DET_HVC_FLAG_028_Rx
          DET_IDM_027_Rx_oRDR_FUSION_DET_025_028_oPCAN_RADAR_353d50d9_Rx: ComBitPosition=287, ComBitSize=1, ComSignalType=BOOLEAN, ComHandleId=614, ComSystemTemplateSystemSignalRef=DET_IDM_027_Rx
          DET_IDM_028_Rx_oRDR_FUSION_DET_025_028_oPCAN_RADAR_b5732271_Rx: ComBitPosition=399, ComBitSize=1, ComSignalType=BOOLEAN, ComHandleId=615, ComSystemTemplateSystemSignalRef=DET_IDM_028_Rx
          DET_SUPER_RES_TARGET_027_Rx_oRDR_FUSION_DET_025_028_oPCAN_RADAR_cbe5d133_Rx: ComBitPosition=311, ComBitSize=1, ComSignalType=BOOLEAN, ComHandleId=653, ComSystemTemplateSystemSignalRef=DET_SUPER_RES_TARGET_027_Rx
          DET_ELEVATION_025_Rx_oRDR_FUSION_DET_025_028_oPCAN_RADAR_7d7b3c5b_Rx: ComBitPosition=72, ComBitSize=8, ComSignalType=UINT8, ComHandleId=596, ComSystemTemplateSystemSignalRef=DET_ELEVATION_025_Rx
          DET_EXISTENCE_PROB_028_Rx_oRDR_FUSION_DET_025_028_oPCAN_RADAR_5d6c3676_Rx: ComBitPosition=448, ComBitSize=6, ComSignalType=UINT8, ComHandleId=607, ComSystemTemplateSystemSignalRef=DET_EXISTENCE_PROB_028_Rx
          DET_RANGE_VELOCITY_025_Rx_oRDR_FUSION_DET_025_028_oPCAN_RADAR_4177310e_Rx: ComBitPosition=48, ComBitSize=15, ComSignalType=UINT16, ComHandleId=635, ComSystemTemplateSystemSignalRef=DET_RANGE_VELOCITY_025_Rx
          DET_SNR_027_Rx_oRDR_FUSION_DET_025_028_oPCAN_RADAR_001ef033_Rx: ComBitPosition=344, ComBitSize=8, ComSignalType=UINT8, ComHandleId=649, ComSystemTemplateSystemSignalRef=DET_SNR_027_Rx
          DET_RANGE_VELOCITY_ERR_027_Rx_oRDR_FUSION_DET_025_028_oPCAN_RADAR_5deb6303_Rx: ComBitPosition=288, ComBitSize=8, ComSignalType=UINT8, ComHandleId=641, ComSystemTemplateSystemSignalRef=DET_RANGE_VELOCITY_ERR_027_Rx
          DET_SNR_026_Rx_oRDR_FUSION_DET_025_028_oPCAN_RADAR_af5a6274_Rx: ComBitPosition=232, ComBitSize=8, ComSignalType=UINT8, ComHandleId=648, ComSystemTemplateSystemSignalRef=DET_SNR_026_Rx
          DET_BELOW_RAIN_THOLD_026_Rx_oRDR_FUSION_DET_025_028_oPCAN_RADAR_c342a1ea_Rx: ComBitPosition=151, ComBitSize=1, ComSignalType=BOOLEAN, ComHandleId=581, ComSystemTemplateSystemSignalRef=DET_BELOW_RAIN_THOLD_026_Rx
          DET_RANGE_025_Rx_oRDR_FUSION_DET_025_028_oPCAN_RADAR_9c82b2f0_Rx: ComBitPosition=24, ComBitSize=15, ComSignalType=UINT16, ComHandleId=627, ComSystemTemplateSystemSignalRef=DET_RANGE_025_Rx
          DET_ELEVATION_027_Rx_oRDR_FUSION_DET_025_028_oPCAN_RADAR_f8831e94_Rx: ComBitPosition=296, ComBitSize=8, ComSignalType=UINT8, ComHandleId=598, ComSystemTemplateSystemSignalRef=DET_ELEVATION_027_Rx
          DET_PROB_1STAZHYPO_028_Rx_oRDR_FUSION_DET_025_028_oPCAN_RADAR_c2890a80_Rx: ComBitPosition=439, ComBitSize=1, ComSignalType=BOOLEAN, ComHandleId=626, ComSystemTemplateSystemSignalRef=DET_PROB_1STAZHYPO_028_Rx
          DET_MH_SCAN_INDEX_4LSB_025_028_Rx_oRDR_FUSION_DET_025_028_oPCAN_RADAR_8ec24617_Rx: ComBitPosition=476, ComBitSize=4, ComSignalType=UINT8, ComHandleId=618, ComSystemTemplateSystemSignalRef=DET_MH_SCAN_INDEX_4LSB_025_028_Rx
          DET_BELOW_RAIN_THOLD_025_Rx_oRDR_FUSION_DET_025_028_oPCAN_RADAR_e9fe1162_Rx: ComBitPosition=39, ComBitSize=1, ComSignalType=BOOLEAN, ComHandleId=580, ComSystemTemplateSystemSignalRef=DET_BELOW_RAIN_THOLD_025_Rx
          DET_BI_STATIC_FLAG_025_Rx_oRDR_FUSION_DET_025_028_oPCAN_RADAR_9e60ba71_Rx: ComBitPosition=104, ComBitSize=1, ComSignalType=BOOLEAN, ComHandleId=584, ComSystemTemplateSystemSignalRef=DET_BI_STATIC_FLAG_025_Rx
          DET_RANGE_ERR_026_Rx_oRDR_FUSION_DET_025_028_oPCAN_RADAR_e6cc8e98_Rx: ComBitPosition=152, ComBitSize=7, ComSignalType=UINT8, ComHandleId=632, ComSystemTemplateSystemSignalRef=DET_RANGE_ERR_026_Rx
          DET_ELEVATION_026_Rx_oRDR_FUSION_DET_025_028_oPCAN_RADAR_57c78cd3_Rx: ComBitPosition=184, ComBitSize=8, ComSignalType=UINT8, ComHandleId=597, ComSystemTemplateSystemSignalRef=DET_ELEVATION_026_Rx
          DET_CONFD_AZIMUTH_026_Rx_oRDR_FUSION_DET_025_028_oPCAN_RADAR_57b5e0ad_Rx: ComBitPosition=230, ComBitSize=2, ComSignalType=UINT8, ComHandleId=589, ComSystemTemplateSystemSignalRef=DET_CONFD_AZIMUTH_026_Rx
          DET_RANGE_027_Rx_oRDR_FUSION_DET_025_028_oPCAN_RADAR_197a903f_Rx: ComBitPosition=248, ComBitSize=15, ComSignalType=UINT16, ComHandleId=629, ComSystemTemplateSystemSignalRef=DET_RANGE_027_Rx
          DET_PROB_1STAZHYPO_025_Rx_oRDR_FUSION_DET_025_028_oPCAN_RADAR_c73f5ae7_Rx: ComBitPosition=103, ComBitSize=1, ComSignalType=BOOLEAN, ComHandleId=623, ComSystemTemplateSystemSignalRef=DET_PROB_1STAZHYPO_025_Rx
          DET_EXISTENCE_PROB_026_Rx_oRDR_FUSION_DET_025_028_oPCAN_RADAR_7266d699_Rx: ComBitPosition=224, ComBitSize=6, ComSignalType=UINT8, ComHandleId=605, ComSystemTemplateSystemSignalRef=DET_EXISTENCE_PROB_026_Rx
          DET_RANGE_VELOCITY_028_Rx_oRDR_FUSION_DET_025_028_oPCAN_RADAR_44c16169_Rx: ComBitPosition=384, ComBitSize=15, ComSignalType=UINT16, ComHandleId=638, ComSystemTemplateSystemSignalRef=DET_RANGE_VELOCITY_028_Rx
          DET_CONFD_ELEVATION_026_Rx_oRDR_FUSION_DET_025_028_oPCAN_RADAR_5d94632a_Rx: ComBitPosition=213, ComBitSize=2, ComSignalType=UINT8, ComHandleId=593, ComSystemTemplateSystemSignalRef=DET_CONFD_ELEVATION_026_Rx
          DET_AZIMUTH_026_Rx_oRDR_FUSION_DET_025_028_oPCAN_RADAR_a5f85e5f_Rx: ComBitPosition=200, ComBitSize=13, ComSignalType=UINT16, ComHandleId=573, ComSystemTemplateSystemSignalRef=DET_AZIMUTH_026_Rx
          DET_CONFD_ELEVATION_025_Rx_oRDR_FUSION_DET_025_028_oPCAN_RADAR_7728d3a2_Rx: ComBitPosition=101, ComBitSize=2, ComSignalType=UINT8, ComHandleId=592, ComSystemTemplateSystemSignalRef=DET_CONFD_ELEVATION_025_Rx
          DET_AZIMUTH_ERR_028_Rx_oRDR_FUSION_DET_025_028_oPCAN_RADAR_889b1f32_Rx: ComBitPosition=441, ComBitSize=7, ComSignalType=UINT8, ComHandleId=579, ComSystemTemplateSystemSignalRef=DET_AZIMUTH_ERR_028_Rx
          DET_BI_STATIC_FLAG_027_Rx_oRDR_FUSION_DET_025_028_oPCAN_RADAR_1b9898be_Rx: ComBitPosition=328, ComBitSize=1, ComSignalType=BOOLEAN, ComHandleId=586, ComSystemTemplateSystemSignalRef=DET_BI_STATIC_FLAG_027_Rx
          DET_HVC_FLAG_025_Rx_oRDR_FUSION_DET_025_028_oPCAN_RADAR_85048b5e_Rx: ComBitPosition=86, ComBitSize=1, ComSignalType=BOOLEAN, ComHandleId=608, ComSystemTemplateSystemSignalRef=DET_HVC_FLAG_025_Rx
          DET_RANGE_VELOCITY_ERR_025_Rx_oRDR_FUSION_DET_025_028_oPCAN_RADAR_d81341cc_Rx: ComBitPosition=64, ComBitSize=8, ComSignalType=UINT8, ComHandleId=639, ComSystemTemplateSystemSignalRef=DET_RANGE_VELOCITY_ERR_025_Rx
          DET_RCS_027_Rx_oRDR_FUSION_DET_025_028_oPCAN_RADAR_094481da_Rx: ComBitPosition=352, ComBitSize=8, ComSignalType=UINT8, ComHandleId=645, ComSystemTemplateSystemSignalRef=DET_RCS_027_Rx
          DET_AZIMUTH_ERR_025_Rx_oRDR_FUSION_DET_025_028_oPCAN_RADAR_8d2d4f55_Rx: ComBitPosition=105, ComBitSize=7, ComSignalType=UINT8, ComHandleId=576, ComSystemTemplateSystemSignalRef=DET_AZIMUTH_ERR_025_Rx
          DET_CONFD_AZIMUTH_028_Rx_oRDR_FUSION_DET_025_028_oPCAN_RADAR_78bf0042_Rx: ComBitPosition=454, ComBitSize=2, ComSignalType=UINT8, ComHandleId=591, ComSystemTemplateSystemSignalRef=DET_CONFD_AZIMUTH_028_Rx
          DET_MH_CYCLE_COUNTER_025_028_Rx_oRDR_FUSION_DET_025_028_oPCAN_RADAR_ea72892c_Rx: ComBitPosition=16, ComBitSize=8, ComSignalType=UINT8, ComHandleId=617, ComSystemTemplateSystemSignalRef=DET_MH_CYCLE_COUNTER_025_028_Rx
          DET_PROB_1STAZHYPO_026_Rx_oRDR_FUSION_DET_025_028_oPCAN_RADAR_ed83ea6f_Rx: ComBitPosition=215, ComBitSize=1, ComSignalType=BOOLEAN, ComHandleId=624, ComSystemTemplateSystemSignalRef=DET_PROB_1STAZHYPO_026_Rx
          DET_BI_STATIC_FLAG_026_Rx_oRDR_FUSION_DET_025_028_oPCAN_RADAR_b4dc0af9_Rx: ComBitPosition=216, ComBitSize=1, ComSignalType=BOOLEAN, ComHandleId=585, ComSystemTemplateSystemSignalRef=DET_BI_STATIC_FLAG_026_Rx
          DET_AZIMUTH_ERR_026_Rx_oRDR_FUSION_DET_025_028_oPCAN_RADAR_a791ffdd_Rx: ComBitPosition=217, ComBitSize=7, ComSignalType=UINT8, ComHandleId=577, ComSystemTemplateSystemSignalRef=DET_AZIMUTH_ERR_026_Rx
          DET_CONFD_ELEVATION_028_Rx_oRDR_FUSION_DET_025_028_oPCAN_RADAR_729e83c5_Rx: ComBitPosition=437, ComBitSize=2, ComSignalType=UINT8, ComHandleId=595, ComSystemTemplateSystemSignalRef=DET_CONFD_ELEVATION_028_Rx
          DET_ELEVATION_ERR_027_Rx_oRDR_FUSION_DET_025_028_oPCAN_RADAR_2a3a3c4b_Rx: ComBitPosition=304, ComBitSize=6, ComSignalType=UINT8, ComHandleId=602, ComSystemTemplateSystemSignalRef=DET_ELEVATION_ERR_027_Rx
          DET_IDM_026_Rx_oRDR_FUSION_DET_025_028_oPCAN_RADAR_9a79c29e_Rx: ComBitPosition=175, ComBitSize=1, ComSignalType=BOOLEAN, ComHandleId=613, ComSystemTemplateSystemSignalRef=DET_IDM_026_Rx
          DET_RANGE_VELOCITY_ERR_026_Rx_oRDR_FUSION_DET_025_028_oPCAN_RADAR_f2aff144_Rx: ComBitPosition=176, ComBitSize=8, ComSignalType=UINT8, ComHandleId=640, ComSystemTemplateSystemSignalRef=DET_RANGE_VELOCITY_ERR_026_Rx
          DET_RANGE_028_Rx_oRDR_FUSION_DET_025_028_oPCAN_RADAR_9934e297_Rx: ComBitPosition=360, ComBitSize=15, ComSignalType=UINT16, ComHandleId=630, ComSystemTemplateSystemSignalRef=DET_RANGE_028_Rx
          DET_HVC_FLAG_026_Rx_oRDR_FUSION_DET_025_028_oPCAN_RADAR_afb83bd6_Rx: ComBitPosition=198, ComBitSize=1, ComSignalType=BOOLEAN, ComHandleId=609, ComSystemTemplateSystemSignalRef=DET_HVC_FLAG_026_Rx
          DET_RANGE_026_Rx_oRDR_FUSION_DET_025_028_oPCAN_RADAR_b63e0278_Rx: ComBitPosition=136, ComBitSize=15, ComSignalType=UINT16, ComHandleId=628, ComSystemTemplateSystemSignalRef=DET_RANGE_026_Rx
          DET_BELOW_RAIN_THOLD_028_Rx_oRDR_FUSION_DET_025_028_oPCAN_RADAR_ec484105_Rx: ComBitPosition=375, ComBitSize=1, ComSignalType=BOOLEAN, ComHandleId=583, ComSystemTemplateSystemSignalRef=DET_BELOW_RAIN_THOLD_028_Rx
          DET_ELEVATION_ERR_026_Rx_oRDR_FUSION_DET_025_028_oPCAN_RADAR_857eae0c_Rx: ComBitPosition=192, ComBitSize=6, ComSignalType=UINT8, ComHandleId=601, ComSystemTemplateSystemSignalRef=DET_ELEVATION_ERR_026_Rx
          DET_HVC_FLAG_027_Rx_oRDR_FUSION_DET_025_028_oPCAN_RADAR_00fca991_Rx: ComBitPosition=310, ComBitSize=1, ComSignalType=BOOLEAN, ComHandleId=610, ComSystemTemplateSystemSignalRef=DET_HVC_FLAG_027_Rx
          DET_SNR_028_Rx_oRDR_FUSION_DET_025_028_oPCAN_RADAR_8050829b_Rx: ComBitPosition=456, ComBitSize=8, ComSignalType=UINT8, ComHandleId=650, ComSystemTemplateSystemSignalRef=DET_SNR_028_Rx
          DET_RANGE_VELOCITY_027_Rx_oRDR_FUSION_DET_025_028_oPCAN_RADAR_c48f13c1_Rx: ComBitPosition=272, ComBitSize=15, ComSignalType=UINT16, ComHandleId=637, ComSystemTemplateSystemSignalRef=DET_RANGE_VELOCITY_027_Rx
          DET_CONFD_AZIMUTH_027_Rx_oRDR_FUSION_DET_025_028_oPCAN_RADAR_f8f172ea_Rx: ComBitPosition=342, ComBitSize=2, ComSignalType=UINT8, ComHandleId=590, ComSystemTemplateSystemSignalRef=DET_CONFD_AZIMUTH_027_Rx
          DET_AZIMUTH_ERR_027_Rx_oRDR_FUSION_DET_025_028_oPCAN_RADAR_08d56d9a_Rx: ComBitPosition=329, ComBitSize=7, ComSignalType=UINT8, ComHandleId=578, ComSystemTemplateSystemSignalRef=DET_AZIMUTH_ERR_027_Rx
          DET_RCS_026_Rx_oRDR_FUSION_DET_025_028_oPCAN_RADAR_a600139d_Rx: ComBitPosition=240, ComBitSize=8, ComSignalType=UINT8, ComHandleId=644, ComSystemTemplateSystemSignalRef=DET_RCS_026_Rx
          DET_AZIMUTH_027_Rx_oRDR_FUSION_DET_025_028_oPCAN_RADAR_0abccc18_Rx: ComBitPosition=312, ComBitSize=13, ComSignalType=UINT16, ComHandleId=574, ComSystemTemplateSystemSignalRef=DET_AZIMUTH_027_Rx
          DET_MTD_026_Rx_oRDR_FUSION_DET_025_028_oPCAN_RADAR_27faf4ee_Rx: ComBitPosition=159, ComBitSize=1, ComSignalType=BOOLEAN, ComHandleId=620, ComSystemTemplateSystemSignalRef=DET_MTD_026_Rx
          DET_ELEVATION_ERR_028_Rx_oRDR_FUSION_DET_025_028_oPCAN_RADAR_aa744ee3_Rx: ComBitPosition=416, ComBitSize=6, ComSignalType=UINT8, ComHandleId=603, ComSystemTemplateSystemSignalRef=DET_ELEVATION_ERR_028_Rx
          DET_RANGE_ERR_027_Rx_oRDR_FUSION_DET_025_028_oPCAN_RADAR_49881cdf_Rx: ComBitPosition=264, ComBitSize=7, ComSignalType=UINT8, ComHandleId=633, ComSystemTemplateSystemSignalRef=DET_RANGE_ERR_027_Rx
          DET_RANGE_ERR_025_Rx_oRDR_FUSION_DET_025_028_oPCAN_RADAR_cc703e10_Rx: ComBitPosition=40, ComBitSize=7, ComSignalType=UINT8, ComHandleId=631, ComSystemTemplateSystemSignalRef=DET_RANGE_ERR_025_Rx
          DET_SUPER_RES_TARGET_028_Rx_oRDR_FUSION_DET_025_028_oPCAN_RADAR_4baba39b_Rx: ComBitPosition=423, ComBitSize=1, ComSignalType=BOOLEAN, ComHandleId=654, ComSystemTemplateSystemSignalRef=DET_SUPER_RES_TARGET_028_Rx
          DET_RANGE_ERR_028_Rx_oRDR_FUSION_DET_025_028_oPCAN_RADAR_c9c66e77_Rx: ComBitPosition=376, ComBitSize=7, ComSignalType=UINT8, ComHandleId=634, ComSystemTemplateSystemSignalRef=DET_RANGE_ERR_028_Rx
          DET_RCS_028_Rx_oRDR_FUSION_DET_025_028_oPCAN_RADAR_890af372_Rx: ComBitPosition=464, ComBitSize=8, ComSignalType=UINT8, ComHandleId=646, ComSystemTemplateSystemSignalRef=DET_RCS_028_Rx
          DET_AZIMUTH_028_Rx_oRDR_FUSION_DET_025_028_oPCAN_RADAR_8af2beb0_Rx: ComBitPosition=424, ComBitSize=13, ComSignalType=UINT16, ComHandleId=575, ComSystemTemplateSystemSignalRef=DET_AZIMUTH_028_Rx
          DET_ELEVATION_028_Rx_oRDR_FUSION_DET_025_028_oPCAN_RADAR_78cd6c3c_Rx: ComBitPosition=408, ComBitSize=8, ComSignalType=UINT8, ComHandleId=599, ComSystemTemplateSystemSignalRef=DET_ELEVATION_028_Rx
          DET_EXISTENCE_PROB_027_Rx_oRDR_FUSION_DET_025_028_oPCAN_RADAR_dd2244de_Rx: ComBitPosition=336, ComBitSize=6, ComSignalType=UINT8, ComHandleId=606, ComSystemTemplateSystemSignalRef=DET_EXISTENCE_PROB_027_Rx
          DET_RANGE_VELOCITY_ERR_028_Rx_oRDR_FUSION_DET_025_028_oPCAN_RADAR_dda511ab_Rx: ComBitPosition=400, ComBitSize=8, ComSignalType=UINT8, ComHandleId=642, ComSystemTemplateSystemSignalRef=DET_RANGE_VELOCITY_ERR_028_Rx
          DET_MH_CRC16_025_028_Rx_oRDR_FUSION_DET_025_028_oPCAN_RADAR_e7a9b4e9_Rx: ComBitPosition=0, ComBitSize=16, ComSignalType=UINT16, ComHandleId=616, ComSystemTemplateSystemSignalRef=DET_MH_CRC16_025_028_Rx
          DET_MTD_025_Rx_oRDR_FUSION_DET_025_028_oPCAN_RADAR_0d464466_Rx: ComBitPosition=47, ComBitSize=1, ComSignalType=BOOLEAN, ComHandleId=619, ComSystemTemplateSystemSignalRef=DET_MTD_025_Rx
          DET_AZIMUTH_025_Rx_oRDR_FUSION_DET_025_028_oPCAN_RADAR_8f44eed7_Rx: ComBitPosition=88, ComBitSize=13, ComSignalType=UINT16, ComHandleId=572, ComSystemTemplateSystemSignalRef=DET_AZIMUTH_025_Rx
          DET_CONFD_ELEVATION_027_Rx_oRDR_FUSION_DET_025_028_oPCAN_RADAR_f2d0f16d_Rx: ComBitPosition=325, ComBitSize=2, ComSignalType=UINT8, ComHandleId=594, ComSystemTemplateSystemSignalRef=DET_CONFD_ELEVATION_027_Rx
          DET_MTD_028_Rx_oRDR_FUSION_DET_025_028_oPCAN_RADAR_08f01401_Rx: ComBitPosition=383, ComBitSize=1, ComSignalType=BOOLEAN, ComHandleId=622, ComSystemTemplateSystemSignalRef=DET_MTD_028_Rx
          DET_EXISTENCE_PROB_025_Rx_oRDR_FUSION_DET_025_028_oPCAN_RADAR_58da6611_Rx: ComBitPosition=112, ComBitSize=6, ComSignalType=UINT8, ComHandleId=604, ComSystemTemplateSystemSignalRef=DET_EXISTENCE_PROB_025_Rx
          DET_MTD_027_Rx_oRDR_FUSION_DET_025_028_oPCAN_RADAR_88be66a9_Rx: ComBitPosition=271, ComBitSize=1, ComSignalType=BOOLEAN, ComHandleId=621, ComSystemTemplateSystemSignalRef=DET_MTD_027_Rx
          DET_BELOW_RAIN_THOLD_027_Rx_oRDR_FUSION_DET_025_028_oPCAN_RADAR_6c0633ad_Rx: ComBitPosition=263, ComBitSize=1, ComSignalType=BOOLEAN, ComHandleId=582, ComSystemTemplateSystemSignalRef=DET_BELOW_RAIN_THOLD_027_Rx
          DET_RANGE_VELOCITY_026_Rx_oRDR_FUSION_DET_025_028_oPCAN_RADAR_6bcb8186_Rx: ComBitPosition=160, ComBitSize=15, ComSignalType=UINT16, ComHandleId=636, ComSystemTemplateSystemSignalRef=DET_RANGE_VELOCITY_026_Rx
          DET_BI_STATIC_FLAG_028_Rx_oRDR_FUSION_DET_025_028_oPCAN_RADAR_9bd6ea16_Rx: ComBitPosition=440, ComBitSize=1, ComSignalType=BOOLEAN, ComHandleId=587, ComSystemTemplateSystemSignalRef=DET_BI_STATIC_FLAG_028_Rx
          DET_CONFD_AZIMUTH_025_Rx_oRDR_FUSION_DET_025_028_oPCAN_RADAR_7d095025_Rx: ComBitPosition=118, ComBitSize=2, ComSignalType=UINT8, ComHandleId=588, ComSystemTemplateSystemSignalRef=DET_CONFD_AZIMUTH_025_Rx
          DET_SNR_025_Rx_oRDR_FUSION_DET_025_028_oPCAN_RADAR_85e6d2fc_Rx: ComBitPosition=120, ComBitSize=8, ComSignalType=UINT8, ComHandleId=647, ComSystemTemplateSystemSignalRef=DET_SNR_025_Rx
      RDR_FUSION_STATUS_001_oPCAN_RADAR_8bf3739d_Rx (ComIPdu):
        ComIPduDirection = RECEIVE
        ComIPduType = NORMAL
        ComIPduCancellationSupport = false
        ComIPduHandleId = 55
        ComIPduSignalProcessing = DEFERRED
        ComIPduChannelRef = CN_PCAN_RADAR_458ff0f1
        ComIPduGroupRef = RDR01_oPCAN_RADAR_Rx_e0e717e1 if post-build-variant-condition{matching-criterion=RDR_POS, value=0}
        ComIPduSignalGroupRef = SG_Fusion_RadarStatus_oRDR_FUSION_STATUS_001_oPCAN_RADAR_00ff53b8_Rx
        ComPduIdRef = RDR_FUSION_STATUS_001_oPCAN_RADAR_8bf3739d_Rx
        ComIPduMainFunctionRef = ComMainFunctionRx
        ComIPduGroupRef = RDR02_oPCAN_RADAR_Rx_c92fa313 if post-build-variant-condition{matching-criterion=RDR_POS, value=1}
        ComIPduGroupRef = RDR03_oPCAN_RADAR_Rx_67473282 if post-build-variant-condition{matching-criterion=RDR_POS, value=2}
        ComIPduGroupRef = RDR04_oPCAN_RADAR_Rx_9abecaf7 if post-build-variant-condition{matching-criterion=RDR_POS, value=3}
        ComIPduGroupRef = RDR05_oPCAN_RADAR_Rx_34d65b66 if post-build-variant-condition{matching-criterion=RDR_POS, value=4}
        ComIPduGroupRef = RDR06_oPCAN_RADAR_Rx_1d1eef94 if post-build-variant-condition{matching-criterion=RDR_POS, value=5}
        ComIPduGroupRef = RDR07_oPCAN_RADAR_Rx_b3767e05 if post-build-variant-condition{matching-criterion=RDR_POS, value=6}
        ComIPduGroupRef = RDR08_oPCAN_RADAR_Rx_3d9c193f if post-build-variant-condition{matching-criterion=RDR_POS, value=7}
      RDR_FUSION_DET_057_060_oPCAN_RADAR_a82b5a7a_Rx (ComIPdu):
        ComIPduDirection = RECEIVE
        ComIPduType = NORMAL
        ComIPduCancellationSupport = false
        ComIPduHandleId = 36
        ComIPduSignalProcessing = DEFERRED
        ComIPduChannelRef = CN_PCAN_RADAR_458ff0f1
        ComIPduGroupRef = RDR01_oPCAN_RADAR_Rx_e0e717e1 if post-build-variant-condition{matching-criterion=RDR_POS, value=0}
        ComIPduSignalGroupRef = SG_Fusion_Detections_057_060_oRDR_FUSION_DET_057_060_oPCAN_RADAR_91e0d8b1_Rx
        ComPduIdRef = RDR_FUSION_DET_057_060_oPCAN_RADAR_a82b5a7a_Rx
        ComIPduMainFunctionRef = ComMainFunctionRx
        ComIPduGroupRef = RDR02_oPCAN_RADAR_Rx_c92fa313 if post-build-variant-condition{matching-criterion=RDR_POS, value=1}
        ComIPduGroupRef = RDR03_oPCAN_RADAR_Rx_67473282 if post-build-variant-condition{matching-criterion=RDR_POS, value=2}
        ComIPduGroupRef = RDR04_oPCAN_RADAR_Rx_9abecaf7 if post-build-variant-condition{matching-criterion=RDR_POS, value=3}
        ComIPduGroupRef = RDR05_oPCAN_RADAR_Rx_34d65b66 if post-build-variant-condition{matching-criterion=RDR_POS, value=4}
        ComIPduGroupRef = RDR06_oPCAN_RADAR_Rx_1d1eef94 if post-build-variant-condition{matching-criterion=RDR_POS, value=5}
        ComIPduGroupRef = RDR07_oPCAN_RADAR_Rx_b3767e05 if post-build-variant-condition{matching-criterion=RDR_POS, value=6}
        ComIPduGroupRef = RDR08_oPCAN_RADAR_Rx_3d9c193f if post-build-variant-condition{matching-criterion=RDR_POS, value=7}
      3 x ComSignalGroup, all with ComTimeout=0, ComTransferProperty=PENDING, ComSignalGroupAccess=ACCESS_NEEDED_BY_SWC_OR_COM, ComSignalGroupArrayAccess=true:
        SG_Fusion_Detections_061_064_oRDR_FUSION_DET_061_064_oPCAN_RADAR_57616c84_Rx: ComHandleId=23, ComSystemTemplateSignalGroupRef=SG_Fusion_Detections_061_064
          83 x ComGroupSignal, all with ComSignalEndianness=LITTLE_ENDIAN, ComSignalInitValue=0, ComSignalAccess=ACCESS_NEEDED_BY_SWC_OR_COM:
            DET_EXISTENCE_PROB_063_Rx_oRDR_FUSION_DET_061_064_oPCAN_RADAR_e0a98f2e_Rx: ComBitPosition=336, ComBitSize=6, ComSignalType=UINT8, ComHandleId=1353, ComSystemTemplateSystemSignalRef=DET_EXISTENCE_PROB_063_Rx
            DET_IDM_063_Rx_oRDR_FUSION_DET_061_064_oPCAN_RADAR_08b69b29_Rx: ComBitPosition=287, ComBitSize=1, ComSignalType=BOOLEAN, ComHandleId=1361, ComSystemTemplateSystemSignalRef=DET_IDM_063_Rx
            DET_BELOW_RAIN_THOLD_061_Rx_oRDR_FUSION_DET_061_064_oPCAN_RADAR_d475da92_Rx: ComBitPosition=39, ComBitSize=1, ComSignalType=BOOLEAN, ComHandleId=1327, ComSystemTemplateSystemSignalRef=DET_BELOW_RAIN_THOLD_061_Rx
            DET_BELOW_RAIN_THOLD_062_Rx_oRDR_FUSION_DET_061_064_oPCAN_RADAR_fec96a1a_Rx: ComBitPosition=151, ComBitSize=1, ComSignalType=BOOLEAN, ComHandleId=1328, ComSystemTemplateSystemSignalRef=DET_BELOW_RAIN_THOLD_062_Rx
            DET_RANGE_061_Rx_oRDR_FUSION_DET_061_064_oPCAN_RADAR_a1097900_Rx: ComBitPosition=24, ComBitSize=15, ComSignalType=UINT16, ComHandleId=1374, ComSystemTemplateSystemSignalRef=DET_RANGE_061_Rx
            DET_AZIMUTH_063_Rx_oRDR_FUSION_DET_061_064_oPCAN_RADAR_373707e8_Rx: ComBitPosition=312, ComBitSize=13, ComSignalType=UINT16, ComHandleId=1321, ComSystemTemplateSystemSignalRef=DET_AZIMUTH_063_Rx
            DET_ELEVATION_ERR_064_Rx_oRDR_FUSION_DET_061_064_oPCAN_RADAR_ed8c04ec_Rx: ComBitPosition=416, ComBitSize=6, ComSignalType=UINT8, ComHandleId=1350, ComSystemTemplateSystemSignalRef=DET_ELEVATION_ERR_064_Rx
            DET_RANGE_VELOCITY_064_Rx_oRDR_FUSION_DET_061_064_oPCAN_RADAR_03392b66_Rx: ComBitPosition=384, ComBitSize=15, ComSignalType=UINT16, ComHandleId=1385, ComSystemTemplateSystemSignalRef=DET_RANGE_VELOCITY_064_Rx
            DET_RANGE_VELOCITY_063_Rx_oRDR_FUSION_DET_061_064_oPCAN_RADAR_f904d831_Rx: ComBitPosition=272, ComBitSize=15, ComSignalType=UINT16, ComHandleId=1384, ComSystemTemplateSystemSignalRef=DET_RANGE_VELOCITY_063_Rx
            DET_MH_CYCLE_COUNTER_061_064_Rx_oRDR_FUSION_DET_061_064_oPCAN_RADAR_e6e18958_Rx: ComBitPosition=16, ComBitSize=8, ComSignalType=UINT8, ComHandleId=1364, ComSystemTemplateSystemSignalRef=DET_MH_CYCLE_COUNTER_061_064_Rx
            DET_RANGE_063_Rx_oRDR_FUSION_DET_061_064_oPCAN_RADAR_24f15bcf_Rx: ComBitPosition=248, ComBitSize=15, ComSignalType=UINT16, ComHandleId=1376, ComSystemTemplateSystemSignalRef=DET_RANGE_063_Rx
            DET_SNR_061_Rx_oRDR_FUSION_DET_061_064_oPCAN_RADAR_b86d190c_Rx: ComBitPosition=120, ComBitSize=8, ComSignalType=UINT8, ComHandleId=1394, ComSystemTemplateSystemSignalRef=DET_SNR_061_Rx
            DET_AZIMUTH_ERR_063_Rx_oRDR_FUSION_DET_061_064_oPCAN_RADAR_355ea66a_Rx: ComBitPosition=329, ComBitSize=7, ComSignalType=UINT8, ComHandleId=1325, ComSystemTemplateSystemSignalRef=DET_AZIMUTH_ERR_063_Rx
            DET_RANGE_ERR_063_Rx_oRDR_FUSION_DET_061_064_oPCAN_RADAR_7403d72f_Rx: ComBitPosition=264, ComBitSize=7, ComSignalType=UINT8, ComHandleId=1380, ComSystemTemplateSystemSignalRef=DET_RANGE_ERR_063_Rx
            DET_SUPER_RES_TARGET_062_Rx_oRDR_FUSION_DET_061_064_oPCAN_RADAR_592a8884_Rx: ComBitPosition=199, ComBitSize=1, ComSignalType=BOOLEAN, ComHandleId=1399, ComSystemTemplateSystemSignalRef=DET_SUPER_RES_TARGET_062_Rx
            DET_PROB_1STAZHYPO_063_Rx_oRDR_FUSION_DET_061_064_oPCAN_RADAR_7f4cb3d8_Rx: ComBitPosition=327, ComBitSize=1, ComSignalType=BOOLEAN, ComHandleId=1372, ComSystemTemplateSystemSignalRef=DET_PROB_1STAZHYPO_063_Rx
            DET_AZIMUTH_062_Rx_oRDR_FUSION_DET_061_064_oPCAN_RADAR_987395af_Rx: ComBitPosition=200, ComBitSize=13, ComSignalType=UINT16, ComHandleId=1320, ComSystemTemplateSystemSignalRef=DET_AZIMUTH_062_Rx
            DET_RANGE_ERR_061_Rx_oRDR_FUSION_DET_061_064_oPCAN_RADAR_f1fbf5e0_Rx: ComBitPosition=40, ComBitSize=7, ComSignalType=UINT8, ComHandleId=1378, ComSystemTemplateSystemSignalRef=DET_RANGE_ERR_061_Rx
            DET_RCS_064_Rx_oRDR_FUSION_DET_061_064_oPCAN_RADAR_cef2b97d_Rx: ComBitPosition=464, ComBitSize=8, ComSignalType=UINT8, ComHandleId=1393, ComSystemTemplateSystemSignalRef=DET_RCS_064_Rx
            DET_ELEVATION_064_Rx_oRDR_FUSION_DET_061_064_oPCAN_RADAR_3f352633_Rx: ComBitPosition=408, ComBitSize=8, ComSignalType=UINT8, ComHandleId=1346, ComSystemTemplateSystemSignalRef=DET_ELEVATION_064_Rx
            DET_EXISTENCE_PROB_064_Rx_oRDR_FUSION_DET_061_064_oPCAN_RADAR_1a947c79_Rx: ComBitPosition=448, ComBitSize=6, ComSignalType=UINT8, ComHandleId=1354, ComSystemTemplateSystemSignalRef=DET_EXISTENCE_PROB_064_Rx
            DET_CONFD_ELEVATION_061_Rx_oRDR_FUSION_DET_061_064_oPCAN_RADAR_4aa31852_Rx: ComBitPosition=101, ComBitSize=2, ComSignalType=UINT8, ComHandleId=1339, ComSystemTemplateSystemSignalRef=DET_CONFD_ELEVATION_061_Rx
            DET_SUPER_RES_TARGET_063_Rx_oRDR_FUSION_DET_061_064_oPCAN_RADAR_f66e1ac3_Rx: ComBitPosition=311, ComBitSize=1, ComSignalType=BOOLEAN, ComHandleId=1400, ComSystemTemplateSystemSignalRef=DET_SUPER_RES_TARGET_063_Rx
            DET_BELOW_RAIN_THOLD_064_Rx_oRDR_FUSION_DET_061_064_oPCAN_RADAR_abb00b0a_Rx: ComBitPosition=375, ComBitSize=1, ComSignalType=BOOLEAN, ComHandleId=1330, ComSystemTemplateSystemSignalRef=DET_BELOW_RAIN_THOLD_064_Rx
            DET_BI_STATIC_FLAG_062_Rx_oRDR_FUSION_DET_061_064_oPCAN_RADAR_8957c109_Rx: ComBitPosition=216, ComBitSize=1, ComSignalType=BOOLEAN, ComHandleId=1332, ComSystemTemplateSystemSignalRef=DET_BI_STATIC_FLAG_062_Rx
            DET_CONFD_ELEVATION_064_Rx_oRDR_FUSION_DET_061_064_oPCAN_RADAR_3566c9ca_Rx: ComBitPosition=437, ComBitSize=2, ComSignalType=UINT8, ComHandleId=1342, ComSystemTemplateSystemSignalRef=DET_CONFD_ELEVATION_064_Rx
            DET_IDM_061_Rx_oRDR_FUSION_DET_061_064_oPCAN_RADAR_8d4eb9e6_Rx: ComBitPosition=63, ComBitSize=1, ComSignalType=BOOLEAN, ComHandleId=1359, ComSystemTemplateSystemSignalRef=DET_IDM_061_Rx
            DET_RANGE_VELOCITY_ERR_062_Rx_oRDR_FUSION_DET_061_064_oPCAN_RADAR_cf243ab4_Rx: ComBitPosition=176, ComBitSize=8, ComSignalType=UINT8, ComHandleId=1387, ComSystemTemplateSystemSignalRef=DET_RANGE_VELOCITY_ERR_062_Rx
            DET_RANGE_VELOCITY_ERR_063_Rx_oRDR_FUSION_DET_061_064_oPCAN_RADAR_6060a8f3_Rx: ComBitPosition=288, ComBitSize=8, ComSignalType=UINT8, ComHandleId=1388, ComSystemTemplateSystemSignalRef=DET_RANGE_VELOCITY_ERR_063_Rx
            DET_ELEVATION_063_Rx_oRDR_FUSION_DET_061_064_oPCAN_RADAR_c508d564_Rx: ComBitPosition=296, ComBitSize=8, ComSignalType=UINT8, ComHandleId=1345, ComSystemTemplateSystemSignalRef=DET_ELEVATION_063_Rx
            DET_MTD_062_Rx_oRDR_FUSION_DET_061_064_oPCAN_RADAR_1a713f1e_Rx: ComBitPosition=159, ComBitSize=1, ComSignalType=BOOLEAN, ComHandleId=1367, ComSystemTemplateSystemSignalRef=DET_MTD_062_Rx
            DET_MTD_063_Rx_oRDR_FUSION_DET_061_064_oPCAN_RADAR_b535ad59_Rx: ComBitPosition=271, ComBitSize=1, ComSignalType=BOOLEAN, ComHandleId=1368, ComSystemTemplateSystemSignalRef=DET_MTD_063_Rx
            DET_RANGE_VELOCITY_ERR_064_Rx_oRDR_FUSION_DET_061_064_oPCAN_RADAR_9a5d5ba4_Rx: ComBitPosition=400, ComBitSize=8, ComSignalType=UINT8, ComHandleId=1389, ComSystemTemplateSystemSignalRef=DET_RANGE_VELOCITY_ERR_064_Rx
            DET_AZIMUTH_ERR_062_Rx_oRDR_FUSION_DET_061_064_oPCAN_RADAR_9a1a342d_Rx: ComBitPosition=217, ComBitSize=7, ComSignalType=UINT8, ComHandleId=1324, ComSystemTemplateSystemSignalRef=DET_AZIMUTH_ERR_062_Rx
            DET_RANGE_VELOCITY_ERR_061_Rx_oRDR_FUSION_DET_061_064_oPCAN_RADAR_e5988a3c_Rx: ComBitPosition=64, ComBitSize=8, ComSignalType=UINT8, ComHandleId=1386, ComSystemTemplateSystemSignalRef=DET_RANGE_VELOCITY_ERR_061_Rx
            DET_PROB_1STAZHYPO_062_Rx_oRDR_FUSION_DET_061_064_oPCAN_RADAR_d008219f_Rx: ComBitPosition=215, ComBitSize=1, ComSignalType=BOOLEAN, ComHandleId=1371, ComSystemTemplateSystemSignalRef=DET_PROB_1STAZHYPO_062_Rx
            DET_RCS_063_Rx_oRDR_FUSION_DET_061_064_oPCAN_RADAR_34cf4a2a_Rx: ComBitPosition=352, ComBitSize=8, ComSignalType=UINT8, ComHandleId=1392, ComSystemTemplateSystemSignalRef=DET_RCS_063_Rx
            DET_CONFD_AZIMUTH_061_Rx_oRDR_FUSION_DET_061_064_oPCAN_RADAR_40829bd5_Rx: ComBitPosition=118, ComBitSize=2, ComSignalType=UINT8, ComHandleId=1335, ComSystemTemplateSystemSignalRef=DET_CONFD_AZIMUTH_061_Rx
            DET_IDM_064_Rx_oRDR_FUSION_DET_061_064_oPCAN_RADAR_f28b687e_Rx: ComBitPosition=399, ComBitSize=1, ComSignalType=BOOLEAN, ComHandleId=1362, ComSystemTemplateSystemSignalRef=DET_IDM_064_Rx
            DET_MTD_061_Rx_oRDR_FUSION_DET_061_064_oPCAN_RADAR_30cd8f96_Rx: ComBitPosition=47, ComBitSize=1, ComSignalType=BOOLEAN, ComHandleId=1366, ComSystemTemplateSystemSignalRef=DET_MTD_061_Rx
            DET_ELEVATION_061_Rx_oRDR_FUSION_DET_061_064_oPCAN_RADAR_40f0f7ab_Rx: ComBitPosition=72, ComBitSize=8, ComSignalType=UINT8, ComHandleId=1343, ComSystemTemplateSystemSignalRef=DET_ELEVATION_061_Rx
            DET_RANGE_ERR_062_Rx_oRDR_FUSION_DET_061_064_oPCAN_RADAR_db474568_Rx: ComBitPosition=152, ComBitSize=7, ComSignalType=UINT8, ComHandleId=1379, ComSystemTemplateSystemSignalRef=DET_RANGE_ERR_062_Rx
            DET_RANGE_VELOCITY_062_Rx_oRDR_FUSION_DET_061_064_oPCAN_RADAR_56404a76_Rx: ComBitPosition=160, ComBitSize=15, ComSignalType=UINT16, ComHandleId=1383, ComSystemTemplateSystemSignalRef=DET_RANGE_VELOCITY_062_Rx
            DET_BI_STATIC_FLAG_061_Rx_oRDR_FUSION_DET_061_064_oPCAN_RADAR_a3eb7181_Rx: ComBitPosition=104, ComBitSize=1, ComSignalType=BOOLEAN, ComHandleId=1331, ComSystemTemplateSystemSignalRef=DET_BI_STATIC_FLAG_061_Rx
            DET_CONFD_ELEVATION_062_Rx_oRDR_FUSION_DET_061_064_oPCAN_RADAR_601fa8da_Rx: ComBitPosition=213, ComBitSize=2, ComSignalType=UINT8, ComHandleId=1340, ComSystemTemplateSystemSignalRef=DET_CONFD_ELEVATION_062_Rx
            DET_SUPER_RES_TARGET_064_Rx_oRDR_FUSION_DET_061_064_oPCAN_RADAR_0c53e994_Rx: ComBitPosition=423, ComBitSize=1, ComSignalType=BOOLEAN, ComHandleId=1401, ComSystemTemplateSystemSignalRef=DET_SUPER_RES_TARGET_064_Rx
            DET_HVC_FLAG_064_Rx_oRDR_FUSION_DET_061_064_oPCAN_RADAR_c74a9136_Rx: ComBitPosition=422, ComBitSize=1, ComSignalType=BOOLEAN, ComHandleId=1358, ComSystemTemplateSystemSignalRef=DET_HVC_FLAG_064_Rx
            DET_ELEVATION_062_Rx_oRDR_FUSION_DET_061_064_oPCAN_RADAR_6a4c4723_Rx: ComBitPosition=184, ComBitSize=8, ComSignalType=UINT8, ComHandleId=1344, ComSystemTemplateSystemSignalRef=DET_ELEVATION_062_Rx
            DET_SNR_062_Rx_oRDR_FUSION_DET_061_064_oPCAN_RADAR_92d1a984_Rx: ComBitPosition=232, ComBitSize=8, ComSignalType=UINT8, ComHandleId=1395, ComSystemTemplateSystemSignalRef=DET_SNR_062_Rx
            DET_SNR_063_Rx_oRDR_FUSION_DET_061_064_oPCAN_RADAR_3d953bc3_Rx: ComBitPosition=344, ComBitSize=8, ComSignalType=UINT8, ComHandleId=1396, ComSystemTemplateSystemSignalRef=DET_SNR_063_Rx
            DET_AZIMUTH_ERR_061_Rx_oRDR_FUSION_DET_061_064_oPCAN_RADAR_b0a684a5_Rx: ComBitPosition=105, ComBitSize=7, ComSignalType=UINT8, ComHandleId=1323, ComSystemTemplateSystemSignalRef=DET_AZIMUTH_ERR_061_Rx
            DET_PROB_1STAZHYPO_064_Rx_oRDR_FUSION_DET_061_064_oPCAN_RADAR_8571408f_Rx: ComBitPosition=439, ComBitSize=1, ComSignalType=BOOLEAN, ComHandleId=1373, ComSystemTemplateSystemSignalRef=DET_PROB_1STAZHYPO_064_Rx
            DET_RCS_062_Rx_oRDR_FUSION_DET_061_064_oPCAN_RADAR_9b8bd86d_Rx: ComBitPosition=240, ComBitSize=8, ComSignalType=UINT8, ComHandleId=1391, ComSystemTemplateSystemSignalRef=DET_RCS_062_Rx
            DET_MH_CRC16_061_064_Rx_oRDR_FUSION_DET_061_064_oPCAN_RADAR_eb3ab49d_Rx: ComBitPosition=0, ComBitSize=16, ComSignalType=UINT16, ComHandleId=1363, ComSystemTemplateSystemSignalRef=DET_MH_CRC16_061_064_Rx
            DET_PROB_1STAZHYPO_061_Rx_oRDR_FUSION_DET_061_064_oPCAN_RADAR_fab49117_Rx: ComBitPosition=103, ComBitSize=1, ComSignalType=BOOLEAN, ComHandleId=1370, ComSystemTemplateSystemSignalRef=DET_PROB_1STAZHYPO_061_Rx
            DET_RCS_061_Rx_oRDR_FUSION_DET_061_064_oPCAN_RADAR_b13768e5_Rx: ComBitPosition=128, ComBitSize=8, ComSignalType=UINT8, ComHandleId=1390, ComSystemTemplateSystemSignalRef=DET_RCS_061_Rx
            DET_CONFD_ELEVATION_063_Rx_oRDR_FUSION_DET_061_064_oPCAN_RADAR_cf5b3a9d_Rx: ComBitPosition=325, ComBitSize=2, ComSignalType=UINT8, ComHandleId=1341, ComSystemTemplateSystemSignalRef=DET_CONFD_ELEVATION_063_Rx
            DET_AZIMUTH_061_Rx_oRDR_FUSION_DET_061_064_oPCAN_RADAR_b2cf2527_Rx: ComBitPosition=88, ComBitSize=13, ComSignalType=UINT16, ComHandleId=1319, ComSystemTemplateSystemSignalRef=DET_AZIMUTH_061_Rx
            DET_RANGE_064_Rx_oRDR_FUSION_DET_061_064_oPCAN_RADAR_decca898_Rx: ComBitPosition=360, ComBitSize=15, ComSignalType=UINT16, ComHandleId=1377, ComSystemTemplateSystemSignalRef=DET_RANGE_064_Rx
            DET_BELOW_RAIN_THOLD_063_Rx_oRDR_FUSION_DET_061_064_oPCAN_RADAR_518df85d_Rx: ComBitPosition=263, ComBitSize=1, ComSignalType=BOOLEAN, ComHandleId=1329, ComSystemTemplateSystemSignalRef=DET_BELOW_RAIN_THOLD_063_Rx
            DET_CONFD_AZIMUTH_064_Rx_oRDR_FUSION_DET_061_064_oPCAN_RADAR_3f474a4d_Rx: ComBitPosition=454, ComBitSize=2, ComSignalType=UINT8, ComHandleId=1338, ComSystemTemplateSystemSignalRef=DET_CONFD_AZIMUTH_064_Rx
            DET_CONFD_AZIMUTH_062_Rx_oRDR_FUSION_DET_061_064_oPCAN_RADAR_6a3e2b5d_Rx: ComBitPosition=230, ComBitSize=2, ComSignalType=UINT8, ComHandleId=1336, ComSystemTemplateSystemSignalRef=DET_CONFD_AZIMUTH_062_Rx
            DET_ELEVATION_ERR_063_Rx_oRDR_FUSION_DET_061_064_oPCAN_RADAR_17b1f7bb_Rx: ComBitPosition=304, ComBitSize=6, ComSignalType=UINT8, ComHandleId=1349, ComSystemTemplateSystemSignalRef=DET_ELEVATION_ERR_063_Rx
            DET_RANGE_ERR_064_Rx_oRDR_FUSION_DET_061_064_oPCAN_RADAR_8e3e2478_Rx: ComBitPosition=376, ComBitSize=7, ComSignalType=UINT8, ComHandleId=1381, ComSystemTemplateSystemSignalRef=DET_RANGE_ERR_064_Rx
            DET_MTD_064_Rx_oRDR_FUSION_DET_061_064_oPCAN_RADAR_4f085e0e_Rx: ComBitPosition=383, ComBitSize=1, ComSignalType=BOOLEAN, ComHandleId=1369, ComSystemTemplateSystemSignalRef=DET_MTD_064_Rx
            DET_SUPER_RES_TARGET_061_Rx_oRDR_FUSION_DET_061_064_oPCAN_RADAR_7396380c_Rx: ComBitPosition=87, ComBitSize=1, ComSignalType=BOOLEAN, ComHandleId=1398, ComSystemTemplateSystemSignalRef=DET_SUPER_RES_TARGET_061_Rx
            DET_BI_STATIC_FLAG_063_Rx_oRDR_FUSION_DET_061_064_oPCAN_RADAR_2613534e_Rx: ComBitPosition=328, ComBitSize=1, ComSignalType=BOOLEAN, ComHandleId=1333, ComSystemTemplateSystemSignalRef=DET_BI_STATIC_FLAG_063_Rx
            DET_HVC_FLAG_063_Rx_oRDR_FUSION_DET_061_064_oPCAN_RADAR_3d776261_Rx: ComBitPosition=310, ComBitSize=1, ComSignalType=BOOLEAN, ComHandleId=1357, ComSystemTemplateSystemSignalRef=DET_HVC_FLAG_063_Rx
            DET_HVC_FLAG_061_Rx_oRDR_FUSION_DET_061_064_oPCAN_RADAR_b88f40ae_Rx: ComBitPosition=86, ComBitSize=1, ComSignalType=BOOLEAN, ComHandleId=1355, ComSystemTemplateSystemSignalRef=DET_HVC_FLAG_061_Rx
            DET_RANGE_062_Rx_oRDR_FUSION_DET_061_064_oPCAN_RADAR_8bb5c988_Rx: ComBitPosition=136, ComBitSize=15, ComSignalType=UINT16, ComHandleId=1375, ComSystemTemplateSystemSignalRef=DET_RANGE_062_Rx
            DET_IDM_062_Rx_oRDR_FUSION_DET_061_064_oPCAN_RADAR_a7f2096e_Rx: ComBitPosition=175, ComBitSize=1, ComSignalType=BOOLEAN, ComHandleId=1360, ComSystemTemplateSystemSignalRef=DET_IDM_062_Rx
            DET_SNR_064_Rx_oRDR_FUSION_DET_061_064_oPCAN_RADAR_c7a8c894_Rx: ComBitPosition=456, ComBitSize=8, ComSignalType=UINT8, ComHandleId=1397, ComSystemTemplateSystemSignalRef=DET_SNR_064_Rx
            DET_AZIMUTH_064_Rx_oRDR_FUSION_DET_061_064_oPCAN_RADAR_cd0af4bf_Rx: ComBitPosition=424, ComBitSize=13, ComSignalType=UINT16, ComHandleId=1322, ComSystemTemplateSystemSignalRef=DET_AZIMUTH_064_Rx
            DET_CONFD_AZIMUTH_063_Rx_oRDR_FUSION_DET_061_064_oPCAN_RADAR_c57ab91a_Rx: ComBitPosition=342, ComBitSize=2, ComSignalType=UINT8, ComHandleId=1337, ComSystemTemplateSystemSignalRef=DET_CONFD_AZIMUTH_063_Rx
            DET_EXISTENCE_PROB_062_Rx_oRDR_FUSION_DET_061_064_oPCAN_RADAR_4fed1d69_Rx: ComBitPosition=224, ComBitSize=6, ComSignalType=UINT8, ComHandleId=1352, ComSystemTemplateSystemSignalRef=DET_EXISTENCE_PROB_062_Rx
            DET_HVC_FLAG_062_Rx_oRDR_FUSION_DET_061_064_oPCAN_RADAR_9233f026_Rx: ComBitPosition=198, ComBitSize=1, ComSignalType=BOOLEAN, ComHandleId=1356, ComSystemTemplateSystemSignalRef=DET_HVC_FLAG_062_Rx
            DET_AZIMUTH_ERR_064_Rx_oRDR_FUSION_DET_061_064_oPCAN_RADAR_cf63553d_Rx: ComBitPosition=441, ComBitSize=7, ComSignalType=UINT8, ComHandleId=1326, ComSystemTemplateSystemSignalRef=DET_AZIMUTH_ERR_064_Rx
            DET_BI_STATIC_FLAG_064_Rx_oRDR_FUSION_DET_061_064_oPCAN_RADAR_dc2ea019_Rx: ComBitPosition=440, ComBitSize=1, ComSignalType=BOOLEAN, ComHandleId=1334, ComSystemTemplateSystemSignalRef=DET_BI_STATIC_FLAG_064_Rx
            DET_ELEVATION_ERR_061_Rx_oRDR_FUSION_DET_061_064_oPCAN_RADAR_9249d574_Rx: ComBitPosition=80, ComBitSize=6, ComSignalType=UINT8, ComHandleId=1347, ComSystemTemplateSystemSignalRef=DET_ELEVATION_ERR_061_Rx
            DET_EXISTENCE_PROB_061_Rx_oRDR_FUSION_DET_061_064_oPCAN_RADAR_6551ade1_Rx: ComBitPosition=112, ComBitSize=6, ComSignalType=UINT8, ComHandleId=1351, ComSystemTemplateSystemSignalRef=DET_EXISTENCE_PROB_061_Rx
            DET_ELEVATION_ERR_062_Rx_oRDR_FUSION_DET_061_064_oPCAN_RADAR_b8f565fc_Rx: ComBitPosition=192, ComBitSize=6, ComSignalType=UINT8, ComHandleId=1348, ComSystemTemplateSystemSignalRef=DET_ELEVATION_ERR_062_Rx
            DET_MH_SCAN_INDEX_4LSB_061_064_Rx_oRDR_FUSION_DET_061_064_oPCAN_RADAR_82514663_Rx: ComBitPosition=476, ComBitSize=4, ComSignalType=UINT8, ComHandleId=1365, ComSystemTemplateSystemSignalRef=DET_MH_SCAN_INDEX_4LSB_061_064_Rx
            DET_RANGE_VELOCITY_061_Rx_oRDR_FUSION_DET_061_064_oPCAN_RADAR_7cfcfafe_Rx: ComBitPosition=48, ComBitSize=15, ComSignalType=UINT16, ComHandleId=1382, ComSystemTemplateSystemSignalRef=DET_RANGE_VELOCITY_061_Rx
        SG_Fusion_Detections_089_092_oRDR_FUSION_DET_089_092_oPCAN_RADAR_1f429d9f_Rx: ComHandleId=30, ComSystemTemplateSignalGroupRef=SG_Fusion_Detections_089_092
          83 x ComGroupSignal, all with ComSignalEndianness=LITTLE_ENDIAN, ComSignalInitValue=0, ComSignalAccess=ACCESS_NEEDED_BY_SWC_OR_COM:
            DET_EXISTENCE_PROB_089_Rx_oRDR_FUSION_DET_089_092_oPCAN_RADAR_26f4ef2b_Rx: ComBitPosition=112, ComBitSize=6, ComSignalType=UINT8, ComHandleId=1932, ComSystemTemplateSystemSignalRef=DET_EXISTENCE_PROB_089_Rx
            DET_RANGE_090_Rx_oRDR_FUSION_DET_089_092_oPCAN_RADAR_df8cb8d3_Rx: ComBitPosition=136, ComBitSize=15, ComSignalType=UINT16, ComHandleId=1956, ComSystemTemplateSystemSignalRef=DET_RANGE_090_Rx
            DET_CONFD_AZIMUTH_091_Rx_oRDR_FUSION_DET_089_092_oPCAN_RADAR_9143c841_Rx: ComBitPosition=342, ComBitSize=2, ComSignalType=UINT8, ComHandleId=1918, ComSystemTemplateSystemSignalRef=DET_CONFD_AZIMUTH_091_Rx
            DET_ELEVATION_ERR_091_Rx_oRDR_FUSION_DET_089_092_oPCAN_RADAR_438886e0_Rx: ComBitPosition=304, ComBitSize=6, ComSignalType=UINT8, ComHandleId=1930, ComSystemTemplateSystemSignalRef=DET_ELEVATION_ERR_091_Rx
            DET_RANGE_ERR_092_Rx_oRDR_FUSION_DET_089_092_oPCAN_RADAR_0a8616fc_Rx: ComBitPosition=376, ComBitSize=7, ComSignalType=UINT8, ComHandleId=1962, ComSystemTemplateSystemSignalRef=DET_RANGE_ERR_092_Rx
            DET_RANGE_VELOCITY_ERR_090_Rx_oRDR_FUSION_DET_089_092_oPCAN_RADAR_9b1d4bef_Rx: ComBitPosition=176, ComBitSize=8, ComSignalType=UINT8, ComHandleId=1968, ComSystemTemplateSystemSignalRef=DET_RANGE_VELOCITY_ERR_090_Rx
            DET_MTD_090_Rx_oRDR_FUSION_DET_089_092_oPCAN_RADAR_4e484e45_Rx: ComBitPosition=159, ComBitSize=1, ComSignalType=BOOLEAN, ComHandleId=1948, ComSystemTemplateSystemSignalRef=DET_MTD_090_Rx
            DET_SNR_089_Rx_oRDR_FUSION_DET_089_092_oPCAN_RADAR_fbc85bc6_Rx: ComBitPosition=120, ComBitSize=8, ComSignalType=UINT8, ComHandleId=1975, ComSystemTemplateSystemSignalRef=DET_SNR_089_Rx
            DET_BELOW_RAIN_THOLD_091_Rx_oRDR_FUSION_DET_089_092_oPCAN_RADAR_05b48906_Rx: ComBitPosition=263, ComBitSize=1, ComSignalType=BOOLEAN, ComHandleId=1910, ComSystemTemplateSystemSignalRef=DET_BELOW_RAIN_THOLD_091_Rx
            DET_BI_STATIC_FLAG_091_Rx_oRDR_FUSION_DET_089_092_oPCAN_RADAR_722a2215_Rx: ComBitPosition=328, ComBitSize=1, ComSignalType=BOOLEAN, ComHandleId=1914, ComSystemTemplateSystemSignalRef=DET_BI_STATIC_FLAG_091_Rx
            DET_ELEVATION_092_Rx_oRDR_FUSION_DET_089_092_oPCAN_RADAR_bb8d14b7_Rx: ComBitPosition=408, ComBitSize=8, ComSignalType=UINT8, ComHandleId=1927, ComSystemTemplateSystemSignalRef=DET_ELEVATION_092_Rx
            DET_SUPER_RES_TARGET_089_Rx_oRDR_FUSION_DET_089_092_oPCAN_RADAR_30337ac6_Rx: ComBitPosition=87, ComBitSize=1, ComSignalType=BOOLEAN, ComHandleId=1979, ComSystemTemplateSystemSignalRef=DET_SUPER_RES_TARGET_089_Rx
            DET_ELEVATION_ERR_090_Rx_oRDR_FUSION_DET_089_092_oPCAN_RADAR_eccc14a7_Rx: ComBitPosition=192, ComBitSize=6, ComSignalType=UINT8, ComHandleId=1929, ComSystemTemplateSystemSignalRef=DET_ELEVATION_ERR_090_Rx
            DET_PROB_1STAZHYPO_090_Rx_oRDR_FUSION_DET_089_092_oPCAN_RADAR_843150c4_Rx: ComBitPosition=215, ComBitSize=1, ComSignalType=BOOLEAN, ComHandleId=1952, ComSystemTemplateSystemSignalRef=DET_PROB_1STAZHYPO_090_Rx
            DET_IDM_091_Rx_oRDR_FUSION_DET_089_092_oPCAN_RADAR_5c8fea72_Rx: ComBitPosition=287, ComBitSize=1, ComSignalType=BOOLEAN, ComHandleId=1942, ComSystemTemplateSystemSignalRef=DET_IDM_091_Rx
            DET_RANGE_VELOCITY_089_Rx_oRDR_FUSION_DET_089_092_oPCAN_RADAR_3f59b834_Rx: ComBitPosition=48, ComBitSize=15, ComSignalType=UINT16, ComHandleId=1963, ComSystemTemplateSystemSignalRef=DET_RANGE_VELOCITY_089_Rx
            DET_IDM_092_Rx_oRDR_FUSION_DET_089_092_oPCAN_RADAR_76335afa_Rx: ComBitPosition=399, ComBitSize=1, ComSignalType=BOOLEAN, ComHandleId=1943, ComSystemTemplateSystemSignalRef=DET_IDM_092_Rx
            DET_CONFD_AZIMUTH_090_Rx_oRDR_FUSION_DET_089_092_oPCAN_RADAR_3e075a06_Rx: ComBitPosition=230, ComBitSize=2, ComSignalType=UINT8, ComHandleId=1917, ComSystemTemplateSystemSignalRef=DET_CONFD_AZIMUTH_090_Rx
            DET_CONFD_AZIMUTH_092_Rx_oRDR_FUSION_DET_089_092_oPCAN_RADAR_bbff78c9_Rx: ComBitPosition=454, ComBitSize=2, ComSignalType=UINT8, ComHandleId=1919, ComSystemTemplateSystemSignalRef=DET_CONFD_AZIMUTH_092_Rx
            DET_RCS_090_Rx_oRDR_FUSION_DET_089_092_oPCAN_RADAR_cfb2a936_Rx: ComBitPosition=240, ComBitSize=8, ComSignalType=UINT8, ComHandleId=1972, ComSystemTemplateSystemSignalRef=DET_RCS_090_Rx
            DET_RANGE_VELOCITY_090_Rx_oRDR_FUSION_DET_089_092_oPCAN_RADAR_02793b2d_Rx: ComBitPosition=160, ComBitSize=15, ComSignalType=UINT16, ComHandleId=1964, ComSystemTemplateSystemSignalRef=DET_RANGE_VELOCITY_090_Rx
            DET_HVC_FLAG_091_Rx_oRDR_FUSION_DET_089_092_oPCAN_RADAR_694e133a_Rx: ComBitPosition=310, ComBitSize=1, ComSignalType=BOOLEAN, ComHandleId=1938, ComSystemTemplateSystemSignalRef=DET_HVC_FLAG_091_Rx
            DET_IDM_089_Rx_oRDR_FUSION_DET_089_092_oPCAN_RADAR_ceebfb2c_Rx: ComBitPosition=63, ComBitSize=1, ComSignalType=BOOLEAN, ComHandleId=1940, ComSystemTemplateSystemSignalRef=DET_IDM_089_Rx
            DET_MTD_089_Rx_oRDR_FUSION_DET_089_092_oPCAN_RADAR_7368cd5c_Rx: ComBitPosition=47, ComBitSize=1, ComSignalType=BOOLEAN, ComHandleId=1947, ComSystemTemplateSystemSignalRef=DET_MTD_089_Rx
            DET_SUPER_RES_TARGET_090_Rx_oRDR_FUSION_DET_089_092_oPCAN_RADAR_0d13f9df_Rx: ComBitPosition=199, ComBitSize=1, ComSignalType=BOOLEAN, ComHandleId=1980, ComSystemTemplateSystemSignalRef=DET_SUPER_RES_TARGET_090_Rx
            DET_RANGE_ERR_090_Rx_oRDR_FUSION_DET_089_092_oPCAN_RADAR_8f7e3433_Rx: ComBitPosition=152, ComBitSize=7, ComSignalType=UINT8, ComHandleId=1960, ComSystemTemplateSystemSignalRef=DET_RANGE_ERR_090_Rx
            DET_RANGE_VELOCITY_ERR_089_Rx_oRDR_FUSION_DET_089_092_oPCAN_RADAR_a63dc8f6_Rx: ComBitPosition=64, ComBitSize=8, ComSignalType=UINT8, ComHandleId=1967, ComSystemTemplateSystemSignalRef=DET_RANGE_VELOCITY_ERR_089_Rx
            DET_IDM_090_Rx_oRDR_FUSION_DET_089_092_oPCAN_RADAR_f3cb7835_Rx: ComBitPosition=175, ComBitSize=1, ComSignalType=BOOLEAN, ComHandleId=1941, ComSystemTemplateSystemSignalRef=DET_IDM_090_Rx
            DET_RANGE_VELOCITY_091_Rx_oRDR_FUSION_DET_089_092_oPCAN_RADAR_ad3da96a_Rx: ComBitPosition=272, ComBitSize=15, ComSignalType=UINT16, ComHandleId=1965, ComSystemTemplateSystemSignalRef=DET_RANGE_VELOCITY_091_Rx
            DET_ELEVATION_091_Rx_oRDR_FUSION_DET_089_092_oPCAN_RADAR_9131a43f_Rx: ComBitPosition=296, ComBitSize=8, ComSignalType=UINT8, ComHandleId=1926, ComSystemTemplateSystemSignalRef=DET_ELEVATION_091_Rx
            DET_AZIMUTH_ERR_092_Rx_oRDR_FUSION_DET_089_092_oPCAN_RADAR_4bdb67b9_Rx: ComBitPosition=441, ComBitSize=7, ComSignalType=UINT8, ComHandleId=1907, ComSystemTemplateSystemSignalRef=DET_AZIMUTH_ERR_092_Rx
            DET_RANGE_091_Rx_oRDR_FUSION_DET_089_092_oPCAN_RADAR_70c82a94_Rx: ComBitPosition=248, ComBitSize=15, ComSignalType=UINT16, ComHandleId=1957, ComSystemTemplateSystemSignalRef=DET_RANGE_091_Rx
            DET_SNR_092_Rx_oRDR_FUSION_DET_089_092_oPCAN_RADAR_4310fa10_Rx: ComBitPosition=456, ComBitSize=8, ComSignalType=UINT8, ComHandleId=1978, ComSystemTemplateSystemSignalRef=DET_SNR_092_Rx
            DET_CONFD_AZIMUTH_089_Rx_oRDR_FUSION_DET_089_092_oPCAN_RADAR_0327d91f_Rx: ComBitPosition=118, ComBitSize=2, ComSignalType=UINT8, ComHandleId=1916, ComSystemTemplateSystemSignalRef=DET_CONFD_AZIMUTH_089_Rx
            DET_SNR_091_Rx_oRDR_FUSION_DET_089_092_oPCAN_RADAR_69ac4a98_Rx: ComBitPosition=344, ComBitSize=8, ComSignalType=UINT8, ComHandleId=1977, ComSystemTemplateSystemSignalRef=DET_SNR_091_Rx
            DET_RANGE_092_Rx_oRDR_FUSION_DET_089_092_oPCAN_RADAR_5a749a1c_Rx: ComBitPosition=360, ComBitSize=15, ComSignalType=UINT16, ComHandleId=1958, ComSystemTemplateSystemSignalRef=DET_RANGE_092_Rx
            DET_PROB_1STAZHYPO_091_Rx_oRDR_FUSION_DET_089_092_oPCAN_RADAR_2b75c283_Rx: ComBitPosition=327, ComBitSize=1, ComSignalType=BOOLEAN, ComHandleId=1953, ComSystemTemplateSystemSignalRef=DET_PROB_1STAZHYPO_091_Rx
            DET_CONFD_ELEVATION_091_Rx_oRDR_FUSION_DET_089_092_oPCAN_RADAR_9b624bc6_Rx: ComBitPosition=325, ComBitSize=2, ComSignalType=UINT8, ComHandleId=1922, ComSystemTemplateSystemSignalRef=DET_CONFD_ELEVATION_091_Rx
            DET_EXISTENCE_PROB_092_Rx_oRDR_FUSION_DET_089_092_oPCAN_RADAR_9e2c4efd_Rx: ComBitPosition=448, ComBitSize=6, ComSignalType=UINT8, ComHandleId=1935, ComSystemTemplateSystemSignalRef=DET_EXISTENCE_PROB_092_Rx
            DET_MH_CYCLE_COUNTER_089_092_Rx_oRDR_FUSION_DET_089_092_oPCAN_RADAR_8b19d200_Rx: ComBitPosition=16, ComBitSize=8, ComSignalType=UINT8, ComHandleId=1945, ComSystemTemplateSystemSignalRef=DET_MH_CYCLE_COUNTER_089_092_Rx
            DET_RANGE_089_Rx_oRDR_FUSION_DET_089_092_oPCAN_RADAR_e2ac3bca_Rx: ComBitPosition=24, ComBitSize=15, ComSignalType=UINT16, ComHandleId=1955, ComSystemTemplateSystemSignalRef=DET_RANGE_089_Rx
            DET_AZIMUTH_ERR_091_Rx_oRDR_FUSION_DET_089_092_oPCAN_RADAR_6167d731_Rx: ComBitPosition=329, ComBitSize=7, ComSignalType=UINT8, ComHandleId=1906, ComSystemTemplateSystemSignalRef=DET_AZIMUTH_ERR_091_Rx
            DET_HVC_FLAG_092_Rx_oRDR_FUSION_DET_089_092_oPCAN_RADAR_43f2a3b2_Rx: ComBitPosition=422, ComBitSize=1, ComSignalType=BOOLEAN, ComHandleId=1939, ComSystemTemplateSystemSignalRef=DET_HVC_FLAG_092_Rx
            DET_BELOW_RAIN_THOLD_092_Rx_oRDR_FUSION_DET_089_092_oPCAN_RADAR_2f08398e_Rx: ComBitPosition=375, ComBitSize=1, ComSignalType=BOOLEAN, ComHandleId=1911, ComSystemTemplateSystemSignalRef=DET_BELOW_RAIN_THOLD_092_Rx
            DET_BI_STATIC_FLAG_090_Rx_oRDR_FUSION_DET_089_092_oPCAN_RADAR_dd6eb052_Rx: ComBitPosition=216, ComBitSize=1, ComSignalType=BOOLEAN, ComHandleId=1913, ComSystemTemplateSystemSignalRef=DET_BI_STATIC_FLAG_090_Rx
            DET_MH_CRC16_089_092_Rx_oRDR_FUSION_DET_089_092_oPCAN_RADAR_86c2efc5_Rx: ComBitPosition=0, ComBitSize=16, ComSignalType=UINT16, ComHandleId=1944, ComSystemTemplateSystemSignalRef=DET_MH_CRC16_089_092_Rx
            DET_RANGE_VELOCITY_ERR_091_Rx_oRDR_FUSION_DET_089_092_oPCAN_RADAR_3459d9a8_Rx: ComBitPosition=288, ComBitSize=8, ComSignalType=UINT8, ComHandleId=1969, ComSystemTemplateSystemSignalRef=DET_RANGE_VELOCITY_ERR_091_Rx
            DET_CONFD_ELEVATION_089_Rx_oRDR_FUSION_DET_089_092_oPCAN_RADAR_09065a98_Rx: ComBitPosition=101, ComBitSize=2, ComSignalType=UINT8, ComHandleId=1920, ComSystemTemplateSystemSignalRef=DET_CONFD_ELEVATION_089_Rx
            DET_EXISTENCE_PROB_090_Rx_oRDR_FUSION_DET_089_092_oPCAN_RADAR_1bd46c32_Rx: ComBitPosition=224, ComBitSize=6, ComSignalType=UINT8, ComHandleId=1933, ComSystemTemplateSystemSignalRef=DET_EXISTENCE_PROB_090_Rx
            DET_MH_SCAN_INDEX_4LSB_089_092_Rx_oRDR_FUSION_DET_089_092_oPCAN_RADAR_efa91d3b_Rx: ComBitPosition=476, ComBitSize=4, ComSignalType=UINT8, ComHandleId=1946, ComSystemTemplateSystemSignalRef=DET_MH_SCAN_INDEX_4LSB_089_092_Rx
            DET_CONFD_ELEVATION_092_Rx_oRDR_FUSION_DET_089_092_oPCAN_RADAR_b1defb4e_Rx: ComBitPosition=437, ComBitSize=2, ComSignalType=UINT8, ComHandleId=1923, ComSystemTemplateSystemSignalRef=DET_CONFD_ELEVATION_092_Rx
            DET_BELOW_RAIN_THOLD_089_Rx_oRDR_FUSION_DET_089_092_oPCAN_RADAR_97d09858_Rx: ComBitPosition=39, ComBitSize=1, ComSignalType=BOOLEAN, ComHandleId=1908, ComSystemTemplateSystemSignalRef=DET_BELOW_RAIN_THOLD_089_Rx
            DET_HVC_FLAG_090_Rx_oRDR_FUSION_DET_089_092_oPCAN_RADAR_c60a817d_Rx: ComBitPosition=198, ComBitSize=1, ComSignalType=BOOLEAN, ComHandleId=1937, ComSystemTemplateSystemSignalRef=DET_HVC_FLAG_090_Rx
            DET_BELOW_RAIN_THOLD_090_Rx_oRDR_FUSION_DET_089_092_oPCAN_RADAR_aaf01b41_Rx: ComBitPosition=151, ComBitSize=1, ComSignalType=BOOLEAN, ComHandleId=1909, ComSystemTemplateSystemSignalRef=DET_BELOW_RAIN_THOLD_090_Rx
            DET_AZIMUTH_090_Rx_oRDR_FUSION_DET_089_092_oPCAN_RADAR_cc4ae4f4_Rx: ComBitPosition=200, ComBitSize=13, ComSignalType=UINT16, ComHandleId=1901, ComSystemTemplateSystemSignalRef=DET_AZIMUTH_090_Rx
            DET_ELEVATION_089_Rx_oRDR_FUSION_DET_089_092_oPCAN_RADAR_0355b561_Rx: ComBitPosition=72, ComBitSize=8, ComSignalType=UINT8, ComHandleId=1924, ComSystemTemplateSystemSignalRef=DET_ELEVATION_089_Rx
            DET_RCS_091_Rx_oRDR_FUSION_DET_089_092_oPCAN_RADAR_60f63b71_Rx: ComBitPosition=352, ComBitSize=8, ComSignalType=UINT8, ComHandleId=1973, ComSystemTemplateSystemSignalRef=DET_RCS_091_Rx
            DET_ELEVATION_ERR_092_Rx_oRDR_FUSION_DET_089_092_oPCAN_RADAR_69343668_Rx: ComBitPosition=416, ComBitSize=6, ComSignalType=UINT8, ComHandleId=1931, ComSystemTemplateSystemSignalRef=DET_ELEVATION_ERR_092_Rx
            DET_AZIMUTH_ERR_090_Rx_oRDR_FUSION_DET_089_092_oPCAN_RADAR_ce234576_Rx: ComBitPosition=217, ComBitSize=7, ComSignalType=UINT8, ComHandleId=1905, ComSystemTemplateSystemSignalRef=DET_AZIMUTH_ERR_090_Rx
            DET_EXISTENCE_PROB_091_Rx_oRDR_FUSION_DET_089_092_oPCAN_RADAR_b490fe75_Rx: ComBitPosition=336, ComBitSize=6, ComSignalType=UINT8, ComHandleId=1934, ComSystemTemplateSystemSignalRef=DET_EXISTENCE_PROB_091_Rx
            DET_SUPER_RES_TARGET_092_Rx_oRDR_FUSION_DET_089_092_oPCAN_RADAR_88ebdb10_Rx: ComBitPosition=423, ComBitSize=1, ComSignalType=BOOLEAN, ComHandleId=1982, ComSystemTemplateSystemSignalRef=DET_SUPER_RES_TARGET_092_Rx
            DET_RANGE_ERR_091_Rx_oRDR_FUSION_DET_089_092_oPCAN_RADAR_203aa674_Rx: ComBitPosition=264, ComBitSize=7, ComSignalType=UINT8, ComHandleId=1961, ComSystemTemplateSystemSignalRef=DET_RANGE_ERR_091_Rx
            DET_AZIMUTH_092_Rx_oRDR_FUSION_DET_089_092_oPCAN_RADAR_49b2c63b_Rx: ComBitPosition=424, ComBitSize=13, ComSignalType=UINT16, ComHandleId=1903, ComSystemTemplateSystemSignalRef=DET_AZIMUTH_092_Rx
            DET_BI_STATIC_FLAG_092_Rx_oRDR_FUSION_DET_089_092_oPCAN_RADAR_5896929d_Rx: ComBitPosition=440, ComBitSize=1, ComSignalType=BOOLEAN, ComHandleId=1915, ComSystemTemplateSystemSignalRef=DET_BI_STATIC_FLAG_092_Rx
            DET_CONFD_ELEVATION_090_Rx_oRDR_FUSION_DET_089_092_oPCAN_RADAR_3426d981_Rx: ComBitPosition=213, ComBitSize=2, ComSignalType=UINT8, ComHandleId=1921, ComSystemTemplateSystemSignalRef=DET_CONFD_ELEVATION_090_Rx
            DET_PROB_1STAZHYPO_089_Rx_oRDR_FUSION_DET_089_092_oPCAN_RADAR_b911d3dd_Rx: ComBitPosition=103, ComBitSize=1, ComSignalType=BOOLEAN, ComHandleId=1951, ComSystemTemplateSystemSignalRef=DET_PROB_1STAZHYPO_089_Rx
            DET_RANGE_VELOCITY_ERR_092_Rx_oRDR_FUSION_DET_089_092_oPCAN_RADAR_1ee56920_Rx: ComBitPosition=400, ComBitSize=8, ComSignalType=UINT8, ComHandleId=1970, ComSystemTemplateSystemSignalRef=DET_RANGE_VELOCITY_ERR_092_Rx
            DET_SUPER_RES_TARGET_091_Rx_oRDR_FUSION_DET_089_092_oPCAN_RADAR_a2576b98_Rx: ComBitPosition=311, ComBitSize=1, ComSignalType=BOOLEAN, ComHandleId=1981, ComSystemTemplateSystemSignalRef=DET_SUPER_RES_TARGET_091_Rx
            DET_AZIMUTH_ERR_089_Rx_oRDR_FUSION_DET_089_092_oPCAN_RADAR_f303c66f_Rx: ComBitPosition=105, ComBitSize=7, ComSignalType=UINT8, ComHandleId=1904, ComSystemTemplateSystemSignalRef=DET_AZIMUTH_ERR_089_Rx
            DET_MTD_092_Rx_oRDR_FUSION_DET_089_092_oPCAN_RADAR_cbb06c8a_Rx: ComBitPosition=383, ComBitSize=1, ComSignalType=BOOLEAN, ComHandleId=1950, ComSystemTemplateSystemSignalRef=DET_MTD_092_Rx
            DET_HVC_FLAG_089_Rx_oRDR_FUSION_DET_089_092_oPCAN_RADAR_fb2a0264_Rx: ComBitPosition=86, ComBitSize=1, ComSignalType=BOOLEAN, ComHandleId=1936, ComSystemTemplateSystemSignalRef=DET_HVC_FLAG_089_Rx
            DET_RCS_089_Rx_oRDR_FUSION_DET_089_092_oPCAN_RADAR_f2922a2f_Rx: ComBitPosition=128, ComBitSize=8, ComSignalType=UINT8, ComHandleId=1971, ComSystemTemplateSystemSignalRef=DET_RCS_089_Rx
            DET_ELEVATION_ERR_089_Rx_oRDR_FUSION_DET_089_092_oPCAN_RADAR_d1ec97be_Rx: ComBitPosition=80, ComBitSize=6, ComSignalType=UINT8, ComHandleId=1928, ComSystemTemplateSystemSignalRef=DET_ELEVATION_ERR_089_Rx
            DET_AZIMUTH_091_Rx_oRDR_FUSION_DET_089_092_oPCAN_RADAR_630e76b3_Rx: ComBitPosition=312, ComBitSize=13, ComSignalType=UINT16, ComHandleId=1902, ComSystemTemplateSystemSignalRef=DET_AZIMUTH_091_Rx
            DET_SNR_090_Rx_oRDR_FUSION_DET_089_092_oPCAN_RADAR_c6e8d8df_Rx: ComBitPosition=232, ComBitSize=8, ComSignalType=UINT8, ComHandleId=1976, ComSystemTemplateSystemSignalRef=DET_SNR_090_Rx
            DET_RANGE_VELOCITY_092_Rx_oRDR_FUSION_DET_089_092_oPCAN_RADAR_878119e2_Rx: ComBitPosition=384, ComBitSize=15, ComSignalType=UINT16, ComHandleId=1966, ComSystemTemplateSystemSignalRef=DET_RANGE_VELOCITY_092_Rx
            DET_AZIMUTH_089_Rx_oRDR_FUSION_DET_089_092_oPCAN_RADAR_f16a67ed_Rx: ComBitPosition=88, ComBitSize=13, ComSignalType=UINT16, ComHandleId=1900, ComSystemTemplateSystemSignalRef=DET_AZIMUTH_089_Rx
            DET_ELEVATION_090_Rx_oRDR_FUSION_DET_089_092_oPCAN_RADAR_3e753678_Rx: ComBitPosition=184, ComBitSize=8, ComSignalType=UINT8, ComHandleId=1925, ComSystemTemplateSystemSignalRef=DET_ELEVATION_090_Rx
            DET_PROB_1STAZHYPO_092_Rx_oRDR_FUSION_DET_089_092_oPCAN_RADAR_01c9720b_Rx: ComBitPosition=439, ComBitSize=1, ComSignalType=BOOLEAN, ComHandleId=1954, ComSystemTemplateSystemSignalRef=DET_PROB_1STAZHYPO_092_Rx
            DET_RANGE_ERR_089_Rx_oRDR_FUSION_DET_089_092_oPCAN_RADAR_b25eb72a_Rx: ComBitPosition=40, ComBitSize=7, ComSignalType=UINT8, ComHandleId=1959, ComSystemTemplateSystemSignalRef=DET_RANGE_ERR_089_Rx
            DET_RCS_092_Rx_oRDR_FUSION_DET_089_092_oPCAN_RADAR_4a4a8bf9_Rx: ComBitPosition=464, ComBitSize=8, ComSignalType=UINT8, ComHandleId=1974, ComSystemTemplateSystemSignalRef=DET_RCS_092_Rx
            DET_MTD_091_Rx_oRDR_FUSION_DET_089_092_oPCAN_RADAR_e10cdc02_Rx: ComBitPosition=271, ComBitSize=1, ComSignalType=BOOLEAN, ComHandleId=1949, ComSystemTemplateSystemSignalRef=DET_MTD_091_Rx
            DET_BI_STATIC_FLAG_089_Rx_oRDR_FUSION_DET_089_092_oPCAN_RADAR_e04e334b_Rx: ComBitPosition=104, ComBitSize=1, ComSignalType=BOOLEAN, ComHandleId=1912, ComSystemTemplateSystemSignalRef=DET_BI_STATIC_FLAG_089_Rx
        SG_Fusion_Detections_013_016_oRDR_FUSION_DET_013_016_oPCAN_RADAR_713b89f4_Rx: ComHandleId=11, ComSystemTemplateSignalGroupRef=SG_Fusion_Detections_013_016
          83 x ComGroupSignal, all with ComSignalEndianness=LITTLE_ENDIAN, ComSignalInitValue=0, ComSignalAccess=ACCESS_NEEDED_BY_SWC_OR_COM:
            DET_BELOW_RAIN_THOLD_016_Rx_oRDR_FUSION_DET_013_016_oPCAN_RADAR_eb3e5549_Rx: ComBitPosition=375, ComBitSize=1, ComSignalType=BOOLEAN, ComHandleId=334, ComSystemTemplateSystemSignalRef=DET_BELOW_RAIN_THOLD_016_Rx
            DET_ELEVATION_013_Rx_oRDR_FUSION_DET_013_016_oPCAN_RADAR_007ea9e8_Rx: ComBitPosition=72, ComBitSize=8, ComSignalType=UINT8, ComHandleId=347, ComSystemTemplateSystemSignalRef=DET_ELEVATION_013_Rx
            DET_RANGE_ERR_015_Rx_oRDR_FUSION_DET_013_016_oPCAN_RADAR_e40ccab3_Rx: ComBitPosition=264, ComBitSize=7, ComSignalType=UINT8, ComHandleId=384, ComSystemTemplateSystemSignalRef=DET_RANGE_ERR_015_Rx
            DET_ELEVATION_015_Rx_oRDR_FUSION_DET_013_016_oPCAN_RADAR_5507c8f8_Rx: ComBitPosition=296, ComBitSize=8, ComSignalType=UINT8, ComHandleId=349, ComSystemTemplateSystemSignalRef=DET_ELEVATION_015_Rx
            DET_AZIMUTH_ERR_016_Rx_oRDR_FUSION_DET_013_016_oPCAN_RADAR_8fed0b7e_Rx: ComBitPosition=441, ComBitSize=7, ComSignalType=UINT8, ComHandleId=330, ComSystemTemplateSystemSignalRef=DET_AZIMUTH_ERR_016_Rx
            DET_CONFD_AZIMUTH_014_Rx_oRDR_FUSION_DET_013_016_oPCAN_RADAR_fa3136c1_Rx: ComBitPosition=230, ComBitSize=2, ComSignalType=UINT8, ComHandleId=340, ComSystemTemplateSystemSignalRef=DET_CONFD_AZIMUTH_014_Rx
            DET_RANGE_VELOCITY_013_Rx_oRDR_FUSION_DET_013_016_oPCAN_RADAR_3c72a4bd_Rx: ComBitPosition=48, ComBitSize=15, ComSignalType=UINT16, ComHandleId=386, ComSystemTemplateSystemSignalRef=DET_RANGE_VELOCITY_013_Rx
            DET_RANGE_VELOCITY_ERR_015_Rx_oRDR_FUSION_DET_013_016_oPCAN_RADAR_f06fb56f_Rx: ComBitPosition=288, ComBitSize=8, ComSignalType=UINT8, ComHandleId=392, ComSystemTemplateSystemSignalRef=DET_RANGE_VELOCITY_ERR_015_Rx
            DET_RANGE_VELOCITY_ERR_016_Rx_oRDR_FUSION_DET_013_016_oPCAN_RADAR_dad305e7_Rx: ComBitPosition=400, ComBitSize=8, ComSignalType=UINT8, ComHandleId=393, ComSystemTemplateSystemSignalRef=DET_RANGE_VELOCITY_ERR_016_Rx
            DET_CONFD_ELEVATION_014_Rx_oRDR_FUSION_DET_013_016_oPCAN_RADAR_f010b546_Rx: ComBitPosition=213, ComBitSize=2, ComSignalType=UINT8, ComHandleId=344, ComSystemTemplateSystemSignalRef=DET_CONFD_ELEVATION_014_Rx
            DET_ELEVATION_ERR_015_Rx_oRDR_FUSION_DET_013_016_oPCAN_RADAR_87beea27_Rx: ComBitPosition=304, ComBitSize=6, ComSignalType=UINT8, ComHandleId=353, ComSystemTemplateSystemSignalRef=DET_ELEVATION_ERR_015_Rx
            DET_RANGE_VELOCITY_014_Rx_oRDR_FUSION_DET_013_016_oPCAN_RADAR_c64f57ea_Rx: ComBitPosition=160, ComBitSize=15, ComSignalType=UINT16, ComHandleId=387, ComSystemTemplateSystemSignalRef=DET_RANGE_VELOCITY_014_Rx
            DET_BELOW_RAIN_THOLD_013_Rx_oRDR_FUSION_DET_013_016_oPCAN_RADAR_94fb84d1_Rx: ComBitPosition=39, ComBitSize=1, ComSignalType=BOOLEAN, ComHandleId=331, ComSystemTemplateSystemSignalRef=DET_BELOW_RAIN_THOLD_013_Rx
            DET_MTD_014_Rx_oRDR_FUSION_DET_013_016_oPCAN_RADAR_8a7e2282_Rx: ComBitPosition=159, ComBitSize=1, ComSignalType=BOOLEAN, ComHandleId=371, ComSystemTemplateSystemSignalRef=DET_MTD_014_Rx
            DET_BELOW_RAIN_THOLD_014_Rx_oRDR_FUSION_DET_013_016_oPCAN_RADAR_6ec67786_Rx: ComBitPosition=151, ComBitSize=1, ComSignalType=BOOLEAN, ComHandleId=332, ComSystemTemplateSystemSignalRef=DET_BELOW_RAIN_THOLD_014_Rx
            DET_BI_STATIC_FLAG_015_Rx_oRDR_FUSION_DET_013_016_oPCAN_RADAR_b61c4ed2_Rx: ComBitPosition=328, ComBitSize=1, ComSignalType=BOOLEAN, ComHandleId=337, ComSystemTemplateSystemSignalRef=DET_BI_STATIC_FLAG_015_Rx
            DET_AZIMUTH_ERR_015_Rx_oRDR_FUSION_DET_013_016_oPCAN_RADAR_a551bbf6_Rx: ComBitPosition=329, ComBitSize=7, ComSignalType=UINT8, ComHandleId=329, ComSystemTemplateSystemSignalRef=DET_AZIMUTH_ERR_015_Rx
            DET_CONFD_ELEVATION_013_Rx_oRDR_FUSION_DET_013_016_oPCAN_RADAR_0a2d4611_Rx: ComBitPosition=101, ComBitSize=2, ComSignalType=UINT8, ComHandleId=343, ComSystemTemplateSystemSignalRef=DET_CONFD_ELEVATION_013_Rx
            DET_RANGE_VELOCITY_ERR_014_Rx_oRDR_FUSION_DET_013_016_oPCAN_RADAR_5f2b2728_Rx: ComBitPosition=176, ComBitSize=8, ComSignalType=UINT8, ComHandleId=391, ComSystemTemplateSystemSignalRef=DET_RANGE_VELOCITY_ERR_014_Rx
            DET_MTD_016_Rx_oRDR_FUSION_DET_013_016_oPCAN_RADAR_0f86004d_Rx: ComBitPosition=383, ComBitSize=1, ComSignalType=BOOLEAN, ComHandleId=373, ComSystemTemplateSystemSignalRef=DET_MTD_016_Rx
            DET_SUPER_RES_TARGET_016_Rx_oRDR_FUSION_DET_013_016_oPCAN_RADAR_4cddb7d7_Rx: ComBitPosition=423, ComBitSize=1, ComSignalType=BOOLEAN, ComHandleId=405, ComSystemTemplateSystemSignalRef=DET_SUPER_RES_TARGET_016_Rx
            DET_EXISTENCE_PROB_015_Rx_oRDR_FUSION_DET_013_016_oPCAN_RADAR_70a692b2_Rx: ComBitPosition=336, ComBitSize=6, ComSignalType=UINT8, ComHandleId=357, ComSystemTemplateSystemSignalRef=DET_EXISTENCE_PROB_015_Rx
            DET_CONFD_ELEVATION_015_Rx_oRDR_FUSION_DET_013_016_oPCAN_RADAR_5f542701_Rx: ComBitPosition=325, ComBitSize=2, ComSignalType=UINT8, ComHandleId=345, ComSystemTemplateSystemSignalRef=DET_CONFD_ELEVATION_015_Rx
            DET_ELEVATION_ERR_016_Rx_oRDR_FUSION_DET_013_016_oPCAN_RADAR_ad025aaf_Rx: ComBitPosition=416, ComBitSize=6, ComSignalType=UINT8, ComHandleId=354, ComSystemTemplateSystemSignalRef=DET_ELEVATION_ERR_016_Rx
            DET_BI_STATIC_FLAG_016_Rx_oRDR_FUSION_DET_013_016_oPCAN_RADAR_9ca0fe5a_Rx: ComBitPosition=440, ComBitSize=1, ComSignalType=BOOLEAN, ComHandleId=338, ComSystemTemplateSystemSignalRef=DET_BI_STATIC_FLAG_016_Rx
            DET_HVC_FLAG_016_Rx_oRDR_FUSION_DET_013_016_oPCAN_RADAR_87c4cf75_Rx: ComBitPosition=422, ComBitSize=1, ComSignalType=BOOLEAN, ComHandleId=362, ComSystemTemplateSystemSignalRef=DET_HVC_FLAG_016_Rx
            DET_RANGE_ERR_016_Rx_oRDR_FUSION_DET_013_016_oPCAN_RADAR_ceb07a3b_Rx: ComBitPosition=376, ComBitSize=7, ComSignalType=UINT8, ComHandleId=385, ComSystemTemplateSystemSignalRef=DET_RANGE_ERR_016_Rx
            DET_AZIMUTH_ERR_013_Rx_oRDR_FUSION_DET_013_016_oPCAN_RADAR_f028dae6_Rx: ComBitPosition=105, ComBitSize=7, ComSignalType=UINT8, ComHandleId=327, ComSystemTemplateSystemSignalRef=DET_AZIMUTH_ERR_013_Rx
            DET_PROB_1STAZHYPO_015_Rx_oRDR_FUSION_DET_013_016_oPCAN_RADAR_ef43ae44_Rx: ComBitPosition=327, ComBitSize=1, ComSignalType=BOOLEAN, ComHandleId=376, ComSystemTemplateSystemSignalRef=DET_PROB_1STAZHYPO_015_Rx
            DET_EXISTENCE_PROB_014_Rx_oRDR_FUSION_DET_013_016_oPCAN_RADAR_dfe200f5_Rx: ComBitPosition=224, ComBitSize=6, ComSignalType=UINT8, ComHandleId=356, ComSystemTemplateSystemSignalRef=DET_EXISTENCE_PROB_014_Rx
            DET_MH_CRC16_013_016_Rx_oRDR_FUSION_DET_013_016_oPCAN_RADAR_23e44f7c_Rx: ComBitPosition=0, ComBitSize=16, ComSignalType=UINT16, ComHandleId=367, ComSystemTemplateSystemSignalRef=DET_MH_CRC16_013_016_Rx
            DET_CONFD_AZIMUTH_015_Rx_oRDR_FUSION_DET_013_016_oPCAN_RADAR_5575a486_Rx: ComBitPosition=342, ComBitSize=2, ComSignalType=UINT8, ComHandleId=341, ComSystemTemplateSystemSignalRef=DET_CONFD_AZIMUTH_015_Rx
            DET_CONFD_AZIMUTH_013_Rx_oRDR_FUSION_DET_013_016_oPCAN_RADAR_000cc596_Rx: ComBitPosition=118, ComBitSize=2, ComSignalType=UINT8, ComHandleId=339, ComSystemTemplateSystemSignalRef=DET_CONFD_AZIMUTH_013_Rx
            DET_MH_CYCLE_COUNTER_013_016_Rx_oRDR_FUSION_DET_013_016_oPCAN_RADAR_2e3f72b9_Rx: ComBitPosition=16, ComBitSize=8, ComSignalType=UINT8, ComHandleId=368, ComSystemTemplateSystemSignalRef=DET_MH_CYCLE_COUNTER_013_016_Rx
            DET_RANGE_ERR_013_Rx_oRDR_FUSION_DET_013_016_oPCAN_RADAR_b175aba3_Rx: ComBitPosition=40, ComBitSize=7, ComSignalType=UINT8, ComHandleId=382, ComSystemTemplateSystemSignalRef=DET_RANGE_ERR_013_Rx
            DET_ELEVATION_016_Rx_oRDR_FUSION_DET_013_016_oPCAN_RADAR_7fbb7870_Rx: ComBitPosition=408, ComBitSize=8, ComSignalType=UINT8, ComHandleId=350, ComSystemTemplateSystemSignalRef=DET_ELEVATION_016_Rx
            DET_SUPER_RES_TARGET_014_Rx_oRDR_FUSION_DET_013_016_oPCAN_RADAR_c9259518_Rx: ComBitPosition=199, ComBitSize=1, ComSignalType=BOOLEAN, ComHandleId=403, ComSystemTemplateSystemSignalRef=DET_SUPER_RES_TARGET_014_Rx
            DET_ELEVATION_ERR_014_Rx_oRDR_FUSION_DET_013_016_oPCAN_RADAR_28fa7860_Rx: ComBitPosition=192, ComBitSize=6, ComSignalType=UINT8, ComHandleId=352, ComSystemTemplateSystemSignalRef=DET_ELEVATION_ERR_014_Rx
            DET_AZIMUTH_ERR_014_Rx_oRDR_FUSION_DET_013_016_oPCAN_RADAR_0a1529b1_Rx: ComBitPosition=217, ComBitSize=7, ComSignalType=UINT8, ComHandleId=328, ComSystemTemplateSystemSignalRef=DET_AZIMUTH_ERR_014_Rx
            DET_IDM_015_Rx_oRDR_FUSION_DET_013_016_oPCAN_RADAR_98b986b5_Rx: ComBitPosition=287, ComBitSize=1, ComSignalType=BOOLEAN, ComHandleId=365, ComSystemTemplateSystemSignalRef=DET_IDM_015_Rx
            DET_RANGE_016_Rx_oRDR_FUSION_DET_013_016_oPCAN_RADAR_9e42f6db_Rx: ComBitPosition=360, ComBitSize=15, ComSignalType=UINT16, ComHandleId=381, ComSystemTemplateSystemSignalRef=DET_RANGE_016_Rx
            DET_ELEVATION_014_Rx_oRDR_FUSION_DET_013_016_oPCAN_RADAR_fa435abf_Rx: ComBitPosition=184, ComBitSize=8, ComSignalType=UINT8, ComHandleId=348, ComSystemTemplateSystemSignalRef=DET_ELEVATION_014_Rx
            DET_SUPER_RES_TARGET_013_Rx_oRDR_FUSION_DET_013_016_oPCAN_RADAR_3318664f_Rx: ComBitPosition=87, ComBitSize=1, ComSignalType=BOOLEAN, ComHandleId=402, ComSystemTemplateSystemSignalRef=DET_SUPER_RES_TARGET_013_Rx
            DET_MTD_013_Rx_oRDR_FUSION_DET_013_016_oPCAN_RADAR_7043d1d5_Rx: ComBitPosition=47, ComBitSize=1, ComSignalType=BOOLEAN, ComHandleId=370, ComSystemTemplateSystemSignalRef=DET_MTD_013_Rx
            DET_EXISTENCE_PROB_013_Rx_oRDR_FUSION_DET_013_016_oPCAN_RADAR_25dff3a2_Rx: ComBitPosition=112, ComBitSize=6, ComSignalType=UINT8, ComHandleId=355, ComSystemTemplateSystemSignalRef=DET_EXISTENCE_PROB_013_Rx
            DET_RANGE_VELOCITY_ERR_013_Rx_oRDR_FUSION_DET_013_016_oPCAN_RADAR_a516d47f_Rx: ComBitPosition=64, ComBitSize=8, ComSignalType=UINT8, ComHandleId=390, ComSystemTemplateSystemSignalRef=DET_RANGE_VELOCITY_ERR_013_Rx
            DET_BI_STATIC_FLAG_013_Rx_oRDR_FUSION_DET_013_016_oPCAN_RADAR_e3652fc2_Rx: ComBitPosition=104, ComBitSize=1, ComSignalType=BOOLEAN, ComHandleId=335, ComSystemTemplateSystemSignalRef=DET_BI_STATIC_FLAG_013_Rx
            DET_PROB_1STAZHYPO_013_Rx_oRDR_FUSION_DET_013_016_oPCAN_RADAR_ba3acf54_Rx: ComBitPosition=103, ComBitSize=1, ComSignalType=BOOLEAN, ComHandleId=374, ComSystemTemplateSystemSignalRef=DET_PROB_1STAZHYPO_013_Rx
            DET_SNR_013_Rx_oRDR_FUSION_DET_013_016_oPCAN_RADAR_f8e3474f_Rx: ComBitPosition=120, ComBitSize=8, ComSignalType=UINT8, ComHandleId=398, ComSystemTemplateSystemSignalRef=DET_SNR_013_Rx
            DET_MH_SCAN_INDEX_4LSB_013_016_Rx_oRDR_FUSION_DET_013_016_oPCAN_RADAR_4a8fbd82_Rx: ComBitPosition=476, ComBitSize=4, ComSignalType=UINT8, ComHandleId=369, ComSystemTemplateSystemSignalRef=DET_MH_SCAN_INDEX_4LSB_013_016_Rx
            DET_RCS_016_Rx_oRDR_FUSION_DET_013_016_oPCAN_RADAR_8e7ce73e_Rx: ComBitPosition=464, ComBitSize=8, ComSignalType=UINT8, ComHandleId=397, ComSystemTemplateSystemSignalRef=DET_RCS_016_Rx
            DET_SUPER_RES_TARGET_015_Rx_oRDR_FUSION_DET_013_016_oPCAN_RADAR_6661075f_Rx: ComBitPosition=311, ComBitSize=1, ComSignalType=BOOLEAN, ComHandleId=404, ComSystemTemplateSystemSignalRef=DET_SUPER_RES_TARGET_015_Rx
            DET_EXISTENCE_PROB_016_Rx_oRDR_FUSION_DET_013_016_oPCAN_RADAR_5a1a223a_Rx: ComBitPosition=448, ComBitSize=6, ComSignalType=UINT8, ComHandleId=358, ComSystemTemplateSystemSignalRef=DET_EXISTENCE_PROB_016_Rx
            DET_SNR_014_Rx_oRDR_FUSION_DET_013_016_oPCAN_RADAR_02deb418_Rx: ComBitPosition=232, ComBitSize=8, ComSignalType=UINT8, ComHandleId=399, ComSystemTemplateSystemSignalRef=DET_SNR_014_Rx
            DET_RANGE_VELOCITY_015_Rx_oRDR_FUSION_DET_013_016_oPCAN_RADAR_690bc5ad_Rx: ComBitPosition=272, ComBitSize=15, ComSignalType=UINT16, ComHandleId=388, ComSystemTemplateSystemSignalRef=DET_RANGE_VELOCITY_015_Rx
            DET_RANGE_013_Rx_oRDR_FUSION_DET_013_016_oPCAN_RADAR_e1872743_Rx: ComBitPosition=24, ComBitSize=15, ComSignalType=UINT16, ComHandleId=378, ComSystemTemplateSystemSignalRef=DET_RANGE_013_Rx
            DET_MTD_015_Rx_oRDR_FUSION_DET_013_016_oPCAN_RADAR_253ab0c5_Rx: ComBitPosition=271, ComBitSize=1, ComSignalType=BOOLEAN, ComHandleId=372, ComSystemTemplateSystemSignalRef=DET_MTD_015_Rx
            DET_RCS_015_Rx_oRDR_FUSION_DET_013_016_oPCAN_RADAR_a4c057b6_Rx: ComBitPosition=352, ComBitSize=8, ComSignalType=UINT8, ComHandleId=396, ComSystemTemplateSystemSignalRef=DET_RCS_015_Rx
            DET_CONFD_AZIMUTH_016_Rx_oRDR_FUSION_DET_013_016_oPCAN_RADAR_7fc9140e_Rx: ComBitPosition=454, ComBitSize=2, ComSignalType=UINT8, ComHandleId=342, ComSystemTemplateSystemSignalRef=DET_CONFD_AZIMUTH_016_Rx
            DET_IDM_013_Rx_oRDR_FUSION_DET_013_016_oPCAN_RADAR_cdc0e7a5_Rx: ComBitPosition=63, ComBitSize=1, ComSignalType=BOOLEAN, ComHandleId=363, ComSystemTemplateSystemSignalRef=DET_IDM_013_Rx
            DET_PROB_1STAZHYPO_014_Rx_oRDR_FUSION_DET_013_016_oPCAN_RADAR_40073c03_Rx: ComBitPosition=215, ComBitSize=1, ComSignalType=BOOLEAN, ComHandleId=375, ComSystemTemplateSystemSignalRef=DET_PROB_1STAZHYPO_014_Rx
            DET_ELEVATION_ERR_013_Rx_oRDR_FUSION_DET_013_016_oPCAN_RADAR_d2c78b37_Rx: ComBitPosition=80, ComBitSize=6, ComSignalType=UINT8, ComHandleId=351, ComSystemTemplateSystemSignalRef=DET_ELEVATION_ERR_013_Rx
            DET_BELOW_RAIN_THOLD_015_Rx_oRDR_FUSION_DET_013_016_oPCAN_RADAR_c182e5c1_Rx: ComBitPosition=263, ComBitSize=1, ComSignalType=BOOLEAN, ComHandleId=333, ComSystemTemplateSystemSignalRef=DET_BELOW_RAIN_THOLD_015_Rx
            DET_RANGE_ERR_014_Rx_oRDR_FUSION_DET_013_016_oPCAN_RADAR_4b4858f4_Rx: ComBitPosition=152, ComBitSize=7, ComSignalType=UINT8, ComHandleId=383, ComSystemTemplateSystemSignalRef=DET_RANGE_ERR_014_Rx
            DET_RANGE_VELOCITY_016_Rx_oRDR_FUSION_DET_013_016_oPCAN_RADAR_43b77525_Rx: ComBitPosition=384, ComBitSize=15, ComSignalType=UINT16, ComHandleId=389, ComSystemTemplateSystemSignalRef=DET_RANGE_VELOCITY_016_Rx
            DET_AZIMUTH_014_Rx_oRDR_FUSION_DET_013_016_oPCAN_RADAR_087c8833_Rx: ComBitPosition=200, ComBitSize=13, ComSignalType=UINT16, ComHandleId=324, ComSystemTemplateSystemSignalRef=DET_AZIMUTH_014_Rx
            DET_SNR_016_Rx_oRDR_FUSION_DET_013_016_oPCAN_RADAR_872696d7_Rx: ComBitPosition=456, ComBitSize=8, ComSignalType=UINT8, ComHandleId=401, ComSystemTemplateSystemSignalRef=DET_SNR_016_Rx
            DET_SNR_015_Rx_oRDR_FUSION_DET_013_016_oPCAN_RADAR_ad9a265f_Rx: ComBitPosition=344, ComBitSize=8, ComSignalType=UINT8, ComHandleId=400, ComSystemTemplateSystemSignalRef=DET_SNR_015_Rx
            DET_HVC_FLAG_015_Rx_oRDR_FUSION_DET_013_016_oPCAN_RADAR_ad787ffd_Rx: ComBitPosition=310, ComBitSize=1, ComSignalType=BOOLEAN, ComHandleId=361, ComSystemTemplateSystemSignalRef=DET_HVC_FLAG_015_Rx
            DET_BI_STATIC_FLAG_014_Rx_oRDR_FUSION_DET_013_016_oPCAN_RADAR_1958dc95_Rx: ComBitPosition=216, ComBitSize=1, ComSignalType=BOOLEAN, ComHandleId=336, ComSystemTemplateSystemSignalRef=DET_BI_STATIC_FLAG_014_Rx
            DET_CONFD_ELEVATION_016_Rx_oRDR_FUSION_DET_013_016_oPCAN_RADAR_75e89789_Rx: ComBitPosition=437, ComBitSize=2, ComSignalType=UINT8, ComHandleId=346, ComSystemTemplateSystemSignalRef=DET_CONFD_ELEVATION_016_Rx
            DET_PROB_1STAZHYPO_016_Rx_oRDR_FUSION_DET_013_016_oPCAN_RADAR_c5ff1ecc_Rx: ComBitPosition=439, ComBitSize=1, ComSignalType=BOOLEAN, ComHandleId=377, ComSystemTemplateSystemSignalRef=DET_PROB_1STAZHYPO_016_Rx
            DET_RCS_014_Rx_oRDR_FUSION_DET_013_016_oPCAN_RADAR_0b84c5f1_Rx: ComBitPosition=240, ComBitSize=8, ComSignalType=UINT8, ComHandleId=395, ComSystemTemplateSystemSignalRef=DET_RCS_014_Rx
            DET_RANGE_015_Rx_oRDR_FUSION_DET_013_016_oPCAN_RADAR_b4fe4653_Rx: ComBitPosition=248, ComBitSize=15, ComSignalType=UINT16, ComHandleId=380, ComSystemTemplateSystemSignalRef=DET_RANGE_015_Rx
            DET_HVC_FLAG_013_Rx_oRDR_FUSION_DET_013_016_oPCAN_RADAR_f8011eed_Rx: ComBitPosition=86, ComBitSize=1, ComSignalType=BOOLEAN, ComHandleId=359, ComSystemTemplateSystemSignalRef=DET_HVC_FLAG_013_Rx
            DET_AZIMUTH_016_Rx_oRDR_FUSION_DET_013_016_oPCAN_RADAR_8d84aafc_Rx: ComBitPosition=424, ComBitSize=13, ComSignalType=UINT16, ComHandleId=326, ComSystemTemplateSystemSignalRef=DET_AZIMUTH_016_Rx
            DET_HVC_FLAG_014_Rx_oRDR_FUSION_DET_013_016_oPCAN_RADAR_023cedba_Rx: ComBitPosition=198, ComBitSize=1, ComSignalType=BOOLEAN, ComHandleId=360, ComSystemTemplateSystemSignalRef=DET_HVC_FLAG_014_Rx
            DET_AZIMUTH_013_Rx_oRDR_FUSION_DET_013_016_oPCAN_RADAR_f2417b64_Rx: ComBitPosition=88, ComBitSize=13, ComSignalType=UINT16, ComHandleId=323, ComSystemTemplateSystemSignalRef=DET_AZIMUTH_013_Rx
            DET_RANGE_014_Rx_oRDR_FUSION_DET_013_016_oPCAN_RADAR_1bbad414_Rx: ComBitPosition=136, ComBitSize=15, ComSignalType=UINT16, ComHandleId=379, ComSystemTemplateSystemSignalRef=DET_RANGE_014_Rx
            DET_IDM_014_Rx_oRDR_FUSION_DET_013_016_oPCAN_RADAR_37fd14f2_Rx: ComBitPosition=175, ComBitSize=1, ComSignalType=BOOLEAN, ComHandleId=364, ComSystemTemplateSystemSignalRef=DET_IDM_014_Rx
            DET_IDM_016_Rx_oRDR_FUSION_DET_013_016_oPCAN_RADAR_b205363d_Rx: ComBitPosition=399, ComBitSize=1, ComSignalType=BOOLEAN, ComHandleId=366, ComSystemTemplateSystemSignalRef=DET_IDM_016_Rx
            DET_AZIMUTH_015_Rx_oRDR_FUSION_DET_013_016_oPCAN_RADAR_a7381a74_Rx: ComBitPosition=312, ComBitSize=13, ComSignalType=UINT16, ComHandleId=325, ComSystemTemplateSystemSignalRef=DET_AZIMUTH_015_Rx
            DET_RCS_013_Rx_oRDR_FUSION_DET_013_016_oPCAN_RADAR_f1b936a6_Rx: ComBitPosition=128, ComBitSize=8, ComSignalType=UINT8, ComHandleId=394, ComSystemTemplateSystemSignalRef=DET_RCS_013_Rx
      RDR_FUSION_DET_045_048_oPCAN_RADAR_28286b9c_Rx (ComIPdu):
        ComIPduDirection = RECEIVE
        ComIPduType = NORMAL
        ComIPduCancellationSupport = false
        ComIPduHandleId = 33
        ComIPduSignalProcessing = DEFERRED
        ComIPduChannelRef = CN_PCAN_RADAR_458ff0f1
        ComIPduGroupRef = RDR01_oPCAN_RADAR_Rx_e0e717e1 if post-build-variant-condition{matching-criterion=RDR_POS, value=0}
        ComIPduSignalGroupRef = SG_Fusion_Detections_045_048_oRDR_FUSION_DET_045_048_oPCAN_RADAR_a7421a41_Rx
        ComPduIdRef = RDR_FUSION_DET_045_048_oPCAN_RADAR_28286b9c_Rx
        ComIPduMainFunctionRef = ComMainFunctionRx
        ComIPduGroupRef = RDR02_oPCAN_RADAR_Rx_c92fa313 if post-build-variant-condition{matching-criterion=RDR_POS, value=1}
        ComIPduGroupRef = RDR03_oPCAN_RADAR_Rx_67473282 if post-build-variant-condition{matching-criterion=RDR_POS, value=2}
        ComIPduGroupRef = RDR04_oPCAN_RADAR_Rx_9abecaf7 if post-build-variant-condition{matching-criterion=RDR_POS, value=3}
        ComIPduGroupRef = RDR05_oPCAN_RADAR_Rx_34d65b66 if post-build-variant-condition{matching-criterion=RDR_POS, value=4}
        ComIPduGroupRef = RDR06_oPCAN_RADAR_Rx_1d1eef94 if post-build-variant-condition{matching-criterion=RDR_POS, value=5}
        ComIPduGroupRef = RDR07_oPCAN_RADAR_Rx_b3767e05 if post-build-variant-condition{matching-criterion=RDR_POS, value=6}
        ComIPduGroupRef = RDR08_oPCAN_RADAR_Rx_3d9c193f if post-build-variant-condition{matching-criterion=RDR_POS, value=7}
      SG_Fusion_Detections_109_112_oRDR_FUSION_DET_109_112_oPCAN_RADAR_e2334566_Rx (ComSignalGroup):
        ComTimeout = 0
        ComTransferProperty = PENDING
        ComSignalGroupAccess = ACCESS_NEEDED_BY_SWC_OR_COM
        ComHandleId = 35
        ComSignalGroupArrayAccess = true
        ComSystemTemplateSignalGroupRef = SG_Fusion_Detections_109_112
        83 x ComGroupSignal, all with ComSignalEndianness=LITTLE_ENDIAN, ComSignalInitValue=0, ComSignalAccess=ACCESS_NEEDED_BY_SWC_OR_COM:
          DET_AZIMUTH_112_Rx_oRDR_FUSION_DET_109_112_oPCAN_RADAR_8fe23553_Rx: ComBitPosition=424, ComBitSize=13, ComSignalType=UINT16, ComHandleId=2318, ComSystemTemplateSystemSignalRef=DET_AZIMUTH_112_Rx
          DET_SNR_112_Rx_oRDR_FUSION_DET_109_112_oPCAN_RADAR_85400978_Rx: ComBitPosition=456, ComBitSize=8, ComSignalType=UINT8, ComHandleId=2393, ComSystemTemplateSystemSignalRef=DET_SNR_112_Rx
          DET_RANGE_111_Rx_oRDR_FUSION_DET_109_112_oPCAN_RADAR_b698d9fc_Rx: ComBitPosition=248, ComBitSize=15, ComSignalType=UINT16, ComHandleId=2372, ComSystemTemplateSystemSignalRef=DET_RANGE_111_Rx
          DET_AZIMUTH_ERR_112_Rx_oRDR_FUSION_DET_109_112_oPCAN_RADAR_8d8b94d1_Rx: ComBitPosition=441, ComBitSize=7, ComSignalType=UINT8, ComHandleId=2322, ComSystemTemplateSystemSignalRef=DET_AZIMUTH_ERR_112_Rx
          DET_MTD_111_Rx_oRDR_FUSION_DET_109_112_oPCAN_RADAR_275c2f6a_Rx: ComBitPosition=271, ComBitSize=1, ComSignalType=BOOLEAN, ComHandleId=2364, ComSystemTemplateSystemSignalRef=DET_MTD_111_Rx
          DET_AZIMUTH_109_Rx_oRDR_FUSION_DET_109_112_oPCAN_RADAR_373a9485_Rx: ComBitPosition=88, ComBitSize=13, ComSignalType=UINT16, ComHandleId=2315, ComSystemTemplateSystemSignalRef=DET_AZIMUTH_109_Rx
          DET_SUPER_RES_TARGET_111_Rx_oRDR_FUSION_DET_109_112_oPCAN_RADAR_640798f0_Rx: ComBitPosition=311, ComBitSize=1, ComSignalType=BOOLEAN, ComHandleId=2396, ComSystemTemplateSystemSignalRef=DET_SUPER_RES_TARGET_111_Rx
          DET_MH_CRC16_109_112_Rx_oRDR_FUSION_DET_109_112_oPCAN_RADAR_23bdd699_Rx: ComBitPosition=0, ComBitSize=16, ComSignalType=UINT16, ComHandleId=2359, ComSystemTemplateSystemSignalRef=DET_MH_CRC16_109_112_Rx
          DET_BELOW_RAIN_THOLD_111_Rx_oRDR_FUSION_DET_109_112_oPCAN_RADAR_c3e47a6e_Rx: ComBitPosition=263, ComBitSize=1, ComSignalType=BOOLEAN, ComHandleId=2325, ComSystemTemplateSystemSignalRef=DET_BELOW_RAIN_THOLD_111_Rx
          DET_RANGE_109_Rx_oRDR_FUSION_DET_109_112_oPCAN_RADAR_24fcc8a2_Rx: ComBitPosition=24, ComBitSize=15, ComSignalType=UINT16, ComHandleId=2370, ComSystemTemplateSystemSignalRef=DET_RANGE_109_Rx
          DET_CONFD_ELEVATION_112_Rx_oRDR_FUSION_DET_109_112_oPCAN_RADAR_778e0826_Rx: ComBitPosition=437, ComBitSize=2, ComSignalType=UINT8, ComHandleId=2338, ComSystemTemplateSystemSignalRef=DET_CONFD_ELEVATION_112_Rx
          DET_CONFD_AZIMUTH_109_Rx_oRDR_FUSION_DET_109_112_oPCAN_RADAR_c5772a77_Rx: ComBitPosition=118, ComBitSize=2, ComSignalType=UINT8, ComHandleId=2331, ComSystemTemplateSystemSignalRef=DET_CONFD_AZIMUTH_109_Rx
          DET_RANGE_ERR_109_Rx_oRDR_FUSION_DET_109_112_oPCAN_RADAR_740e4442_Rx: ComBitPosition=40, ComBitSize=7, ComSignalType=UINT8, ComHandleId=2374, ComSystemTemplateSystemSignalRef=DET_RANGE_ERR_109_Rx
          DET_MTD_110_Rx_oRDR_FUSION_DET_109_112_oPCAN_RADAR_8818bd2d_Rx: ComBitPosition=159, ComBitSize=1, ComSignalType=BOOLEAN, ComHandleId=2363, ComSystemTemplateSystemSignalRef=DET_MTD_110_Rx
          DET_RCS_109_Rx_oRDR_FUSION_DET_109_112_oPCAN_RADAR_34c2d947_Rx: ComBitPosition=128, ComBitSize=8, ComSignalType=UINT8, ComHandleId=2386, ComSystemTemplateSystemSignalRef=DET_RCS_109_Rx
          DET_HVC_FLAG_112_Rx_oRDR_FUSION_DET_109_112_oPCAN_RADAR_85a250da_Rx: ComBitPosition=422, ComBitSize=1, ComSignalType=BOOLEAN, ComHandleId=2354, ComSystemTemplateSystemSignalRef=DET_HVC_FLAG_112_Rx
          DET_CONFD_AZIMUTH_110_Rx_oRDR_FUSION_DET_109_112_oPCAN_RADAR_f857a96e_Rx: ComBitPosition=230, ComBitSize=2, ComSignalType=UINT8, ComHandleId=2332, ComSystemTemplateSystemSignalRef=DET_CONFD_AZIMUTH_110_Rx
          DET_IDM_110_Rx_oRDR_FUSION_DET_109_112_oPCAN_RADAR_359b8b5d_Rx: ComBitPosition=175, ComBitSize=1, ComSignalType=BOOLEAN, ComHandleId=2356, ComSystemTemplateSystemSignalRef=DET_IDM_110_Rx
          DET_PROB_1STAZHYPO_112_Rx_oRDR_FUSION_DET_109_112_oPCAN_RADAR_c7998163_Rx: ComBitPosition=439, ComBitSize=1, ComSignalType=BOOLEAN, ComHandleId=2369, ComSystemTemplateSystemSignalRef=DET_PROB_1STAZHYPO_112_Rx
          DET_ELEVATION_ERR_111_Rx_oRDR_FUSION_DET_109_112_oPCAN_RADAR_85d87588_Rx: ComBitPosition=304, ComBitSize=6, ComSignalType=UINT8, ComHandleId=2345, ComSystemTemplateSystemSignalRef=DET_ELEVATION_ERR_111_Rx
          DET_RCS_110_Rx_oRDR_FUSION_DET_109_112_oPCAN_RADAR_09e25a5e_Rx: ComBitPosition=240, ComBitSize=8, ComSignalType=UINT8, ComHandleId=2387, ComSystemTemplateSystemSignalRef=DET_RCS_110_Rx
          DET_ELEVATION_ERR_109_Rx_oRDR_FUSION_DET_109_112_oPCAN_RADAR_17bc64d6_Rx: ComBitPosition=80, ComBitSize=6, ComSignalType=UINT8, ComHandleId=2343, ComSystemTemplateSystemSignalRef=DET_ELEVATION_ERR_109_Rx
          DET_EXISTENCE_PROB_112_Rx_oRDR_FUSION_DET_109_112_oPCAN_RADAR_587cbd95_Rx: ComBitPosition=448, ComBitSize=6, ComSignalType=UINT8, ComHandleId=2350, ComSystemTemplateSystemSignalRef=DET_EXISTENCE_PROB_112_Rx
          DET_HVC_FLAG_111_Rx_oRDR_FUSION_DET_109_112_oPCAN_RADAR_af1ee052_Rx: ComBitPosition=310, ComBitSize=1, ComSignalType=BOOLEAN, ComHandleId=2353, ComSystemTemplateSystemSignalRef=DET_HVC_FLAG_111_Rx
          DET_HVC_FLAG_109_Rx_oRDR_FUSION_DET_109_112_oPCAN_RADAR_3d7af10c_Rx: ComBitPosition=86, ComBitSize=1, ComSignalType=BOOLEAN, ComHandleId=2351, ComSystemTemplateSystemSignalRef=DET_HVC_FLAG_109_Rx
          DET_RANGE_ERR_110_Rx_oRDR_FUSION_DET_109_112_oPCAN_RADAR_492ec75b_Rx: ComBitPosition=152, ComBitSize=7, ComSignalType=UINT8, ComHandleId=2375, ComSystemTemplateSystemSignalRef=DET_RANGE_ERR_110_Rx
          DET_RANGE_VELOCITY_111_Rx_oRDR_FUSION_DET_109_112_oPCAN_RADAR_6b6d5a02_Rx: ComBitPosition=272, ComBitSize=15, ComSignalType=UINT16, ComHandleId=2380, ComSystemTemplateSystemSignalRef=DET_RANGE_VELOCITY_111_Rx
          DET_SUPER_RES_TARGET_112_Rx_oRDR_FUSION_DET_109_112_oPCAN_RADAR_4ebb2878_Rx: ComBitPosition=423, ComBitSize=1, ComSignalType=BOOLEAN, ComHandleId=2397, ComSystemTemplateSystemSignalRef=DET_SUPER_RES_TARGET_112_Rx
          DET_MH_CYCLE_COUNTER_109_112_Rx_oRDR_FUSION_DET_109_112_oPCAN_RADAR_2e66eb5c_Rx: ComBitPosition=16, ComBitSize=8, ComSignalType=UINT8, ComHandleId=2360, ComSystemTemplateSystemSignalRef=DET_MH_CYCLE_COUNTER_109_112_Rx
          DET_PROB_1STAZHYPO_111_Rx_oRDR_FUSION_DET_109_112_oPCAN_RADAR_ed2531eb_Rx: ComBitPosition=327, ComBitSize=1, ComSignalType=BOOLEAN, ComHandleId=2368, ComSystemTemplateSystemSignalRef=DET_PROB_1STAZHYPO_111_Rx
          DET_MH_SCAN_INDEX_4LSB_109_112_Rx_oRDR_FUSION_DET_109_112_oPCAN_RADAR_4ad62467_Rx: ComBitPosition=476, ComBitSize=4, ComSignalType=UINT8, ComHandleId=2361, ComSystemTemplateSystemSignalRef=DET_MH_SCAN_INDEX_4LSB_109_112_Rx
          DET_MTD_112_Rx_oRDR_FUSION_DET_109_112_oPCAN_RADAR_0de09fe2_Rx: ComBitPosition=383, ComBitSize=1, ComSignalType=BOOLEAN, ComHandleId=2365, ComSystemTemplateSystemSignalRef=DET_MTD_112_Rx
          DET_BI_STATIC_FLAG_111_Rx_oRDR_FUSION_DET_109_112_oPCAN_RADAR_b47ad17d_Rx: ComBitPosition=328, ComBitSize=1, ComSignalType=BOOLEAN, ComHandleId=2329, ComSystemTemplateSystemSignalRef=DET_BI_STATIC_FLAG_111_Rx
          DET_RANGE_VELOCITY_112_Rx_oRDR_FUSION_DET_109_112_oPCAN_RADAR_41d1ea8a_Rx: ComBitPosition=384, ComBitSize=15, ComSignalType=UINT16, ComHandleId=2381, ComSystemTemplateSystemSignalRef=DET_RANGE_VELOCITY_112_Rx
          DET_MTD_109_Rx_oRDR_FUSION_DET_109_112_oPCAN_RADAR_b5383e34_Rx: ComBitPosition=47, ComBitSize=1, ComSignalType=BOOLEAN, ComHandleId=2362, ComSystemTemplateSystemSignalRef=DET_MTD_109_Rx
          DET_BI_STATIC_FLAG_112_Rx_oRDR_FUSION_DET_109_112_oPCAN_RADAR_9ec661f5_Rx: ComBitPosition=440, ComBitSize=1, ComSignalType=BOOLEAN, ComHandleId=2330, ComSystemTemplateSystemSignalRef=DET_BI_STATIC_FLAG_112_Rx
          DET_AZIMUTH_110_Rx_oRDR_FUSION_DET_109_112_oPCAN_RADAR_0a1a179c_Rx: ComBitPosition=200, ComBitSize=13, ComSignalType=UINT16, ComHandleId=2316, ComSystemTemplateSystemSignalRef=DET_AZIMUTH_110_Rx
          DET_CONFD_ELEVATION_109_Rx_oRDR_FUSION_DET_109_112_oPCAN_RADAR_cf56a9f0_Rx: ComBitPosition=101, ComBitSize=2, ComSignalType=UINT8, ComHandleId=2335, ComSystemTemplateSystemSignalRef=DET_CONFD_ELEVATION_109_Rx
          DET_ELEVATION_ERR_112_Rx_oRDR_FUSION_DET_109_112_oPCAN_RADAR_af64c500_Rx: ComBitPosition=416, ComBitSize=6, ComSignalType=UINT8, ComHandleId=2346, ComSystemTemplateSystemSignalRef=DET_ELEVATION_ERR_112_Rx
          DET_AZIMUTH_ERR_111_Rx_oRDR_FUSION_DET_109_112_oPCAN_RADAR_a7372459_Rx: ComBitPosition=329, ComBitSize=7, ComSignalType=UINT8, ComHandleId=2321, ComSystemTemplateSystemSignalRef=DET_AZIMUTH_ERR_111_Rx
          DET_BELOW_RAIN_THOLD_109_Rx_oRDR_FUSION_DET_109_112_oPCAN_RADAR_51806b30_Rx: ComBitPosition=39, ComBitSize=1, ComSignalType=BOOLEAN, ComHandleId=2323, ComSystemTemplateSystemSignalRef=DET_BELOW_RAIN_THOLD_109_Rx
          DET_RANGE_ERR_112_Rx_oRDR_FUSION_DET_109_112_oPCAN_RADAR_ccd6e594_Rx: ComBitPosition=376, ComBitSize=7, ComSignalType=UINT8, ComHandleId=2377, ComSystemTemplateSystemSignalRef=DET_RANGE_ERR_112_Rx
          DET_IDM_111_Rx_oRDR_FUSION_DET_109_112_oPCAN_RADAR_9adf191a_Rx: ComBitPosition=287, ComBitSize=1, ComSignalType=BOOLEAN, ComHandleId=2357, ComSystemTemplateSystemSignalRef=DET_IDM_111_Rx
          DET_ELEVATION_ERR_110_Rx_oRDR_FUSION_DET_109_112_oPCAN_RADAR_2a9ce7cf_Rx: ComBitPosition=192, ComBitSize=6, ComSignalType=UINT8, ComHandleId=2344, ComSystemTemplateSystemSignalRef=DET_ELEVATION_ERR_110_Rx
          DET_RANGE_VELOCITY_ERR_112_Rx_oRDR_FUSION_DET_109_112_oPCAN_RADAR_d8b59a48_Rx: ComBitPosition=400, ComBitSize=8, ComSignalType=UINT8, ComHandleId=2385, ComSystemTemplateSystemSignalRef=DET_RANGE_VELOCITY_ERR_112_Rx
          DET_PROB_1STAZHYPO_110_Rx_oRDR_FUSION_DET_109_112_oPCAN_RADAR_4261a3ac_Rx: ComBitPosition=215, ComBitSize=1, ComSignalType=BOOLEAN, ComHandleId=2367, ComSystemTemplateSystemSignalRef=DET_PROB_1STAZHYPO_110_Rx
          DET_RANGE_VELOCITY_ERR_109_Rx_oRDR_FUSION_DET_109_112_oPCAN_RADAR_606d3b9e_Rx: ComBitPosition=64, ComBitSize=8, ComSignalType=UINT8, ComHandleId=2382, ComSystemTemplateSystemSignalRef=DET_RANGE_VELOCITY_ERR_109_Rx
          DET_AZIMUTH_ERR_109_Rx_oRDR_FUSION_DET_109_112_oPCAN_RADAR_35533507_Rx: ComBitPosition=105, ComBitSize=7, ComSignalType=UINT8, ComHandleId=2319, ComSystemTemplateSystemSignalRef=DET_AZIMUTH_ERR_109_Rx
          DET_BELOW_RAIN_THOLD_112_Rx_oRDR_FUSION_DET_109_112_oPCAN_RADAR_e958cae6_Rx: ComBitPosition=375, ComBitSize=1, ComSignalType=BOOLEAN, ComHandleId=2326, ComSystemTemplateSystemSignalRef=DET_BELOW_RAIN_THOLD_112_Rx
          DET_EXISTENCE_PROB_110_Rx_oRDR_FUSION_DET_109_112_oPCAN_RADAR_dd849f5a_Rx: ComBitPosition=224, ComBitSize=6, ComSignalType=UINT8, ComHandleId=2348, ComSystemTemplateSystemSignalRef=DET_EXISTENCE_PROB_110_Rx
          DET_BI_STATIC_FLAG_110_Rx_oRDR_FUSION_DET_109_112_oPCAN_RADAR_1b3e433a_Rx: ComBitPosition=216, ComBitSize=1, ComSignalType=BOOLEAN, ComHandleId=2328, ComSystemTemplateSystemSignalRef=DET_BI_STATIC_FLAG_110_Rx
          DET_CONFD_AZIMUTH_112_Rx_oRDR_FUSION_DET_109_112_oPCAN_RADAR_7daf8ba1_Rx: ComBitPosition=454, ComBitSize=2, ComSignalType=UINT8, ComHandleId=2334, ComSystemTemplateSystemSignalRef=DET_CONFD_AZIMUTH_112_Rx
          DET_AZIMUTH_111_Rx_oRDR_FUSION_DET_109_112_oPCAN_RADAR_a55e85db_Rx: ComBitPosition=312, ComBitSize=13, ComSignalType=UINT16, ComHandleId=2317, ComSystemTemplateSystemSignalRef=DET_AZIMUTH_111_Rx
          DET_BI_STATIC_FLAG_109_Rx_oRDR_FUSION_DET_109_112_oPCAN_RADAR_261ec023_Rx: ComBitPosition=104, ComBitSize=1, ComSignalType=BOOLEAN, ComHandleId=2327, ComSystemTemplateSystemSignalRef=DET_BI_STATIC_FLAG_109_Rx
          DET_ELEVATION_109_Rx_oRDR_FUSION_DET_109_112_oPCAN_RADAR_c5054609_Rx: ComBitPosition=72, ComBitSize=8, ComSignalType=UINT8, ComHandleId=2339, ComSystemTemplateSystemSignalRef=DET_ELEVATION_109_Rx
          DET_RCS_111_Rx_oRDR_FUSION_DET_109_112_oPCAN_RADAR_a6a6c819_Rx: ComBitPosition=352, ComBitSize=8, ComSignalType=UINT8, ComHandleId=2388, ComSystemTemplateSystemSignalRef=DET_RCS_111_Rx
          DET_AZIMUTH_ERR_110_Rx_oRDR_FUSION_DET_109_112_oPCAN_RADAR_0873b61e_Rx: ComBitPosition=217, ComBitSize=7, ComSignalType=UINT8, ComHandleId=2320, ComSystemTemplateSystemSignalRef=DET_AZIMUTH_ERR_110_Rx
          DET_PROB_1STAZHYPO_109_Rx_oRDR_FUSION_DET_109_112_oPCAN_RADAR_7f4120b5_Rx: ComBitPosition=103, ComBitSize=1, ComSignalType=BOOLEAN, ComHandleId=2366, ComSystemTemplateSystemSignalRef=DET_PROB_1STAZHYPO_109_Rx
          DET_RANGE_112_Rx_oRDR_FUSION_DET_109_112_oPCAN_RADAR_9c246974_Rx: ComBitPosition=360, ComBitSize=15, ComSignalType=UINT16, ComHandleId=2373, ComSystemTemplateSystemSignalRef=DET_RANGE_112_Rx
          DET_RANGE_VELOCITY_ERR_111_Rx_oRDR_FUSION_DET_109_112_oPCAN_RADAR_f2092ac0_Rx: ComBitPosition=288, ComBitSize=8, ComSignalType=UINT8, ComHandleId=2384, ComSystemTemplateSystemSignalRef=DET_RANGE_VELOCITY_ERR_111_Rx
          DET_ELEVATION_111_Rx_oRDR_FUSION_DET_109_112_oPCAN_RADAR_57615757_Rx: ComBitPosition=296, ComBitSize=8, ComSignalType=UINT8, ComHandleId=2341, ComSystemTemplateSystemSignalRef=DET_ELEVATION_111_Rx
          DET_SNR_109_Rx_oRDR_FUSION_DET_109_112_oPCAN_RADAR_3d98a8ae_Rx: ComBitPosition=120, ComBitSize=8, ComSignalType=UINT8, ComHandleId=2390, ComSystemTemplateSystemSignalRef=DET_SNR_109_Rx
          DET_EXISTENCE_PROB_111_Rx_oRDR_FUSION_DET_109_112_oPCAN_RADAR_72c00d1d_Rx: ComBitPosition=336, ComBitSize=6, ComSignalType=UINT8, ComHandleId=2349, ComSystemTemplateSystemSignalRef=DET_EXISTENCE_PROB_111_Rx
          DET_SNR_111_Rx_oRDR_FUSION_DET_109_112_oPCAN_RADAR_affcb9f0_Rx: ComBitPosition=344, ComBitSize=8, ComSignalType=UINT8, ComHandleId=2392, ComSystemTemplateSystemSignalRef=DET_SNR_111_Rx
          DET_RANGE_VELOCITY_ERR_110_Rx_oRDR_FUSION_DET_109_112_oPCAN_RADAR_5d4db887_Rx: ComBitPosition=176, ComBitSize=8, ComSignalType=UINT8, ComHandleId=2383, ComSystemTemplateSystemSignalRef=DET_RANGE_VELOCITY_ERR_110_Rx
          DET_CONFD_ELEVATION_111_Rx_oRDR_FUSION_DET_109_112_oPCAN_RADAR_5d32b8ae_Rx: ComBitPosition=325, ComBitSize=2, ComSignalType=UINT8, ComHandleId=2337, ComSystemTemplateSystemSignalRef=DET_CONFD_ELEVATION_111_Rx
          DET_HVC_FLAG_110_Rx_oRDR_FUSION_DET_109_112_oPCAN_RADAR_005a7215_Rx: ComBitPosition=198, ComBitSize=1, ComSignalType=BOOLEAN, ComHandleId=2352, ComSystemTemplateSystemSignalRef=DET_HVC_FLAG_110_Rx
          DET_RCS_112_Rx_oRDR_FUSION_DET_109_112_oPCAN_RADAR_8c1a7891_Rx: ComBitPosition=464, ComBitSize=8, ComSignalType=UINT8, ComHandleId=2389, ComSystemTemplateSystemSignalRef=DET_RCS_112_Rx
          DET_ELEVATION_112_Rx_oRDR_FUSION_DET_109_112_oPCAN_RADAR_7ddde7df_Rx: ComBitPosition=408, ComBitSize=8, ComSignalType=UINT8, ComHandleId=2342, ComSystemTemplateSystemSignalRef=DET_ELEVATION_112_Rx
          DET_SNR_110_Rx_oRDR_FUSION_DET_109_112_oPCAN_RADAR_00b82bb7_Rx: ComBitPosition=232, ComBitSize=8, ComSignalType=UINT8, ComHandleId=2391, ComSystemTemplateSystemSignalRef=DET_SNR_110_Rx
          DET_CONFD_AZIMUTH_111_Rx_oRDR_FUSION_DET_109_112_oPCAN_RADAR_57133b29_Rx: ComBitPosition=342, ComBitSize=2, ComSignalType=UINT8, ComHandleId=2333, ComSystemTemplateSystemSignalRef=DET_CONFD_AZIMUTH_111_Rx
          DET_RANGE_VELOCITY_110_Rx_oRDR_FUSION_DET_109_112_oPCAN_RADAR_c429c845_Rx: ComBitPosition=160, ComBitSize=15, ComSignalType=UINT16, ComHandleId=2379, ComSystemTemplateSystemSignalRef=DET_RANGE_VELOCITY_110_Rx
          DET_EXISTENCE_PROB_109_Rx_oRDR_FUSION_DET_109_112_oPCAN_RADAR_e0a41c43_Rx: ComBitPosition=112, ComBitSize=6, ComSignalType=UINT8, ComHandleId=2347, ComSystemTemplateSystemSignalRef=DET_EXISTENCE_PROB_109_Rx
          DET_BELOW_RAIN_THOLD_110_Rx_oRDR_FUSION_DET_109_112_oPCAN_RADAR_6ca0e829_Rx: ComBitPosition=151, ComBitSize=1, ComSignalType=BOOLEAN, ComHandleId=2324, ComSystemTemplateSystemSignalRef=DET_BELOW_RAIN_THOLD_110_Rx
          DET_IDM_112_Rx_oRDR_FUSION_DET_109_112_oPCAN_RADAR_b063a992_Rx: ComBitPosition=399, ComBitSize=1, ComSignalType=BOOLEAN, ComHandleId=2358, ComSystemTemplateSystemSignalRef=DET_IDM_112_Rx
          DET_RANGE_VELOCITY_109_Rx_oRDR_FUSION_DET_109_112_oPCAN_RADAR_f9094b5c_Rx: ComBitPosition=48, ComBitSize=15, ComSignalType=UINT16, ComHandleId=2378, ComSystemTemplateSystemSignalRef=DET_RANGE_VELOCITY_109_Rx
          DET_SUPER_RES_TARGET_110_Rx_oRDR_FUSION_DET_109_112_oPCAN_RADAR_cb430ab7_Rx: ComBitPosition=199, ComBitSize=1, ComSignalType=BOOLEAN, ComHandleId=2395, ComSystemTemplateSystemSignalRef=DET_SUPER_RES_TARGET_110_Rx
          DET_CONFD_ELEVATION_110_Rx_oRDR_FUSION_DET_109_112_oPCAN_RADAR_f2762ae9_Rx: ComBitPosition=213, ComBitSize=2, ComSignalType=UINT8, ComHandleId=2336, ComSystemTemplateSystemSignalRef=DET_CONFD_ELEVATION_110_Rx
          DET_IDM_109_Rx_oRDR_FUSION_DET_109_112_oPCAN_RADAR_08bb0844_Rx: ComBitPosition=63, ComBitSize=1, ComSignalType=BOOLEAN, ComHandleId=2355, ComSystemTemplateSystemSignalRef=DET_IDM_109_Rx
          DET_RANGE_110_Rx_oRDR_FUSION_DET_109_112_oPCAN_RADAR_19dc4bbb_Rx: ComBitPosition=136, ComBitSize=15, ComSignalType=UINT16, ComHandleId=2371, ComSystemTemplateSystemSignalRef=DET_RANGE_110_Rx
          DET_RANGE_ERR_111_Rx_oRDR_FUSION_DET_109_112_oPCAN_RADAR_e66a551c_Rx: ComBitPosition=264, ComBitSize=7, ComSignalType=UINT8, ComHandleId=2376, ComSystemTemplateSystemSignalRef=DET_RANGE_ERR_111_Rx
          DET_ELEVATION_110_Rx_oRDR_FUSION_DET_109_112_oPCAN_RADAR_f825c510_Rx: ComBitPosition=184, ComBitSize=8, ComSignalType=UINT8, ComHandleId=2340, ComSystemTemplateSystemSignalRef=DET_ELEVATION_110_Rx
          DET_SUPER_RES_TARGET_109_Rx_oRDR_FUSION_DET_109_112_oPCAN_RADAR_f66389ae_Rx: ComBitPosition=87, ComBitSize=1, ComSignalType=BOOLEAN, ComHandleId=2394, ComSystemTemplateSystemSignalRef=DET_SUPER_RES_TARGET_109_Rx
      SG_Fusion_Detections_097_100_oRDR_FUSION_DET_097_100_oPCAN_RADAR_f997174e_Rx (ComSignalGroup):
        ComTimeout = 0
        ComTransferProperty = PENDING
        ComSignalGroupAccess = ACCESS_NEEDED_BY_SWC_OR_COM
        ComHandleId = 32
        ComSignalGroupArrayAccess = true
        ComSystemTemplateSignalGroupRef = SG_Fusion_Detections_097_100
        83 x ComGroupSignal, all with ComSignalEndianness=LITTLE_ENDIAN, ComSignalInitValue=0, ComSignalAccess=ACCESS_NEEDED_BY_SWC_OR_COM:
          DET_RANGE_VELOCITY_ERR_099_Rx_oRDR_FUSION_DET_097_100_oPCAN_RADAR_97ad87c3_Rx: ComBitPosition=288, ComBitSize=8, ComSignalType=UINT8, ComHandleId=2135, ComSystemTemplateSystemSignalRef=DET_RANGE_VELOCITY_ERR_099_Rx
          DET_RANGE_VELOCITY_ERR_100_Rx_oRDR_FUSION_DET_097_100_oPCAN_RADAR_26cc1c38_Rx: ComBitPosition=400, ComBitSize=8, ComSignalType=UINT8, ComHandleId=2136, ComSystemTemplateSystemSignalRef=DET_RANGE_VELOCITY_ERR_100_Rx
          DET_CONFD_ELEVATION_097_Rx_oRDR_FUSION_DET_097_100_oPCAN_RADAR_179cf542_Rx: ComBitPosition=101, ComBitSize=2, ComSignalType=UINT8, ComHandleId=2086, ComSystemTemplateSystemSignalRef=DET_CONFD_ELEVATION_097_Rx
          DET_AZIMUTH_097_Rx_oRDR_FUSION_DET_097_100_oPCAN_RADAR_eff0c837_Rx: ComBitPosition=88, ComBitSize=13, ComSignalType=UINT16, ComHandleId=2066, ComSystemTemplateSystemSignalRef=DET_AZIMUTH_097_Rx
          DET_AZIMUTH_ERR_099_Rx_oRDR_FUSION_DET_097_100_oPCAN_RADAR_c293895a_Rx: ComBitPosition=329, ComBitSize=7, ComSignalType=UINT8, ComHandleId=2072, ComSystemTemplateSystemSignalRef=DET_AZIMUTH_ERR_099_Rx
          DET_CONFD_AZIMUTH_098_Rx_oRDR_FUSION_DET_097_100_oPCAN_RADAR_9df3046d_Rx: ComBitPosition=230, ComBitSize=2, ComSignalType=UINT8, ComHandleId=2083, ComSystemTemplateSystemSignalRef=DET_CONFD_AZIMUTH_098_Rx
          DET_MH_CRC16_097_100_Rx_oRDR_FUSION_DET_097_100_oPCAN_RADAR_6bbde68c_Rx: ComBitPosition=0, ComBitSize=16, ComSignalType=UINT16, ComHandleId=2110, ComSystemTemplateSystemSignalRef=DET_MH_CRC16_097_100_Rx
          DET_RANGE_VELOCITY_ERR_097_Rx_oRDR_FUSION_DET_097_100_oPCAN_RADAR_b8a7672c_Rx: ComBitPosition=64, ComBitSize=8, ComSignalType=UINT8, ComHandleId=2133, ComSystemTemplateSystemSignalRef=DET_RANGE_VELOCITY_ERR_097_Rx
          DET_BELOW_RAIN_THOLD_097_Rx_oRDR_FUSION_DET_097_100_oPCAN_RADAR_894a3782_Rx: ComBitPosition=39, ComBitSize=1, ComSignalType=BOOLEAN, ComHandleId=2074, ComSystemTemplateSystemSignalRef=DET_BELOW_RAIN_THOLD_097_Rx
          DET_AZIMUTH_ERR_097_Rx_oRDR_FUSION_DET_097_100_oPCAN_RADAR_ed9969b5_Rx: ComBitPosition=105, ComBitSize=7, ComSignalType=UINT8, ComHandleId=2070, ComSystemTemplateSystemSignalRef=DET_AZIMUTH_ERR_097_Rx
          DET_IDM_098_Rx_oRDR_FUSION_DET_097_100_oPCAN_RADAR_503f265e_Rx: ComBitPosition=175, ComBitSize=1, ComSignalType=BOOLEAN, ComHandleId=2107, ComSystemTemplateSystemSignalRef=DET_IDM_098_Rx
          DET_RANGE_VELOCITY_100_Rx_oRDR_FUSION_DET_097_100_oPCAN_RADAR_bfa86cfa_Rx: ComBitPosition=384, ComBitSize=15, ComSignalType=UINT16, ComHandleId=2132, ComSystemTemplateSystemSignalRef=DET_RANGE_VELOCITY_100_Rx
          DET_RANGE_100_Rx_oRDR_FUSION_DET_097_100_oPCAN_RADAR_625def04_Rx: ComBitPosition=360, ComBitSize=15, ComSignalType=UINT16, ComHandleId=2124, ComSystemTemplateSystemSignalRef=DET_RANGE_100_Rx
          DET_PROB_1STAZHYPO_098_Rx_oRDR_FUSION_DET_097_100_oPCAN_RADAR_27c50eaf_Rx: ComBitPosition=215, ComBitSize=1, ComSignalType=BOOLEAN, ComHandleId=2118, ComSystemTemplateSystemSignalRef=DET_PROB_1STAZHYPO_098_Rx
          DET_PROB_1STAZHYPO_100_Rx_oRDR_FUSION_DET_097_100_oPCAN_RADAR_39e00713_Rx: ComBitPosition=439, ComBitSize=1, ComSignalType=BOOLEAN, ComHandleId=2120, ComSystemTemplateSystemSignalRef=DET_PROB_1STAZHYPO_100_Rx
          DET_HVC_FLAG_099_Rx_oRDR_FUSION_DET_097_100_oPCAN_RADAR_caba4d51_Rx: ComBitPosition=310, ComBitSize=1, ComSignalType=BOOLEAN, ComHandleId=2104, ComSystemTemplateSystemSignalRef=DET_HVC_FLAG_099_Rx
          DET_AZIMUTH_ERR_098_Rx_oRDR_FUSION_DET_097_100_oPCAN_RADAR_6dd71b1d_Rx: ComBitPosition=217, ComBitSize=7, ComSignalType=UINT8, ComHandleId=2071, ComSystemTemplateSystemSignalRef=DET_AZIMUTH_ERR_098_Rx
          DET_CONFD_ELEVATION_100_Rx_oRDR_FUSION_DET_097_100_oPCAN_RADAR_89f78e56_Rx: ComBitPosition=437, ComBitSize=2, ComSignalType=UINT8, ComHandleId=2089, ComSystemTemplateSystemSignalRef=DET_CONFD_ELEVATION_100_Rx
          DET_ELEVATION_ERR_099_Rx_oRDR_FUSION_DET_097_100_oPCAN_RADAR_e07cd88b_Rx: ComBitPosition=304, ComBitSize=6, ComSignalType=UINT8, ComHandleId=2096, ComSystemTemplateSystemSignalRef=DET_ELEVATION_ERR_099_Rx
          DET_RANGE_ERR_097_Rx_oRDR_FUSION_DET_097_100_oPCAN_RADAR_acc418f0_Rx: ComBitPosition=40, ComBitSize=7, ComSignalType=UINT8, ComHandleId=2125, ComSystemTemplateSystemSignalRef=DET_RANGE_ERR_097_Rx
          DET_SUPER_RES_TARGET_099_Rx_oRDR_FUSION_DET_097_100_oPCAN_RADAR_01a335f3_Rx: ComBitPosition=311, ComBitSize=1, ComSignalType=BOOLEAN, ComHandleId=2147, ComSystemTemplateSystemSignalRef=DET_SUPER_RES_TARGET_099_Rx
          DET_MH_CYCLE_COUNTER_097_100_Rx_oRDR_FUSION_DET_097_100_oPCAN_RADAR_6666db49_Rx: ComBitPosition=16, ComBitSize=8, ComSignalType=UINT8, ComHandleId=2111, ComSystemTemplateSystemSignalRef=DET_MH_CYCLE_COUNTER_097_100_Rx
          DET_AZIMUTH_099_Rx_oRDR_FUSION_DET_097_100_oPCAN_RADAR_c0fa28d8_Rx: ComBitPosition=312, ComBitSize=13, ComSignalType=UINT16, ComHandleId=2068, ComSystemTemplateSystemSignalRef=DET_AZIMUTH_099_Rx
          DET_ELEVATION_100_Rx_oRDR_FUSION_DET_097_100_oPCAN_RADAR_83a461af_Rx: ComBitPosition=408, ComBitSize=8, ComSignalType=UINT8, ComHandleId=2093, ComSystemTemplateSystemSignalRef=DET_ELEVATION_100_Rx
          DET_AZIMUTH_100_Rx_oRDR_FUSION_DET_097_100_oPCAN_RADAR_719bb323_Rx: ComBitPosition=424, ComBitSize=13, ComSignalType=UINT16, ComHandleId=2069, ComSystemTemplateSystemSignalRef=DET_AZIMUTH_100_Rx
          DET_CONFD_ELEVATION_099_Rx_oRDR_FUSION_DET_097_100_oPCAN_RADAR_389615ad_Rx: ComBitPosition=325, ComBitSize=2, ComSignalType=UINT8, ComHandleId=2088, ComSystemTemplateSystemSignalRef=DET_CONFD_ELEVATION_099_Rx
          DET_RANGE_VELOCITY_099_Rx_oRDR_FUSION_DET_097_100_oPCAN_RADAR_0ec9f701_Rx: ComBitPosition=272, ComBitSize=15, ComSignalType=UINT16, ComHandleId=2131, ComSystemTemplateSystemSignalRef=DET_RANGE_VELOCITY_099_Rx
          DET_PROB_1STAZHYPO_099_Rx_oRDR_FUSION_DET_097_100_oPCAN_RADAR_88819ce8_Rx: ComBitPosition=327, ComBitSize=1, ComSignalType=BOOLEAN, ComHandleId=2119, ComSystemTemplateSystemSignalRef=DET_PROB_1STAZHYPO_099_Rx
          DET_SNR_097_Rx_oRDR_FUSION_DET_097_100_oPCAN_RADAR_e552f41c_Rx: ComBitPosition=120, ComBitSize=8, ComSignalType=UINT8, ComHandleId=2141, ComSystemTemplateSystemSignalRef=DET_SNR_097_Rx
          DET_RANGE_VELOCITY_098_Rx_oRDR_FUSION_DET_097_100_oPCAN_RADAR_a18d6546_Rx: ComBitPosition=160, ComBitSize=15, ComSignalType=UINT16, ComHandleId=2130, ComSystemTemplateSystemSignalRef=DET_RANGE_VELOCITY_098_Rx
          DET_HVC_FLAG_098_Rx_oRDR_FUSION_DET_097_100_oPCAN_RADAR_65fedf16_Rx: ComBitPosition=198, ComBitSize=1, ComSignalType=BOOLEAN, ComHandleId=2103, ComSystemTemplateSystemSignalRef=DET_HVC_FLAG_098_Rx
          DET_AZIMUTH_ERR_100_Rx_oRDR_FUSION_DET_097_100_oPCAN_RADAR_73f212a1_Rx: ComBitPosition=441, ComBitSize=7, ComSignalType=UINT8, ComHandleId=2073, ComSystemTemplateSystemSignalRef=DET_AZIMUTH_ERR_100_Rx
          DET_RANGE_097_Rx_oRDR_FUSION_DET_097_100_oPCAN_RADAR_fc369410_Rx: ComBitPosition=24, ComBitSize=15, ComSignalType=UINT16, ComHandleId=2121, ComSystemTemplateSystemSignalRef=DET_RANGE_097_Rx
          DET_SUPER_RES_TARGET_098_Rx_oRDR_FUSION_DET_097_100_oPCAN_RADAR_aee7a7b4_Rx: ComBitPosition=199, ComBitSize=1, ComSignalType=BOOLEAN, ComHandleId=2146, ComSystemTemplateSystemSignalRef=DET_SUPER_RES_TARGET_098_Rx
          DET_AZIMUTH_098_Rx_oRDR_FUSION_DET_097_100_oPCAN_RADAR_6fbeba9f_Rx: ComBitPosition=200, ComBitSize=13, ComSignalType=UINT16, ComHandleId=2067, ComSystemTemplateSystemSignalRef=DET_AZIMUTH_098_Rx
          DET_SNR_098_Rx_oRDR_FUSION_DET_097_100_oPCAN_RADAR_651c86b4_Rx: ComBitPosition=232, ComBitSize=8, ComSignalType=UINT8, ComHandleId=2142, ComSystemTemplateSystemSignalRef=DET_SNR_098_Rx
          DET_BI_STATIC_FLAG_099_Rx_oRDR_FUSION_DET_097_100_oPCAN_RADAR_d1de7c7e_Rx: ComBitPosition=328, ComBitSize=1, ComSignalType=BOOLEAN, ComHandleId=2080, ComSystemTemplateSystemSignalRef=DET_BI_STATIC_FLAG_099_Rx
          DET_BI_STATIC_FLAG_100_Rx_oRDR_FUSION_DET_097_100_oPCAN_RADAR_60bfe785_Rx: ComBitPosition=440, ComBitSize=1, ComSignalType=BOOLEAN, ComHandleId=2081, ComSystemTemplateSystemSignalRef=DET_BI_STATIC_FLAG_100_Rx
          DET_RANGE_099_Rx_oRDR_FUSION_DET_097_100_oPCAN_RADAR_d33c74ff_Rx: ComBitPosition=248, ComBitSize=15, ComSignalType=UINT16, ComHandleId=2123, ComSystemTemplateSystemSignalRef=DET_RANGE_099_Rx
          DET_HVC_FLAG_100_Rx_oRDR_FUSION_DET_097_100_oPCAN_RADAR_7bdbd6aa_Rx: ComBitPosition=422, ComBitSize=1, ComSignalType=BOOLEAN, ComHandleId=2105, ComSystemTemplateSystemSignalRef=DET_HVC_FLAG_100_Rx
          DET_CONFD_AZIMUTH_099_Rx_oRDR_FUSION_DET_097_100_oPCAN_RADAR_32b7962a_Rx: ComBitPosition=342, ComBitSize=2, ComSignalType=UINT8, ComHandleId=2084, ComSystemTemplateSystemSignalRef=DET_CONFD_AZIMUTH_099_Rx
          DET_MTD_100_Rx_oRDR_FUSION_DET_097_100_oPCAN_RADAR_f3991992_Rx: ComBitPosition=383, ComBitSize=1, ComSignalType=BOOLEAN, ComHandleId=2116, ComSystemTemplateSystemSignalRef=DET_MTD_100_Rx
          DET_MTD_098_Rx_oRDR_FUSION_DET_097_100_oPCAN_RADAR_edbc102e_Rx: ComBitPosition=159, ComBitSize=1, ComSignalType=BOOLEAN, ComHandleId=2114, ComSystemTemplateSystemSignalRef=DET_MTD_098_Rx
          DET_ELEVATION_097_Rx_oRDR_FUSION_DET_097_100_oPCAN_RADAR_1dcf1abb_Rx: ComBitPosition=72, ComBitSize=8, ComSignalType=UINT8, ComHandleId=2090, ComSystemTemplateSystemSignalRef=DET_ELEVATION_097_Rx
          DET_BI_STATIC_FLAG_097_Rx_oRDR_FUSION_DET_097_100_oPCAN_RADAR_fed49c91_Rx: ComBitPosition=104, ComBitSize=1, ComSignalType=BOOLEAN, ComHandleId=2078, ComSystemTemplateSystemSignalRef=DET_BI_STATIC_FLAG_097_Rx
          DET_ELEVATION_ERR_100_Rx_oRDR_FUSION_DET_097_100_oPCAN_RADAR_511d4370_Rx: ComBitPosition=416, ComBitSize=6, ComSignalType=UINT8, ComHandleId=2097, ComSystemTemplateSystemSignalRef=DET_ELEVATION_ERR_100_Rx
          DET_RCS_098_Rx_oRDR_FUSION_DET_097_100_oPCAN_RADAR_6c46f75d_Rx: ComBitPosition=240, ComBitSize=8, ComSignalType=UINT8, ComHandleId=2138, ComSystemTemplateSystemSignalRef=DET_RCS_098_Rx
          DET_BELOW_RAIN_THOLD_099_Rx_oRDR_FUSION_DET_097_100_oPCAN_RADAR_a640d76d_Rx: ComBitPosition=263, ComBitSize=1, ComSignalType=BOOLEAN, ComHandleId=2076, ComSystemTemplateSystemSignalRef=DET_BELOW_RAIN_THOLD_099_Rx
          DET_CONFD_AZIMUTH_100_Rx_oRDR_FUSION_DET_097_100_oPCAN_RADAR_83d60dd1_Rx: ComBitPosition=454, ComBitSize=2, ComSignalType=UINT8, ComHandleId=2085, ComSystemTemplateSystemSignalRef=DET_CONFD_AZIMUTH_100_Rx
          DET_SNR_100_Rx_oRDR_FUSION_DET_097_100_oPCAN_RADAR_7b398f08_Rx: ComBitPosition=456, ComBitSize=8, ComSignalType=UINT8, ComHandleId=2144, ComSystemTemplateSystemSignalRef=DET_SNR_100_Rx
          DET_ELEVATION_ERR_098_Rx_oRDR_FUSION_DET_097_100_oPCAN_RADAR_4f384acc_Rx: ComBitPosition=192, ComBitSize=6, ComSignalType=UINT8, ComHandleId=2095, ComSystemTemplateSystemSignalRef=DET_ELEVATION_ERR_098_Rx
          DET_RANGE_ERR_098_Rx_oRDR_FUSION_DET_097_100_oPCAN_RADAR_2c8a6a58_Rx: ComBitPosition=152, ComBitSize=7, ComSignalType=UINT8, ComHandleId=2126, ComSystemTemplateSystemSignalRef=DET_RANGE_ERR_098_Rx
          DET_MH_SCAN_INDEX_4LSB_097_100_Rx_oRDR_FUSION_DET_097_100_oPCAN_RADAR_02d61472_Rx: ComBitPosition=476, ComBitSize=4, ComSignalType=UINT8, ComHandleId=2112, ComSystemTemplateSystemSignalRef=DET_MH_SCAN_INDEX_4LSB_097_100_Rx
          DET_EXISTENCE_PROB_098_Rx_oRDR_FUSION_DET_097_100_oPCAN_RADAR_b8203259_Rx: ComBitPosition=224, ComBitSize=6, ComSignalType=UINT8, ComHandleId=2099, ComSystemTemplateSystemSignalRef=DET_EXISTENCE_PROB_098_Rx
          DET_RANGE_VELOCITY_097_Rx_oRDR_FUSION_DET_097_100_oPCAN_RADAR_21c317ee_Rx: ComBitPosition=48, ComBitSize=15, ComSignalType=UINT16, ComHandleId=2129, ComSystemTemplateSystemSignalRef=DET_RANGE_VELOCITY_097_Rx
          DET_RANGE_ERR_099_Rx_oRDR_FUSION_DET_097_100_oPCAN_RADAR_83cef81f_Rx: ComBitPosition=264, ComBitSize=7, ComSignalType=UINT8, ComHandleId=2127, ComSystemTemplateSystemSignalRef=DET_RANGE_ERR_099_Rx
          DET_RCS_097_Rx_oRDR_FUSION_DET_097_100_oPCAN_RADAR_ec0885f5_Rx: ComBitPosition=128, ComBitSize=8, ComSignalType=UINT8, ComHandleId=2137, ComSystemTemplateSystemSignalRef=DET_RCS_097_Rx
          DET_RANGE_098_Rx_oRDR_FUSION_DET_097_100_oPCAN_RADAR_7c78e6b8_Rx: ComBitPosition=136, ComBitSize=15, ComSignalType=UINT16, ComHandleId=2122, ComSystemTemplateSystemSignalRef=DET_RANGE_098_Rx
          DET_ELEVATION_ERR_097_Rx_oRDR_FUSION_DET_097_100_oPCAN_RADAR_cf763864_Rx: ComBitPosition=80, ComBitSize=6, ComSignalType=UINT8, ComHandleId=2094, ComSystemTemplateSystemSignalRef=DET_ELEVATION_ERR_097_Rx
          DET_RCS_099_Rx_oRDR_FUSION_DET_097_100_oPCAN_RADAR_c302651a_Rx: ComBitPosition=352, ComBitSize=8, ComSignalType=UINT8, ComHandleId=2139, ComSystemTemplateSystemSignalRef=DET_RCS_099_Rx
          DET_RCS_100_Rx_oRDR_FUSION_DET_097_100_oPCAN_RADAR_7263fee1_Rx: ComBitPosition=464, ComBitSize=8, ComSignalType=UINT8, ComHandleId=2140, ComSystemTemplateSystemSignalRef=DET_RCS_100_Rx
          DET_ELEVATION_098_Rx_oRDR_FUSION_DET_097_100_oPCAN_RADAR_9d816813_Rx: ComBitPosition=184, ComBitSize=8, ComSignalType=UINT8, ComHandleId=2091, ComSystemTemplateSystemSignalRef=DET_ELEVATION_098_Rx
          DET_IDM_097_Rx_oRDR_FUSION_DET_097_100_oPCAN_RADAR_d07154f6_Rx: ComBitPosition=63, ComBitSize=1, ComSignalType=BOOLEAN, ComHandleId=2106, ComSystemTemplateSystemSignalRef=DET_IDM_097_Rx
          DET_ELEVATION_099_Rx_oRDR_FUSION_DET_097_100_oPCAN_RADAR_32c5fa54_Rx: ComBitPosition=296, ComBitSize=8, ComSignalType=UINT8, ComHandleId=2092, ComSystemTemplateSystemSignalRef=DET_ELEVATION_099_Rx
          DET_EXISTENCE_PROB_097_Rx_oRDR_FUSION_DET_097_100_oPCAN_RADAR_386e40f1_Rx: ComBitPosition=112, ComBitSize=6, ComSignalType=UINT8, ComHandleId=2098, ComSystemTemplateSystemSignalRef=DET_EXISTENCE_PROB_097_Rx
          DET_EXISTENCE_PROB_099_Rx_oRDR_FUSION_DET_097_100_oPCAN_RADAR_1764a01e_Rx: ComBitPosition=336, ComBitSize=6, ComSignalType=UINT8, ComHandleId=2100, ComSystemTemplateSystemSignalRef=DET_EXISTENCE_PROB_099_Rx
          DET_CONFD_ELEVATION_098_Rx_oRDR_FUSION_DET_097_100_oPCAN_RADAR_97d287ea_Rx: ComBitPosition=213, ComBitSize=2, ComSignalType=UINT8, ComHandleId=2087, ComSystemTemplateSystemSignalRef=DET_CONFD_ELEVATION_098_Rx
          DET_HVC_FLAG_097_Rx_oRDR_FUSION_DET_097_100_oPCAN_RADAR_e5b0adbe_Rx: ComBitPosition=86, ComBitSize=1, ComSignalType=BOOLEAN, ComHandleId=2102, ComSystemTemplateSystemSignalRef=DET_HVC_FLAG_097_Rx
          DET_MTD_099_Rx_oRDR_FUSION_DET_097_100_oPCAN_RADAR_42f88269_Rx: ComBitPosition=271, ComBitSize=1, ComSignalType=BOOLEAN, ComHandleId=2115, ComSystemTemplateSystemSignalRef=DET_MTD_099_Rx
          DET_IDM_099_Rx_oRDR_FUSION_DET_097_100_oPCAN_RADAR_ff7bb419_Rx: ComBitPosition=287, ComBitSize=1, ComSignalType=BOOLEAN, ComHandleId=2108, ComSystemTemplateSystemSignalRef=DET_IDM_099_Rx
          DET_BI_STATIC_FLAG_098_Rx_oRDR_FUSION_DET_097_100_oPCAN_RADAR_7e9aee39_Rx: ComBitPosition=216, ComBitSize=1, ComSignalType=BOOLEAN, ComHandleId=2079, ComSystemTemplateSystemSignalRef=DET_BI_STATIC_FLAG_098_Rx
          DET_IDM_100_Rx_oRDR_FUSION_DET_097_100_oPCAN_RADAR_4e1a2fe2_Rx: ComBitPosition=399, ComBitSize=1, ComSignalType=BOOLEAN, ComHandleId=2109, ComSystemTemplateSystemSignalRef=DET_IDM_100_Rx
          DET_PROB_1STAZHYPO_097_Rx_oRDR_FUSION_DET_097_100_oPCAN_RADAR_a78b7c07_Rx: ComBitPosition=103, ComBitSize=1, ComSignalType=BOOLEAN, ComHandleId=2117, ComSystemTemplateSystemSignalRef=DET_PROB_1STAZHYPO_097_Rx
          DET_EXISTENCE_PROB_100_Rx_oRDR_FUSION_DET_097_100_oPCAN_RADAR_a6053be5_Rx: ComBitPosition=448, ComBitSize=6, ComSignalType=UINT8, ComHandleId=2101, ComSystemTemplateSystemSignalRef=DET_EXISTENCE_PROB_100_Rx
          DET_BELOW_RAIN_THOLD_098_Rx_oRDR_FUSION_DET_097_100_oPCAN_RADAR_0904452a_Rx: ComBitPosition=151, ComBitSize=1, ComSignalType=BOOLEAN, ComHandleId=2075, ComSystemTemplateSystemSignalRef=DET_BELOW_RAIN_THOLD_098_Rx
          DET_CONFD_AZIMUTH_097_Rx_oRDR_FUSION_DET_097_100_oPCAN_RADAR_1dbd76c5_Rx: ComBitPosition=118, ComBitSize=2, ComSignalType=UINT8, ComHandleId=2082, ComSystemTemplateSystemSignalRef=DET_CONFD_AZIMUTH_097_Rx
          DET_BELOW_RAIN_THOLD_100_Rx_oRDR_FUSION_DET_097_100_oPCAN_RADAR_17214c96_Rx: ComBitPosition=375, ComBitSize=1, ComSignalType=BOOLEAN, ComHandleId=2077, ComSystemTemplateSystemSignalRef=DET_BELOW_RAIN_THOLD_100_Rx
          DET_RANGE_ERR_100_Rx_oRDR_FUSION_DET_097_100_oPCAN_RADAR_32af63e4_Rx: ComBitPosition=376, ComBitSize=7, ComSignalType=UINT8, ComHandleId=2128, ComSystemTemplateSystemSignalRef=DET_RANGE_ERR_100_Rx
          DET_SUPER_RES_TARGET_100_Rx_oRDR_FUSION_DET_097_100_oPCAN_RADAR_b0c2ae08_Rx: ComBitPosition=423, ComBitSize=1, ComSignalType=BOOLEAN, ComHandleId=2148, ComSystemTemplateSystemSignalRef=DET_SUPER_RES_TARGET_100_Rx
          DET_MTD_097_Rx_oRDR_FUSION_DET_097_100_oPCAN_RADAR_6df26286_Rx: ComBitPosition=47, ComBitSize=1, ComSignalType=BOOLEAN, ComHandleId=2113, ComSystemTemplateSystemSignalRef=DET_MTD_097_Rx
          DET_SUPER_RES_TARGET_097_Rx_oRDR_FUSION_DET_097_100_oPCAN_RADAR_2ea9d51c_Rx: ComBitPosition=87, ComBitSize=1, ComSignalType=BOOLEAN, ComHandleId=2145, ComSystemTemplateSystemSignalRef=DET_SUPER_RES_TARGET_097_Rx
          DET_RANGE_VELOCITY_ERR_098_Rx_oRDR_FUSION_DET_097_100_oPCAN_RADAR_38e91584_Rx: ComBitPosition=176, ComBitSize=8, ComSignalType=UINT8, ComHandleId=2134, ComSystemTemplateSystemSignalRef=DET_RANGE_VELOCITY_ERR_098_Rx
          DET_SNR_099_Rx_oRDR_FUSION_DET_097_100_oPCAN_RADAR_ca5814f3_Rx: ComBitPosition=344, ComBitSize=8, ComSignalType=UINT8, ComHandleId=2143, ComSystemTemplateSystemSignalRef=DET_SNR_099_Rx
      4 x ComIPdu, all with ComIPduDirection=RECEIVE, ComIPduType=NORMAL, ComIPduCancellationSupport=false, ComIPduSignalProcessing=DEFERRED, ComIPduChannelRef=CN_PCAN_RADAR_458ff0f1, ComIPduGroupRef=RDR01_oPCAN_RADAR_Rx_e0e717e1 if post-build-variant-condition{matching-criterion=RDR_POS, value=0}, ComIPduMainFunctionRef=ComMainFunctionRx, ComIPduGroupRef=RDR02_oPCAN_RADAR_Rx_c92fa313 if post-build-variant-condition{matching-criterion=RDR_POS, value=1}, ComIPduGroupRef=RDR03_oPCAN_RADAR_Rx_67473282 if post-build-variant-condition{matching-criterion=RDR_POS, value=2}, ComIPduGroupRef=RDR04_oPCAN_RADAR_Rx_9abecaf7 if post-build-variant-condition{matching-criterion=RDR_POS, value=3}, ComIPduGroupRef=RDR05_oPCAN_RADAR_Rx_34d65b66 if post-build-variant-condition{matching-criterion=RDR_POS, value=4}, ComIPduGroupRef=RDR06_oPCAN_RADAR_Rx_1d1eef94 if post-build-variant-condition{matching-criterion=RDR_POS, value=5}, ComIPduGroupRef=RDR07_oPCAN_RADAR_Rx_b3767e05 if post-build-variant-condition{matching-criterion=RDR_POS, value=6}, ComIPduGroupRef=RDR08_oPCAN_RADAR_Rx_3d9c193f if post-build-variant-condition{matching-criterion=RDR_POS, value=7}:
        RDR_FUSION_DET_005_008_oPCAN_RADAR_3a2c3381_Rx: ComIPduHandleId=23, ComIPduSignalGroupRef=SG_Fusion_Detections_005_008_oRDR_FUSION_DET_005_008_oPCAN_RADAR_0783a66c_Rx, ComPduIdRef=RDR_FUSION_DET_005_008_oPCAN_RADAR_3a2c3381_Rx
        RDR_FUSION_DET_053_056_oPCAN_RADAR_07a787b3_Rx: ComIPduHandleId=35, ComIPduSignalGroupRef=SG_Fusion_Detections_053_056_oRDR_FUSION_DET_053_056_oPCAN_RADAR_d1fa35d9_Rx, ComPduIdRef=RDR_FUSION_DET_053_056_oPCAN_RADAR_07a787b3_Rx
        RDR_FUSION_DET_065_068_oPCAN_RADAR_cc92c4b2_Rx: ComIPduHandleId=38, ComIPduSignalGroupRef=SG_Fusion_Detections_065_068_oRDR_FUSION_DET_065_068_oPCAN_RADAR_1a9a4777_Rx, ComPduIdRef=RDR_FUSION_DET_065_068_oPCAN_RADAR_cc92c4b2_Rx
        RDR_FUSION_DET_021_024_oPCAN_RADAR_3724029b_Rx: ComIPduHandleId=27, ComIPduSignalGroupRef=SG_Fusion_Detections_021_024_oRDR_FUSION_DET_021_024_oPCAN_RADAR_f7a0d0a9_Rx, ComPduIdRef=RDR_FUSION_DET_021_024_oPCAN_RADAR_3724029b_Rx
      SG_Fusion_Detections_065_068_oRDR_FUSION_DET_065_068_oPCAN_RADAR_1a9a4777_Rx (ComSignalGroup):
        ComTimeout = 0
        ComTransferProperty = PENDING
        ComSignalGroupAccess = ACCESS_NEEDED_BY_SWC_OR_COM
        ComHandleId = 24
        ComSignalGroupArrayAccess = true
        ComSystemTemplateSignalGroupRef = SG_Fusion_Detections_065_068
        83 x ComGroupSignal, all with ComSignalEndianness=LITTLE_ENDIAN, ComSignalInitValue=0, ComSignalAccess=ACCESS_NEEDED_BY_SWC_OR_COM:
          DET_AZIMUTH_065_Rx_oRDR_FUSION_DET_065_068_oPCAN_RADAR_8bfcf8cc_Rx: ComBitPosition=88, ComBitSize=13, ComSignalType=UINT16, ComHandleId=1402, ComSystemTemplateSystemSignalRef=DET_AZIMUTH_065_Rx
          DET_ELEVATION_068_Rx_oRDR_FUSION_DET_065_068_oPCAN_RADAR_7c757a27_Rx: ComBitPosition=408, ComBitSize=8, ComSignalType=UINT8, ComHandleId=1429, ComSystemTemplateSystemSignalRef=DET_ELEVATION_068_Rx
          DET_EXISTENCE_PROB_068_Rx_oRDR_FUSION_DET_065_068_oPCAN_RADAR_59d4206d_Rx: ComBitPosition=448, ComBitSize=6, ComSignalType=UINT8, ComHandleId=1437, ComSystemTemplateSystemSignalRef=DET_EXISTENCE_PROB_068_Rx
          DET_HVC_FLAG_067_Rx_oRDR_FUSION_DET_065_068_oPCAN_RADAR_0444bf8a_Rx: ComBitPosition=310, ComBitSize=1, ComSignalType=BOOLEAN, ComHandleId=1440, ComSystemTemplateSystemSignalRef=DET_HVC_FLAG_067_Rx
          DET_MTD_068_Rx_oRDR_FUSION_DET_065_068_oPCAN_RADAR_0c48021a_Rx: ComBitPosition=383, ComBitSize=1, ComSignalType=BOOLEAN, ComHandleId=1452, ComSystemTemplateSystemSignalRef=DET_MTD_068_Rx
          DET_RANGE_067_Rx_oRDR_FUSION_DET_065_068_oPCAN_RADAR_1dc28624_Rx: ComBitPosition=248, ComBitSize=15, ComSignalType=UINT16, ComHandleId=1459, ComSystemTemplateSystemSignalRef=DET_RANGE_067_Rx
          DET_RANGE_065_Rx_oRDR_FUSION_DET_065_068_oPCAN_RADAR_983aa4eb_Rx: ComBitPosition=24, ComBitSize=15, ComSignalType=UINT16, ComHandleId=1457, ComSystemTemplateSystemSignalRef=DET_RANGE_065_Rx
          DET_BI_STATIC_FLAG_068_Rx_oRDR_FUSION_DET_065_068_oPCAN_RADAR_9f6efc0d_Rx: ComBitPosition=440, ComBitSize=1, ComSignalType=BOOLEAN, ComHandleId=1417, ComSystemTemplateSystemSignalRef=DET_BI_STATIC_FLAG_068_Rx
          DET_RANGE_VELOCITY_068_Rx_oRDR_FUSION_DET_065_068_oPCAN_RADAR_40797772_Rx: ComBitPosition=384, ComBitSize=15, ComSignalType=UINT16, ComHandleId=1468, ComSystemTemplateSystemSignalRef=DET_RANGE_VELOCITY_068_Rx
          DET_CONFD_AZIMUTH_067_Rx_oRDR_FUSION_DET_065_068_oPCAN_RADAR_fc4964f1_Rx: ComBitPosition=342, ComBitSize=2, ComSignalType=UINT8, ComHandleId=1420, ComSystemTemplateSystemSignalRef=DET_CONFD_AZIMUTH_067_Rx
          DET_ELEVATION_ERR_067_Rx_oRDR_FUSION_DET_065_068_oPCAN_RADAR_2e822a50_Rx: ComBitPosition=304, ComBitSize=6, ComSignalType=UINT8, ComHandleId=1432, ComSystemTemplateSystemSignalRef=DET_ELEVATION_ERR_067_Rx
          DET_RANGE_VELOCITY_ERR_068_Rx_oRDR_FUSION_DET_065_068_oPCAN_RADAR_d91d07b0_Rx: ComBitPosition=400, ComBitSize=8, ComSignalType=UINT8, ComHandleId=1472, ComSystemTemplateSystemSignalRef=DET_RANGE_VELOCITY_ERR_068_Rx
          DET_IDM_065_Rx_oRDR_FUSION_DET_065_068_oPCAN_RADAR_b47d640d_Rx: ComBitPosition=63, ComBitSize=1, ComSignalType=BOOLEAN, ComHandleId=1442, ComSystemTemplateSystemSignalRef=DET_IDM_065_Rx
          DET_SNR_065_Rx_oRDR_FUSION_DET_065_068_oPCAN_RADAR_815ec4e7_Rx: ComBitPosition=120, ComBitSize=8, ComSignalType=UINT8, ComHandleId=1477, ComSystemTemplateSystemSignalRef=DET_SNR_065_Rx
          DET_EXISTENCE_PROB_065_Rx_oRDR_FUSION_DET_065_068_oPCAN_RADAR_5c62700a_Rx: ComBitPosition=112, ComBitSize=6, ComSignalType=UINT8, ComHandleId=1434, ComSystemTemplateSystemSignalRef=DET_EXISTENCE_PROB_065_Rx
          DET_HVC_FLAG_068_Rx_oRDR_FUSION_DET_065_068_oPCAN_RADAR_840acd22_Rx: ComBitPosition=422, ComBitSize=1, ComSignalType=BOOLEAN, ComHandleId=1441, ComSystemTemplateSystemSignalRef=DET_HVC_FLAG_068_Rx
          DET_PROB_1STAZHYPO_065_Rx_oRDR_FUSION_DET_065_068_oPCAN_RADAR_c3874cfc_Rx: ComBitPosition=103, ComBitSize=1, ComSignalType=BOOLEAN, ComHandleId=1453, ComSystemTemplateSystemSignalRef=DET_PROB_1STAZHYPO_065_Rx
          DET_SNR_067_Rx_oRDR_FUSION_DET_065_068_oPCAN_RADAR_04a6e628_Rx: ComBitPosition=344, ComBitSize=8, ComSignalType=UINT8, ComHandleId=1479, ComSystemTemplateSystemSignalRef=DET_SNR_067_Rx
          DET_PROB_1STAZHYPO_066_Rx_oRDR_FUSION_DET_065_068_oPCAN_RADAR_e93bfc74_Rx: ComBitPosition=215, ComBitSize=1, ComSignalType=BOOLEAN, ComHandleId=1454, ComSystemTemplateSystemSignalRef=DET_PROB_1STAZHYPO_066_Rx
          DET_RANGE_ERR_065_Rx_oRDR_FUSION_DET_065_068_oPCAN_RADAR_c8c8280b_Rx: ComBitPosition=40, ComBitSize=7, ComSignalType=UINT8, ComHandleId=1461, ComSystemTemplateSystemSignalRef=DET_RANGE_ERR_065_Rx
          DET_CONFD_AZIMUTH_068_Rx_oRDR_FUSION_DET_065_068_oPCAN_RADAR_7c071659_Rx: ComBitPosition=454, ComBitSize=2, ComSignalType=UINT8, ComHandleId=1421, ComSystemTemplateSystemSignalRef=DET_CONFD_AZIMUTH_068_Rx
          DET_CONFD_ELEVATION_067_Rx_oRDR_FUSION_DET_065_068_oPCAN_RADAR_f668e776_Rx: ComBitPosition=325, ComBitSize=2, ComSignalType=UINT8, ComHandleId=1424, ComSystemTemplateSystemSignalRef=DET_CONFD_ELEVATION_067_Rx
          DET_HVC_FLAG_065_Rx_oRDR_FUSION_DET_065_068_oPCAN_RADAR_81bc9d45_Rx: ComBitPosition=86, ComBitSize=1, ComSignalType=BOOLEAN, ComHandleId=1438, ComSystemTemplateSystemSignalRef=DET_HVC_FLAG_065_Rx
          DET_RCS_067_Rx_oRDR_FUSION_DET_065_068_oPCAN_RADAR_0dfc97c1_Rx: ComBitPosition=352, ComBitSize=8, ComSignalType=UINT8, ComHandleId=1475, ComSystemTemplateSystemSignalRef=DET_RCS_067_Rx
          DET_ELEVATION_065_Rx_oRDR_FUSION_DET_065_068_oPCAN_RADAR_79c32a40_Rx: ComBitPosition=72, ComBitSize=8, ComSignalType=UINT8, ComHandleId=1426, ComSystemTemplateSystemSignalRef=DET_ELEVATION_065_Rx
          DET_RANGE_VELOCITY_ERR_066_Rx_oRDR_FUSION_DET_065_068_oPCAN_RADAR_f617e75f_Rx: ComBitPosition=176, ComBitSize=8, ComSignalType=UINT8, ComHandleId=1470, ComSystemTemplateSystemSignalRef=DET_RANGE_VELOCITY_ERR_066_Rx
          DET_RCS_065_Rx_oRDR_FUSION_DET_065_068_oPCAN_RADAR_8804b50e_Rx: ComBitPosition=128, ComBitSize=8, ComSignalType=UINT8, ComHandleId=1473, ComSystemTemplateSystemSignalRef=DET_RCS_065_Rx
          DET_BELOW_RAIN_THOLD_065_Rx_oRDR_FUSION_DET_065_068_oPCAN_RADAR_ed460779_Rx: ComBitPosition=39, ComBitSize=1, ComSignalType=BOOLEAN, ComHandleId=1410, ComSystemTemplateSystemSignalRef=DET_BELOW_RAIN_THOLD_065_Rx
          DET_AZIMUTH_ERR_068_Rx_oRDR_FUSION_DET_065_068_oPCAN_RADAR_8c230929_Rx: ComBitPosition=441, ComBitSize=7, ComSignalType=UINT8, ComHandleId=1409, ComSystemTemplateSystemSignalRef=DET_AZIMUTH_ERR_068_Rx
          DET_ELEVATION_066_Rx_oRDR_FUSION_DET_065_068_oPCAN_RADAR_537f9ac8_Rx: ComBitPosition=184, ComBitSize=8, ComSignalType=UINT8, ComHandleId=1427, ComSystemTemplateSystemSignalRef=DET_ELEVATION_066_Rx
          DET_BELOW_RAIN_THOLD_067_Rx_oRDR_FUSION_DET_065_068_oPCAN_RADAR_68be25b6_Rx: ComBitPosition=263, ComBitSize=1, ComSignalType=BOOLEAN, ComHandleId=1412, ComSystemTemplateSystemSignalRef=DET_BELOW_RAIN_THOLD_067_Rx
          DET_CONFD_ELEVATION_068_Rx_oRDR_FUSION_DET_065_068_oPCAN_RADAR_762695de_Rx: ComBitPosition=437, ComBitSize=2, ComSignalType=UINT8, ComHandleId=1425, ComSystemTemplateSystemSignalRef=DET_CONFD_ELEVATION_068_Rx
          DET_CONFD_AZIMUTH_065_Rx_oRDR_FUSION_DET_065_068_oPCAN_RADAR_79b1463e_Rx: ComBitPosition=118, ComBitSize=2, ComSignalType=UINT8, ComHandleId=1418, ComSystemTemplateSystemSignalRef=DET_CONFD_AZIMUTH_065_Rx
          DET_IDM_066_Rx_oRDR_FUSION_DET_065_068_oPCAN_RADAR_9ec1d485_Rx: ComBitPosition=175, ComBitSize=1, ComSignalType=BOOLEAN, ComHandleId=1443, ComSystemTemplateSystemSignalRef=DET_IDM_066_Rx
          DET_AZIMUTH_067_Rx_oRDR_FUSION_DET_065_068_oPCAN_RADAR_0e04da03_Rx: ComBitPosition=312, ComBitSize=13, ComSignalType=UINT16, ComHandleId=1404, ComSystemTemplateSystemSignalRef=DET_AZIMUTH_067_Rx
          DET_RCS_068_Rx_oRDR_FUSION_DET_065_068_oPCAN_RADAR_8db2e569_Rx: ComBitPosition=464, ComBitSize=8, ComSignalType=UINT8, ComHandleId=1476, ComSystemTemplateSystemSignalRef=DET_RCS_068_Rx
          DET_CONFD_ELEVATION_065_Rx_oRDR_FUSION_DET_065_068_oPCAN_RADAR_7390c5b9_Rx: ComBitPosition=101, ComBitSize=2, ComSignalType=UINT8, ComHandleId=1422, ComSystemTemplateSystemSignalRef=DET_CONFD_ELEVATION_065_Rx
          DET_MTD_066_Rx_oRDR_FUSION_DET_065_068_oPCAN_RADAR_2342e2f5_Rx: ComBitPosition=159, ComBitSize=1, ComSignalType=BOOLEAN, ComHandleId=1450, ComSystemTemplateSystemSignalRef=DET_MTD_066_Rx
          DET_RANGE_ERR_066_Rx_oRDR_FUSION_DET_065_068_oPCAN_RADAR_e2749883_Rx: ComBitPosition=152, ComBitSize=7, ComSignalType=UINT8, ComHandleId=1462, ComSystemTemplateSystemSignalRef=DET_RANGE_ERR_066_Rx
          DET_RANGE_068_Rx_oRDR_FUSION_DET_065_068_oPCAN_RADAR_9d8cf48c_Rx: ComBitPosition=360, ComBitSize=15, ComSignalType=UINT16, ComHandleId=1460, ComSystemTemplateSystemSignalRef=DET_RANGE_068_Rx
          DET_RANGE_VELOCITY_066_Rx_oRDR_FUSION_DET_065_068_oPCAN_RADAR_6f73979d_Rx: ComBitPosition=160, ComBitSize=15, ComSignalType=UINT16, ComHandleId=1466, ComSystemTemplateSystemSignalRef=DET_RANGE_VELOCITY_066_Rx
          DET_MH_CYCLE_COUNTER_065_068_Rx_oRDR_FUSION_DET_065_068_oPCAN_RADAR_0d0134c4_Rx: ComBitPosition=16, ComBitSize=8, ComSignalType=UINT8, ComHandleId=1447, ComSystemTemplateSystemSignalRef=DET_MH_CYCLE_COUNTER_065_068_Rx
          DET_SUPER_RES_TARGET_068_Rx_oRDR_FUSION_DET_065_068_oPCAN_RADAR_4f13b580_Rx: ComBitPosition=423, ComBitSize=1, ComSignalType=BOOLEAN, ComHandleId=1484, ComSystemTemplateSystemSignalRef=DET_SUPER_RES_TARGET_068_Rx
          DET_ELEVATION_ERR_065_Rx_oRDR_FUSION_DET_065_068_oPCAN_RADAR_ab7a089f_Rx: ComBitPosition=80, ComBitSize=6, ComSignalType=UINT8, ComHandleId=1430, ComSystemTemplateSystemSignalRef=DET_ELEVATION_ERR_065_Rx
          DET_BELOW_RAIN_THOLD_066_Rx_oRDR_FUSION_DET_065_068_oPCAN_RADAR_c7fab7f1_Rx: ComBitPosition=151, ComBitSize=1, ComSignalType=BOOLEAN, ComHandleId=1411, ComSystemTemplateSystemSignalRef=DET_BELOW_RAIN_THOLD_066_Rx
          DET_BI_STATIC_FLAG_067_Rx_oRDR_FUSION_DET_065_068_oPCAN_RADAR_1f208ea5_Rx: ComBitPosition=328, ComBitSize=1, ComSignalType=BOOLEAN, ComHandleId=1416, ComSystemTemplateSystemSignalRef=DET_BI_STATIC_FLAG_067_Rx
          DET_RANGE_ERR_067_Rx_oRDR_FUSION_DET_065_068_oPCAN_RADAR_4d300ac4_Rx: ComBitPosition=264, ComBitSize=7, ComSignalType=UINT8, ComHandleId=1463, ComSystemTemplateSystemSignalRef=DET_RANGE_ERR_067_Rx
          DET_AZIMUTH_ERR_067_Rx_oRDR_FUSION_DET_065_068_oPCAN_RADAR_0c6d7b81_Rx: ComBitPosition=329, ComBitSize=7, ComSignalType=UINT8, ComHandleId=1408, ComSystemTemplateSystemSignalRef=DET_AZIMUTH_ERR_067_Rx
          DET_BI_STATIC_FLAG_065_Rx_oRDR_FUSION_DET_065_068_oPCAN_RADAR_9ad8ac6a_Rx: ComBitPosition=104, ComBitSize=1, ComSignalType=BOOLEAN, ComHandleId=1414, ComSystemTemplateSystemSignalRef=DET_BI_STATIC_FLAG_065_Rx
          DET_MTD_067_Rx_oRDR_FUSION_DET_065_068_oPCAN_RADAR_8c0670b2_Rx: ComBitPosition=271, ComBitSize=1, ComSignalType=BOOLEAN, ComHandleId=1451, ComSystemTemplateSystemSignalRef=DET_MTD_067_Rx
          DET_MH_CRC16_065_068_Rx_oRDR_FUSION_DET_065_068_oPCAN_RADAR_00da0901_Rx: ComBitPosition=0, ComBitSize=16, ComSignalType=UINT16, ComHandleId=1446, ComSystemTemplateSystemSignalRef=DET_MH_CRC16_065_068_Rx
          DET_SNR_068_Rx_oRDR_FUSION_DET_065_068_oPCAN_RADAR_84e89480_Rx: ComBitPosition=456, ComBitSize=8, ComSignalType=UINT8, ComHandleId=1480, ComSystemTemplateSystemSignalRef=DET_SNR_068_Rx
          DET_CONFD_AZIMUTH_066_Rx_oRDR_FUSION_DET_065_068_oPCAN_RADAR_530df6b6_Rx: ComBitPosition=230, ComBitSize=2, ComSignalType=UINT8, ComHandleId=1419, ComSystemTemplateSystemSignalRef=DET_CONFD_AZIMUTH_066_Rx
          DET_SUPER_RES_TARGET_065_Rx_oRDR_FUSION_DET_065_068_oPCAN_RADAR_4aa5e5e7_Rx: ComBitPosition=87, ComBitSize=1, ComSignalType=BOOLEAN, ComHandleId=1481, ComSystemTemplateSystemSignalRef=DET_SUPER_RES_TARGET_065_Rx
          DET_IDM_067_Rx_oRDR_FUSION_DET_065_068_oPCAN_RADAR_318546c2_Rx: ComBitPosition=287, ComBitSize=1, ComSignalType=BOOLEAN, ComHandleId=1444, ComSystemTemplateSystemSignalRef=DET_IDM_067_Rx
          DET_RANGE_VELOCITY_067_Rx_oRDR_FUSION_DET_065_068_oPCAN_RADAR_c03705da_Rx: ComBitPosition=272, ComBitSize=15, ComSignalType=UINT16, ComHandleId=1467, ComSystemTemplateSystemSignalRef=DET_RANGE_VELOCITY_067_Rx
          DET_SNR_066_Rx_oRDR_FUSION_DET_065_068_oPCAN_RADAR_abe2746f_Rx: ComBitPosition=232, ComBitSize=8, ComSignalType=UINT8, ComHandleId=1478, ComSystemTemplateSystemSignalRef=DET_SNR_066_Rx
          DET_PROB_1STAZHYPO_068_Rx_oRDR_FUSION_DET_065_068_oPCAN_RADAR_c6311c9b_Rx: ComBitPosition=439, ComBitSize=1, ComSignalType=BOOLEAN, ComHandleId=1456, ComSystemTemplateSystemSignalRef=DET_PROB_1STAZHYPO_068_Rx
          DET_RANGE_VELOCITY_ERR_065_Rx_oRDR_FUSION_DET_065_068_oPCAN_RADAR_dcab57d7_Rx: ComBitPosition=64, ComBitSize=8, ComSignalType=UINT8, ComHandleId=1469, ComSystemTemplateSystemSignalRef=DET_RANGE_VELOCITY_ERR_065_Rx
          DET_AZIMUTH_ERR_065_Rx_oRDR_FUSION_DET_065_068_oPCAN_RADAR_8995594e_Rx: ComBitPosition=105, ComBitSize=7, ComSignalType=UINT8, ComHandleId=1406, ComSystemTemplateSystemSignalRef=DET_AZIMUTH_ERR_065_Rx
          DET_RANGE_VELOCITY_065_Rx_oRDR_FUSION_DET_065_068_oPCAN_RADAR_45cf2715_Rx: ComBitPosition=48, ComBitSize=15, ComSignalType=UINT16, ComHandleId=1465, ComSystemTemplateSystemSignalRef=DET_RANGE_VELOCITY_065_Rx
          DET_RCS_066_Rx_oRDR_FUSION_DET_065_068_oPCAN_RADAR_a2b80586_Rx: ComBitPosition=240, ComBitSize=8, ComSignalType=UINT8, ComHandleId=1474, ComSystemTemplateSystemSignalRef=DET_RCS_066_Rx
          DET_AZIMUTH_ERR_066_Rx_oRDR_FUSION_DET_065_068_oPCAN_RADAR_a329e9c6_Rx: ComBitPosition=217, ComBitSize=7, ComSignalType=UINT8, ComHandleId=1407, ComSystemTemplateSystemSignalRef=DET_AZIMUTH_ERR_066_Rx
          DET_BELOW_RAIN_THOLD_068_Rx_oRDR_FUSION_DET_065_068_oPCAN_RADAR_e8f0571e_Rx: ComBitPosition=375, ComBitSize=1, ComSignalType=BOOLEAN, ComHandleId=1413, ComSystemTemplateSystemSignalRef=DET_BELOW_RAIN_THOLD_068_Rx
          DET_EXISTENCE_PROB_067_Rx_oRDR_FUSION_DET_065_068_oPCAN_RADAR_d99a52c5_Rx: ComBitPosition=336, ComBitSize=6, ComSignalType=UINT8, ComHandleId=1436, ComSystemTemplateSystemSignalRef=DET_EXISTENCE_PROB_067_Rx
          DET_AZIMUTH_066_Rx_oRDR_FUSION_DET_065_068_oPCAN_RADAR_a1404844_Rx: ComBitPosition=200, ComBitSize=13, ComSignalType=UINT16, ComHandleId=1403, ComSystemTemplateSystemSignalRef=DET_AZIMUTH_066_Rx
          DET_MH_SCAN_INDEX_4LSB_065_068_Rx_oRDR_FUSION_DET_065_068_oPCAN_RADAR_69b1fbff_Rx: ComBitPosition=476, ComBitSize=4, ComSignalType=UINT8, ComHandleId=1448, ComSystemTemplateSystemSignalRef=DET_MH_SCAN_INDEX_4LSB_065_068_Rx
          DET_RANGE_066_Rx_oRDR_FUSION_DET_065_068_oPCAN_RADAR_b2861463_Rx: ComBitPosition=136, ComBitSize=15, ComSignalType=UINT16, ComHandleId=1458, ComSystemTemplateSystemSignalRef=DET_RANGE_066_Rx
          DET_RANGE_ERR_068_Rx_oRDR_FUSION_DET_065_068_oPCAN_RADAR_cd7e786c_Rx: ComBitPosition=376, ComBitSize=7, ComSignalType=UINT8, ComHandleId=1464, ComSystemTemplateSystemSignalRef=DET_RANGE_ERR_068_Rx
          DET_MTD_065_Rx_oRDR_FUSION_DET_065_068_oPCAN_RADAR_09fe527d_Rx: ComBitPosition=47, ComBitSize=1, ComSignalType=BOOLEAN, ComHandleId=1449, ComSystemTemplateSystemSignalRef=DET_MTD_065_Rx
          DET_PROB_1STAZHYPO_067_Rx_oRDR_FUSION_DET_065_068_oPCAN_RADAR_467f6e33_Rx: ComBitPosition=327, ComBitSize=1, ComSignalType=BOOLEAN, ComHandleId=1455, ComSystemTemplateSystemSignalRef=DET_PROB_1STAZHYPO_067_Rx
          DET_EXISTENCE_PROB_066_Rx_oRDR_FUSION_DET_065_068_oPCAN_RADAR_76dec082_Rx: ComBitPosition=224, ComBitSize=6, ComSignalType=UINT8, ComHandleId=1435, ComSystemTemplateSystemSignalRef=DET_EXISTENCE_PROB_066_Rx
          DET_SUPER_RES_TARGET_067_Rx_oRDR_FUSION_DET_065_068_oPCAN_RADAR_cf5dc728_Rx: ComBitPosition=311, ComBitSize=1, ComSignalType=BOOLEAN, ComHandleId=1483, ComSystemTemplateSystemSignalRef=DET_SUPER_RES_TARGET_067_Rx
          DET_ELEVATION_ERR_068_Rx_oRDR_FUSION_DET_065_068_oPCAN_RADAR_aecc58f8_Rx: ComBitPosition=416, ComBitSize=6, ComSignalType=UINT8, ComHandleId=1433, ComSystemTemplateSystemSignalRef=DET_ELEVATION_ERR_068_Rx
          DET_ELEVATION_067_Rx_oRDR_FUSION_DET_065_068_oPCAN_RADAR_fc3b088f_Rx: ComBitPosition=296, ComBitSize=8, ComSignalType=UINT8, ComHandleId=1428, ComSystemTemplateSystemSignalRef=DET_ELEVATION_067_Rx
          DET_IDM_068_Rx_oRDR_FUSION_DET_065_068_oPCAN_RADAR_b1cb346a_Rx: ComBitPosition=399, ComBitSize=1, ComSignalType=BOOLEAN, ComHandleId=1445, ComSystemTemplateSystemSignalRef=DET_IDM_068_Rx
          DET_RANGE_VELOCITY_ERR_067_Rx_oRDR_FUSION_DET_065_068_oPCAN_RADAR_59537518_Rx: ComBitPosition=288, ComBitSize=8, ComSignalType=UINT8, ComHandleId=1471, ComSystemTemplateSystemSignalRef=DET_RANGE_VELOCITY_ERR_067_Rx
          DET_SUPER_RES_TARGET_066_Rx_oRDR_FUSION_DET_065_068_oPCAN_RADAR_6019556f_Rx: ComBitPosition=199, ComBitSize=1, ComSignalType=BOOLEAN, ComHandleId=1482, ComSystemTemplateSystemSignalRef=DET_SUPER_RES_TARGET_066_Rx
          DET_HVC_FLAG_066_Rx_oRDR_FUSION_DET_065_068_oPCAN_RADAR_ab002dcd_Rx: ComBitPosition=198, ComBitSize=1, ComSignalType=BOOLEAN, ComHandleId=1439, ComSystemTemplateSystemSignalRef=DET_HVC_FLAG_066_Rx
          DET_BI_STATIC_FLAG_066_Rx_oRDR_FUSION_DET_065_068_oPCAN_RADAR_b0641ce2_Rx: ComBitPosition=216, ComBitSize=1, ComSignalType=BOOLEAN, ComHandleId=1415, ComSystemTemplateSystemSignalRef=DET_BI_STATIC_FLAG_066_Rx
          DET_ELEVATION_ERR_066_Rx_oRDR_FUSION_DET_065_068_oPCAN_RADAR_81c6b817_Rx: ComBitPosition=192, ComBitSize=6, ComSignalType=UINT8, ComHandleId=1431, ComSystemTemplateSystemSignalRef=DET_ELEVATION_ERR_066_Rx
          DET_CONFD_ELEVATION_066_Rx_oRDR_FUSION_DET_065_068_oPCAN_RADAR_592c7531_Rx: ComBitPosition=213, ComBitSize=2, ComSignalType=UINT8, ComHandleId=1423, ComSystemTemplateSystemSignalRef=DET_CONFD_ELEVATION_066_Rx
          DET_AZIMUTH_068_Rx_oRDR_FUSION_DET_065_068_oPCAN_RADAR_8e4aa8ab_Rx: ComBitPosition=424, ComBitSize=13, ComSignalType=UINT16, ComHandleId=1405, ComSystemTemplateSystemSignalRef=DET_AZIMUTH_068_Rx
