[part 8 of 20: package /ActiveEcuC]
AUTOSAR XML (schema 00053)
package /ActiveEcuC  (continued)
  module config Com: implementation-config-variant=VARIANT-PRE-COMPILE, module-description=Com_Impl  (continued)
    ComConfig: ComConfigurationId=0, ComRxImmediateNotificationCacheSize=0, ComRxDeferredNotificationCacheSize=1  (continued)
      109 x ComSignalGroup, all with ComSignalGroupAccess=ACCESS_NEEDED_BY_SWC_OR_COM, ComSignalGroupArrayAccess=true:  (continued)
        SG_Detections_345_348_oRDR_DETECTION_345_348_oPCAN_RADAR_03988697_Tx: ComTransferProperty=TRIGGERED, ComHandleId=88, ComSystemTemplateSignalGroupRef=SG_Detections_345_348
          83 x ComGroupSignal, all with ComSignalEndianness=LITTLE_ENDIAN, ComTransferProperty=PENDING, ComSignalAccess=ACCESS_NEEDED_BY_SWC_OR_COM:
            DET_BI_STATIC_FLAG_346_oRDR_DETECTION_345_348_oPCAN_RADAR_a427da8a_Tx: ComBitPosition=216, ComBitSize=1, ComSignalInitValue=0, ComSignalType=BOOLEAN, ComHandleId=7212, ComSystemTemplateSystemSignalRef=DET_BI_STATIC_FLAG_346
            DET_CONFD_AZIMUTH_346_oRDR_DETECTION_345_348_oPCAN_RADAR_f0ed90c5_Tx: ComBitPosition=230, ComBitSize=2, ComSignalInitValue=0, ComSignalType=UINT8, ComHandleId=7216, ComSystemTemplateSystemSignalRef=DET_CONFD_AZIMUTH_346
            DET_RANGE_VELOCITY_345_oRDR_DETECTION_345_348_oPCAN_RADAR_f3d6506f_Tx: ComBitPosition=48, ComBitSize=15, ComSignalInitValue=16384, ComSignalType=UINT16, ComHandleId=7262, ComSystemTemplateSystemSignalRef=DET_RANGE_VELOCITY_345
            DET_RANGE_346_oRDR_DETECTION_345_348_oPCAN_RADAR_e290e9b4_Tx: ComBitPosition=136, ComBitSize=15, ComSignalInitValue=0, ComSignalType=UINT16, ComHandleId=7255, ComSystemTemplateSystemSignalRef=DET_RANGE_346
            DET_SUPER_RES_TARGET_345_oRDR_DETECTION_345_348_oPCAN_RADAR_98611b52_Tx: ComBitPosition=87, ComBitSize=1, ComSignalInitValue=0, ComSignalType=BOOLEAN, ComHandleId=7278, ComSystemTemplateSystemSignalRef=DET_SUPER_RES_TARGET_345
            DET_AZIMUTH_ERR_348_oRDR_DETECTION_345_348_oPCAN_RADAR_efde4928_Tx: ComBitPosition=441, ComBitSize=7, ComSignalInitValue=0, ComSignalType=UINT8, ComHandleId=7206, ComSystemTemplateSystemSignalRef=DET_AZIMUTH_ERR_348
            DET_HVC_FLAG_348_oRDR_DETECTION_345_348_oPCAN_RADAR_2e0aadbb_Tx: ComBitPosition=422, ComBitSize=1, ComSignalInitValue=0, ComSignalType=BOOLEAN, ComHandleId=7238, ComSystemTemplateSystemSignalRef=DET_HVC_FLAG_348
            DET_AZIMUTH_348_oRDR_DETECTION_345_348_oPCAN_RADAR_4b6bdcdd_Tx: ComBitPosition=424, ComBitSize=13, ComSignalInitValue=0, ComSignalType=UINT16, ComHandleId=7202, ComSystemTemplateSystemSignalRef=DET_AZIMUTH_348
            DET_RANGE_VELOCITY_346_oRDR_DETECTION_345_348_oPCAN_RADAR_97362b91_Tx: ComBitPosition=160, ComBitSize=15, ComSignalInitValue=16384, ComSignalType=UINT16, ComHandleId=7263, ComSystemTemplateSystemSignalRef=DET_RANGE_VELOCITY_346
            DET_RCS_348_oRDR_DETECTION_345_348_oPCAN_RADAR_a9d65a19_Tx: ComBitPosition=464, ComBitSize=8, ComSignalInitValue=128, ComSignalType=UINT8, ComHandleId=7273, ComSystemTemplateSystemSignalRef=DET_RCS_348
            DET_SNR_346_oRDR_DETECTION_345_348_oPCAN_RADAR_cd1848c9_Tx: ComBitPosition=232, ComBitSize=8, ComSignalInitValue=0, ComSignalType=UINT8, ComHandleId=7275, ComSystemTemplateSystemSignalRef=DET_SNR_346
            DET_ELEVATION_345_oRDR_DETECTION_345_348_oPCAN_RADAR_47583efd_Tx: ComBitPosition=72, ComBitSize=8, ComSignalInitValue=0, ComSignalType=UINT8, ComHandleId=7223, ComSystemTemplateSystemSignalRef=DET_ELEVATION_345
            DET_RANGE_345_oRDR_DETECTION_345_348_oPCAN_RADAR_8670924a_Tx: ComBitPosition=24, ComBitSize=15, ComSignalInitValue=0, ComSignalType=UINT16, ComHandleId=7254, ComSystemTemplateSystemSignalRef=DET_RANGE_345
            DET_RANGE_347_oRDR_DETECTION_345_348_oPCAN_RADAR_77e03d21_Tx: ComBitPosition=248, ComBitSize=15, ComSignalInitValue=0, ComSignalType=UINT16, ComHandleId=7256, ComSystemTemplateSystemSignalRef=DET_RANGE_347
            DET_CONFD_AZIMUTH_348_oRDR_DETECTION_345_348_oPCAN_RADAR_498dd617_Tx: ComBitPosition=454, ComBitSize=2, ComSignalInitValue=0, ComSignalType=UINT8, ComHandleId=7218, ComSystemTemplateSystemSignalRef=DET_CONFD_AZIMUTH_348
            DET_RANGE_VELOCITY_347_oRDR_DETECTION_345_348_oPCAN_RADAR_0246ff04_Tx: ComBitPosition=272, ComBitSize=15, ComSignalInitValue=16384, ComSignalType=UINT16, ComHandleId=7264, ComSystemTemplateSystemSignalRef=DET_RANGE_VELOCITY_347
            DET_CONFD_AZIMUTH_345_oRDR_DETECTION_345_348_oPCAN_RADAR_940deb3b_Tx: ComBitPosition=118, ComBitSize=2, ComSignalInitValue=0, ComSignalType=UINT8, ComHandleId=7215, ComSystemTemplateSystemSignalRef=DET_CONFD_AZIMUTH_345
            DET_CONFD_ELEVATION_347_oRDR_DETECTION_345_348_oPCAN_RADAR_670845aa_Tx: ComBitPosition=325, ComBitSize=2, ComSignalInitValue=0, ComSignalType=UINT8, ComHandleId=7221, ComSystemTemplateSystemSignalRef=DET_CONFD_ELEVATION_347
            DET_EXISTENCE_PROB_345_oRDR_DETECTION_345_348_oPCAN_RADAR_12fed3e8_Tx: ComBitPosition=112, ComBitSize=6, ComSignalInitValue=0, ComSignalType=UINT8, ComHandleId=7231, ComSystemTemplateSystemSignalRef=DET_EXISTENCE_PROB_345
            DET_CONFD_ELEVATION_348_oRDR_DETECTION_345_348_oPCAN_RADAR_4b18d7ed_Tx: ComBitPosition=437, ComBitSize=2, ComSignalInitValue=0, ComSignalType=UINT8, ComHandleId=7222, ComSystemTemplateSystemSignalRef=DET_CONFD_ELEVATION_348
            DET_ELEVATION_346_oRDR_DETECTION_345_348_oPCAN_RADAR_23b84503_Tx: ComBitPosition=184, ComBitSize=8, ComSignalInitValue=0, ComSignalType=UINT8, ComHandleId=7224, ComSystemTemplateSystemSignalRef=DET_ELEVATION_346
            DET_RANGE_VELOCITY_ERR_346_oRDR_DETECTION_345_348_oPCAN_RADAR_988dd023_Tx: ComBitPosition=176, ComBitSize=8, ComSignalInitValue=0, ComSignalType=UINT8, ComHandleId=7267, ComSystemTemplateSystemSignalRef=DET_RANGE_VELOCITY_ERR_346
            DET_AZIMUTH_347_oRDR_DETECTION_345_348_oPCAN_RADAR_677b4e9a_Tx: ComBitPosition=312, ComBitSize=13, ComSignalInitValue=0, ComSignalType=UINT16, ComHandleId=7201, ComSystemTemplateSystemSignalRef=DET_AZIMUTH_347
            DET_ELEVATION_ERR_347_oRDR_DETECTION_345_348_oPCAN_RADAR_31f109e3_Tx: ComBitPosition=304, ComBitSize=6, ComSignalInitValue=0, ComSignalType=UINT8, ComHandleId=7229, ComSystemTemplateSystemSignalRef=DET_ELEVATION_ERR_347
            DET_SNR_348_oRDR_DETECTION_345_348_oPCAN_RADAR_74780e1b_Tx: ComBitPosition=456, ComBitSize=8, ComSignalInitValue=0, ComSignalType=UINT8, ComHandleId=7277, ComSystemTemplateSystemSignalRef=DET_SNR_348
            DET_RANGE_VELOCITY_ERR_347_oRDR_DETECTION_345_348_oPCAN_RADAR_0dfd04b6_Tx: ComBitPosition=288, ComBitSize=8, ComSignalInitValue=0, ComSignalType=UINT8, ComHandleId=7268, ComSystemTemplateSystemSignalRef=DET_RANGE_VELOCITY_ERR_347
            DET_SUPER_RES_TARGET_346_oRDR_DETECTION_345_348_oPCAN_RADAR_fc8160ac_Tx: ComBitPosition=199, ComBitSize=1, ComSignalInitValue=0, ComSignalType=BOOLEAN, ComHandleId=7279, ComSystemTemplateSystemSignalRef=DET_SUPER_RES_TARGET_346
            DET_ELEVATION_ERR_345_oRDR_DETECTION_345_348_oPCAN_RADAR_c061a688_Tx: ComBitPosition=80, ComBitSize=6, ComSignalInitValue=0, ComSignalType=UINT8, ComHandleId=7227, ComSystemTemplateSystemSignalRef=DET_ELEVATION_ERR_345
            DET_RANGE_VELOCITY_ERR_345_oRDR_DETECTION_345_348_oPCAN_RADAR_fc6dabdd_Tx: ComBitPosition=64, ComBitSize=8, ComSignalInitValue=0, ComSignalType=UINT8, ComHandleId=7266, ComSystemTemplateSystemSignalRef=DET_RANGE_VELOCITY_ERR_345
            DET_SUPER_RES_TARGET_348_oRDR_DETECTION_345_348_oPCAN_RADAR_45e1267e_Tx: ComBitPosition=423, ComBitSize=1, ComSignalInitValue=0, ComSignalType=BOOLEAN, ComHandleId=7281, ComSystemTemplateSystemSignalRef=DET_SUPER_RES_TARGET_348
            DET_BI_STATIC_FLAG_348_oRDR_DETECTION_345_348_oPCAN_RADAR_1d479c58_Tx: ComBitPosition=440, ComBitSize=1, ComSignalInitValue=0, ComSignalType=BOOLEAN, ComHandleId=7214, ComSystemTemplateSystemSignalRef=DET_BI_STATIC_FLAG_348
            DET_RANGE_VELOCITY_348_oRDR_DETECTION_345_348_oPCAN_RADAR_2e566d43_Tx: ComBitPosition=384, ComBitSize=15, ComSignalInitValue=16384, ComSignalType=UINT16, ComHandleId=7265, ComSystemTemplateSystemSignalRef=DET_RANGE_VELOCITY_348
            DET_AZIMUTH_345_oRDR_DETECTION_345_348_oPCAN_RADAR_96ebe1f1_Tx: ComBitPosition=88, ComBitSize=13, ComSignalInitValue=0, ComSignalType=UINT16, ComHandleId=7199, ComSystemTemplateSystemSignalRef=DET_AZIMUTH_345
            DET_AZIMUTH_ERR_347_oRDR_DETECTION_345_348_oPCAN_RADAR_c3cedb6f_Tx: ComBitPosition=329, ComBitSize=7, ComSignalInitValue=0, ComSignalType=UINT8, ComHandleId=7205, ComSystemTemplateSystemSignalRef=DET_AZIMUTH_ERR_347
            DET_MH_CYCLE_COUNTER_345_348_oRDR_DETECTION_345_348_oPCAN_RADAR_0365f5ab_Tx: ComBitPosition=16, ComBitSize=8, ComSignalInitValue=0, ComSignalType=UINT8, ComHandleId=7244, ComSystemTemplateSystemSignalRef=DET_MH_CYCLE_COUNTER_345_348
            DET_RANGE_348_oRDR_DETECTION_345_348_oPCAN_RADAR_5bf0af66_Tx: ComBitPosition=360, ComBitSize=15, ComSignalInitValue=0, ComSignalType=UINT16, ComHandleId=7257, ComSystemTemplateSystemSignalRef=DET_RANGE_348
            DET_SUPER_RES_TARGET_347_oRDR_DETECTION_345_348_oPCAN_RADAR_69f1b439_Tx: ComBitPosition=311, ComBitSize=1, ComSignalInitValue=0, ComSignalType=BOOLEAN, ComHandleId=7280, ComSystemTemplateSystemSignalRef=DET_SUPER_RES_TARGET_347
            DET_RANGE_ERR_346_oRDR_DETECTION_345_348_oPCAN_RADAR_457853dd_Tx: ComBitPosition=152, ComBitSize=7, ComSignalInitValue=0, ComSignalType=UINT8, ComHandleId=7259, ComSystemTemplateSystemSignalRef=DET_RANGE_ERR_346
            DET_AZIMUTH_346_oRDR_DETECTION_345_348_oPCAN_RADAR_f20b9a0f_Tx: ComBitPosition=200, ComBitSize=13, ComSignalInitValue=0, ComSignalType=UINT16, ComHandleId=7200, ComSystemTemplateSystemSignalRef=DET_AZIMUTH_346
            DET_RANGE_ERR_347_oRDR_DETECTION_345_348_oPCAN_RADAR_d0088748_Tx: ComBitPosition=264, ComBitSize=7, ComSignalInitValue=0, ComSignalType=UINT8, ComHandleId=7260, ComSystemTemplateSystemSignalRef=DET_RANGE_ERR_347
            DET_MH_CRC16_345_348_oRDR_DETECTION_345_348_oPCAN_RADAR_8710549c_Tx: ComBitPosition=0, ComBitSize=16, ComSignalInitValue=0, ComSignalType=UINT16, ComHandleId=7243, ComSystemTemplateSystemSignalRef=DET_MH_CRC16_345_348
            DET_RANGE_ERR_348_oRDR_DETECTION_345_348_oPCAN_RADAR_fc18150f_Tx: ComBitPosition=376, ComBitSize=7, ComSignalInitValue=0, ComSignalType=UINT8, ComHandleId=7261, ComSystemTemplateSystemSignalRef=DET_RANGE_ERR_348
            DET_ELEVATION_347_oRDR_DETECTION_345_348_oPCAN_RADAR_b6c89196_Tx: ComBitPosition=296, ComBitSize=8, ComSignalInitValue=0, ComSignalType=UINT8, ComHandleId=7225, ComSystemTemplateSystemSignalRef=DET_ELEVATION_347
            DET_MH_SCAN_INDEX_4LSB_345_348_oRDR_DETECTION_345_348_oPCAN_RADAR_cf4fd027_Tx: ComBitPosition=476, ComBitSize=4, ComSignalInitValue=0, ComSignalType=UINT8, ComHandleId=7245, ComSystemTemplateSystemSignalRef=DET_MH_SCAN_INDEX_4LSB_345_348
            DET_RCS_345_oRDR_DETECTION_345_348_oPCAN_RADAR_74566735_Tx: ComBitPosition=128, ComBitSize=8, ComSignalInitValue=128, ComSignalType=UINT8, ComHandleId=7270, ComSystemTemplateSystemSignalRef=DET_RCS_345
            DET_HVC_FLAG_345_oRDR_DETECTION_345_348_oPCAN_RADAR_f38a9097_Tx: ComBitPosition=86, ComBitSize=1, ComSignalInitValue=0, ComSignalType=BOOLEAN, ComHandleId=7235, ComSystemTemplateSystemSignalRef=DET_HVC_FLAG_345
            DET_BI_STATIC_FLAG_347_oRDR_DETECTION_345_348_oPCAN_RADAR_31570e1f_Tx: ComBitPosition=328, ComBitSize=1, ComSignalInitValue=0, ComSignalType=BOOLEAN, ComHandleId=7213, ComSystemTemplateSystemSignalRef=DET_BI_STATIC_FLAG_347
            DET_CONFD_ELEVATION_345_oRDR_DETECTION_345_348_oPCAN_RADAR_9698eac1_Tx: ComBitPosition=101, ComBitSize=2, ComSignalInitValue=0, ComSignalType=UINT8, ComHandleId=7219, ComSystemTemplateSystemSignalRef=DET_CONFD_ELEVATION_345
            DET_EXISTENCE_PROB_348_oRDR_DETECTION_345_348_oPCAN_RADAR_cf7eeec4_Tx: ComBitPosition=448, ComBitSize=6, ComSignalInitValue=0, ComSignalType=UINT8, ComHandleId=7234, ComSystemTemplateSystemSignalRef=DET_EXISTENCE_PROB_348
            DET_SNR_347_oRDR_DETECTION_345_348_oPCAN_RADAR_58689c5c_Tx: ComBitPosition=344, ComBitSize=8, ComSignalInitValue=0, ComSignalType=UINT8, ComHandleId=7276, ComSystemTemplateSystemSignalRef=DET_SNR_347
            DET_SNR_345_oRDR_DETECTION_345_348_oPCAN_RADAR_a9f83337_Tx: ComBitPosition=120, ComBitSize=8, ComSignalInitValue=0, ComSignalType=UINT8, ComHandleId=7274, ComSystemTemplateSystemSignalRef=DET_SNR_345
            DET_EXISTENCE_PROB_346_oRDR_DETECTION_345_348_oPCAN_RADAR_761ea816_Tx: ComBitPosition=224, ComBitSize=6, ComSignalInitValue=0, ComSignalType=UINT8, ComHandleId=7232, ComSystemTemplateSystemSignalRef=DET_EXISTENCE_PROB_346
            DET_BI_STATIC_FLAG_345_oRDR_DETECTION_345_348_oPCAN_RADAR_c0c7a174_Tx: ComBitPosition=104, ComBitSize=1, ComSignalInitValue=0, ComSignalType=BOOLEAN, ComHandleId=7211, ComSystemTemplateSystemSignalRef=DET_BI_STATIC_FLAG_345
            DET_AZIMUTH_ERR_345_oRDR_DETECTION_345_348_oPCAN_RADAR_325e7404_Tx: ComBitPosition=105, ComBitSize=7, ComSignalInitValue=0, ComSignalType=UINT8, ComHandleId=7203, ComSystemTemplateSystemSignalRef=DET_AZIMUTH_ERR_345
            DET_HVC_FLAG_346_oRDR_DETECTION_345_348_oPCAN_RADAR_976aeb69_Tx: ComBitPosition=198, ComBitSize=1, ComSignalInitValue=0, ComSignalType=BOOLEAN, ComHandleId=7236, ComSystemTemplateSystemSignalRef=DET_HVC_FLAG_346
            DET_RANGE_VELOCITY_ERR_348_oRDR_DETECTION_345_348_oPCAN_RADAR_21ed96f1_Tx: ComBitPosition=400, ComBitSize=8, ComSignalInitValue=0, ComSignalType=UINT8, ComHandleId=7269, ComSystemTemplateSystemSignalRef=DET_RANGE_VELOCITY_ERR_348
            DET_ELEVATION_ERR_348_oRDR_DETECTION_345_348_oPCAN_RADAR_1de19ba4_Tx: ComBitPosition=416, ComBitSize=6, ComSignalInitValue=0, ComSignalType=UINT8, ComHandleId=7230, ComSystemTemplateSystemSignalRef=DET_ELEVATION_ERR_348
            DET_EXISTENCE_PROB_347_oRDR_DETECTION_345_348_oPCAN_RADAR_e36e7c83_Tx: ComBitPosition=336, ComBitSize=6, ComSignalInitValue=0, ComSignalType=UINT8, ComHandleId=7233, ComSystemTemplateSystemSignalRef=DET_EXISTENCE_PROB_347
            DET_RCS_347_oRDR_DETECTION_345_348_oPCAN_RADAR_85c6c85e_Tx: ComBitPosition=352, ComBitSize=8, ComSignalInitValue=128, ComSignalType=UINT8, ComHandleId=7272, ComSystemTemplateSystemSignalRef=DET_RCS_347
            DET_HVC_FLAG_347_oRDR_DETECTION_345_348_oPCAN_RADAR_021a3ffc_Tx: ComBitPosition=310, ComBitSize=1, ComSignalInitValue=0, ComSignalType=BOOLEAN, ComHandleId=7237, ComSystemTemplateSystemSignalRef=DET_HVC_FLAG_347
            DET_RANGE_ERR_345_oRDR_DETECTION_345_348_oPCAN_RADAR_21982823_Tx: ComBitPosition=40, ComBitSize=7, ComSignalInitValue=0, ComSignalType=UINT8, ComHandleId=7258, ComSystemTemplateSystemSignalRef=DET_RANGE_ERR_345
            DET_RCS_346_oRDR_DETECTION_345_348_oPCAN_RADAR_10b61ccb_Tx: ComBitPosition=240, ComBitSize=8, ComSignalInitValue=128, ComSignalType=UINT8, ComHandleId=7271, ComSystemTemplateSystemSignalRef=DET_RCS_346
            DET_CONFD_AZIMUTH_347_oRDR_DETECTION_345_348_oPCAN_RADAR_659d4450_Tx: ComBitPosition=342, ComBitSize=2, ComSignalInitValue=0, ComSignalType=UINT8, ComHandleId=7217, ComSystemTemplateSystemSignalRef=DET_CONFD_AZIMUTH_347
            DET_ELEVATION_348_oRDR_DETECTION_345_348_oPCAN_RADAR_9ad803d1_Tx: ComBitPosition=408, ComBitSize=8, ComSignalInitValue=0, ComSignalType=UINT8, ComHandleId=7226, ComSystemTemplateSystemSignalRef=DET_ELEVATION_348
            DET_CONFD_ELEVATION_346_oRDR_DETECTION_345_348_oPCAN_RADAR_f278913f_Tx: ComBitPosition=213, ComBitSize=2, ComSignalInitValue=0, ComSignalType=UINT8, ComHandleId=7220, ComSystemTemplateSystemSignalRef=DET_CONFD_ELEVATION_346
            DET_ELEVATION_ERR_346_oRDR_DETECTION_345_348_oPCAN_RADAR_a481dd76_Tx: ComBitPosition=192, ComBitSize=6, ComSignalInitValue=0, ComSignalType=UINT8, ComHandleId=7228, ComSystemTemplateSystemSignalRef=DET_ELEVATION_ERR_346
            DET_AZIMUTH_ERR_346_oRDR_DETECTION_345_348_oPCAN_RADAR_56be0ffa_Tx: ComBitPosition=217, ComBitSize=7, ComSignalInitValue=0, ComSignalType=UINT8, ComHandleId=7204, ComSystemTemplateSystemSignalRef=DET_AZIMUTH_ERR_346
            DET_IDM_345_oRDR_DETECTION_345_348_oPCAN_RADAR_78d8ab2a_Tx: ComBitPosition=63, ComBitSize=1, ComSignalInitValue=0, ComSignalType=UINT8, ComHandleId=7239, ComSystemTemplateSystemSignalRef=DET_IDM_345
            DET_BELOW_RAIN_THOLD_345_oRDR_DETECTION_345_348_oPCAN_RADAR_43ea7231_Tx: ComBitPosition=39, ComBitSize=1, ComSignalInitValue=0, ComSignalType=UINT8, ComHandleId=7207, ComSystemTemplateSystemSignalRef=DET_BELOW_RAIN_THOLD_345
            DET_MTD_348_oRDR_DETECTION_345_348_oPCAN_RADAR_c3eba4dd_Tx: ComBitPosition=383, ComBitSize=1, ComSignalInitValue=0, ComSignalType=UINT8, ComHandleId=7249, ComSystemTemplateSystemSignalRef=DET_MTD_348
            DET_PROB_1STAZHYPO_346_oRDR_DETECTION_345_348_oPCAN_RADAR_e93f0ac2_Tx: ComBitPosition=215, ComBitSize=1, ComSignalInitValue=0, ComSignalType=BOOLEAN, ComHandleId=7251, ComSystemTemplateSystemSignalRef=DET_PROB_1STAZHYPO_346
            DET_IDM_348_oRDR_DETECTION_345_348_oPCAN_RADAR_a5589606_Tx: ComBitPosition=399, ComBitSize=1, ComSignalInitValue=0, ComSignalType=UINT8, ComHandleId=7242, ComSystemTemplateSystemSignalRef=DET_IDM_348
            DET_BELOW_RAIN_THOLD_348_oRDR_DETECTION_345_348_oPCAN_RADAR_9e6a4f1d_Tx: ComBitPosition=375, ComBitSize=1, ComSignalInitValue=0, ComSignalType=UINT8, ComHandleId=7210, ComSystemTemplateSystemSignalRef=DET_BELOW_RAIN_THOLD_348
            DET_MTD_347_oRDR_DETECTION_345_348_oPCAN_RADAR_effb369a_Tx: ComBitPosition=271, ComBitSize=1, ComSignalInitValue=0, ComSignalType=UINT8, ComHandleId=7248, ComSystemTemplateSystemSignalRef=DET_MTD_347
            DET_IDM_347_oRDR_DETECTION_345_348_oPCAN_RADAR_89480441_Tx: ComBitPosition=287, ComBitSize=1, ComSignalInitValue=0, ComSignalType=UINT8, ComHandleId=7241, ComSystemTemplateSystemSignalRef=DET_IDM_347
            DET_PROB_1STAZHYPO_345_oRDR_DETECTION_345_348_oPCAN_RADAR_8ddf713c_Tx: ComBitPosition=103, ComBitSize=1, ComSignalInitValue=0, ComSignalType=BOOLEAN, ComHandleId=7250, ComSystemTemplateSystemSignalRef=DET_PROB_1STAZHYPO_345
            DET_BELOW_RAIN_THOLD_346_oRDR_DETECTION_345_348_oPCAN_RADAR_270a09cf_Tx: ComBitPosition=151, ComBitSize=1, ComSignalInitValue=0, ComSignalType=UINT8, ComHandleId=7208, ComSystemTemplateSystemSignalRef=DET_BELOW_RAIN_THOLD_346
            DET_BELOW_RAIN_THOLD_347_oRDR_DETECTION_345_348_oPCAN_RADAR_b27add5a_Tx: ComBitPosition=263, ComBitSize=1, ComSignalInitValue=0, ComSignalType=UINT8, ComHandleId=7209, ComSystemTemplateSystemSignalRef=DET_BELOW_RAIN_THOLD_347
            DET_PROB_1STAZHYPO_347_oRDR_DETECTION_345_348_oPCAN_RADAR_7c4fde57_Tx: ComBitPosition=327, ComBitSize=1, ComSignalInitValue=0, ComSignalType=BOOLEAN, ComHandleId=7252, ComSystemTemplateSystemSignalRef=DET_PROB_1STAZHYPO_347
            DET_IDM_346_oRDR_DETECTION_345_348_oPCAN_RADAR_1c38d0d4_Tx: ComBitPosition=175, ComBitSize=1, ComSignalInitValue=0, ComSignalType=UINT8, ComHandleId=7240, ComSystemTemplateSystemSignalRef=DET_IDM_346
            DET_PROB_1STAZHYPO_348_oRDR_DETECTION_345_348_oPCAN_RADAR_505f4c10_Tx: ComBitPosition=439, ComBitSize=1, ComSignalInitValue=0, ComSignalType=BOOLEAN, ComHandleId=7253, ComSystemTemplateSystemSignalRef=DET_PROB_1STAZHYPO_348
            DET_MTD_346_oRDR_DETECTION_345_348_oPCAN_RADAR_7a8be20f_Tx: ComBitPosition=159, ComBitSize=1, ComSignalInitValue=0, ComSignalType=UINT8, ComHandleId=7247, ComSystemTemplateSystemSignalRef=DET_MTD_346
            DET_MTD_345_oRDR_DETECTION_345_348_oPCAN_RADAR_1e6b99f1_Tx: ComBitPosition=47, ComBitSize=1, ComSignalInitValue=0, ComSignalType=UINT8, ComHandleId=7246, ComSystemTemplateSystemSignalRef=DET_MTD_345
        SG_Detections_221_224_oRDR_DETECTION_221_224_oPCAN_RADAR_6f6d708f_Tx: ComTransferProperty=TRIGGERED, ComHandleId=57, ComSystemTemplateSignalGroupRef=SG_Detections_221_224
          83 x ComGroupSignal, all with ComSignalEndianness=LITTLE_ENDIAN, ComTransferProperty=PENDING, ComSignalAccess=ACCESS_NEEDED_BY_SWC_OR_COM:
            DET_BI_STATIC_FLAG_223_oRDR_DETECTION_221_224_oPCAN_RADAR_4158e71d_Tx: ComBitPosition=328, ComBitSize=1, ComSignalInitValue=0, ComSignalType=BOOLEAN, ComHandleId=4640, ComSystemTemplateSystemSignalRef=DET_BI_STATIC_FLAG_223
            DET_RCS_223_oRDR_DETECTION_221_224_oPCAN_RADAR_f5c9215c_Tx: ComBitPosition=352, ComBitSize=8, ComSignalInitValue=128, ComSignalType=UINT8, ComHandleId=4699, ComSystemTemplateSystemSignalRef=DET_RCS_223
            DET_AZIMUTH_224_oRDR_DETECTION_221_224_oPCAN_RADAR_4bc484f1_Tx: ComBitPosition=424, ComBitSize=13, ComSignalInitValue=0, ComSignalType=UINT16, ComHandleId=4629, ComSystemTemplateSystemSignalRef=DET_AZIMUTH_224
            DET_MH_CRC16_221_224_oRDR_DETECTION_221_224_oPCAN_RADAR_ebe5a284_Tx: ComBitPosition=0, ComBitSize=16, ComSignalInitValue=0, ComSignalType=UINT16, ComHandleId=4670, ComSystemTemplateSystemSignalRef=DET_MH_CRC16_221_224
            DET_AZIMUTH_222_oRDR_DETECTION_221_224_oPCAN_RADAR_8204730d_Tx: ComBitPosition=200, ComBitSize=13, ComSignalInitValue=0, ComSignalType=UINT16, ComHandleId=4627, ComSystemTemplateSystemSignalRef=DET_AZIMUTH_222
            DET_HVC_FLAG_224_oRDR_DETECTION_221_224_oPCAN_RADAR_2ea5f597_Tx: ComBitPosition=422, ComBitSize=1, ComSignalInitValue=0, ComSignalType=BOOLEAN, ComHandleId=4665, ComSystemTemplateSystemSignalRef=DET_HVC_FLAG_224
            DET_BI_STATIC_FLAG_222_oRDR_DETECTION_221_224_oPCAN_RADAR_d4283388_Tx: ComBitPosition=216, ComBitSize=1, ComSignalInitValue=0, ComSignalType=BOOLEAN, ComHandleId=4639, ComSystemTemplateSystemSignalRef=DET_BI_STATIC_FLAG_222
            DET_RANGE_224_oRDR_DETECTION_221_224_oPCAN_RADAR_5b5ff74a_Tx: ComBitPosition=360, ComBitSize=15, ComSignalInitValue=0, ComSignalType=UINT16, ComHandleId=4684, ComSystemTemplateSystemSignalRef=DET_RANGE_224
            DET_RCS_222_oRDR_DETECTION_221_224_oPCAN_RADAR_60b9f5c9_Tx: ComBitPosition=240, ComBitSize=8, ComSignalInitValue=128, ComSignalType=UINT8, ComHandleId=4698, ComSystemTemplateSystemSignalRef=DET_RCS_222
            DET_SNR_221_oRDR_DETECTION_221_224_oPCAN_RADAR_d9f7da35_Tx: ComBitPosition=120, ComBitSize=8, ComSignalInitValue=0, ComSignalType=UINT8, ComHandleId=4701, ComSystemTemplateSystemSignalRef=DET_SNR_221
            DET_SNR_224_oRDR_DETECTION_221_224_oPCAN_RADAR_74d75637_Tx: ComBitPosition=456, ComBitSize=8, ComSignalInitValue=0, ComSignalType=UINT8, ComHandleId=4704, ComSystemTemplateSystemSignalRef=DET_SNR_224
            DET_EXISTENCE_PROB_222_oRDR_DETECTION_221_224_oPCAN_RADAR_06114114_Tx: ComBitPosition=224, ComBitSize=6, ComSignalInitValue=0, ComSignalType=UINT8, ComHandleId=4659, ComSystemTemplateSystemSignalRef=DET_EXISTENCE_PROB_222
            DET_CONFD_AZIMUTH_221_oRDR_DETECTION_221_224_oPCAN_RADAR_e4020239_Tx: ComBitPosition=118, ComBitSize=2, ComSignalInitValue=0, ComSignalType=UINT8, ComHandleId=4642, ComSystemTemplateSystemSignalRef=DET_CONFD_AZIMUTH_221
            DET_EXISTENCE_PROB_223_oRDR_DETECTION_221_224_oPCAN_RADAR_93619581_Tx: ComBitPosition=336, ComBitSize=6, ComSignalInitValue=0, ComSignalType=UINT8, ComHandleId=4660, ComSystemTemplateSystemSignalRef=DET_EXISTENCE_PROB_223
            DET_AZIMUTH_ERR_224_oRDR_DETECTION_221_224_oPCAN_RADAR_ef711104_Tx: ComBitPosition=441, ComBitSize=7, ComSignalInitValue=0, ComSignalType=UINT8, ComHandleId=4633, ComSystemTemplateSystemSignalRef=DET_AZIMUTH_ERR_224
            DET_RANGE_ERR_221_oRDR_DETECTION_221_224_oPCAN_RADAR_5197c121_Tx: ComBitPosition=40, ComBitSize=7, ComSignalInitValue=0, ComSignalType=UINT8, ComHandleId=4685, ComSystemTemplateSystemSignalRef=DET_RANGE_ERR_221
            DET_BI_STATIC_FLAG_224_oRDR_DETECTION_221_224_oPCAN_RADAR_1de8c474_Tx: ComBitPosition=440, ComBitSize=1, ComSignalInitValue=0, ComSignalType=BOOLEAN, ComHandleId=4641, ComSystemTemplateSystemSignalRef=DET_BI_STATIC_FLAG_224
            DET_AZIMUTH_ERR_222_oRDR_DETECTION_221_224_oPCAN_RADAR_26b1e6f8_Tx: ComBitPosition=217, ComBitSize=7, ComSignalInitValue=0, ComSignalType=UINT8, ComHandleId=4631, ComSystemTemplateSystemSignalRef=DET_AZIMUTH_ERR_222
            DET_AZIMUTH_ERR_223_oRDR_DETECTION_221_224_oPCAN_RADAR_b3c1326d_Tx: ComBitPosition=329, ComBitSize=7, ComSignalInitValue=0, ComSignalType=UINT8, ComHandleId=4632, ComSystemTemplateSystemSignalRef=DET_AZIMUTH_ERR_223
            DET_RANGE_222_oRDR_DETECTION_221_224_oPCAN_RADAR_929f00b6_Tx: ComBitPosition=136, ComBitSize=15, ComSignalInitValue=0, ComSignalType=UINT16, ComHandleId=4682, ComSystemTemplateSystemSignalRef=DET_RANGE_222
            DET_ELEVATION_ERR_222_oRDR_DETECTION_221_224_oPCAN_RADAR_d48e3474_Tx: ComBitPosition=192, ComBitSize=6, ComSignalInitValue=0, ComSignalType=UINT8, ComHandleId=4655, ComSystemTemplateSystemSignalRef=DET_ELEVATION_ERR_222
            DET_CONFD_AZIMUTH_223_oRDR_DETECTION_221_224_oPCAN_RADAR_1592ad52_Tx: ComBitPosition=342, ComBitSize=2, ComSignalInitValue=0, ComSignalType=UINT8, ComHandleId=4644, ComSystemTemplateSystemSignalRef=DET_CONFD_AZIMUTH_223
            DET_RANGE_VELOCITY_224_oRDR_DETECTION_221_224_oPCAN_RADAR_2ef9356f_Tx: ComBitPosition=384, ComBitSize=15, ComSignalInitValue=16384, ComSignalType=UINT16, ComHandleId=4692, ComSystemTemplateSystemSignalRef=DET_RANGE_VELOCITY_224
            DET_SUPER_RES_TARGET_224_oRDR_DETECTION_221_224_oPCAN_RADAR_454e7e52_Tx: ComBitPosition=423, ComBitSize=1, ComSignalInitValue=0, ComSignalType=BOOLEAN, ComHandleId=4708, ComSystemTemplateSystemSignalRef=DET_SUPER_RES_TARGET_224
            DET_RANGE_ERR_224_oRDR_DETECTION_221_224_oPCAN_RADAR_fcb74d23_Tx: ComBitPosition=376, ComBitSize=7, ComSignalInitValue=0, ComSignalType=UINT8, ComHandleId=4688, ComSystemTemplateSystemSignalRef=DET_RANGE_ERR_224
            DET_RANGE_VELOCITY_ERR_221_oRDR_DETECTION_221_224_oPCAN_RADAR_8c6242df_Tx: ComBitPosition=64, ComBitSize=8, ComSignalInitValue=0, ComSignalType=UINT8, ComHandleId=4693, ComSystemTemplateSystemSignalRef=DET_RANGE_VELOCITY_ERR_221
            DET_RANGE_VELOCITY_223_oRDR_DETECTION_221_224_oPCAN_RADAR_72491606_Tx: ComBitPosition=272, ComBitSize=15, ComSignalInitValue=16384, ComSignalType=UINT16, ComHandleId=4691, ComSystemTemplateSystemSignalRef=DET_RANGE_VELOCITY_223
            DET_AZIMUTH_221_oRDR_DETECTION_221_224_oPCAN_RADAR_e6e408f3_Tx: ComBitPosition=88, ComBitSize=13, ComSignalInitValue=0, ComSignalType=UINT16, ComHandleId=4626, ComSystemTemplateSystemSignalRef=DET_AZIMUTH_221
            DET_EXISTENCE_PROB_221_oRDR_DETECTION_221_224_oPCAN_RADAR_62f13aea_Tx: ComBitPosition=112, ComBitSize=6, ComSignalInitValue=0, ComSignalType=UINT8, ComHandleId=4658, ComSystemTemplateSystemSignalRef=DET_EXISTENCE_PROB_221
            DET_RANGE_221_oRDR_DETECTION_221_224_oPCAN_RADAR_f67f7b48_Tx: ComBitPosition=24, ComBitSize=15, ComSignalInitValue=0, ComSignalType=UINT16, ComHandleId=4681, ComSystemTemplateSystemSignalRef=DET_RANGE_221
            DET_HVC_FLAG_223_oRDR_DETECTION_221_224_oPCAN_RADAR_7215d6fe_Tx: ComBitPosition=310, ComBitSize=1, ComSignalInitValue=0, ComSignalType=BOOLEAN, ComHandleId=4664, ComSystemTemplateSystemSignalRef=DET_HVC_FLAG_223
            DET_SUPER_RES_TARGET_222_oRDR_DETECTION_221_224_oPCAN_RADAR_8c8e89ae_Tx: ComBitPosition=199, ComBitSize=1, ComSignalInitValue=0, ComSignalType=BOOLEAN, ComHandleId=4706, ComSystemTemplateSystemSignalRef=DET_SUPER_RES_TARGET_222
            DET_AZIMUTH_223_oRDR_DETECTION_221_224_oPCAN_RADAR_1774a798_Tx: ComBitPosition=312, ComBitSize=13, ComSignalInitValue=0, ComSignalType=UINT16, ComHandleId=4628, ComSystemTemplateSystemSignalRef=DET_AZIMUTH_223
            DET_RANGE_223_oRDR_DETECTION_221_224_oPCAN_RADAR_07efd423_Tx: ComBitPosition=248, ComBitSize=15, ComSignalInitValue=0, ComSignalType=UINT16, ComHandleId=4683, ComSystemTemplateSystemSignalRef=DET_RANGE_223
            DET_ELEVATION_ERR_224_oRDR_DETECTION_221_224_oPCAN_RADAR_1d4ec388_Tx: ComBitPosition=416, ComBitSize=6, ComSignalInitValue=0, ComSignalType=UINT8, ComHandleId=4657, ComSystemTemplateSystemSignalRef=DET_ELEVATION_ERR_224
            DET_CONFD_AZIMUTH_224_oRDR_DETECTION_221_224_oPCAN_RADAR_49228e3b_Tx: ComBitPosition=454, ComBitSize=2, ComSignalInitValue=0, ComSignalType=UINT8, ComHandleId=4645, ComSystemTemplateSystemSignalRef=DET_CONFD_AZIMUTH_224
            DET_RANGE_ERR_222_oRDR_DETECTION_221_224_oPCAN_RADAR_3577badf_Tx: ComBitPosition=152, ComBitSize=7, ComSignalInitValue=0, ComSignalType=UINT8, ComHandleId=4686, ComSystemTemplateSystemSignalRef=DET_RANGE_ERR_222
            DET_SNR_223_oRDR_DETECTION_221_224_oPCAN_RADAR_2867755e_Tx: ComBitPosition=344, ComBitSize=8, ComSignalInitValue=0, ComSignalType=UINT8, ComHandleId=4703, ComSystemTemplateSystemSignalRef=DET_SNR_223
            DET_HVC_FLAG_221_oRDR_DETECTION_221_224_oPCAN_RADAR_83857995_Tx: ComBitPosition=86, ComBitSize=1, ComSignalInitValue=0, ComSignalType=BOOLEAN, ComHandleId=4662, ComSystemTemplateSystemSignalRef=DET_HVC_FLAG_221
            DET_CONFD_ELEVATION_222_oRDR_DETECTION_221_224_oPCAN_RADAR_8277783d_Tx: ComBitPosition=213, ComBitSize=2, ComSignalInitValue=0, ComSignalType=UINT8, ComHandleId=4647, ComSystemTemplateSystemSignalRef=DET_CONFD_ELEVATION_222
            DET_RCS_221_oRDR_DETECTION_221_224_oPCAN_RADAR_04598e37_Tx: ComBitPosition=128, ComBitSize=8, ComSignalInitValue=128, ComSignalType=UINT8, ComHandleId=4697, ComSystemTemplateSystemSignalRef=DET_RCS_221
            DET_ELEVATION_221_oRDR_DETECTION_221_224_oPCAN_RADAR_3757d7ff_Tx: ComBitPosition=72, ComBitSize=8, ComSignalInitValue=0, ComSignalType=UINT8, ComHandleId=4650, ComSystemTemplateSystemSignalRef=DET_ELEVATION_221
            DET_CONFD_ELEVATION_221_oRDR_DETECTION_221_224_oPCAN_RADAR_e69703c3_Tx: ComBitPosition=101, ComBitSize=2, ComSignalInitValue=0, ComSignalType=UINT8, ComHandleId=4646, ComSystemTemplateSystemSignalRef=DET_CONFD_ELEVATION_221
            DET_SNR_222_oRDR_DETECTION_221_224_oPCAN_RADAR_bd17a1cb_Tx: ComBitPosition=232, ComBitSize=8, ComSignalInitValue=0, ComSignalType=UINT8, ComHandleId=4702, ComSystemTemplateSystemSignalRef=DET_SNR_222
            DET_ELEVATION_222_oRDR_DETECTION_221_224_oPCAN_RADAR_53b7ac01_Tx: ComBitPosition=184, ComBitSize=8, ComSignalInitValue=0, ComSignalType=UINT8, ComHandleId=4651, ComSystemTemplateSystemSignalRef=DET_ELEVATION_222
            DET_EXISTENCE_PROB_224_oRDR_DETECTION_221_224_oPCAN_RADAR_cfd1b6e8_Tx: ComBitPosition=448, ComBitSize=6, ComSignalInitValue=0, ComSignalType=UINT8, ComHandleId=4661, ComSystemTemplateSystemSignalRef=DET_EXISTENCE_PROB_224
            DET_SUPER_RES_TARGET_221_oRDR_DETECTION_221_224_oPCAN_RADAR_e86ef250_Tx: ComBitPosition=87, ComBitSize=1, ComSignalInitValue=0, ComSignalType=BOOLEAN, ComHandleId=4705, ComSystemTemplateSystemSignalRef=DET_SUPER_RES_TARGET_221
            DET_RANGE_VELOCITY_ERR_224_oRDR_DETECTION_221_224_oPCAN_RADAR_2142cedd_Tx: ComBitPosition=400, ComBitSize=8, ComSignalInitValue=0, ComSignalType=UINT8, ComHandleId=4696, ComSystemTemplateSystemSignalRef=DET_RANGE_VELOCITY_ERR_224
            DET_CONFD_AZIMUTH_222_oRDR_DETECTION_221_224_oPCAN_RADAR_80e279c7_Tx: ComBitPosition=230, ComBitSize=2, ComSignalInitValue=0, ComSignalType=UINT8, ComHandleId=4643, ComSystemTemplateSystemSignalRef=DET_CONFD_AZIMUTH_222
            DET_CONFD_ELEVATION_224_oRDR_DETECTION_221_224_oPCAN_RADAR_4bb78fc1_Tx: ComBitPosition=437, ComBitSize=2, ComSignalInitValue=0, ComSignalType=UINT8, ComHandleId=4649, ComSystemTemplateSystemSignalRef=DET_CONFD_ELEVATION_224
            DET_ELEVATION_ERR_223_oRDR_DETECTION_221_224_oPCAN_RADAR_41fee0e1_Tx: ComBitPosition=304, ComBitSize=6, ComSignalInitValue=0, ComSignalType=UINT8, ComHandleId=4656, ComSystemTemplateSystemSignalRef=DET_ELEVATION_ERR_223
            DET_RANGE_VELOCITY_222_oRDR_DETECTION_221_224_oPCAN_RADAR_e739c293_Tx: ComBitPosition=160, ComBitSize=15, ComSignalInitValue=16384, ComSignalType=UINT16, ComHandleId=4690, ComSystemTemplateSystemSignalRef=DET_RANGE_VELOCITY_222
            DET_ELEVATION_224_oRDR_DETECTION_221_224_oPCAN_RADAR_9a775bfd_Tx: ComBitPosition=408, ComBitSize=8, ComSignalInitValue=0, ComSignalType=UINT8, ComHandleId=4653, ComSystemTemplateSystemSignalRef=DET_ELEVATION_224
            DET_ELEVATION_ERR_221_oRDR_DETECTION_221_224_oPCAN_RADAR_b06e4f8a_Tx: ComBitPosition=80, ComBitSize=6, ComSignalInitValue=0, ComSignalType=UINT8, ComHandleId=4654, ComSystemTemplateSystemSignalRef=DET_ELEVATION_ERR_221
            DET_ELEVATION_223_oRDR_DETECTION_221_224_oPCAN_RADAR_c6c77894_Tx: ComBitPosition=296, ComBitSize=8, ComSignalInitValue=0, ComSignalType=UINT8, ComHandleId=4652, ComSystemTemplateSystemSignalRef=DET_ELEVATION_223
            DET_SUPER_RES_TARGET_223_oRDR_DETECTION_221_224_oPCAN_RADAR_19fe5d3b_Tx: ComBitPosition=311, ComBitSize=1, ComSignalInitValue=0, ComSignalType=BOOLEAN, ComHandleId=4707, ComSystemTemplateSystemSignalRef=DET_SUPER_RES_TARGET_223
            DET_RANGE_ERR_223_oRDR_DETECTION_221_224_oPCAN_RADAR_a0076e4a_Tx: ComBitPosition=264, ComBitSize=7, ComSignalInitValue=0, ComSignalType=UINT8, ComHandleId=4687, ComSystemTemplateSystemSignalRef=DET_RANGE_ERR_223
            DET_MH_CYCLE_COUNTER_221_224_oRDR_DETECTION_221_224_oPCAN_RADAR_6f9003b3_Tx: ComBitPosition=16, ComBitSize=8, ComSignalInitValue=0, ComSignalType=UINT8, ComHandleId=4671, ComSystemTemplateSystemSignalRef=DET_MH_CYCLE_COUNTER_221_224
            DET_BI_STATIC_FLAG_221_oRDR_DETECTION_221_224_oPCAN_RADAR_b0c84876_Tx: ComBitPosition=104, ComBitSize=1, ComSignalInitValue=0, ComSignalType=BOOLEAN, ComHandleId=4638, ComSystemTemplateSystemSignalRef=DET_BI_STATIC_FLAG_221
            DET_RANGE_VELOCITY_ERR_223_oRDR_DETECTION_221_224_oPCAN_RADAR_7df2edb4_Tx: ComBitPosition=288, ComBitSize=8, ComSignalInitValue=0, ComSignalType=UINT8, ComHandleId=4695, ComSystemTemplateSystemSignalRef=DET_RANGE_VELOCITY_ERR_223
            DET_RCS_224_oRDR_DETECTION_221_224_oPCAN_RADAR_a9790235_Tx: ComBitPosition=464, ComBitSize=8, ComSignalInitValue=128, ComSignalType=UINT8, ComHandleId=4700, ComSystemTemplateSystemSignalRef=DET_RCS_224
            DET_HVC_FLAG_222_oRDR_DETECTION_221_224_oPCAN_RADAR_e765026b_Tx: ComBitPosition=198, ComBitSize=1, ComSignalInitValue=0, ComSignalType=BOOLEAN, ComHandleId=4663, ComSystemTemplateSystemSignalRef=DET_HVC_FLAG_222
            DET_RANGE_VELOCITY_221_oRDR_DETECTION_221_224_oPCAN_RADAR_83d9b96d_Tx: ComBitPosition=48, ComBitSize=15, ComSignalInitValue=16384, ComSignalType=UINT16, ComHandleId=4689, ComSystemTemplateSystemSignalRef=DET_RANGE_VELOCITY_221
            DET_AZIMUTH_ERR_221_oRDR_DETECTION_221_224_oPCAN_RADAR_42519d06_Tx: ComBitPosition=105, ComBitSize=7, ComSignalInitValue=0, ComSignalType=UINT8, ComHandleId=4630, ComSystemTemplateSystemSignalRef=DET_AZIMUTH_ERR_221
            DET_CONFD_ELEVATION_223_oRDR_DETECTION_221_224_oPCAN_RADAR_1707aca8_Tx: ComBitPosition=325, ComBitSize=2, ComSignalInitValue=0, ComSignalType=UINT8, ComHandleId=4648, ComSystemTemplateSystemSignalRef=DET_CONFD_ELEVATION_223
            DET_MH_SCAN_INDEX_4LSB_221_224_oRDR_DETECTION_221_224_oPCAN_RADAR_a3ba263f_Tx: ComBitPosition=476, ComBitSize=4, ComSignalInitValue=0, ComSignalType=UINT8, ComHandleId=4672, ComSystemTemplateSystemSignalRef=DET_MH_SCAN_INDEX_4LSB_221_224
            DET_RANGE_VELOCITY_ERR_222_oRDR_DETECTION_221_224_oPCAN_RADAR_e8823921_Tx: ComBitPosition=176, ComBitSize=8, ComSignalInitValue=0, ComSignalType=UINT8, ComHandleId=4694, ComSystemTemplateSystemSignalRef=DET_RANGE_VELOCITY_ERR_222
            DET_MTD_222_oRDR_DETECTION_221_224_oPCAN_RADAR_0a840b0d_Tx: ComBitPosition=159, ComBitSize=1, ComSignalInitValue=0, ComSignalType=UINT8, ComHandleId=4674, ComSystemTemplateSystemSignalRef=DET_MTD_222
            DET_BELOW_RAIN_THOLD_222_oRDR_DETECTION_221_224_oPCAN_RADAR_5705e0cd_Tx: ComBitPosition=151, ComBitSize=1, ComSignalInitValue=0, ComSignalType=UINT8, ComHandleId=4635, ComSystemTemplateSystemSignalRef=DET_BELOW_RAIN_THOLD_222
            DET_IDM_221_oRDR_DETECTION_221_224_oPCAN_RADAR_08d74228_Tx: ComBitPosition=63, ComBitSize=1, ComSignalInitValue=0, ComSignalType=UINT8, ComHandleId=4666, ComSystemTemplateSystemSignalRef=DET_IDM_221
            DET_PROB_1STAZHYPO_223_oRDR_DETECTION_221_224_oPCAN_RADAR_0c403755_Tx: ComBitPosition=327, ComBitSize=1, ComSignalInitValue=0, ComSignalType=BOOLEAN, ComHandleId=4679, ComSystemTemplateSystemSignalRef=DET_PROB_1STAZHYPO_223
            DET_PROB_1STAZHYPO_222_oRDR_DETECTION_221_224_oPCAN_RADAR_9930e3c0_Tx: ComBitPosition=215, ComBitSize=1, ComSignalInitValue=0, ComSignalType=BOOLEAN, ComHandleId=4678, ComSystemTemplateSystemSignalRef=DET_PROB_1STAZHYPO_222
            DET_MTD_224_oRDR_DETECTION_221_224_oPCAN_RADAR_c344fcf1_Tx: ComBitPosition=383, ComBitSize=1, ComSignalInitValue=0, ComSignalType=UINT8, ComHandleId=4676, ComSystemTemplateSystemSignalRef=DET_MTD_224
            DET_BELOW_RAIN_THOLD_221_oRDR_DETECTION_221_224_oPCAN_RADAR_33e59b33_Tx: ComBitPosition=39, ComBitSize=1, ComSignalInitValue=0, ComSignalType=UINT8, ComHandleId=4634, ComSystemTemplateSystemSignalRef=DET_BELOW_RAIN_THOLD_221
            DET_IDM_222_oRDR_DETECTION_221_224_oPCAN_RADAR_6c3739d6_Tx: ComBitPosition=175, ComBitSize=1, ComSignalInitValue=0, ComSignalType=UINT8, ComHandleId=4667, ComSystemTemplateSystemSignalRef=DET_IDM_222
            DET_PROB_1STAZHYPO_224_oRDR_DETECTION_221_224_oPCAN_RADAR_50f0143c_Tx: ComBitPosition=439, ComBitSize=1, ComSignalInitValue=0, ComSignalType=BOOLEAN, ComHandleId=4680, ComSystemTemplateSystemSignalRef=DET_PROB_1STAZHYPO_224
            DET_MTD_223_oRDR_DETECTION_221_224_oPCAN_RADAR_9ff4df98_Tx: ComBitPosition=271, ComBitSize=1, ComSignalInitValue=0, ComSignalType=UINT8, ComHandleId=4675, ComSystemTemplateSystemSignalRef=DET_MTD_223
            DET_BELOW_RAIN_THOLD_223_oRDR_DETECTION_221_224_oPCAN_RADAR_c2753458_Tx: ComBitPosition=263, ComBitSize=1, ComSignalInitValue=0, ComSignalType=UINT8, ComHandleId=4636, ComSystemTemplateSystemSignalRef=DET_BELOW_RAIN_THOLD_223
            DET_IDM_223_oRDR_DETECTION_221_224_oPCAN_RADAR_f947ed43_Tx: ComBitPosition=287, ComBitSize=1, ComSignalInitValue=0, ComSignalType=UINT8, ComHandleId=4668, ComSystemTemplateSystemSignalRef=DET_IDM_223
            DET_PROB_1STAZHYPO_221_oRDR_DETECTION_221_224_oPCAN_RADAR_fdd0983e_Tx: ComBitPosition=103, ComBitSize=1, ComSignalInitValue=0, ComSignalType=BOOLEAN, ComHandleId=4677, ComSystemTemplateSystemSignalRef=DET_PROB_1STAZHYPO_221
            DET_BELOW_RAIN_THOLD_224_oRDR_DETECTION_221_224_oPCAN_RADAR_9ec51731_Tx: ComBitPosition=375, ComBitSize=1, ComSignalInitValue=0, ComSignalType=UINT8, ComHandleId=4637, ComSystemTemplateSystemSignalRef=DET_BELOW_RAIN_THOLD_224
            DET_MTD_221_oRDR_DETECTION_221_224_oPCAN_RADAR_6e6470f3_Tx: ComBitPosition=47, ComBitSize=1, ComSignalInitValue=0, ComSignalType=UINT8, ComHandleId=4673, ComSystemTemplateSystemSignalRef=DET_MTD_221
            DET_IDM_224_oRDR_DETECTION_221_224_oPCAN_RADAR_a5f7ce2a_Tx: ComBitPosition=399, ComBitSize=1, ComSignalInitValue=0, ComSignalType=UINT8, ComHandleId=4669, ComSystemTemplateSystemSignalRef=DET_IDM_224
        SG_Detections_361_364_oRDR_DETECTION_361_364_oPCAN_RADAR_472e1297_Tx: ComTransferProperty=TRIGGERED, ComHandleId=92, ComSystemTemplateSignalGroupRef=SG_Detections_361_364
          83 x ComGroupSignal, all with ComSignalEndianness=LITTLE_ENDIAN, ComTransferProperty=PENDING, ComSignalAccess=ACCESS_NEEDED_BY_SWC_OR_COM:
            DET_BI_STATIC_FLAG_361_oRDR_DETECTION_361_364_oPCAN_RADAR_2f0ee086_Tx: ComBitPosition=104, ComBitSize=1, ComSignalInitValue=0, ComSignalType=BOOLEAN, ComHandleId=7543, ComSystemTemplateSystemSignalRef=DET_BI_STATIC_FLAG_361
            DET_CONFD_AZIMUTH_364_oRDR_DETECTION_361_364_oPCAN_RADAR_d6e426cb_Tx: ComBitPosition=454, ComBitSize=2, ComSignalInitValue=0, ComSignalType=UINT8, ComHandleId=7550, ComSystemTemplateSystemSignalRef=DET_CONFD_AZIMUTH_364
            DET_AZIMUTH_364_oRDR_DETECTION_361_364_oPCAN_RADAR_d4022c01_Tx: ComBitPosition=424, ComBitSize=13, ComSignalInitValue=0, ComSignalType=UINT16, ComHandleId=7534, ComSystemTemplateSystemSignalRef=DET_AZIMUTH_364
            DET_ELEVATION_361_oRDR_DETECTION_361_364_oPCAN_RADAR_a8917f0f_Tx: ComBitPosition=72, ComBitSize=8, ComSignalInitValue=0, ComSignalType=UINT8, ComHandleId=7555, ComSystemTemplateSystemSignalRef=DET_ELEVATION_361
            DET_AZIMUTH_ERR_364_oRDR_DETECTION_361_364_oPCAN_RADAR_70b7b9f4_Tx: ComBitPosition=441, ComBitSize=7, ComSignalInitValue=0, ComSignalType=UINT8, ComHandleId=7538, ComSystemTemplateSystemSignalRef=DET_AZIMUTH_ERR_364
            DET_CONFD_ELEVATION_364_oRDR_DETECTION_361_364_oPCAN_RADAR_d4712731_Tx: ComBitPosition=437, ComBitSize=2, ComSignalInitValue=0, ComSignalType=UINT8, ComHandleId=7554, ComSystemTemplateSystemSignalRef=DET_CONFD_ELEVATION_364
            DET_AZIMUTH_363_oRDR_DETECTION_361_364_oPCAN_RADAR_88b20f68_Tx: ComBitPosition=312, ComBitSize=13, ComSignalInitValue=0, ComSignalType=UINT16, ComHandleId=7533, ComSystemTemplateSystemSignalRef=DET_AZIMUTH_363
            DET_ELEVATION_364_oRDR_DETECTION_361_364_oPCAN_RADAR_05b1f30d_Tx: ComBitPosition=408, ComBitSize=8, ComSignalInitValue=0, ComSignalType=UINT8, ComHandleId=7558, ComSystemTemplateSystemSignalRef=DET_ELEVATION_364
            DET_ELEVATION_ERR_364_oRDR_DETECTION_361_364_oPCAN_RADAR_82886b78_Tx: ComBitPosition=416, ComBitSize=6, ComSignalInitValue=0, ComSignalType=UINT8, ComHandleId=7562, ComSystemTemplateSystemSignalRef=DET_ELEVATION_ERR_364
            DET_CONFD_ELEVATION_361_oRDR_DETECTION_361_364_oPCAN_RADAR_7951ab33_Tx: ComBitPosition=101, ComBitSize=2, ComSignalInitValue=0, ComSignalType=UINT8, ComHandleId=7551, ComSystemTemplateSystemSignalRef=DET_CONFD_ELEVATION_361
            DET_HVC_FLAG_364_oRDR_DETECTION_361_364_oPCAN_RADAR_b1635d67_Tx: ComBitPosition=422, ComBitSize=1, ComSignalInitValue=0, ComSignalType=BOOLEAN, ComHandleId=7570, ComSystemTemplateSystemSignalRef=DET_HVC_FLAG_364
            DET_RANGE_VELOCITY_364_oRDR_DETECTION_361_364_oPCAN_RADAR_b13f9d9f_Tx: ComBitPosition=384, ComBitSize=15, ComSignalInitValue=16384, ComSignalType=UINT16, ComHandleId=7597, ComSystemTemplateSystemSignalRef=DET_RANGE_VELOCITY_364
            DET_EXISTENCE_PROB_361_oRDR_DETECTION_361_364_oPCAN_RADAR_fd37921a_Tx: ComBitPosition=112, ComBitSize=6, ComSignalInitValue=0, ComSignalType=UINT8, ComHandleId=7563, ComSystemTemplateSystemSignalRef=DET_EXISTENCE_PROB_361
            DET_AZIMUTH_361_oRDR_DETECTION_361_364_oPCAN_RADAR_7922a003_Tx: ComBitPosition=88, ComBitSize=13, ComSignalInitValue=0, ComSignalType=UINT16, ComHandleId=7531, ComSystemTemplateSystemSignalRef=DET_AZIMUTH_361
            DET_BI_STATIC_FLAG_362_oRDR_DETECTION_361_364_oPCAN_RADAR_4bee9b78_Tx: ComBitPosition=216, ComBitSize=1, ComSignalInitValue=0, ComSignalType=BOOLEAN, ComHandleId=7544, ComSystemTemplateSystemSignalRef=DET_BI_STATIC_FLAG_362
            DET_ELEVATION_ERR_362_oRDR_DETECTION_361_364_oPCAN_RADAR_4b489c84_Tx: ComBitPosition=192, ComBitSize=6, ComSignalInitValue=0, ComSignalType=UINT8, ComHandleId=7560, ComSystemTemplateSystemSignalRef=DET_ELEVATION_ERR_362
            DET_SUPER_RES_TARGET_364_oRDR_DETECTION_361_364_oPCAN_RADAR_da88d6a2_Tx: ComBitPosition=423, ComBitSize=1, ComSignalInitValue=0, ComSignalType=BOOLEAN, ComHandleId=7613, ComSystemTemplateSystemSignalRef=DET_SUPER_RES_TARGET_364
            DET_AZIMUTH_ERR_363_oRDR_DETECTION_361_364_oPCAN_RADAR_2c079a9d_Tx: ComBitPosition=329, ComBitSize=7, ComSignalInitValue=0, ComSignalType=UINT8, ComHandleId=7537, ComSystemTemplateSystemSignalRef=DET_AZIMUTH_ERR_363
            DET_HVC_FLAG_362_oRDR_DETECTION_361_364_oPCAN_RADAR_78a3aa9b_Tx: ComBitPosition=198, ComBitSize=1, ComSignalInitValue=0, ComSignalType=BOOLEAN, ComHandleId=7568, ComSystemTemplateSystemSignalRef=DET_HVC_FLAG_362
            DET_SUPER_RES_TARGET_361_oRDR_DETECTION_361_364_oPCAN_RADAR_77a85aa0_Tx: ComBitPosition=87, ComBitSize=1, ComSignalInitValue=0, ComSignalType=BOOLEAN, ComHandleId=7610, ComSystemTemplateSystemSignalRef=DET_SUPER_RES_TARGET_361
            DET_RCS_363_oRDR_DETECTION_361_364_oPCAN_RADAR_6a0f89ac_Tx: ComBitPosition=352, ComBitSize=8, ComSignalInitValue=128, ComSignalType=UINT8, ComHandleId=7604, ComSystemTemplateSystemSignalRef=DET_RCS_363
            DET_RANGE_ERR_362_oRDR_DETECTION_361_364_oPCAN_RADAR_aab1122f_Tx: ComBitPosition=152, ComBitSize=7, ComSignalInitValue=0, ComSignalType=UINT8, ComHandleId=7591, ComSystemTemplateSystemSignalRef=DET_RANGE_ERR_362
            DET_CONFD_AZIMUTH_361_oRDR_DETECTION_361_364_oPCAN_RADAR_7bc4aac9_Tx: ComBitPosition=118, ComBitSize=2, ComSignalInitValue=0, ComSignalType=UINT8, ComHandleId=7547, ComSystemTemplateSystemSignalRef=DET_CONFD_AZIMUTH_361
            DET_RANGE_363_oRDR_DETECTION_361_364_oPCAN_RADAR_98297cd3_Tx: ComBitPosition=248, ComBitSize=15, ComSignalInitValue=0, ComSignalType=UINT16, ComHandleId=7588, ComSystemTemplateSystemSignalRef=DET_RANGE_363
            DET_CONFD_ELEVATION_362_oRDR_DETECTION_361_364_oPCAN_RADAR_1db1d0cd_Tx: ComBitPosition=213, ComBitSize=2, ComSignalInitValue=0, ComSignalType=UINT8, ComHandleId=7552, ComSystemTemplateSystemSignalRef=DET_CONFD_ELEVATION_362
            DET_AZIMUTH_ERR_361_oRDR_DETECTION_361_364_oPCAN_RADAR_dd9735f6_Tx: ComBitPosition=105, ComBitSize=7, ComSignalInitValue=0, ComSignalType=UINT8, ComHandleId=7535, ComSystemTemplateSystemSignalRef=DET_AZIMUTH_ERR_361
            DET_HVC_FLAG_361_oRDR_DETECTION_361_364_oPCAN_RADAR_1c43d165_Tx: ComBitPosition=86, ComBitSize=1, ComSignalInitValue=0, ComSignalType=BOOLEAN, ComHandleId=7567, ComSystemTemplateSystemSignalRef=DET_HVC_FLAG_361
            DET_RANGE_VELOCITY_361_oRDR_DETECTION_361_364_oPCAN_RADAR_1c1f119d_Tx: ComBitPosition=48, ComBitSize=15, ComSignalInitValue=16384, ComSignalType=UINT16, ComHandleId=7594, ComSystemTemplateSystemSignalRef=DET_RANGE_VELOCITY_361
            DET_HVC_FLAG_363_oRDR_DETECTION_361_364_oPCAN_RADAR_edd37e0e_Tx: ComBitPosition=310, ComBitSize=1, ComSignalInitValue=0, ComSignalType=BOOLEAN, ComHandleId=7569, ComSystemTemplateSystemSignalRef=DET_HVC_FLAG_363
            DET_SUPER_RES_TARGET_362_oRDR_DETECTION_361_364_oPCAN_RADAR_1348215e_Tx: ComBitPosition=199, ComBitSize=1, ComSignalInitValue=0, ComSignalType=BOOLEAN, ComHandleId=7611, ComSystemTemplateSystemSignalRef=DET_SUPER_RES_TARGET_362
            DET_SUPER_RES_TARGET_363_oRDR_DETECTION_361_364_oPCAN_RADAR_8638f5cb_Tx: ComBitPosition=311, ComBitSize=1, ComSignalInitValue=0, ComSignalType=BOOLEAN, ComHandleId=7612, ComSystemTemplateSystemSignalRef=DET_SUPER_RES_TARGET_363
            DET_RANGE_VELOCITY_ERR_363_oRDR_DETECTION_361_364_oPCAN_RADAR_e2344544_Tx: ComBitPosition=288, ComBitSize=8, ComSignalInitValue=0, ComSignalType=UINT8, ComHandleId=7600, ComSystemTemplateSystemSignalRef=DET_RANGE_VELOCITY_ERR_363
            DET_AZIMUTH_362_oRDR_DETECTION_361_364_oPCAN_RADAR_1dc2dbfd_Tx: ComBitPosition=200, ComBitSize=13, ComSignalInitValue=0, ComSignalType=UINT16, ComHandleId=7532, ComSystemTemplateSystemSignalRef=DET_AZIMUTH_362
            DET_BI_STATIC_FLAG_363_oRDR_DETECTION_361_364_oPCAN_RADAR_de9e4fed_Tx: ComBitPosition=328, ComBitSize=1, ComSignalInitValue=0, ComSignalType=BOOLEAN, ComHandleId=7545, ComSystemTemplateSystemSignalRef=DET_BI_STATIC_FLAG_363
            DET_RANGE_VELOCITY_ERR_362_oRDR_DETECTION_361_364_oPCAN_RADAR_774491d1_Tx: ComBitPosition=176, ComBitSize=8, ComSignalInitValue=0, ComSignalType=UINT8, ComHandleId=7599, ComSystemTemplateSystemSignalRef=DET_RANGE_VELOCITY_ERR_362
            DET_RANGE_361_oRDR_DETECTION_361_364_oPCAN_RADAR_69b9d3b8_Tx: ComBitPosition=24, ComBitSize=15, ComSignalInitValue=0, ComSignalType=UINT16, ComHandleId=7586, ComSystemTemplateSystemSignalRef=DET_RANGE_361
            DET_RANGE_ERR_361_oRDR_DETECTION_361_364_oPCAN_RADAR_ce5169d1_Tx: ComBitPosition=40, ComBitSize=7, ComSignalInitValue=0, ComSignalType=UINT8, ComHandleId=7590, ComSystemTemplateSystemSignalRef=DET_RANGE_ERR_361
            DET_EXISTENCE_PROB_363_oRDR_DETECTION_361_364_oPCAN_RADAR_0ca73d71_Tx: ComBitPosition=336, ComBitSize=6, ComSignalInitValue=0, ComSignalType=UINT8, ComHandleId=7565, ComSystemTemplateSystemSignalRef=DET_EXISTENCE_PROB_363
            DET_RANGE_VELOCITY_362_oRDR_DETECTION_361_364_oPCAN_RADAR_78ff6a63_Tx: ComBitPosition=160, ComBitSize=15, ComSignalInitValue=16384, ComSignalType=UINT16, ComHandleId=7595, ComSystemTemplateSystemSignalRef=DET_RANGE_VELOCITY_362
            DET_BI_STATIC_FLAG_364_oRDR_DETECTION_361_364_oPCAN_RADAR_822e6c84_Tx: ComBitPosition=440, ComBitSize=1, ComSignalInitValue=0, ComSignalType=BOOLEAN, ComHandleId=7546, ComSystemTemplateSystemSignalRef=DET_BI_STATIC_FLAG_364
            DET_EXISTENCE_PROB_362_oRDR_DETECTION_361_364_oPCAN_RADAR_99d7e9e4_Tx: ComBitPosition=224, ComBitSize=6, ComSignalInitValue=0, ComSignalType=UINT8, ComHandleId=7564, ComSystemTemplateSystemSignalRef=DET_EXISTENCE_PROB_362
            DET_MH_CYCLE_COUNTER_361_364_oRDR_DETECTION_361_364_oPCAN_RADAR_47d361ab_Tx: ComBitPosition=16, ComBitSize=8, ComSignalInitValue=0, ComSignalType=UINT8, ComHandleId=7576, ComSystemTemplateSystemSignalRef=DET_MH_CYCLE_COUNTER_361_364
            DET_RANGE_ERR_364_oRDR_DETECTION_361_364_oPCAN_RADAR_6371e5d3_Tx: ComBitPosition=376, ComBitSize=7, ComSignalInitValue=0, ComSignalType=UINT8, ComHandleId=7593, ComSystemTemplateSystemSignalRef=DET_RANGE_ERR_364
            DET_ELEVATION_ERR_363_oRDR_DETECTION_361_364_oPCAN_RADAR_de384811_Tx: ComBitPosition=304, ComBitSize=6, ComSignalInitValue=0, ComSignalType=UINT8, ComHandleId=7561, ComSystemTemplateSystemSignalRef=DET_ELEVATION_ERR_363
            DET_RCS_362_oRDR_DETECTION_361_364_oPCAN_RADAR_ff7f5d39_Tx: ComBitPosition=240, ComBitSize=8, ComSignalInitValue=128, ComSignalType=UINT8, ComHandleId=7603, ComSystemTemplateSystemSignalRef=DET_RCS_362
            DET_SNR_361_oRDR_DETECTION_361_364_oPCAN_RADAR_463172c5_Tx: ComBitPosition=120, ComBitSize=8, ComSignalInitValue=0, ComSignalType=UINT8, ComHandleId=7606, ComSystemTemplateSystemSignalRef=DET_SNR_361
            DET_CONFD_AZIMUTH_363_oRDR_DETECTION_361_364_oPCAN_RADAR_8a5405a2_Tx: ComBitPosition=342, ComBitSize=2, ComSignalInitValue=0, ComSignalType=UINT8, ComHandleId=7549, ComSystemTemplateSystemSignalRef=DET_CONFD_AZIMUTH_363
            DET_MH_SCAN_INDEX_4LSB_361_364_oRDR_DETECTION_361_364_oPCAN_RADAR_8bf94427_Tx: ComBitPosition=476, ComBitSize=4, ComSignalInitValue=0, ComSignalType=UINT8, ComHandleId=7577, ComSystemTemplateSystemSignalRef=DET_MH_SCAN_INDEX_4LSB_361_364
            DET_SNR_363_oRDR_DETECTION_361_364_oPCAN_RADAR_b7a1ddae_Tx: ComBitPosition=344, ComBitSize=8, ComSignalInitValue=0, ComSignalType=UINT8, ComHandleId=7608, ComSystemTemplateSystemSignalRef=DET_SNR_363
            DET_ELEVATION_363_oRDR_DETECTION_361_364_oPCAN_RADAR_5901d064_Tx: ComBitPosition=296, ComBitSize=8, ComSignalInitValue=0, ComSignalType=UINT8, ComHandleId=7557, ComSystemTemplateSystemSignalRef=DET_ELEVATION_363
            DET_RANGE_VELOCITY_363_oRDR_DETECTION_361_364_oPCAN_RADAR_ed8fbef6_Tx: ComBitPosition=272, ComBitSize=15, ComSignalInitValue=16384, ComSignalType=UINT16, ComHandleId=7596, ComSystemTemplateSystemSignalRef=DET_RANGE_VELOCITY_363
            DET_RCS_361_oRDR_DETECTION_361_364_oPCAN_RADAR_9b9f26c7_Tx: ComBitPosition=128, ComBitSize=8, ComSignalInitValue=128, ComSignalType=UINT8, ComHandleId=7602, ComSystemTemplateSystemSignalRef=DET_RCS_361
            DET_MH_CRC16_361_364_oRDR_DETECTION_361_364_oPCAN_RADAR_c3a6c09c_Tx: ComBitPosition=0, ComBitSize=16, ComSignalInitValue=0, ComSignalType=UINT16, ComHandleId=7575, ComSystemTemplateSystemSignalRef=DET_MH_CRC16_361_364
            DET_AZIMUTH_ERR_362_oRDR_DETECTION_361_364_oPCAN_RADAR_b9774e08_Tx: ComBitPosition=217, ComBitSize=7, ComSignalInitValue=0, ComSignalType=UINT8, ComHandleId=7536, ComSystemTemplateSystemSignalRef=DET_AZIMUTH_ERR_362
            DET_ELEVATION_362_oRDR_DETECTION_361_364_oPCAN_RADAR_cc7104f1_Tx: ComBitPosition=184, ComBitSize=8, ComSignalInitValue=0, ComSignalType=UINT8, ComHandleId=7556, ComSystemTemplateSystemSignalRef=DET_ELEVATION_362
            DET_CONFD_AZIMUTH_362_oRDR_DETECTION_361_364_oPCAN_RADAR_1f24d137_Tx: ComBitPosition=230, ComBitSize=2, ComSignalInitValue=0, ComSignalType=UINT8, ComHandleId=7548, ComSystemTemplateSystemSignalRef=DET_CONFD_AZIMUTH_362
            DET_ELEVATION_ERR_361_oRDR_DETECTION_361_364_oPCAN_RADAR_2fa8e77a_Tx: ComBitPosition=80, ComBitSize=6, ComSignalInitValue=0, ComSignalType=UINT8, ComHandleId=7559, ComSystemTemplateSystemSignalRef=DET_ELEVATION_ERR_361
            DET_SNR_364_oRDR_DETECTION_361_364_oPCAN_RADAR_eb11fec7_Tx: ComBitPosition=456, ComBitSize=8, ComSignalInitValue=0, ComSignalType=UINT8, ComHandleId=7609, ComSystemTemplateSystemSignalRef=DET_SNR_364
            DET_RANGE_362_oRDR_DETECTION_361_364_oPCAN_RADAR_0d59a846_Tx: ComBitPosition=136, ComBitSize=15, ComSignalInitValue=0, ComSignalType=UINT16, ComHandleId=7587, ComSystemTemplateSystemSignalRef=DET_RANGE_362
            DET_EXISTENCE_PROB_364_oRDR_DETECTION_361_364_oPCAN_RADAR_50171e18_Tx: ComBitPosition=448, ComBitSize=6, ComSignalInitValue=0, ComSignalType=UINT8, ComHandleId=7566, ComSystemTemplateSystemSignalRef=DET_EXISTENCE_PROB_364
            DET_RCS_364_oRDR_DETECTION_361_364_oPCAN_RADAR_36bfaac5_Tx: ComBitPosition=464, ComBitSize=8, ComSignalInitValue=128, ComSignalType=UINT8, ComHandleId=7605, ComSystemTemplateSystemSignalRef=DET_RCS_364
            DET_RANGE_364_oRDR_DETECTION_361_364_oPCAN_RADAR_c4995fba_Tx: ComBitPosition=360, ComBitSize=15, ComSignalInitValue=0, ComSignalType=UINT16, ComHandleId=7589, ComSystemTemplateSystemSignalRef=DET_RANGE_364
            DET_RANGE_VELOCITY_ERR_361_oRDR_DETECTION_361_364_oPCAN_RADAR_13a4ea2f_Tx: ComBitPosition=64, ComBitSize=8, ComSignalInitValue=0, ComSignalType=UINT8, ComHandleId=7598, ComSystemTemplateSystemSignalRef=DET_RANGE_VELOCITY_ERR_361
            DET_CONFD_ELEVATION_363_oRDR_DETECTION_361_364_oPCAN_RADAR_88c10458_Tx: ComBitPosition=325, ComBitSize=2, ComSignalInitValue=0, ComSignalType=UINT8, ComHandleId=7553, ComSystemTemplateSystemSignalRef=DET_CONFD_ELEVATION_363
            DET_RANGE_VELOCITY_ERR_364_oRDR_DETECTION_361_364_oPCAN_RADAR_be84662d_Tx: ComBitPosition=400, ComBitSize=8, ComSignalInitValue=0, ComSignalType=UINT8, ComHandleId=7601, ComSystemTemplateSystemSignalRef=DET_RANGE_VELOCITY_ERR_364
            DET_RANGE_ERR_363_oRDR_DETECTION_361_364_oPCAN_RADAR_3fc1c6ba_Tx: ComBitPosition=264, ComBitSize=7, ComSignalInitValue=0, ComSignalType=UINT8, ComHandleId=7592, ComSystemTemplateSystemSignalRef=DET_RANGE_ERR_363
            DET_SNR_362_oRDR_DETECTION_361_364_oPCAN_RADAR_22d1093b_Tx: ComBitPosition=232, ComBitSize=8, ComSignalInitValue=0, ComSignalType=UINT8, ComHandleId=7607, ComSystemTemplateSystemSignalRef=DET_SNR_362
            DET_IDM_362_oRDR_DETECTION_361_364_oPCAN_RADAR_f3f19126_Tx: ComBitPosition=175, ComBitSize=1, ComSignalInitValue=0, ComSignalType=UINT8, ComHandleId=7572, ComSystemTemplateSystemSignalRef=DET_IDM_362
            DET_MTD_361_oRDR_DETECTION_361_364_oPCAN_RADAR_f1a2d803_Tx: ComBitPosition=47, ComBitSize=1, ComSignalInitValue=0, ComSignalType=UINT8, ComHandleId=7578, ComSystemTemplateSystemSignalRef=DET_MTD_361
            DET_IDM_364_oRDR_DETECTION_361_364_oPCAN_RADAR_3a3166da_Tx: ComBitPosition=399, ComBitSize=1, ComSignalInitValue=0, ComSignalType=UINT8, ComHandleId=7574, ComSystemTemplateSystemSignalRef=DET_IDM_364
            DET_PROB_1STAZHYPO_362_oRDR_DETECTION_361_364_oPCAN_RADAR_06f64b30_Tx: ComBitPosition=215, ComBitSize=1, ComSignalInitValue=0, ComSignalType=BOOLEAN, ComHandleId=7583, ComSystemTemplateSystemSignalRef=DET_PROB_1STAZHYPO_362
            DET_PROB_1STAZHYPO_363_oRDR_DETECTION_361_364_oPCAN_RADAR_93869fa5_Tx: ComBitPosition=327, ComBitSize=1, ComSignalInitValue=0, ComSignalType=BOOLEAN, ComHandleId=7584, ComSystemTemplateSystemSignalRef=DET_PROB_1STAZHYPO_363
            DET_BELOW_RAIN_THOLD_363_oRDR_DETECTION_361_364_oPCAN_RADAR_5db39ca8_Tx: ComBitPosition=263, ComBitSize=1, ComSignalInitValue=0, ComSignalType=UINT8, ComHandleId=7541, ComSystemTemplateSystemSignalRef=DET_BELOW_RAIN_THOLD_363
            DET_PROB_1STAZHYPO_364_oRDR_DETECTION_361_364_oPCAN_RADAR_cf36bccc_Tx: ComBitPosition=439, ComBitSize=1, ComSignalInitValue=0, ComSignalType=BOOLEAN, ComHandleId=7585, ComSystemTemplateSystemSignalRef=DET_PROB_1STAZHYPO_364
            DET_MTD_362_oRDR_DETECTION_361_364_oPCAN_RADAR_9542a3fd_Tx: ComBitPosition=159, ComBitSize=1, ComSignalInitValue=0, ComSignalType=UINT8, ComHandleId=7579, ComSystemTemplateSystemSignalRef=DET_MTD_362
            DET_MTD_364_oRDR_DETECTION_361_364_oPCAN_RADAR_5c825401_Tx: ComBitPosition=383, ComBitSize=1, ComSignalInitValue=0, ComSignalType=UINT8, ComHandleId=7581, ComSystemTemplateSystemSignalRef=DET_MTD_364
            DET_IDM_363_oRDR_DETECTION_361_364_oPCAN_RADAR_668145b3_Tx: ComBitPosition=287, ComBitSize=1, ComSignalInitValue=0, ComSignalType=UINT8, ComHandleId=7573, ComSystemTemplateSystemSignalRef=DET_IDM_363
            DET_PROB_1STAZHYPO_361_oRDR_DETECTION_361_364_oPCAN_RADAR_621630ce_Tx: ComBitPosition=103, ComBitSize=1, ComSignalInitValue=0, ComSignalType=BOOLEAN, ComHandleId=7582, ComSystemTemplateSystemSignalRef=DET_PROB_1STAZHYPO_361
            DET_IDM_361_oRDR_DETECTION_361_364_oPCAN_RADAR_9711ead8_Tx: ComBitPosition=63, ComBitSize=1, ComSignalInitValue=0, ComSignalType=UINT8, ComHandleId=7571, ComSystemTemplateSystemSignalRef=DET_IDM_361
            DET_MTD_363_oRDR_DETECTION_361_364_oPCAN_RADAR_00327768_Tx: ComBitPosition=271, ComBitSize=1, ComSignalInitValue=0, ComSignalType=UINT8, ComHandleId=7580, ComSystemTemplateSystemSignalRef=DET_MTD_363
            DET_BELOW_RAIN_THOLD_361_oRDR_DETECTION_361_364_oPCAN_RADAR_ac2333c3_Tx: ComBitPosition=39, ComBitSize=1, ComSignalInitValue=0, ComSignalType=UINT8, ComHandleId=7539, ComSystemTemplateSystemSignalRef=DET_BELOW_RAIN_THOLD_361
            DET_BELOW_RAIN_THOLD_362_oRDR_DETECTION_361_364_oPCAN_RADAR_c8c3483d_Tx: ComBitPosition=151, ComBitSize=1, ComSignalInitValue=0, ComSignalType=UINT8, ComHandleId=7540, ComSystemTemplateSystemSignalRef=DET_BELOW_RAIN_THOLD_362
            DET_BELOW_RAIN_THOLD_364_oRDR_DETECTION_361_364_oPCAN_RADAR_0103bfc1_Tx: ComBitPosition=375, ComBitSize=1, ComSignalInitValue=0, ComSignalType=UINT8, ComHandleId=7542, ComSystemTemplateSystemSignalRef=DET_BELOW_RAIN_THOLD_364
        SG_Detections_181_184_oRDR_DETECTION_181_184_oPCAN_RADAR_48363651_Tx: ComTransferProperty=TRIGGERED, ComHandleId=47, ComSystemTemplateSignalGroupRef=SG_Detections_181_184
          83 x ComGroupSignal, all with ComSignalEndianness=LITTLE_ENDIAN, ComTransferProperty=PENDING, ComSignalAccess=ACCESS_NEEDED_BY_SWC_OR_COM:
            DET_ELEVATION_ERR_183_oRDR_DETECTION_181_184_oPCAN_RADAR_78b89643_Tx: ComBitPosition=304, ComBitSize=6, ComSignalInitValue=0, ComSignalType=UINT8, ComHandleId=3826, ComSystemTemplateSystemSignalRef=DET_ELEVATION_ERR_183
            DET_BI_STATIC_FLAG_182_oRDR_DETECTION_181_184_oPCAN_RADAR_ed6e452a_Tx: ComBitPosition=216, ComBitSize=1, ComSignalInitValue=0, ComSignalType=BOOLEAN, ComHandleId=3809, ComSystemTemplateSystemSignalRef=DET_BI_STATIC_FLAG_182
            DET_CONFD_ELEVATION_183_oRDR_DETECTION_181_184_oPCAN_RADAR_2e41da0a_Tx: ComBitPosition=325, ComBitSize=2, ComSignalInitValue=0, ComSignalType=UINT8, ComHandleId=3818, ComSystemTemplateSystemSignalRef=DET_CONFD_ELEVATION_183
            DET_MH_CRC16_181_184_oRDR_DETECTION_181_184_oPCAN_RADAR_ccbee45a_Tx: ComBitPosition=0, ComBitSize=16, ComSignalInitValue=0, ComSignalType=UINT16, ComHandleId=3840, ComSystemTemplateSystemSignalRef=DET_MH_CRC16_181_184
            DET_AZIMUTH_184_oRDR_DETECTION_181_184_oPCAN_RADAR_7282f253_Tx: ComBitPosition=424, ComBitSize=13, ComSignalInitValue=0, ComSignalType=UINT16, ComHandleId=3799, ComSystemTemplateSystemSignalRef=DET_AZIMUTH_184
            DET_CONFD_AZIMUTH_181_oRDR_DETECTION_181_184_oPCAN_RADAR_dd44749b_Tx: ComBitPosition=118, ComBitSize=2, ComSignalInitValue=0, ComSignalType=UINT8, ComHandleId=3812, ComSystemTemplateSystemSignalRef=DET_CONFD_AZIMUTH_181
            DET_CONFD_ELEVATION_184_oRDR_DETECTION_181_184_oPCAN_RADAR_72f1f963_Tx: ComBitPosition=437, ComBitSize=2, ComSignalInitValue=0, ComSignalType=UINT8, ComHandleId=3819, ComSystemTemplateSystemSignalRef=DET_CONFD_ELEVATION_184
            DET_BI_STATIC_FLAG_184_oRDR_DETECTION_181_184_oPCAN_RADAR_24aeb2d6_Tx: ComBitPosition=440, ComBitSize=1, ComSignalInitValue=0, ComSignalType=BOOLEAN, ComHandleId=3811, ComSystemTemplateSystemSignalRef=DET_BI_STATIC_FLAG_184
            DET_RANGE_181_oRDR_DETECTION_181_184_oPCAN_RADAR_cf390dea_Tx: ComBitPosition=24, ComBitSize=15, ComSignalInitValue=0, ComSignalType=UINT16, ComHandleId=3851, ComSystemTemplateSystemSignalRef=DET_RANGE_181
            DET_SUPER_RES_TARGET_183_oRDR_DETECTION_181_184_oPCAN_RADAR_20b82b99_Tx: ComBitPosition=311, ComBitSize=1, ComSignalInitValue=0, ComSignalType=BOOLEAN, ComHandleId=3877, ComSystemTemplateSystemSignalRef=DET_SUPER_RES_TARGET_183
            DET_SNR_183_oRDR_DETECTION_181_184_oPCAN_RADAR_112103fc_Tx: ComBitPosition=344, ComBitSize=8, ComSignalInitValue=0, ComSignalType=UINT8, ComHandleId=3873, ComSystemTemplateSystemSignalRef=DET_SNR_183
            DET_CONFD_AZIMUTH_183_oRDR_DETECTION_181_184_oPCAN_RADAR_2cd4dbf0_Tx: ComBitPosition=342, ComBitSize=2, ComSignalInitValue=0, ComSignalType=UINT8, ComHandleId=3814, ComSystemTemplateSystemSignalRef=DET_CONFD_AZIMUTH_183
            DET_HVC_FLAG_184_oRDR_DETECTION_181_184_oPCAN_RADAR_17e38335_Tx: ComBitPosition=422, ComBitSize=1, ComSignalInitValue=0, ComSignalType=BOOLEAN, ComHandleId=3835, ComSystemTemplateSystemSignalRef=DET_HVC_FLAG_184
            DET_AZIMUTH_183_oRDR_DETECTION_181_184_oPCAN_RADAR_2e32d13a_Tx: ComBitPosition=312, ComBitSize=13, ComSignalInitValue=0, ComSignalType=UINT16, ComHandleId=3798, ComSystemTemplateSystemSignalRef=DET_AZIMUTH_183
            DET_AZIMUTH_ERR_182_oRDR_DETECTION_181_184_oPCAN_RADAR_1ff7905a_Tx: ComBitPosition=217, ComBitSize=7, ComSignalInitValue=0, ComSignalType=UINT8, ComHandleId=3801, ComSystemTemplateSystemSignalRef=DET_AZIMUTH_ERR_182
            DET_AZIMUTH_ERR_184_oRDR_DETECTION_181_184_oPCAN_RADAR_d63767a6_Tx: ComBitPosition=441, ComBitSize=7, ComSignalInitValue=0, ComSignalType=UINT8, ComHandleId=3803, ComSystemTemplateSystemSignalRef=DET_AZIMUTH_ERR_184
            DET_SNR_181_oRDR_DETECTION_181_184_oPCAN_RADAR_e0b1ac97_Tx: ComBitPosition=120, ComBitSize=8, ComSignalInitValue=0, ComSignalType=UINT8, ComHandleId=3871, ComSystemTemplateSystemSignalRef=DET_SNR_181
            DET_RCS_181_oRDR_DETECTION_181_184_oPCAN_RADAR_3d1ff895_Tx: ComBitPosition=128, ComBitSize=8, ComSignalInitValue=128, ComSignalType=UINT8, ComHandleId=3867, ComSystemTemplateSystemSignalRef=DET_RCS_181
            DET_HVC_FLAG_181_oRDR_DETECTION_181_184_oPCAN_RADAR_bac30f37_Tx: ComBitPosition=86, ComBitSize=1, ComSignalInitValue=0, ComSignalType=BOOLEAN, ComHandleId=3832, ComSystemTemplateSystemSignalRef=DET_HVC_FLAG_181
            DET_SUPER_RES_TARGET_181_oRDR_DETECTION_181_184_oPCAN_RADAR_d12884f2_Tx: ComBitPosition=87, ComBitSize=1, ComSignalInitValue=0, ComSignalType=BOOLEAN, ComHandleId=3875, ComSystemTemplateSystemSignalRef=DET_SUPER_RES_TARGET_181
            DET_RCS_184_oRDR_DETECTION_181_184_oPCAN_RADAR_903f7497_Tx: ComBitPosition=464, ComBitSize=8, ComSignalInitValue=128, ComSignalType=UINT8, ComHandleId=3870, ComSystemTemplateSystemSignalRef=DET_RCS_184
            DET_RANGE_VELOCITY_184_oRDR_DETECTION_181_184_oPCAN_RADAR_17bf43cd_Tx: ComBitPosition=384, ComBitSize=15, ComSignalInitValue=16384, ComSignalType=UINT16, ComHandleId=3862, ComSystemTemplateSystemSignalRef=DET_RANGE_VELOCITY_184
            DET_AZIMUTH_ERR_183_oRDR_DETECTION_181_184_oPCAN_RADAR_8a8744cf_Tx: ComBitPosition=329, ComBitSize=7, ComSignalInitValue=0, ComSignalType=UINT8, ComHandleId=3802, ComSystemTemplateSystemSignalRef=DET_AZIMUTH_ERR_183
            DET_CONFD_ELEVATION_182_oRDR_DETECTION_181_184_oPCAN_RADAR_bb310e9f_Tx: ComBitPosition=213, ComBitSize=2, ComSignalInitValue=0, ComSignalType=UINT8, ComHandleId=3817, ComSystemTemplateSystemSignalRef=DET_CONFD_ELEVATION_182
            DET_EXISTENCE_PROB_181_oRDR_DETECTION_181_184_oPCAN_RADAR_5bb74c48_Tx: ComBitPosition=112, ComBitSize=6, ComSignalInitValue=0, ComSignalType=UINT8, ComHandleId=3828, ComSystemTemplateSystemSignalRef=DET_EXISTENCE_PROB_181
            DET_RANGE_VELOCITY_181_oRDR_DETECTION_181_184_oPCAN_RADAR_ba9fcfcf_Tx: ComBitPosition=48, ComBitSize=15, ComSignalInitValue=16384, ComSignalType=UINT16, ComHandleId=3859, ComSystemTemplateSystemSignalRef=DET_RANGE_VELOCITY_181
            DET_BI_STATIC_FLAG_183_oRDR_DETECTION_181_184_oPCAN_RADAR_781e91bf_Tx: ComBitPosition=328, ComBitSize=1, ComSignalInitValue=0, ComSignalType=BOOLEAN, ComHandleId=3810, ComSystemTemplateSystemSignalRef=DET_BI_STATIC_FLAG_183
            DET_RANGE_ERR_184_oRDR_DETECTION_181_184_oPCAN_RADAR_c5f13b81_Tx: ComBitPosition=376, ComBitSize=7, ComSignalInitValue=0, ComSignalType=UINT8, ComHandleId=3858, ComSystemTemplateSystemSignalRef=DET_RANGE_ERR_184
            DET_SUPER_RES_TARGET_184_oRDR_DETECTION_181_184_oPCAN_RADAR_7c0808f0_Tx: ComBitPosition=423, ComBitSize=1, ComSignalInitValue=0, ComSignalType=BOOLEAN, ComHandleId=3878, ComSystemTemplateSystemSignalRef=DET_SUPER_RES_TARGET_184
            DET_RANGE_ERR_183_oRDR_DETECTION_181_184_oPCAN_RADAR_994118e8_Tx: ComBitPosition=264, ComBitSize=7, ComSignalInitValue=0, ComSignalType=UINT8, ComHandleId=3857, ComSystemTemplateSystemSignalRef=DET_RANGE_ERR_183
            DET_RANGE_182_oRDR_DETECTION_181_184_oPCAN_RADAR_abd97614_Tx: ComBitPosition=136, ComBitSize=15, ComSignalInitValue=0, ComSignalType=UINT16, ComHandleId=3852, ComSystemTemplateSystemSignalRef=DET_RANGE_182
            DET_SNR_182_oRDR_DETECTION_181_184_oPCAN_RADAR_8451d769_Tx: ComBitPosition=232, ComBitSize=8, ComSignalInitValue=0, ComSignalType=UINT8, ComHandleId=3872, ComSystemTemplateSystemSignalRef=DET_SNR_182
            DET_MH_CYCLE_COUNTER_181_184_oRDR_DETECTION_181_184_oPCAN_RADAR_48cb456d_Tx: ComBitPosition=16, ComBitSize=8, ComSignalInitValue=0, ComSignalType=UINT8, ComHandleId=3841, ComSystemTemplateSystemSignalRef=DET_MH_CYCLE_COUNTER_181_184
            DET_AZIMUTH_182_oRDR_DETECTION_181_184_oPCAN_RADAR_bb4205af_Tx: ComBitPosition=200, ComBitSize=13, ComSignalInitValue=0, ComSignalType=UINT16, ComHandleId=3797, ComSystemTemplateSystemSignalRef=DET_AZIMUTH_182
            DET_EXISTENCE_PROB_184_oRDR_DETECTION_181_184_oPCAN_RADAR_f697c04a_Tx: ComBitPosition=448, ComBitSize=6, ComSignalInitValue=0, ComSignalType=UINT8, ComHandleId=3831, ComSystemTemplateSystemSignalRef=DET_EXISTENCE_PROB_184
            DET_RANGE_VELOCITY_ERR_184_oRDR_DETECTION_181_184_oPCAN_RADAR_1804b87f_Tx: ComBitPosition=400, ComBitSize=8, ComSignalInitValue=0, ComSignalType=UINT8, ComHandleId=3866, ComSystemTemplateSystemSignalRef=DET_RANGE_VELOCITY_ERR_184
            DET_ELEVATION_ERR_181_oRDR_DETECTION_181_184_oPCAN_RADAR_89283928_Tx: ComBitPosition=80, ComBitSize=6, ComSignalInitValue=0, ComSignalType=UINT8, ComHandleId=3824, ComSystemTemplateSystemSignalRef=DET_ELEVATION_ERR_181
            DET_HVC_FLAG_183_oRDR_DETECTION_181_184_oPCAN_RADAR_4b53a05c_Tx: ComBitPosition=310, ComBitSize=1, ComSignalInitValue=0, ComSignalType=BOOLEAN, ComHandleId=3834, ComSystemTemplateSystemSignalRef=DET_HVC_FLAG_183
            DET_RANGE_VELOCITY_183_oRDR_DETECTION_181_184_oPCAN_RADAR_4b0f60a4_Tx: ComBitPosition=272, ComBitSize=15, ComSignalInitValue=16384, ComSignalType=UINT16, ComHandleId=3861, ComSystemTemplateSystemSignalRef=DET_RANGE_VELOCITY_183
            DET_RANGE_ERR_181_oRDR_DETECTION_181_184_oPCAN_RADAR_68d1b783_Tx: ComBitPosition=40, ComBitSize=7, ComSignalInitValue=0, ComSignalType=UINT8, ComHandleId=3855, ComSystemTemplateSystemSignalRef=DET_RANGE_ERR_181
            DET_ELEVATION_181_oRDR_DETECTION_181_184_oPCAN_RADAR_0e11a15d_Tx: ComBitPosition=72, ComBitSize=8, ComSignalInitValue=0, ComSignalType=UINT8, ComHandleId=3820, ComSystemTemplateSystemSignalRef=DET_ELEVATION_181
            DET_RANGE_184_oRDR_DETECTION_181_184_oPCAN_RADAR_621981e8_Tx: ComBitPosition=360, ComBitSize=15, ComSignalInitValue=0, ComSignalType=UINT16, ComHandleId=3854, ComSystemTemplateSystemSignalRef=DET_RANGE_184
            DET_ELEVATION_183_oRDR_DETECTION_181_184_oPCAN_RADAR_ff810e36_Tx: ComBitPosition=296, ComBitSize=8, ComSignalInitValue=0, ComSignalType=UINT8, ComHandleId=3822, ComSystemTemplateSystemSignalRef=DET_ELEVATION_183
            DET_RANGE_VELOCITY_ERR_183_oRDR_DETECTION_181_184_oPCAN_RADAR_44b49b16_Tx: ComBitPosition=288, ComBitSize=8, ComSignalInitValue=0, ComSignalType=UINT8, ComHandleId=3865, ComSystemTemplateSystemSignalRef=DET_RANGE_VELOCITY_ERR_183
            DET_CONFD_ELEVATION_181_oRDR_DETECTION_181_184_oPCAN_RADAR_dfd17561_Tx: ComBitPosition=101, ComBitSize=2, ComSignalInitValue=0, ComSignalType=UINT8, ComHandleId=3816, ComSystemTemplateSystemSignalRef=DET_CONFD_ELEVATION_181
            DET_BI_STATIC_FLAG_181_oRDR_DETECTION_181_184_oPCAN_RADAR_898e3ed4_Tx: ComBitPosition=104, ComBitSize=1, ComSignalInitValue=0, ComSignalType=BOOLEAN, ComHandleId=3808, ComSystemTemplateSystemSignalRef=DET_BI_STATIC_FLAG_181
            DET_ELEVATION_182_oRDR_DETECTION_181_184_oPCAN_RADAR_6af1daa3_Tx: ComBitPosition=184, ComBitSize=8, ComSignalInitValue=0, ComSignalType=UINT8, ComHandleId=3821, ComSystemTemplateSystemSignalRef=DET_ELEVATION_182
            DET_AZIMUTH_181_oRDR_DETECTION_181_184_oPCAN_RADAR_dfa27e51_Tx: ComBitPosition=88, ComBitSize=13, ComSignalInitValue=0, ComSignalType=UINT16, ComHandleId=3796, ComSystemTemplateSystemSignalRef=DET_AZIMUTH_181
            DET_SNR_184_oRDR_DETECTION_181_184_oPCAN_RADAR_4d912095_Tx: ComBitPosition=456, ComBitSize=8, ComSignalInitValue=0, ComSignalType=UINT8, ComHandleId=3874, ComSystemTemplateSystemSignalRef=DET_SNR_184
            DET_RANGE_VELOCITY_ERR_182_oRDR_DETECTION_181_184_oPCAN_RADAR_d1c44f83_Tx: ComBitPosition=176, ComBitSize=8, ComSignalInitValue=0, ComSignalType=UINT8, ComHandleId=3864, ComSystemTemplateSystemSignalRef=DET_RANGE_VELOCITY_ERR_182
            DET_RANGE_VELOCITY_182_oRDR_DETECTION_181_184_oPCAN_RADAR_de7fb431_Tx: ComBitPosition=160, ComBitSize=15, ComSignalInitValue=16384, ComSignalType=UINT16, ComHandleId=3860, ComSystemTemplateSystemSignalRef=DET_RANGE_VELOCITY_182
            DET_RANGE_VELOCITY_ERR_181_oRDR_DETECTION_181_184_oPCAN_RADAR_b524347d_Tx: ComBitPosition=64, ComBitSize=8, ComSignalInitValue=0, ComSignalType=UINT8, ComHandleId=3863, ComSystemTemplateSystemSignalRef=DET_RANGE_VELOCITY_ERR_181
            DET_RCS_183_oRDR_DETECTION_181_184_oPCAN_RADAR_cc8f57fe_Tx: ComBitPosition=352, ComBitSize=8, ComSignalInitValue=128, ComSignalType=UINT8, ComHandleId=3869, ComSystemTemplateSystemSignalRef=DET_RCS_183
            DET_RCS_182_oRDR_DETECTION_181_184_oPCAN_RADAR_59ff836b_Tx: ComBitPosition=240, ComBitSize=8, ComSignalInitValue=128, ComSignalType=UINT8, ComHandleId=3868, ComSystemTemplateSystemSignalRef=DET_RCS_182
            DET_SUPER_RES_TARGET_182_oRDR_DETECTION_181_184_oPCAN_RADAR_b5c8ff0c_Tx: ComBitPosition=199, ComBitSize=1, ComSignalInitValue=0, ComSignalType=BOOLEAN, ComHandleId=3876, ComSystemTemplateSystemSignalRef=DET_SUPER_RES_TARGET_182
            DET_ELEVATION_184_oRDR_DETECTION_181_184_oPCAN_RADAR_a3312d5f_Tx: ComBitPosition=408, ComBitSize=8, ComSignalInitValue=0, ComSignalType=UINT8, ComHandleId=3823, ComSystemTemplateSystemSignalRef=DET_ELEVATION_184
            DET_CONFD_AZIMUTH_182_oRDR_DETECTION_181_184_oPCAN_RADAR_b9a40f65_Tx: ComBitPosition=230, ComBitSize=2, ComSignalInitValue=0, ComSignalType=UINT8, ComHandleId=3813, ComSystemTemplateSystemSignalRef=DET_CONFD_AZIMUTH_182
            DET_RANGE_ERR_182_oRDR_DETECTION_181_184_oPCAN_RADAR_0c31cc7d_Tx: ComBitPosition=152, ComBitSize=7, ComSignalInitValue=0, ComSignalType=UINT8, ComHandleId=3856, ComSystemTemplateSystemSignalRef=DET_RANGE_ERR_182
            DET_ELEVATION_ERR_182_oRDR_DETECTION_181_184_oPCAN_RADAR_edc842d6_Tx: ComBitPosition=192, ComBitSize=6, ComSignalInitValue=0, ComSignalType=UINT8, ComHandleId=3825, ComSystemTemplateSystemSignalRef=DET_ELEVATION_ERR_182
            DET_ELEVATION_ERR_184_oRDR_DETECTION_181_184_oPCAN_RADAR_2408b52a_Tx: ComBitPosition=416, ComBitSize=6, ComSignalInitValue=0, ComSignalType=UINT8, ComHandleId=3827, ComSystemTemplateSystemSignalRef=DET_ELEVATION_ERR_184
            DET_HVC_FLAG_182_oRDR_DETECTION_181_184_oPCAN_RADAR_de2374c9_Tx: ComBitPosition=198, ComBitSize=1, ComSignalInitValue=0, ComSignalType=BOOLEAN, ComHandleId=3833, ComSystemTemplateSystemSignalRef=DET_HVC_FLAG_182
            DET_EXISTENCE_PROB_182_oRDR_DETECTION_181_184_oPCAN_RADAR_3f5737b6_Tx: ComBitPosition=224, ComBitSize=6, ComSignalInitValue=0, ComSignalType=UINT8, ComHandleId=3829, ComSystemTemplateSystemSignalRef=DET_EXISTENCE_PROB_182
            DET_AZIMUTH_ERR_181_oRDR_DETECTION_181_184_oPCAN_RADAR_7b17eba4_Tx: ComBitPosition=105, ComBitSize=7, ComSignalInitValue=0, ComSignalType=UINT8, ComHandleId=3800, ComSystemTemplateSystemSignalRef=DET_AZIMUTH_ERR_181
            DET_MH_SCAN_INDEX_4LSB_181_184_oRDR_DETECTION_181_184_oPCAN_RADAR_84e160e1_Tx: ComBitPosition=476, ComBitSize=4, ComSignalInitValue=0, ComSignalType=UINT8, ComHandleId=3842, ComSystemTemplateSystemSignalRef=DET_MH_SCAN_INDEX_4LSB_181_184
            DET_RANGE_183_oRDR_DETECTION_181_184_oPCAN_RADAR_3ea9a281_Tx: ComBitPosition=248, ComBitSize=15, ComSignalInitValue=0, ComSignalType=UINT16, ComHandleId=3853, ComSystemTemplateSystemSignalRef=DET_RANGE_183
            DET_EXISTENCE_PROB_183_oRDR_DETECTION_181_184_oPCAN_RADAR_aa27e323_Tx: ComBitPosition=336, ComBitSize=6, ComSignalInitValue=0, ComSignalType=UINT8, ComHandleId=3830, ComSystemTemplateSystemSignalRef=DET_EXISTENCE_PROB_183
            DET_CONFD_AZIMUTH_184_oRDR_DETECTION_181_184_oPCAN_RADAR_7064f899_Tx: ComBitPosition=454, ComBitSize=2, ComSignalInitValue=0, ComSignalType=UINT8, ComHandleId=3815, ComSystemTemplateSystemSignalRef=DET_CONFD_AZIMUTH_184
            DET_IDM_183_oRDR_DETECTION_181_184_oPCAN_RADAR_c0019be1_Tx: ComBitPosition=287, ComBitSize=1, ComSignalInitValue=0, ComSignalType=UINT8, ComHandleId=3838, ComSystemTemplateSystemSignalRef=DET_IDM_183
            DET_PROB_1STAZHYPO_181_oRDR_DETECTION_181_184_oPCAN_RADAR_c496ee9c_Tx: ComBitPosition=103, ComBitSize=1, ComSignalInitValue=0, ComSignalType=BOOLEAN, ComHandleId=3847, ComSystemTemplateSystemSignalRef=DET_PROB_1STAZHYPO_181
            DET_IDM_182_oRDR_DETECTION_181_184_oPCAN_RADAR_55714f74_Tx: ComBitPosition=175, ComBitSize=1, ComSignalInitValue=0, ComSignalType=UINT8, ComHandleId=3837, ComSystemTemplateSystemSignalRef=DET_IDM_182
            DET_BELOW_RAIN_THOLD_183_oRDR_DETECTION_181_184_oPCAN_RADAR_fb3342fa_Tx: ComBitPosition=263, ComBitSize=1, ComSignalInitValue=0, ComSignalType=UINT8, ComHandleId=3806, ComSystemTemplateSystemSignalRef=DET_BELOW_RAIN_THOLD_183
            DET_MTD_184_oRDR_DETECTION_181_184_oPCAN_RADAR_fa028a53_Tx: ComBitPosition=383, ComBitSize=1, ComSignalInitValue=0, ComSignalType=UINT8, ComHandleId=3846, ComSystemTemplateSystemSignalRef=DET_MTD_184
            DET_BELOW_RAIN_THOLD_181_oRDR_DETECTION_181_184_oPCAN_RADAR_0aa3ed91_Tx: ComBitPosition=39, ComBitSize=1, ComSignalInitValue=0, ComSignalType=UINT8, ComHandleId=3804, ComSystemTemplateSystemSignalRef=DET_BELOW_RAIN_THOLD_181
            DET_MTD_181_oRDR_DETECTION_181_184_oPCAN_RADAR_57220651_Tx: ComBitPosition=47, ComBitSize=1, ComSignalInitValue=0, ComSignalType=UINT8, ComHandleId=3843, ComSystemTemplateSystemSignalRef=DET_MTD_181
            DET_IDM_184_oRDR_DETECTION_181_184_oPCAN_RADAR_9cb1b888_Tx: ComBitPosition=399, ComBitSize=1, ComSignalInitValue=0, ComSignalType=UINT8, ComHandleId=3839, ComSystemTemplateSystemSignalRef=DET_IDM_184
            DET_MTD_183_oRDR_DETECTION_181_184_oPCAN_RADAR_a6b2a93a_Tx: ComBitPosition=271, ComBitSize=1, ComSignalInitValue=0, ComSignalType=UINT8, ComHandleId=3845, ComSystemTemplateSystemSignalRef=DET_MTD_183
            DET_BELOW_RAIN_THOLD_184_oRDR_DETECTION_181_184_oPCAN_RADAR_a7836193_Tx: ComBitPosition=375, ComBitSize=1, ComSignalInitValue=0, ComSignalType=UINT8, ComHandleId=3807, ComSystemTemplateSystemSignalRef=DET_BELOW_RAIN_THOLD_184
            DET_PROB_1STAZHYPO_183_oRDR_DETECTION_181_184_oPCAN_RADAR_350641f7_Tx: ComBitPosition=327, ComBitSize=1, ComSignalInitValue=0, ComSignalType=BOOLEAN, ComHandleId=3849, ComSystemTemplateSystemSignalRef=DET_PROB_1STAZHYPO_183
            DET_PROB_1STAZHYPO_182_oRDR_DETECTION_181_184_oPCAN_RADAR_a0769562_Tx: ComBitPosition=215, ComBitSize=1, ComSignalInitValue=0, ComSignalType=BOOLEAN, ComHandleId=3848, ComSystemTemplateSystemSignalRef=DET_PROB_1STAZHYPO_182
            DET_BELOW_RAIN_THOLD_182_oRDR_DETECTION_181_184_oPCAN_RADAR_6e43966f_Tx: ComBitPosition=151, ComBitSize=1, ComSignalInitValue=0, ComSignalType=UINT8, ComHandleId=3805, ComSystemTemplateSystemSignalRef=DET_BELOW_RAIN_THOLD_182
            DET_MTD_182_oRDR_DETECTION_181_184_oPCAN_RADAR_33c27daf_Tx: ComBitPosition=159, ComBitSize=1, ComSignalInitValue=0, ComSignalType=UINT8, ComHandleId=3844, ComSystemTemplateSystemSignalRef=DET_MTD_182
            DET_IDM_181_oRDR_DETECTION_181_184_oPCAN_RADAR_3191348a_Tx: ComBitPosition=63, ComBitSize=1, ComSignalInitValue=0, ComSignalType=UINT8, ComHandleId=3836, ComSystemTemplateSystemSignalRef=DET_IDM_181
            DET_PROB_1STAZHYPO_184_oRDR_DETECTION_181_184_oPCAN_RADAR_69b6629e_Tx: ComBitPosition=439, ComBitSize=1, ComSignalInitValue=0, ComSignalType=BOOLEAN, ComHandleId=3850, ComSystemTemplateSystemSignalRef=DET_PROB_1STAZHYPO_184
        SG_Detections_321_324_oRDR_DETECTION_321_324_oPCAN_RADAR_2dc55233_Tx: ComTransferProperty=TRIGGERED, ComHandleId=82, ComSystemTemplateSignalGroupRef=SG_Detections_321_324
          83 x ComGroupSignal, all with ComSignalEndianness=LITTLE_ENDIAN, ComTransferProperty=PENDING, ComSignalAccess=ACCESS_NEEDED_BY_SWC_OR_COM:
            DET_RANGE_VELOCITY_ERR_321_oRDR_DETECTION_321_324_oPCAN_RADAR_6ff3e48d_Tx: ComBitPosition=64, ComBitSize=8, ComSignalInitValue=0, ComSignalType=UINT8, ComHandleId=6768, ComSystemTemplateSystemSignalRef=DET_RANGE_VELOCITY_ERR_321
            DET_EXISTENCE_PROB_321_oRDR_DETECTION_321_324_oPCAN_RADAR_81609cb8_Tx: ComBitPosition=112, ComBitSize=6, ComSignalInitValue=0, ComSignalType=UINT8, ComHandleId=6733, ComSystemTemplateSystemSignalRef=DET_EXISTENCE_PROB_321
            DET_RANGE_324_oRDR_DETECTION_321_324_oPCAN_RADAR_b8ce5118_Tx: ComBitPosition=360, ComBitSize=15, ComSignalInitValue=0, ComSignalType=UINT16, ComHandleId=6759, ComSystemTemplateSystemSignalRef=DET_RANGE_324
            DET_RANGE_321_oRDR_DETECTION_321_324_oPCAN_RADAR_15eedd1a_Tx: ComBitPosition=24, ComBitSize=15, ComSignalInitValue=0, ComSignalType=UINT16, ComHandleId=6756, ComSystemTemplateSystemSignalRef=DET_RANGE_321
            DET_RANGE_VELOCITY_324_oRDR_DETECTION_321_324_oPCAN_RADAR_cd68933d_Tx: ComBitPosition=384, ComBitSize=15, ComSignalInitValue=16384, ComSignalType=UINT16, ComHandleId=6767, ComSystemTemplateSystemSignalRef=DET_RANGE_VELOCITY_324
            DET_EXISTENCE_PROB_324_oRDR_DETECTION_321_324_oPCAN_RADAR_2c4010ba_Tx: ComBitPosition=448, ComBitSize=6, ComSignalInitValue=0, ComSignalType=UINT8, ComHandleId=6736, ComSystemTemplateSystemSignalRef=DET_EXISTENCE_PROB_324
            DET_RANGE_323_oRDR_DETECTION_321_324_oPCAN_RADAR_e47e7271_Tx: ComBitPosition=248, ComBitSize=15, ComSignalInitValue=0, ComSignalType=UINT16, ComHandleId=6758, ComSystemTemplateSystemSignalRef=DET_RANGE_323
            DET_CONFD_ELEVATION_321_oRDR_DETECTION_321_324_oPCAN_RADAR_0506a591_Tx: ComBitPosition=101, ComBitSize=2, ComSignalInitValue=0, ComSignalType=UINT8, ComHandleId=6721, ComSystemTemplateSystemSignalRef=DET_CONFD_ELEVATION_321
            DET_MH_CRC16_321_324_oRDR_DETECTION_321_324_oPCAN_RADAR_a94d8038_Tx: ComBitPosition=0, ComBitSize=16, ComSignalInitValue=0, ComSignalType=UINT16, ComHandleId=6745, ComSystemTemplateSystemSignalRef=DET_MH_CRC16_321_324
            DET_SNR_321_oRDR_DETECTION_321_324_oPCAN_RADAR_3a667c67_Tx: ComBitPosition=120, ComBitSize=8, ComSignalInitValue=0, ComSignalType=UINT8, ComHandleId=6776, ComSystemTemplateSystemSignalRef=DET_SNR_321
            DET_AZIMUTH_323_oRDR_DETECTION_321_324_oPCAN_RADAR_f4e501ca_Tx: ComBitPosition=312, ComBitSize=13, ComSignalInitValue=0, ComSignalType=UINT16, ComHandleId=6703, ComSystemTemplateSystemSignalRef=DET_AZIMUTH_323
            DET_SUPER_RES_TARGET_321_oRDR_DETECTION_321_324_oPCAN_RADAR_0bff5402_Tx: ComBitPosition=87, ComBitSize=1, ComSignalInitValue=0, ComSignalType=BOOLEAN, ComHandleId=6780, ComSystemTemplateSystemSignalRef=DET_SUPER_RES_TARGET_321
            DET_EXISTENCE_PROB_322_oRDR_DETECTION_321_324_oPCAN_RADAR_e580e746_Tx: ComBitPosition=224, ComBitSize=6, ComSignalInitValue=0, ComSignalType=UINT8, ComHandleId=6734, ComSystemTemplateSystemSignalRef=DET_EXISTENCE_PROB_322
            DET_SUPER_RES_TARGET_324_oRDR_DETECTION_321_324_oPCAN_RADAR_a6dfd800_Tx: ComBitPosition=423, ComBitSize=1, ComSignalInitValue=0, ComSignalType=BOOLEAN, ComHandleId=6783, ComSystemTemplateSystemSignalRef=DET_SUPER_RES_TARGET_324
            DET_CONFD_AZIMUTH_323_oRDR_DETECTION_321_324_oPCAN_RADAR_f6030b00_Tx: ComBitPosition=342, ComBitSize=2, ComSignalInitValue=0, ComSignalType=UINT8, ComHandleId=6719, ComSystemTemplateSystemSignalRef=DET_CONFD_AZIMUTH_323
            DET_ELEVATION_ERR_321_oRDR_DETECTION_321_324_oPCAN_RADAR_53ffe9d8_Tx: ComBitPosition=80, ComBitSize=6, ComSignalInitValue=0, ComSignalType=UINT8, ComHandleId=6729, ComSystemTemplateSystemSignalRef=DET_ELEVATION_ERR_321
            DET_HVC_FLAG_323_oRDR_DETECTION_321_324_oPCAN_RADAR_918470ac_Tx: ComBitPosition=310, ComBitSize=1, ComSignalInitValue=0, ComSignalType=BOOLEAN, ComHandleId=6739, ComSystemTemplateSystemSignalRef=DET_HVC_FLAG_323
            DET_ELEVATION_324_oRDR_DETECTION_321_324_oPCAN_RADAR_79e6fdaf_Tx: ComBitPosition=408, ComBitSize=8, ComSignalInitValue=0, ComSignalType=UINT8, ComHandleId=6728, ComSystemTemplateSystemSignalRef=DET_ELEVATION_324
            DET_SUPER_RES_TARGET_322_oRDR_DETECTION_321_324_oPCAN_RADAR_6f1f2ffc_Tx: ComBitPosition=199, ComBitSize=1, ComSignalInitValue=0, ComSignalType=BOOLEAN, ComHandleId=6781, ComSystemTemplateSystemSignalRef=DET_SUPER_RES_TARGET_322
            DET_MH_SCAN_INDEX_4LSB_321_324_oRDR_DETECTION_321_324_oPCAN_RADAR_e1120483_Tx: ComBitPosition=476, ComBitSize=4, ComSignalInitValue=0, ComSignalType=UINT8, ComHandleId=6747, ComSystemTemplateSystemSignalRef=DET_MH_SCAN_INDEX_4LSB_321_324
            DET_RCS_322_oRDR_DETECTION_321_324_oPCAN_RADAR_8328539b_Tx: ComBitPosition=240, ComBitSize=8, ComSignalInitValue=128, ComSignalType=UINT8, ComHandleId=6773, ComSystemTemplateSystemSignalRef=DET_RCS_322
            DET_AZIMUTH_ERR_323_oRDR_DETECTION_321_324_oPCAN_RADAR_5050943f_Tx: ComBitPosition=329, ComBitSize=7, ComSignalInitValue=0, ComSignalType=UINT8, ComHandleId=6707, ComSystemTemplateSystemSignalRef=DET_AZIMUTH_ERR_323
            DET_EXISTENCE_PROB_323_oRDR_DETECTION_321_324_oPCAN_RADAR_70f033d3_Tx: ComBitPosition=336, ComBitSize=6, ComSignalInitValue=0, ComSignalType=UINT8, ComHandleId=6735, ComSystemTemplateSystemSignalRef=DET_EXISTENCE_PROB_323
            DET_BI_STATIC_FLAG_323_oRDR_DETECTION_321_324_oPCAN_RADAR_a2c9414f_Tx: ComBitPosition=328, ComBitSize=1, ComSignalInitValue=0, ComSignalType=BOOLEAN, ComHandleId=6715, ComSystemTemplateSystemSignalRef=DET_BI_STATIC_FLAG_323
            DET_ELEVATION_321_oRDR_DETECTION_321_324_oPCAN_RADAR_d4c671ad_Tx: ComBitPosition=72, ComBitSize=8, ComSignalInitValue=0, ComSignalType=UINT8, ComHandleId=6725, ComSystemTemplateSystemSignalRef=DET_ELEVATION_321
            DET_AZIMUTH_324_oRDR_DETECTION_321_324_oPCAN_RADAR_a85522a3_Tx: ComBitPosition=424, ComBitSize=13, ComSignalInitValue=0, ComSignalType=UINT16, ComHandleId=6704, ComSystemTemplateSystemSignalRef=DET_AZIMUTH_324
            DET_HVC_FLAG_324_oRDR_DETECTION_321_324_oPCAN_RADAR_cd3453c5_Tx: ComBitPosition=422, ComBitSize=1, ComSignalInitValue=0, ComSignalType=BOOLEAN, ComHandleId=6740, ComSystemTemplateSystemSignalRef=DET_HVC_FLAG_324
            DET_RANGE_ERR_321_oRDR_DETECTION_321_324_oPCAN_RADAR_b2066773_Tx: ComBitPosition=40, ComBitSize=7, ComSignalInitValue=0, ComSignalType=UINT8, ComHandleId=6760, ComSystemTemplateSystemSignalRef=DET_RANGE_ERR_321
            DET_CONFD_ELEVATION_323_oRDR_DETECTION_321_324_oPCAN_RADAR_f4960afa_Tx: ComBitPosition=325, ComBitSize=2, ComSignalInitValue=0, ComSignalType=UINT8, ComHandleId=6723, ComSystemTemplateSystemSignalRef=DET_CONFD_ELEVATION_323
            DET_CONFD_ELEVATION_324_oRDR_DETECTION_321_324_oPCAN_RADAR_a8262993_Tx: ComBitPosition=437, ComBitSize=2, ComSignalInitValue=0, ComSignalType=UINT8, ComHandleId=6724, ComSystemTemplateSystemSignalRef=DET_CONFD_ELEVATION_324
            DET_CONFD_AZIMUTH_322_oRDR_DETECTION_321_324_oPCAN_RADAR_6373df95_Tx: ComBitPosition=230, ComBitSize=2, ComSignalInitValue=0, ComSignalType=UINT8, ComHandleId=6718, ComSystemTemplateSystemSignalRef=DET_CONFD_AZIMUTH_322
            DET_ELEVATION_ERR_323_oRDR_DETECTION_321_324_oPCAN_RADAR_a26f46b3_Tx: ComBitPosition=304, ComBitSize=6, ComSignalInitValue=0, ComSignalType=UINT8, ComHandleId=6731, ComSystemTemplateSystemSignalRef=DET_ELEVATION_ERR_323
            DET_RANGE_322_oRDR_DETECTION_321_324_oPCAN_RADAR_710ea6e4_Tx: ComBitPosition=136, ComBitSize=15, ComSignalInitValue=0, ComSignalType=UINT16, ComHandleId=6757, ComSystemTemplateSystemSignalRef=DET_RANGE_322
            DET_RANGE_VELOCITY_ERR_323_oRDR_DETECTION_321_324_oPCAN_RADAR_9e634be6_Tx: ComBitPosition=288, ComBitSize=8, ComSignalInitValue=0, ComSignalType=UINT8, ComHandleId=6770, ComSystemTemplateSystemSignalRef=DET_RANGE_VELOCITY_ERR_323
            DET_ELEVATION_ERR_322_oRDR_DETECTION_321_324_oPCAN_RADAR_371f9226_Tx: ComBitPosition=192, ComBitSize=6, ComSignalInitValue=0, ComSignalType=UINT8, ComHandleId=6730, ComSystemTemplateSystemSignalRef=DET_ELEVATION_ERR_322
            DET_ELEVATION_ERR_324_oRDR_DETECTION_321_324_oPCAN_RADAR_fedf65da_Tx: ComBitPosition=416, ComBitSize=6, ComSignalInitValue=0, ComSignalType=UINT8, ComHandleId=6732, ComSystemTemplateSystemSignalRef=DET_ELEVATION_ERR_324
            DET_RANGE_ERR_322_oRDR_DETECTION_321_324_oPCAN_RADAR_d6e61c8d_Tx: ComBitPosition=152, ComBitSize=7, ComSignalInitValue=0, ComSignalType=UINT8, ComHandleId=6761, ComSystemTemplateSystemSignalRef=DET_RANGE_ERR_322
            DET_SNR_322_oRDR_DETECTION_321_324_oPCAN_RADAR_5e860799_Tx: ComBitPosition=232, ComBitSize=8, ComSignalInitValue=0, ComSignalType=UINT8, ComHandleId=6777, ComSystemTemplateSystemSignalRef=DET_SNR_322
            DET_SUPER_RES_TARGET_323_oRDR_DETECTION_321_324_oPCAN_RADAR_fa6ffb69_Tx: ComBitPosition=311, ComBitSize=1, ComSignalInitValue=0, ComSignalType=BOOLEAN, ComHandleId=6782, ComSystemTemplateSystemSignalRef=DET_SUPER_RES_TARGET_323
            DET_SNR_323_oRDR_DETECTION_321_324_oPCAN_RADAR_cbf6d30c_Tx: ComBitPosition=344, ComBitSize=8, ComSignalInitValue=0, ComSignalType=UINT8, ComHandleId=6778, ComSystemTemplateSystemSignalRef=DET_SNR_323
            DET_RANGE_VELOCITY_321_oRDR_DETECTION_321_324_oPCAN_RADAR_60481f3f_Tx: ComBitPosition=48, ComBitSize=15, ComSignalInitValue=16384, ComSignalType=UINT16, ComHandleId=6764, ComSystemTemplateSystemSignalRef=DET_RANGE_VELOCITY_321
            DET_AZIMUTH_321_oRDR_DETECTION_321_324_oPCAN_RADAR_0575aea1_Tx: ComBitPosition=88, ComBitSize=13, ComSignalInitValue=0, ComSignalType=UINT16, ComHandleId=6701, ComSystemTemplateSystemSignalRef=DET_AZIMUTH_321
            DET_BI_STATIC_FLAG_322_oRDR_DETECTION_321_324_oPCAN_RADAR_37b995da_Tx: ComBitPosition=216, ComBitSize=1, ComSignalInitValue=0, ComSignalType=BOOLEAN, ComHandleId=6714, ComSystemTemplateSystemSignalRef=DET_BI_STATIC_FLAG_322
            DET_RCS_321_oRDR_DETECTION_321_324_oPCAN_RADAR_e7c82865_Tx: ComBitPosition=128, ComBitSize=8, ComSignalInitValue=128, ComSignalType=UINT8, ComHandleId=6772, ComSystemTemplateSystemSignalRef=DET_RCS_321
            DET_AZIMUTH_ERR_322_oRDR_DETECTION_321_324_oPCAN_RADAR_c52040aa_Tx: ComBitPosition=217, ComBitSize=7, ComSignalInitValue=0, ComSignalType=UINT8, ComHandleId=6706, ComSystemTemplateSystemSignalRef=DET_AZIMUTH_ERR_322
            DET_CONFD_AZIMUTH_324_oRDR_DETECTION_321_324_oPCAN_RADAR_aab32869_Tx: ComBitPosition=454, ComBitSize=2, ComSignalInitValue=0, ComSignalType=UINT8, ComHandleId=6720, ComSystemTemplateSystemSignalRef=DET_CONFD_AZIMUTH_324
            DET_ELEVATION_322_oRDR_DETECTION_321_324_oPCAN_RADAR_b0260a53_Tx: ComBitPosition=184, ComBitSize=8, ComSignalInitValue=0, ComSignalType=UINT8, ComHandleId=6726, ComSystemTemplateSystemSignalRef=DET_ELEVATION_322
            DET_SNR_324_oRDR_DETECTION_321_324_oPCAN_RADAR_9746f065_Tx: ComBitPosition=456, ComBitSize=8, ComSignalInitValue=0, ComSignalType=UINT8, ComHandleId=6779, ComSystemTemplateSystemSignalRef=DET_SNR_324
            DET_RANGE_ERR_324_oRDR_DETECTION_321_324_oPCAN_RADAR_1f26eb71_Tx: ComBitPosition=376, ComBitSize=7, ComSignalInitValue=0, ComSignalType=UINT8, ComHandleId=6763, ComSystemTemplateSystemSignalRef=DET_RANGE_ERR_324
            DET_RCS_323_oRDR_DETECTION_321_324_oPCAN_RADAR_1658870e_Tx: ComBitPosition=352, ComBitSize=8, ComSignalInitValue=128, ComSignalType=UINT8, ComHandleId=6774, ComSystemTemplateSystemSignalRef=DET_RCS_323
            DET_CONFD_AZIMUTH_321_oRDR_DETECTION_321_324_oPCAN_RADAR_0793a46b_Tx: ComBitPosition=118, ComBitSize=2, ComSignalInitValue=0, ComSignalType=UINT8, ComHandleId=6717, ComSystemTemplateSystemSignalRef=DET_CONFD_AZIMUTH_321
            DET_HVC_FLAG_321_oRDR_DETECTION_321_324_oPCAN_RADAR_6014dfc7_Tx: ComBitPosition=86, ComBitSize=1, ComSignalInitValue=0, ComSignalType=BOOLEAN, ComHandleId=6737, ComSystemTemplateSystemSignalRef=DET_HVC_FLAG_321
            DET_RANGE_VELOCITY_ERR_322_oRDR_DETECTION_321_324_oPCAN_RADAR_0b139f73_Tx: ComBitPosition=176, ComBitSize=8, ComSignalInitValue=0, ComSignalType=UINT8, ComHandleId=6769, ComSystemTemplateSystemSignalRef=DET_RANGE_VELOCITY_ERR_322
            DET_MH_CYCLE_COUNTER_321_324_oRDR_DETECTION_321_324_oPCAN_RADAR_2d38210f_Tx: ComBitPosition=16, ComBitSize=8, ComSignalInitValue=0, ComSignalType=UINT8, ComHandleId=6746, ComSystemTemplateSystemSignalRef=DET_MH_CYCLE_COUNTER_321_324
            DET_RANGE_VELOCITY_322_oRDR_DETECTION_321_324_oPCAN_RADAR_04a864c1_Tx: ComBitPosition=160, ComBitSize=15, ComSignalInitValue=16384, ComSignalType=UINT16, ComHandleId=6765, ComSystemTemplateSystemSignalRef=DET_RANGE_VELOCITY_322
            DET_RANGE_VELOCITY_ERR_324_oRDR_DETECTION_321_324_oPCAN_RADAR_c2d3688f_Tx: ComBitPosition=400, ComBitSize=8, ComSignalInitValue=0, ComSignalType=UINT8, ComHandleId=6771, ComSystemTemplateSystemSignalRef=DET_RANGE_VELOCITY_ERR_324
            DET_BI_STATIC_FLAG_321_oRDR_DETECTION_321_324_oPCAN_RADAR_5359ee24_Tx: ComBitPosition=104, ComBitSize=1, ComSignalInitValue=0, ComSignalType=BOOLEAN, ComHandleId=6713, ComSystemTemplateSystemSignalRef=DET_BI_STATIC_FLAG_321
            DET_AZIMUTH_322_oRDR_DETECTION_321_324_oPCAN_RADAR_6195d55f_Tx: ComBitPosition=200, ComBitSize=13, ComSignalInitValue=0, ComSignalType=UINT16, ComHandleId=6702, ComSystemTemplateSystemSignalRef=DET_AZIMUTH_322
            DET_AZIMUTH_ERR_321_oRDR_DETECTION_321_324_oPCAN_RADAR_a1c03b54_Tx: ComBitPosition=105, ComBitSize=7, ComSignalInitValue=0, ComSignalType=UINT8, ComHandleId=6705, ComSystemTemplateSystemSignalRef=DET_AZIMUTH_ERR_321
            DET_BI_STATIC_FLAG_324_oRDR_DETECTION_321_324_oPCAN_RADAR_fe796226_Tx: ComBitPosition=440, ComBitSize=1, ComSignalInitValue=0, ComSignalType=BOOLEAN, ComHandleId=6716, ComSystemTemplateSystemSignalRef=DET_BI_STATIC_FLAG_324
            DET_RANGE_ERR_323_oRDR_DETECTION_321_324_oPCAN_RADAR_4396c818_Tx: ComBitPosition=264, ComBitSize=7, ComSignalInitValue=0, ComSignalType=UINT8, ComHandleId=6762, ComSystemTemplateSystemSignalRef=DET_RANGE_ERR_323
            DET_HVC_FLAG_322_oRDR_DETECTION_321_324_oPCAN_RADAR_04f4a439_Tx: ComBitPosition=198, ComBitSize=1, ComSignalInitValue=0, ComSignalType=BOOLEAN, ComHandleId=6738, ComSystemTemplateSystemSignalRef=DET_HVC_FLAG_322
            DET_ELEVATION_323_oRDR_DETECTION_321_324_oPCAN_RADAR_2556dec6_Tx: ComBitPosition=296, ComBitSize=8, ComSignalInitValue=0, ComSignalType=UINT8, ComHandleId=6727, ComSystemTemplateSystemSignalRef=DET_ELEVATION_323
            DET_RCS_324_oRDR_DETECTION_321_324_oPCAN_RADAR_4ae8a467_Tx: ComBitPosition=464, ComBitSize=8, ComSignalInitValue=128, ComSignalType=UINT8, ComHandleId=6775, ComSystemTemplateSystemSignalRef=DET_RCS_324
            DET_AZIMUTH_ERR_324_oRDR_DETECTION_321_324_oPCAN_RADAR_0ce0b756_Tx: ComBitPosition=441, ComBitSize=7, ComSignalInitValue=0, ComSignalType=UINT8, ComHandleId=6708, ComSystemTemplateSystemSignalRef=DET_AZIMUTH_ERR_324
            DET_RANGE_VELOCITY_323_oRDR_DETECTION_321_324_oPCAN_RADAR_91d8b054_Tx: ComBitPosition=272, ComBitSize=15, ComSignalInitValue=16384, ComSignalType=UINT16, ComHandleId=6766, ComSystemTemplateSystemSignalRef=DET_RANGE_VELOCITY_323
            DET_CONFD_ELEVATION_322_oRDR_DETECTION_321_324_oPCAN_RADAR_61e6de6f_Tx: ComBitPosition=213, ComBitSize=2, ComSignalInitValue=0, ComSignalType=UINT8, ComHandleId=6722, ComSystemTemplateSystemSignalRef=DET_CONFD_ELEVATION_322
            DET_PROB_1STAZHYPO_321_oRDR_DETECTION_321_324_oPCAN_RADAR_1e413e6c_Tx: ComBitPosition=103, ComBitSize=1, ComSignalInitValue=0, ComSignalType=BOOLEAN, ComHandleId=6752, ComSystemTemplateSystemSignalRef=DET_PROB_1STAZHYPO_321
            DET_BELOW_RAIN_THOLD_324_oRDR_DETECTION_321_324_oPCAN_RADAR_7d54b163_Tx: ComBitPosition=375, ComBitSize=1, ComSignalInitValue=0, ComSignalType=UINT8, ComHandleId=6712, ComSystemTemplateSystemSignalRef=DET_BELOW_RAIN_THOLD_324
            DET_PROB_1STAZHYPO_324_oRDR_DETECTION_321_324_oPCAN_RADAR_b361b26e_Tx: ComBitPosition=439, ComBitSize=1, ComSignalInitValue=0, ComSignalType=BOOLEAN, ComHandleId=6755, ComSystemTemplateSystemSignalRef=DET_PROB_1STAZHYPO_324
            DET_BELOW_RAIN_THOLD_323_oRDR_DETECTION_321_324_oPCAN_RADAR_21e4920a_Tx: ComBitPosition=263, ComBitSize=1, ComSignalInitValue=0, ComSignalType=UINT8, ComHandleId=6711, ComSystemTemplateSystemSignalRef=DET_BELOW_RAIN_THOLD_323
            DET_IDM_322_oRDR_DETECTION_321_324_oPCAN_RADAR_8fa69f84_Tx: ComBitPosition=175, ComBitSize=1, ComSignalInitValue=0, ComSignalType=UINT8, ComHandleId=6742, ComSystemTemplateSystemSignalRef=DET_IDM_322
            DET_IDM_323_oRDR_DETECTION_321_324_oPCAN_RADAR_1ad64b11_Tx: ComBitPosition=287, ComBitSize=1, ComSignalInitValue=0, ComSignalType=UINT8, ComHandleId=6743, ComSystemTemplateSystemSignalRef=DET_IDM_323
            DET_MTD_324_oRDR_DETECTION_321_324_oPCAN_RADAR_20d55aa3_Tx: ComBitPosition=383, ComBitSize=1, ComSignalInitValue=0, ComSignalType=UINT8, ComHandleId=6751, ComSystemTemplateSystemSignalRef=DET_MTD_324
            DET_BELOW_RAIN_THOLD_322_oRDR_DETECTION_321_324_oPCAN_RADAR_b494469f_Tx: ComBitPosition=151, ComBitSize=1, ComSignalInitValue=0, ComSignalType=UINT8, ComHandleId=6710, ComSystemTemplateSystemSignalRef=DET_BELOW_RAIN_THOLD_322
            DET_IDM_324_oRDR_DETECTION_321_324_oPCAN_RADAR_46666878_Tx: ComBitPosition=399, ComBitSize=1, ComSignalInitValue=0, ComSignalType=UINT8, ComHandleId=6744, ComSystemTemplateSystemSignalRef=DET_IDM_324
            DET_MTD_321_oRDR_DETECTION_321_324_oPCAN_RADAR_8df5d6a1_Tx: ComBitPosition=47, ComBitSize=1, ComSignalInitValue=0, ComSignalType=UINT8, ComHandleId=6748, ComSystemTemplateSystemSignalRef=DET_MTD_321
            DET_MTD_323_oRDR_DETECTION_321_324_oPCAN_RADAR_7c6579ca_Tx: ComBitPosition=271, ComBitSize=1, ComSignalInitValue=0, ComSignalType=UINT8, ComHandleId=6750, ComSystemTemplateSystemSignalRef=DET_MTD_323
            DET_BELOW_RAIN_THOLD_321_oRDR_DETECTION_321_324_oPCAN_RADAR_d0743d61_Tx: ComBitPosition=39, ComBitSize=1, ComSignalInitValue=0, ComSignalType=UINT8, ComHandleId=6709, ComSystemTemplateSystemSignalRef=DET_BELOW_RAIN_THOLD_321
            DET_PROB_1STAZHYPO_323_oRDR_DETECTION_321_324_oPCAN_RADAR_efd19107_Tx: ComBitPosition=327, ComBitSize=1, ComSignalInitValue=0, ComSignalType=BOOLEAN, ComHandleId=6754, ComSystemTemplateSystemSignalRef=DET_PROB_1STAZHYPO_323
            DET_IDM_321_oRDR_DETECTION_321_324_oPCAN_RADAR_eb46e47a_Tx: ComBitPosition=63, ComBitSize=1, ComSignalInitValue=0, ComSignalType=UINT8, ComHandleId=6741, ComSystemTemplateSystemSignalRef=DET_IDM_321
            DET_PROB_1STAZHYPO_322_oRDR_DETECTION_321_324_oPCAN_RADAR_7aa14592_Tx: ComBitPosition=215, ComBitSize=1, ComSignalInitValue=0, ComSignalType=BOOLEAN, ComHandleId=6753, ComSystemTemplateSystemSignalRef=DET_PROB_1STAZHYPO_322
            DET_MTD_322_oRDR_DETECTION_321_324_oPCAN_RADAR_e915ad5f_Tx: ComBitPosition=159, ComBitSize=1, ComSignalInitValue=0, ComSignalType=UINT8, ComHandleId=6749, ComSystemTemplateSystemSignalRef=DET_MTD_322
        SG_Detections_329_332_oRDR_DETECTION_329_332_oPCAN_RADAR_c57c421a_Tx: ComTransferProperty=TRIGGERED, ComHandleId=84, ComSystemTemplateSignalGroupRef=SG_Detections_329_332
          83 x ComGroupSignal, all with ComSignalEndianness=LITTLE_ENDIAN, ComTransferProperty=PENDING, ComSignalAccess=ACCESS_NEEDED_BY_SWC_OR_COM:
            DET_RANGE_VELOCITY_329_oRDR_DETECTION_329_332_oPCAN_RADAR_cb12df24_Tx: ComBitPosition=48, ComBitSize=15, ComSignalInitValue=16384, ComSignalType=UINT16, ComHandleId=6930, ComSystemTemplateSystemSignalRef=DET_RANGE_VELOCITY_329
            DET_RANGE_ERR_329_oRDR_DETECTION_329_332_oPCAN_RADAR_195ca768_Tx: ComBitPosition=40, ComBitSize=7, ComSignalInitValue=0, ComSignalType=UINT8, ComHandleId=6926, ComSystemTemplateSystemSignalRef=DET_RANGE_ERR_329
            DET_RCS_329_oRDR_DETECTION_329_332_oPCAN_RADAR_4c92e87e_Tx: ComBitPosition=128, ComBitSize=8, ComSignalInitValue=128, ComSignalType=UINT8, ComHandleId=6938, ComSystemTemplateSystemSignalRef=DET_RCS_329
            DET_RANGE_VELOCITY_ERR_330_oRDR_DETECTION_329_332_oPCAN_RADAR_a1895632_Tx: ComBitPosition=176, ComBitSize=8, ComSignalInitValue=0, ComSignalType=UINT8, ComHandleId=6935, ComSystemTemplateSystemSignalRef=DET_RANGE_VELOCITY_ERR_330
            DET_AZIMUTH_332_oRDR_DETECTION_329_332_oPCAN_RADAR_3a9fb375_Tx: ComBitPosition=424, ComBitSize=13, ComSignalInitValue=0, ComSignalType=UINT16, ComHandleId=6870, ComSystemTemplateSystemSignalRef=DET_AZIMUTH_332
            DET_HVC_FLAG_329_oRDR_DETECTION_329_332_oPCAN_RADAR_cb4e1fdc_Tx: ComBitPosition=86, ComBitSize=1, ComSignalInitValue=0, ComSignalType=BOOLEAN, ComHandleId=6903, ComSystemTemplateSystemSignalRef=DET_HVC_FLAG_329
            DET_RANGE_VELOCITY_331_oRDR_DETECTION_329_332_oPCAN_RADAR_3b427915_Tx: ComBitPosition=272, ComBitSize=15, ComSignalInitValue=16384, ComSignalType=UINT16, ComHandleId=6932, ComSystemTemplateSystemSignalRef=DET_RANGE_VELOCITY_331
            DET_RANGE_331_oRDR_DETECTION_329_332_oPCAN_RADAR_4ee4bb30_Tx: ComBitPosition=248, ComBitSize=15, ComSignalInitValue=0, ComSignalType=UINT16, ComHandleId=6924, ComSystemTemplateSystemSignalRef=DET_RANGE_331
            DET_RANGE_VELOCITY_ERR_329_oRDR_DETECTION_329_332_oPCAN_RADAR_c4a92496_Tx: ComBitPosition=64, ComBitSize=8, ComSignalInitValue=0, ComSignalType=UINT8, ComHandleId=6934, ComSystemTemplateSystemSignalRef=DET_RANGE_VELOCITY_ERR_329
            DET_BI_STATIC_FLAG_331_oRDR_DETECTION_329_332_oPCAN_RADAR_0853880e_Tx: ComBitPosition=328, ComBitSize=1, ComSignalInitValue=0, ComSignalType=BOOLEAN, ComHandleId=6881, ComSystemTemplateSystemSignalRef=DET_BI_STATIC_FLAG_331
            DET_ELEVATION_ERR_330_oRDR_DETECTION_329_332_oPCAN_RADAR_9d855b67_Tx: ComBitPosition=192, ComBitSize=6, ComSignalInitValue=0, ComSignalType=UINT8, ComHandleId=6896, ComSystemTemplateSystemSignalRef=DET_ELEVATION_ERR_330
            DET_SNR_331_oRDR_DETECTION_329_332_oPCAN_RADAR_616c1a4d_Tx: ComBitPosition=344, ComBitSize=8, ComSignalInitValue=0, ComSignalType=UINT8, ComHandleId=6944, ComSystemTemplateSystemSignalRef=DET_SNR_331
            DET_AZIMUTH_329_oRDR_DETECTION_329_332_oPCAN_RADAR_ae2f6eba_Tx: ComBitPosition=88, ComBitSize=13, ComSignalInitValue=0, ComSignalType=UINT16, ComHandleId=6867, ComSystemTemplateSystemSignalRef=DET_AZIMUTH_329
            DET_RANGE_VELOCITY_ERR_332_oRDR_DETECTION_329_332_oPCAN_RADAR_5019f959_Tx: ComBitPosition=400, ComBitSize=8, ComSignalInitValue=0, ComSignalType=UINT8, ComHandleId=6937, ComSystemTemplateSystemSignalRef=DET_RANGE_VELOCITY_ERR_332
            DET_CONFD_ELEVATION_332_oRDR_DETECTION_329_332_oPCAN_RADAR_3aecb845_Tx: ComBitPosition=437, ComBitSize=2, ComSignalInitValue=0, ComSignalType=UINT8, ComHandleId=6890, ComSystemTemplateSystemSignalRef=DET_CONFD_ELEVATION_332
            DET_HVC_FLAG_332_oRDR_DETECTION_329_332_oPCAN_RADAR_5ffec213_Tx: ComBitPosition=422, ComBitSize=1, ComSignalInitValue=0, ComSignalType=BOOLEAN, ComHandleId=6906, ComSystemTemplateSystemSignalRef=DET_HVC_FLAG_332
            DET_BI_STATIC_FLAG_330_oRDR_DETECTION_329_332_oPCAN_RADAR_9d235c9b_Tx: ComBitPosition=216, ComBitSize=1, ComSignalInitValue=0, ComSignalType=BOOLEAN, ComHandleId=6880, ComSystemTemplateSystemSignalRef=DET_BI_STATIC_FLAG_330
            DET_CONFD_AZIMUTH_332_oRDR_DETECTION_329_332_oPCAN_RADAR_3879b9bf_Tx: ComBitPosition=454, ComBitSize=2, ComSignalInitValue=0, ComSignalType=UINT8, ComHandleId=6886, ComSystemTemplateSystemSignalRef=DET_CONFD_AZIMUTH_332
            DET_ELEVATION_331_oRDR_DETECTION_329_332_oPCAN_RADAR_8fcc1787_Tx: ComBitPosition=296, ComBitSize=8, ComSignalInitValue=0, ComSignalType=UINT8, ComHandleId=6893, ComSystemTemplateSystemSignalRef=DET_ELEVATION_331
            DET_AZIMUTH_330_oRDR_DETECTION_329_332_oPCAN_RADAR_cb0f1c1e_Tx: ComBitPosition=200, ComBitSize=13, ComSignalInitValue=0, ComSignalType=UINT16, ComHandleId=6868, ComSystemTemplateSystemSignalRef=DET_AZIMUTH_330
            DET_HVC_FLAG_331_oRDR_DETECTION_329_332_oPCAN_RADAR_3b1eb9ed_Tx: ComBitPosition=310, ComBitSize=1, ComSignalInitValue=0, ComSignalType=BOOLEAN, ComHandleId=6905, ComSystemTemplateSystemSignalRef=DET_HVC_FLAG_331
            DET_ELEVATION_ERR_329_oRDR_DETECTION_329_332_oPCAN_RADAR_f8a529c3_Tx: ComBitPosition=80, ComBitSize=6, ComSignalInitValue=0, ComSignalType=UINT8, ComHandleId=6895, ComSystemTemplateSystemSignalRef=DET_ELEVATION_ERR_329
            DET_EXISTENCE_PROB_331_oRDR_DETECTION_329_332_oPCAN_RADAR_da6afa92_Tx: ComBitPosition=336, ComBitSize=6, ComSignalInitValue=0, ComSignalType=UINT8, ComHandleId=6901, ComSystemTemplateSystemSignalRef=DET_EXISTENCE_PROB_331
            DET_EXISTENCE_PROB_332_oRDR_DETECTION_329_332_oPCAN_RADAR_be8a816c_Tx: ComBitPosition=448, ComBitSize=6, ComSignalInitValue=0, ComSignalType=UINT8, ComHandleId=6902, ComSystemTemplateSystemSignalRef=DET_EXISTENCE_PROB_332
            DET_AZIMUTH_ERR_332_oRDR_DETECTION_329_332_oPCAN_RADAR_9e2a2680_Tx: ComBitPosition=441, ComBitSize=7, ComSignalInitValue=0, ComSignalType=UINT8, ComHandleId=6874, ComSystemTemplateSystemSignalRef=DET_AZIMUTH_ERR_332
            DET_RANGE_VELOCITY_332_oRDR_DETECTION_329_332_oPCAN_RADAR_5fa202eb_Tx: ComBitPosition=384, ComBitSize=15, ComSignalInitValue=16384, ComSignalType=UINT16, ComHandleId=6933, ComSystemTemplateSystemSignalRef=DET_RANGE_VELOCITY_332
            DET_EXISTENCE_PROB_329_oRDR_DETECTION_329_332_oPCAN_RADAR_2a3a5ca3_Tx: ComBitPosition=112, ComBitSize=6, ComSignalInitValue=0, ComSignalType=UINT8, ComHandleId=6899, ComSystemTemplateSystemSignalRef=DET_EXISTENCE_PROB_329
            DET_RCS_331_oRDR_DETECTION_329_332_oPCAN_RADAR_bcc24e4f_Tx: ComBitPosition=352, ComBitSize=8, ComSignalInitValue=128, ComSignalType=UINT8, ComHandleId=6940, ComSystemTemplateSystemSignalRef=DET_RCS_331
            DET_SUPER_RES_TARGET_331_oRDR_DETECTION_329_332_oPCAN_RADAR_50f53228_Tx: ComBitPosition=311, ComBitSize=1, ComSignalInitValue=0, ComSignalType=BOOLEAN, ComHandleId=6948, ComSystemTemplateSystemSignalRef=DET_SUPER_RES_TARGET_331
            DET_ELEVATION_ERR_332_oRDR_DETECTION_329_332_oPCAN_RADAR_6c15f40c_Tx: ComBitPosition=416, ComBitSize=6, ComSignalInitValue=0, ComSignalType=UINT8, ComHandleId=6898, ComSystemTemplateSystemSignalRef=DET_ELEVATION_ERR_332
            DET_CONFD_AZIMUTH_331_oRDR_DETECTION_329_332_oPCAN_RADAR_5c99c241_Tx: ComBitPosition=342, ComBitSize=2, ComSignalInitValue=0, ComSignalType=UINT8, ComHandleId=6885, ComSystemTemplateSystemSignalRef=DET_CONFD_AZIMUTH_331
            DET_RANGE_VELOCITY_ERR_331_oRDR_DETECTION_329_332_oPCAN_RADAR_34f982a7_Tx: ComBitPosition=288, ComBitSize=8, ComSignalInitValue=0, ComSignalType=UINT8, ComHandleId=6936, ComSystemTemplateSystemSignalRef=DET_RANGE_VELOCITY_ERR_331
            DET_ELEVATION_ERR_331_oRDR_DETECTION_329_332_oPCAN_RADAR_08f58ff2_Tx: ComBitPosition=304, ComBitSize=6, ComSignalInitValue=0, ComSignalType=UINT8, ComHandleId=6897, ComSystemTemplateSystemSignalRef=DET_ELEVATION_ERR_331
            DET_CONFD_ELEVATION_330_oRDR_DETECTION_329_332_oPCAN_RADAR_cb7c172e_Tx: ComBitPosition=213, ComBitSize=2, ComSignalInitValue=0, ComSignalType=UINT8, ComHandleId=6888, ComSystemTemplateSystemSignalRef=DET_CONFD_ELEVATION_330
            DET_AZIMUTH_331_oRDR_DETECTION_329_332_oPCAN_RADAR_5e7fc88b_Tx: ComBitPosition=312, ComBitSize=13, ComSignalInitValue=0, ComSignalType=UINT16, ComHandleId=6869, ComSystemTemplateSystemSignalRef=DET_AZIMUTH_331
            DET_CONFD_AZIMUTH_330_oRDR_DETECTION_329_332_oPCAN_RADAR_c9e916d4_Tx: ComBitPosition=230, ComBitSize=2, ComSignalInitValue=0, ComSignalType=UINT8, ComHandleId=6884, ComSystemTemplateSystemSignalRef=DET_CONFD_AZIMUTH_330
            DET_RANGE_ERR_331_oRDR_DETECTION_329_332_oPCAN_RADAR_e90c0159_Tx: ComBitPosition=264, ComBitSize=7, ComSignalInitValue=0, ComSignalType=UINT8, ComHandleId=6928, ComSystemTemplateSystemSignalRef=DET_RANGE_ERR_331
            DET_HVC_FLAG_330_oRDR_DETECTION_329_332_oPCAN_RADAR_ae6e6d78_Tx: ComBitPosition=198, ComBitSize=1, ComSignalInitValue=0, ComSignalType=BOOLEAN, ComHandleId=6904, ComSystemTemplateSystemSignalRef=DET_HVC_FLAG_330
            DET_RANGE_329_oRDR_DETECTION_329_332_oPCAN_RADAR_beb41d01_Tx: ComBitPosition=24, ComBitSize=15, ComSignalInitValue=0, ComSignalType=UINT16, ComHandleId=6922, ComSystemTemplateSystemSignalRef=DET_RANGE_329
            DET_SNR_330_oRDR_DETECTION_329_332_oPCAN_RADAR_f41cced8_Tx: ComBitPosition=232, ComBitSize=8, ComSignalInitValue=0, ComSignalType=UINT8, ComHandleId=6943, ComSystemTemplateSystemSignalRef=DET_SNR_330
            DET_ELEVATION_329_oRDR_DETECTION_329_332_oPCAN_RADAR_7f9cb1b6_Tx: ComBitPosition=72, ComBitSize=8, ComSignalInitValue=0, ComSignalType=UINT8, ComHandleId=6891, ComSystemTemplateSystemSignalRef=DET_ELEVATION_329
            DET_AZIMUTH_ERR_331_oRDR_DETECTION_329_332_oPCAN_RADAR_faca5d7e_Tx: ComBitPosition=329, ComBitSize=7, ComSignalInitValue=0, ComSignalType=UINT8, ComHandleId=6873, ComSystemTemplateSystemSignalRef=DET_AZIMUTH_ERR_331
            DET_BI_STATIC_FLAG_329_oRDR_DETECTION_329_332_oPCAN_RADAR_f8032e3f_Tx: ComBitPosition=104, ComBitSize=1, ComSignalInitValue=0, ComSignalType=BOOLEAN, ComHandleId=6879, ComSystemTemplateSystemSignalRef=DET_BI_STATIC_FLAG_329
            DET_RANGE_ERR_330_oRDR_DETECTION_329_332_oPCAN_RADAR_7c7cd5cc_Tx: ComBitPosition=152, ComBitSize=7, ComSignalInitValue=0, ComSignalType=UINT8, ComHandleId=6927, ComSystemTemplateSystemSignalRef=DET_RANGE_ERR_330
            DET_EXISTENCE_PROB_330_oRDR_DETECTION_329_332_oPCAN_RADAR_4f1a2e07_Tx: ComBitPosition=224, ComBitSize=6, ComSignalInitValue=0, ComSignalType=UINT8, ComHandleId=6900, ComSystemTemplateSystemSignalRef=DET_EXISTENCE_PROB_330
            DET_SNR_329_oRDR_DETECTION_329_332_oPCAN_RADAR_913cbc7c_Tx: ComBitPosition=120, ComBitSize=8, ComSignalInitValue=0, ComSignalType=UINT8, ComHandleId=6942, ComSystemTemplateSystemSignalRef=DET_SNR_329
            DET_BI_STATIC_FLAG_332_oRDR_DETECTION_329_332_oPCAN_RADAR_6cb3f3f0_Tx: ComBitPosition=440, ComBitSize=1, ComSignalInitValue=0, ComSignalType=BOOLEAN, ComHandleId=6882, ComSystemTemplateSystemSignalRef=DET_BI_STATIC_FLAG_332
            DET_RCS_330_oRDR_DETECTION_329_332_oPCAN_RADAR_29b29ada_Tx: ComBitPosition=240, ComBitSize=8, ComSignalInitValue=128, ComSignalType=UINT8, ComHandleId=6939, ComSystemTemplateSystemSignalRef=DET_RCS_330
            DET_RANGE_330_oRDR_DETECTION_329_332_oPCAN_RADAR_db946fa5_Tx: ComBitPosition=136, ComBitSize=15, ComSignalInitValue=0, ComSignalType=UINT16, ComHandleId=6923, ComSystemTemplateSystemSignalRef=DET_RANGE_330
            DET_SUPER_RES_TARGET_330_oRDR_DETECTION_329_332_oPCAN_RADAR_c585e6bd_Tx: ComBitPosition=199, ComBitSize=1, ComSignalInitValue=0, ComSignalType=BOOLEAN, ComHandleId=6947, ComSystemTemplateSystemSignalRef=DET_SUPER_RES_TARGET_330
            DET_ELEVATION_332_oRDR_DETECTION_329_332_oPCAN_RADAR_eb2c6c79_Tx: ComBitPosition=408, ComBitSize=8, ComSignalInitValue=0, ComSignalType=UINT8, ComHandleId=6894, ComSystemTemplateSystemSignalRef=DET_ELEVATION_332
            DET_RANGE_ERR_332_oRDR_DETECTION_329_332_oPCAN_RADAR_8dec7aa7_Tx: ComBitPosition=376, ComBitSize=7, ComSignalInitValue=0, ComSignalType=UINT8, ComHandleId=6929, ComSystemTemplateSystemSignalRef=DET_RANGE_ERR_332
            DET_MH_CRC16_329_332_oRDR_DETECTION_329_332_oPCAN_RADAR_41f49011_Tx: ComBitPosition=0, ComBitSize=16, ComSignalInitValue=0, ComSignalType=UINT16, ComHandleId=6911, ComSystemTemplateSystemSignalRef=DET_MH_CRC16_329_332
            DET_CONFD_AZIMUTH_329_oRDR_DETECTION_329_332_oPCAN_RADAR_acc96470_Tx: ComBitPosition=118, ComBitSize=2, ComSignalInitValue=0, ComSignalType=UINT8, ComHandleId=6883, ComSystemTemplateSystemSignalRef=DET_CONFD_AZIMUTH_329
            DET_RANGE_VELOCITY_330_oRDR_DETECTION_329_332_oPCAN_RADAR_ae32ad80_Tx: ComBitPosition=160, ComBitSize=15, ComSignalInitValue=16384, ComSignalType=UINT16, ComHandleId=6931, ComSystemTemplateSystemSignalRef=DET_RANGE_VELOCITY_330
            DET_AZIMUTH_ERR_330_oRDR_DETECTION_329_332_oPCAN_RADAR_6fba89eb_Tx: ComBitPosition=217, ComBitSize=7, ComSignalInitValue=0, ComSignalType=UINT8, ComHandleId=6872, ComSystemTemplateSystemSignalRef=DET_AZIMUTH_ERR_330
            DET_RANGE_332_oRDR_DETECTION_329_332_oPCAN_RADAR_2a04c0ce_Tx: ComBitPosition=360, ComBitSize=15, ComSignalInitValue=0, ComSignalType=UINT16, ComHandleId=6925, ComSystemTemplateSystemSignalRef=DET_RANGE_332
            DET_MH_SCAN_INDEX_4LSB_329_332_oRDR_DETECTION_329_332_oPCAN_RADAR_09ab14aa_Tx: ComBitPosition=476, ComBitSize=4, ComSignalInitValue=0, ComSignalType=UINT8, ComHandleId=6913, ComSystemTemplateSystemSignalRef=DET_MH_SCAN_INDEX_4LSB_329_332
            DET_CONFD_ELEVATION_329_oRDR_DETECTION_329_332_oPCAN_RADAR_ae5c658a_Tx: ComBitPosition=101, ComBitSize=2, ComSignalInitValue=0, ComSignalType=UINT8, ComHandleId=6887, ComSystemTemplateSystemSignalRef=DET_CONFD_ELEVATION_329
            DET_CONFD_ELEVATION_331_oRDR_DETECTION_329_332_oPCAN_RADAR_5e0cc3bb_Tx: ComBitPosition=325, ComBitSize=2, ComSignalInitValue=0, ComSignalType=UINT8, ComHandleId=6889, ComSystemTemplateSystemSignalRef=DET_CONFD_ELEVATION_331
            DET_ELEVATION_330_oRDR_DETECTION_329_332_oPCAN_RADAR_1abcc312_Tx: ComBitPosition=184, ComBitSize=8, ComSignalInitValue=0, ComSignalType=UINT8, ComHandleId=6892, ComSystemTemplateSystemSignalRef=DET_ELEVATION_330
            DET_SUPER_RES_TARGET_329_oRDR_DETECTION_329_332_oPCAN_RADAR_a0a59419_Tx: ComBitPosition=87, ComBitSize=1, ComSignalInitValue=0, ComSignalType=BOOLEAN, ComHandleId=6946, ComSystemTemplateSystemSignalRef=DET_SUPER_RES_TARGET_329
            DET_SUPER_RES_TARGET_332_oRDR_DETECTION_329_332_oPCAN_RADAR_341549d6_Tx: ComBitPosition=423, ComBitSize=1, ComSignalInitValue=0, ComSignalType=BOOLEAN, ComHandleId=6949, ComSystemTemplateSystemSignalRef=DET_SUPER_RES_TARGET_332
            DET_AZIMUTH_ERR_329_oRDR_DETECTION_329_332_oPCAN_RADAR_0a9afb4f_Tx: ComBitPosition=105, ComBitSize=7, ComSignalInitValue=0, ComSignalType=UINT8, ComHandleId=6871, ComSystemTemplateSystemSignalRef=DET_AZIMUTH_ERR_329
            DET_RCS_332_oRDR_DETECTION_329_332_oPCAN_RADAR_d82235b1_Tx: ComBitPosition=464, ComBitSize=8, ComSignalInitValue=128, ComSignalType=UINT8, ComHandleId=6941, ComSystemTemplateSystemSignalRef=DET_RCS_332
            DET_SNR_332_oRDR_DETECTION_329_332_oPCAN_RADAR_058c61b3_Tx: ComBitPosition=456, ComBitSize=8, ComSignalInitValue=0, ComSignalType=UINT8, ComHandleId=6945, ComSystemTemplateSystemSignalRef=DET_SNR_332
            DET_MH_CYCLE_COUNTER_329_332_oRDR_DETECTION_329_332_oPCAN_RADAR_c5813126_Tx: ComBitPosition=16, ComBitSize=8, ComSignalInitValue=0, ComSignalType=UINT8, ComHandleId=6912, ComSystemTemplateSystemSignalRef=DET_MH_CYCLE_COUNTER_329_332
            DET_PROB_1STAZHYPO_330_oRDR_DETECTION_329_332_oPCAN_RADAR_d03b8cd3_Tx: ComBitPosition=215, ComBitSize=1, ComSignalInitValue=0, ComSignalType=BOOLEAN, ComHandleId=6919, ComSystemTemplateSystemSignalRef=DET_PROB_1STAZHYPO_330
            DET_MTD_331_oRDR_DETECTION_329_332_oPCAN_RADAR_d6ffb08b_Tx: ComBitPosition=271, ComBitSize=1, ComSignalInitValue=0, ComSignalType=UINT8, ComHandleId=6916, ComSystemTemplateSystemSignalRef=DET_MTD_331
            DET_IDM_330_oRDR_DETECTION_329_332_oPCAN_RADAR_253c56c5_Tx: ComBitPosition=175, ComBitSize=1, ComSignalInitValue=0, ComSignalType=UINT8, ComHandleId=6908, ComSystemTemplateSystemSignalRef=DET_IDM_330
            DET_BELOW_RAIN_THOLD_330_oRDR_DETECTION_329_332_oPCAN_RADAR_1e0e8fde_Tx: ComBitPosition=151, ComBitSize=1, ComSignalInitValue=0, ComSignalType=UINT8, ComHandleId=6876, ComSystemTemplateSystemSignalRef=DET_BELOW_RAIN_THOLD_330
            DET_MTD_329_oRDR_DETECTION_329_332_oPCAN_RADAR_26af16ba_Tx: ComBitPosition=47, ComBitSize=1, ComSignalInitValue=0, ComSignalType=UINT8, ComHandleId=6914, ComSystemTemplateSystemSignalRef=DET_MTD_329
            DET_BELOW_RAIN_THOLD_331_oRDR_DETECTION_329_332_oPCAN_RADAR_8b7e5b4b_Tx: ComBitPosition=263, ComBitSize=1, ComSignalInitValue=0, ComSignalType=UINT8, ComHandleId=6877, ComSystemTemplateSystemSignalRef=DET_BELOW_RAIN_THOLD_331
            DET_MTD_332_oRDR_DETECTION_329_332_oPCAN_RADAR_b21fcb75_Tx: ComBitPosition=383, ComBitSize=1, ComSignalInitValue=0, ComSignalType=UINT8, ComHandleId=6917, ComSystemTemplateSystemSignalRef=DET_MTD_332
            DET_IDM_331_oRDR_DETECTION_329_332_oPCAN_RADAR_b04c8250_Tx: ComBitPosition=287, ComBitSize=1, ComSignalInitValue=0, ComSignalType=UINT8, ComHandleId=6909, ComSystemTemplateSystemSignalRef=DET_IDM_331
            DET_IDM_332_oRDR_DETECTION_329_332_oPCAN_RADAR_d4acf9ae_Tx: ComBitPosition=399, ComBitSize=1, ComSignalInitValue=0, ComSignalType=UINT8, ComHandleId=6910, ComSystemTemplateSystemSignalRef=DET_IDM_332
            DET_IDM_329_oRDR_DETECTION_329_332_oPCAN_RADAR_401c2461_Tx: ComBitPosition=63, ComBitSize=1, ComSignalInitValue=0, ComSignalType=UINT8, ComHandleId=6907, ComSystemTemplateSystemSignalRef=DET_IDM_329
            DET_PROB_1STAZHYPO_332_oRDR_DETECTION_329_332_oPCAN_RADAR_21ab23b8_Tx: ComBitPosition=439, ComBitSize=1, ComSignalInitValue=0, ComSignalType=BOOLEAN, ComHandleId=6921, ComSystemTemplateSystemSignalRef=DET_PROB_1STAZHYPO_332
            DET_MTD_330_oRDR_DETECTION_329_332_oPCAN_RADAR_438f641e_Tx: ComBitPosition=159, ComBitSize=1, ComSignalInitValue=0, ComSignalType=UINT8, ComHandleId=6915, ComSystemTemplateSystemSignalRef=DET_MTD_330
            DET_BELOW_RAIN_THOLD_329_oRDR_DETECTION_329_332_oPCAN_RADAR_7b2efd7a_Tx: ComBitPosition=39, ComBitSize=1, ComSignalInitValue=0, ComSignalType=UINT8, ComHandleId=6875, ComSystemTemplateSystemSignalRef=DET_BELOW_RAIN_THOLD_329
            DET_BELOW_RAIN_THOLD_332_oRDR_DETECTION_329_332_oPCAN_RADAR_ef9e20b5_Tx: ComBitPosition=375, ComBitSize=1, ComSignalInitValue=0, ComSignalType=UINT8, ComHandleId=6878, ComSystemTemplateSystemSignalRef=DET_BELOW_RAIN_THOLD_332
            DET_PROB_1STAZHYPO_331_oRDR_DETECTION_329_332_oPCAN_RADAR_454b5846_Tx: ComBitPosition=327, ComBitSize=1, ComSignalInitValue=0, ComSignalType=BOOLEAN, ComHandleId=6920, ComSystemTemplateSystemSignalRef=DET_PROB_1STAZHYPO_331
            DET_PROB_1STAZHYPO_329_oRDR_DETECTION_329_332_oPCAN_RADAR_b51bfe77_Tx: ComBitPosition=103, ComBitSize=1, ComSignalInitValue=0, ComSignalType=BOOLEAN, ComHandleId=6918, ComSystemTemplateSystemSignalRef=DET_PROB_1STAZHYPO_329
        SG_Detections_289_292_oRDR_DETECTION_289_292_oPCAN_RADAR_677741bc_Tx: ComTransferProperty=TRIGGERED, ComHandleId=74, ComSystemTemplateSignalGroupRef=SG_Detections_289_292
          83 x ComGroupSignal, all with ComSignalEndianness=LITTLE_ENDIAN, ComTransferProperty=PENDING, ComSignalAccess=ACCESS_NEEDED_BY_SWC_OR_COM:
            DET_AZIMUTH_292_oRDR_DETECTION_289_292_oPCAN_RADAR_1f8b8f32_Tx: ComBitPosition=424, ComBitSize=13, ComSignalInitValue=0, ComSignalType=UINT16, ComHandleId=6040, ComSystemTemplateSystemSignalRef=DET_AZIMUTH_292
            DET_RANGE_ERR_292_oRDR_DETECTION_289_292_oPCAN_RADAR_a8f846e0_Tx: ComBitPosition=376, ComBitSize=7, ComSignalInitValue=0, ComSignalType=UINT8, ComHandleId=6099, ComSystemTemplateSystemSignalRef=DET_RANGE_ERR_292
            DET_ELEVATION_292_oRDR_DETECTION_289_292_oPCAN_RADAR_ce38503e_Tx: ComBitPosition=408, ComBitSize=8, ComSignalInitValue=0, ComSignalType=UINT8, ComHandleId=6064, ComSystemTemplateSystemSignalRef=DET_ELEVATION_292
            DET_EXISTENCE_PROB_292_oRDR_DETECTION_289_292_oPCAN_RADAR_9b9ebd2b_Tx: ComBitPosition=448, ComBitSize=6, ComSignalInitValue=0, ComSignalType=UINT8, ComHandleId=6072, ComSystemTemplateSystemSignalRef=DET_EXISTENCE_PROB_292
            DET_MH_CYCLE_COUNTER_289_292_oRDR_DETECTION_289_292_oPCAN_RADAR_678a3280_Tx: ComBitPosition=16, ComBitSize=8, ComSignalInitValue=0, ComSignalType=UINT8, ComHandleId=6082, ComSystemTemplateSystemSignalRef=DET_MH_CYCLE_COUNTER_289_292
            DET_RANGE_291_oRDR_DETECTION_289_292_oPCAN_RADAR_6bf08777_Tx: ComBitPosition=248, ComBitSize=15, ComSignalInitValue=0, ComSignalType=UINT16, ComHandleId=6094, ComSystemTemplateSystemSignalRef=DET_RANGE_291
            DET_RCS_292_oRDR_DETECTION_289_292_oPCAN_RADAR_fd3609f6_Tx: ComBitPosition=464, ComBitSize=8, ComSignalInitValue=128, ComSignalType=UINT8, ComHandleId=6111, ComSystemTemplateSystemSignalRef=DET_RCS_292
            DET_CONFD_ELEVATION_291_oRDR_DETECTION_289_292_oPCAN_RADAR_7b18fffc_Tx: ComBitPosition=325, ComBitSize=2, ComSignalInitValue=0, ComSignalType=UINT8, ComHandleId=6059, ComSystemTemplateSystemSignalRef=DET_CONFD_ELEVATION_291
            DET_AZIMUTH_291_oRDR_DETECTION_289_292_oPCAN_RADAR_7b6bf4cc_Tx: ComBitPosition=312, ComBitSize=13, ComSignalInitValue=0, ComSignalType=UINT16, ComHandleId=6039, ComSystemTemplateSystemSignalRef=DET_AZIMUTH_291
            DET_RANGE_VELOCITY_289_oRDR_DETECTION_289_292_oPCAN_RADAR_ee06e363_Tx: ComBitPosition=48, ComBitSize=15, ComSignalInitValue=16384, ComSignalType=UINT16, ComHandleId=6100, ComSystemTemplateSystemSignalRef=DET_RANGE_VELOCITY_289
            DET_CONFD_ELEVATION_292_oRDR_DETECTION_289_292_oPCAN_RADAR_1ff88402_Tx: ComBitPosition=437, ComBitSize=2, ComSignalInitValue=0, ComSignalType=UINT8, ComHandleId=6060, ComSystemTemplateSystemSignalRef=DET_CONFD_ELEVATION_292
            DET_HVC_FLAG_290_oRDR_DETECTION_289_292_oPCAN_RADAR_8b7a513f_Tx: ComBitPosition=198, ComBitSize=1, ComSignalInitValue=0, ComSignalType=BOOLEAN, ComHandleId=6074, ComSystemTemplateSystemSignalRef=DET_HVC_FLAG_290
            DET_ELEVATION_291_oRDR_DETECTION_289_292_oPCAN_RADAR_aad82bc0_Tx: ComBitPosition=296, ComBitSize=8, ComSignalInitValue=0, ComSignalType=UINT8, ComHandleId=6063, ComSystemTemplateSystemSignalRef=DET_ELEVATION_291
            DET_RCS_291_oRDR_DETECTION_289_292_oPCAN_RADAR_99d67208_Tx: ComBitPosition=352, ComBitSize=8, ComSignalInitValue=128, ComSignalType=UINT8, ComHandleId=6110, ComSystemTemplateSystemSignalRef=DET_RCS_291
            DET_CONFD_ELEVATION_290_oRDR_DETECTION_289_292_oPCAN_RADAR_ee682b69_Tx: ComBitPosition=213, ComBitSize=2, ComSignalInitValue=0, ComSignalType=UINT8, ComHandleId=6058, ComSystemTemplateSystemSignalRef=DET_CONFD_ELEVATION_290
            DET_HVC_FLAG_291_oRDR_DETECTION_289_292_oPCAN_RADAR_1e0a85aa_Tx: ComBitPosition=310, ComBitSize=1, ComSignalInitValue=0, ComSignalType=BOOLEAN, ComHandleId=6075, ComSystemTemplateSystemSignalRef=DET_HVC_FLAG_291
            DET_SNR_289_oRDR_DETECTION_289_292_oPCAN_RADAR_b428803b_Tx: ComBitPosition=120, ComBitSize=8, ComSignalInitValue=0, ComSignalType=UINT8, ComHandleId=6112, ComSystemTemplateSystemSignalRef=DET_SNR_289
            DET_RANGE_VELOCITY_ERR_291_oRDR_DETECTION_289_292_oPCAN_RADAR_11edbee0_Tx: ComBitPosition=288, ComBitSize=8, ComSignalInitValue=0, ComSignalType=UINT8, ComHandleId=6106, ComSystemTemplateSystemSignalRef=DET_RANGE_VELOCITY_ERR_291
            DET_ELEVATION_289_oRDR_DETECTION_289_292_oPCAN_RADAR_5a888df1_Tx: ComBitPosition=72, ComBitSize=8, ComSignalInitValue=0, ComSignalType=UINT8, ComHandleId=6061, ComSystemTemplateSystemSignalRef=DET_ELEVATION_289
            DET_RANGE_VELOCITY_291_oRDR_DETECTION_289_292_oPCAN_RADAR_1e564552_Tx: ComBitPosition=272, ComBitSize=15, ComSignalInitValue=16384, ComSignalType=UINT16, ComHandleId=6102, ComSystemTemplateSystemSignalRef=DET_RANGE_VELOCITY_291
            DET_ELEVATION_ERR_291_oRDR_DETECTION_289_292_oPCAN_RADAR_2de1b3b5_Tx: ComBitPosition=304, ComBitSize=6, ComSignalInitValue=0, ComSignalType=UINT8, ComHandleId=6067, ComSystemTemplateSystemSignalRef=DET_ELEVATION_ERR_291
            DET_MH_SCAN_INDEX_4LSB_289_292_oRDR_DETECTION_289_292_oPCAN_RADAR_aba0170c_Tx: ComBitPosition=476, ComBitSize=4, ComSignalInitValue=0, ComSignalType=UINT8, ComHandleId=6083, ComSystemTemplateSystemSignalRef=DET_MH_SCAN_INDEX_4LSB_289_292
            DET_SUPER_RES_TARGET_292_oRDR_DETECTION_289_292_oPCAN_RADAR_11017591_Tx: ComBitPosition=423, ComBitSize=1, ComSignalInitValue=0, ComSignalType=BOOLEAN, ComHandleId=6119, ComSystemTemplateSystemSignalRef=DET_SUPER_RES_TARGET_292
            DET_BI_STATIC_FLAG_291_oRDR_DETECTION_289_292_oPCAN_RADAR_2d47b449_Tx: ComBitPosition=328, ComBitSize=1, ComSignalInitValue=0, ComSignalType=BOOLEAN, ComHandleId=6051, ComSystemTemplateSystemSignalRef=DET_BI_STATIC_FLAG_291
            DET_AZIMUTH_290_oRDR_DETECTION_289_292_oPCAN_RADAR_ee1b2059_Tx: ComBitPosition=200, ComBitSize=13, ComSignalInitValue=0, ComSignalType=UINT16, ComHandleId=6038, ComSystemTemplateSystemSignalRef=DET_AZIMUTH_290
            DET_RANGE_VELOCITY_ERR_292_oRDR_DETECTION_289_292_oPCAN_RADAR_750dc51e_Tx: ComBitPosition=400, ComBitSize=8, ComSignalInitValue=0, ComSignalType=UINT8, ComHandleId=6107, ComSystemTemplateSystemSignalRef=DET_RANGE_VELOCITY_ERR_292
            DET_AZIMUTH_ERR_291_oRDR_DETECTION_289_292_oPCAN_RADAR_dfde6139_Tx: ComBitPosition=329, ComBitSize=7, ComSignalInitValue=0, ComSignalType=UINT8, ComHandleId=6043, ComSystemTemplateSystemSignalRef=DET_AZIMUTH_ERR_291
            DET_RANGE_ERR_291_oRDR_DETECTION_289_292_oPCAN_RADAR_cc183d1e_Tx: ComBitPosition=264, ComBitSize=7, ComSignalInitValue=0, ComSignalType=UINT8, ComHandleId=6098, ComSystemTemplateSystemSignalRef=DET_RANGE_ERR_291
            DET_SNR_292_oRDR_DETECTION_289_292_oPCAN_RADAR_20985df4_Tx: ComBitPosition=456, ComBitSize=8, ComSignalInitValue=0, ComSignalType=UINT8, ComHandleId=6115, ComSystemTemplateSystemSignalRef=DET_SNR_292
            DET_SUPER_RES_TARGET_289_oRDR_DETECTION_289_292_oPCAN_RADAR_85b1a85e_Tx: ComBitPosition=87, ComBitSize=1, ComSignalInitValue=0, ComSignalType=BOOLEAN, ComHandleId=6116, ComSystemTemplateSystemSignalRef=DET_SUPER_RES_TARGET_289
            DET_BI_STATIC_FLAG_289_oRDR_DETECTION_289_292_oPCAN_RADAR_dd171278_Tx: ComBitPosition=104, ComBitSize=1, ComSignalInitValue=0, ComSignalType=BOOLEAN, ComHandleId=6049, ComSystemTemplateSystemSignalRef=DET_BI_STATIC_FLAG_289
            DET_MH_CRC16_289_292_oRDR_DETECTION_289_292_oPCAN_RADAR_e3ff93b7_Tx: ComBitPosition=0, ComBitSize=16, ComSignalInitValue=0, ComSignalType=UINT16, ComHandleId=6081, ComSystemTemplateSystemSignalRef=DET_MH_CRC16_289_292
            DET_SUPER_RES_TARGET_291_oRDR_DETECTION_289_292_oPCAN_RADAR_75e10e6f_Tx: ComBitPosition=311, ComBitSize=1, ComSignalInitValue=0, ComSignalType=BOOLEAN, ComHandleId=6118, ComSystemTemplateSystemSignalRef=DET_SUPER_RES_TARGET_291
            DET_EXISTENCE_PROB_289_oRDR_DETECTION_289_292_oPCAN_RADAR_0f2e60e4_Tx: ComBitPosition=112, ComBitSize=6, ComSignalInitValue=0, ComSignalType=UINT8, ComHandleId=6069, ComSystemTemplateSystemSignalRef=DET_EXISTENCE_PROB_289
            DET_RCS_289_oRDR_DETECTION_289_292_oPCAN_RADAR_6986d439_Tx: ComBitPosition=128, ComBitSize=8, ComSignalInitValue=128, ComSignalType=UINT8, ComHandleId=6108, ComSystemTemplateSystemSignalRef=DET_RCS_289
            DET_ELEVATION_ERR_289_oRDR_DETECTION_289_292_oPCAN_RADAR_ddb11584_Tx: ComBitPosition=80, ComBitSize=6, ComSignalInitValue=0, ComSignalType=UINT8, ComHandleId=6065, ComSystemTemplateSystemSignalRef=DET_ELEVATION_ERR_289
            DET_AZIMUTH_ERR_292_oRDR_DETECTION_289_292_oPCAN_RADAR_bb3e1ac7_Tx: ComBitPosition=441, ComBitSize=7, ComSignalInitValue=0, ComSignalType=UINT8, ComHandleId=6044, ComSystemTemplateSystemSignalRef=DET_AZIMUTH_ERR_292
            DET_RANGE_VELOCITY_290_oRDR_DETECTION_289_292_oPCAN_RADAR_8b2691c7_Tx: ComBitPosition=160, ComBitSize=15, ComSignalInitValue=16384, ComSignalType=UINT16, ComHandleId=6101, ComSystemTemplateSystemSignalRef=DET_RANGE_VELOCITY_290
            DET_ELEVATION_290_oRDR_DETECTION_289_292_oPCAN_RADAR_3fa8ff55_Tx: ComBitPosition=184, ComBitSize=8, ComSignalInitValue=0, ComSignalType=UINT8, ComHandleId=6062, ComSystemTemplateSystemSignalRef=DET_ELEVATION_290
            DET_AZIMUTH_289_oRDR_DETECTION_289_292_oPCAN_RADAR_8b3b52fd_Tx: ComBitPosition=88, ComBitSize=13, ComSignalInitValue=0, ComSignalType=UINT16, ComHandleId=6037, ComSystemTemplateSystemSignalRef=DET_AZIMUTH_289
            DET_RANGE_VELOCITY_292_oRDR_DETECTION_289_292_oPCAN_RADAR_7ab63eac_Tx: ComBitPosition=384, ComBitSize=15, ComSignalInitValue=16384, ComSignalType=UINT16, ComHandleId=6103, ComSystemTemplateSystemSignalRef=DET_RANGE_VELOCITY_292
            DET_CONFD_AZIMUTH_289_oRDR_DETECTION_289_292_oPCAN_RADAR_89dd5837_Tx: ComBitPosition=118, ComBitSize=2, ComSignalInitValue=0, ComSignalType=UINT8, ComHandleId=6053, ComSystemTemplateSystemSignalRef=DET_CONFD_AZIMUTH_289
            DET_RANGE_289_oRDR_DETECTION_289_292_oPCAN_RADAR_9ba02146_Tx: ComBitPosition=24, ComBitSize=15, ComSignalInitValue=0, ComSignalType=UINT16, ComHandleId=6092, ComSystemTemplateSystemSignalRef=DET_RANGE_289
            DET_SNR_290_oRDR_DETECTION_289_292_oPCAN_RADAR_d108f29f_Tx: ComBitPosition=232, ComBitSize=8, ComSignalInitValue=0, ComSignalType=UINT8, ComHandleId=6113, ComSystemTemplateSystemSignalRef=DET_SNR_290
            DET_CONFD_ELEVATION_289_oRDR_DETECTION_289_292_oPCAN_RADAR_8b4859cd_Tx: ComBitPosition=101, ComBitSize=2, ComSignalInitValue=0, ComSignalType=UINT8, ComHandleId=6057, ComSystemTemplateSystemSignalRef=DET_CONFD_ELEVATION_289
            DET_CONFD_AZIMUTH_290_oRDR_DETECTION_289_292_oPCAN_RADAR_ecfd2a93_Tx: ComBitPosition=230, ComBitSize=2, ComSignalInitValue=0, ComSignalType=UINT8, ComHandleId=6054, ComSystemTemplateSystemSignalRef=DET_CONFD_AZIMUTH_290
            DET_EXISTENCE_PROB_291_oRDR_DETECTION_289_292_oPCAN_RADAR_ff7ec6d5_Tx: ComBitPosition=336, ComBitSize=6, ComSignalInitValue=0, ComSignalType=UINT8, ComHandleId=6071, ComSystemTemplateSystemSignalRef=DET_EXISTENCE_PROB_291
            DET_RCS_290_oRDR_DETECTION_289_292_oPCAN_RADAR_0ca6a69d_Tx: ComBitPosition=240, ComBitSize=8, ComSignalInitValue=128, ComSignalType=UINT8, ComHandleId=6109, ComSystemTemplateSystemSignalRef=DET_RCS_290
            DET_CONFD_AZIMUTH_292_oRDR_DETECTION_289_292_oPCAN_RADAR_1d6d85f8_Tx: ComBitPosition=454, ComBitSize=2, ComSignalInitValue=0, ComSignalType=UINT8, ComHandleId=6056, ComSystemTemplateSystemSignalRef=DET_CONFD_AZIMUTH_292
            DET_EXISTENCE_PROB_290_oRDR_DETECTION_289_292_oPCAN_RADAR_6a0e1240_Tx: ComBitPosition=224, ComBitSize=6, ComSignalInitValue=0, ComSignalType=UINT8, ComHandleId=6070, ComSystemTemplateSystemSignalRef=DET_EXISTENCE_PROB_290
            DET_AZIMUTH_ERR_289_oRDR_DETECTION_289_292_oPCAN_RADAR_2f8ec708_Tx: ComBitPosition=105, ComBitSize=7, ComSignalInitValue=0, ComSignalType=UINT8, ComHandleId=6041, ComSystemTemplateSystemSignalRef=DET_AZIMUTH_ERR_289
            DET_SUPER_RES_TARGET_290_oRDR_DETECTION_289_292_oPCAN_RADAR_e091dafa_Tx: ComBitPosition=199, ComBitSize=1, ComSignalInitValue=0, ComSignalType=BOOLEAN, ComHandleId=6117, ComSystemTemplateSystemSignalRef=DET_SUPER_RES_TARGET_290
            DET_ELEVATION_ERR_290_oRDR_DETECTION_289_292_oPCAN_RADAR_b8916720_Tx: ComBitPosition=192, ComBitSize=6, ComSignalInitValue=0, ComSignalType=UINT8, ComHandleId=6066, ComSystemTemplateSystemSignalRef=DET_ELEVATION_ERR_290
            DET_RANGE_ERR_289_oRDR_DETECTION_289_292_oPCAN_RADAR_3c489b2f_Tx: ComBitPosition=40, ComBitSize=7, ComSignalInitValue=0, ComSignalType=UINT8, ComHandleId=6096, ComSystemTemplateSystemSignalRef=DET_RANGE_ERR_289
            DET_ELEVATION_ERR_292_oRDR_DETECTION_289_292_oPCAN_RADAR_4901c84b_Tx: ComBitPosition=416, ComBitSize=6, ComSignalInitValue=0, ComSignalType=UINT8, ComHandleId=6068, ComSystemTemplateSystemSignalRef=DET_ELEVATION_ERR_292
            DET_AZIMUTH_ERR_290_oRDR_DETECTION_289_292_oPCAN_RADAR_4aaeb5ac_Tx: ComBitPosition=217, ComBitSize=7, ComSignalInitValue=0, ComSignalType=UINT8, ComHandleId=6042, ComSystemTemplateSystemSignalRef=DET_AZIMUTH_ERR_290
            DET_HVC_FLAG_292_oRDR_DETECTION_289_292_oPCAN_RADAR_7aeafe54_Tx: ComBitPosition=422, ComBitSize=1, ComSignalInitValue=0, ComSignalType=BOOLEAN, ComHandleId=6076, ComSystemTemplateSystemSignalRef=DET_HVC_FLAG_292
            DET_RANGE_290_oRDR_DETECTION_289_292_oPCAN_RADAR_fe8053e2_Tx: ComBitPosition=136, ComBitSize=15, ComSignalInitValue=0, ComSignalType=UINT16, ComHandleId=6093, ComSystemTemplateSystemSignalRef=DET_RANGE_290
            DET_RANGE_ERR_290_oRDR_DETECTION_289_292_oPCAN_RADAR_5968e98b_Tx: ComBitPosition=152, ComBitSize=7, ComSignalInitValue=0, ComSignalType=UINT8, ComHandleId=6097, ComSystemTemplateSystemSignalRef=DET_RANGE_ERR_290
            DET_BI_STATIC_FLAG_292_oRDR_DETECTION_289_292_oPCAN_RADAR_49a7cfb7_Tx: ComBitPosition=440, ComBitSize=1, ComSignalInitValue=0, ComSignalType=BOOLEAN, ComHandleId=6052, ComSystemTemplateSystemSignalRef=DET_BI_STATIC_FLAG_292
            DET_BI_STATIC_FLAG_290_oRDR_DETECTION_289_292_oPCAN_RADAR_b83760dc_Tx: ComBitPosition=216, ComBitSize=1, ComSignalInitValue=0, ComSignalType=BOOLEAN, ComHandleId=6050, ComSystemTemplateSystemSignalRef=DET_BI_STATIC_FLAG_290
            DET_RANGE_VELOCITY_ERR_290_oRDR_DETECTION_289_292_oPCAN_RADAR_849d6a75_Tx: ComBitPosition=176, ComBitSize=8, ComSignalInitValue=0, ComSignalType=UINT8, ComHandleId=6105, ComSystemTemplateSystemSignalRef=DET_RANGE_VELOCITY_ERR_290
            DET_HVC_FLAG_289_oRDR_DETECTION_289_292_oPCAN_RADAR_ee5a239b_Tx: ComBitPosition=86, ComBitSize=1, ComSignalInitValue=0, ComSignalType=BOOLEAN, ComHandleId=6073, ComSystemTemplateSystemSignalRef=DET_HVC_FLAG_289
            DET_RANGE_VELOCITY_ERR_289_oRDR_DETECTION_289_292_oPCAN_RADAR_e1bd18d1_Tx: ComBitPosition=64, ComBitSize=8, ComSignalInitValue=0, ComSignalType=UINT8, ComHandleId=6104, ComSystemTemplateSystemSignalRef=DET_RANGE_VELOCITY_ERR_289
            DET_SNR_291_oRDR_DETECTION_289_292_oPCAN_RADAR_4478260a_Tx: ComBitPosition=344, ComBitSize=8, ComSignalInitValue=0, ComSignalType=UINT8, ComHandleId=6114, ComSystemTemplateSystemSignalRef=DET_SNR_291
            DET_CONFD_AZIMUTH_291_oRDR_DETECTION_289_292_oPCAN_RADAR_798dfe06_Tx: ComBitPosition=342, ComBitSize=2, ComSignalInitValue=0, ComSignalType=UINT8, ComHandleId=6055, ComSystemTemplateSystemSignalRef=DET_CONFD_AZIMUTH_291
            DET_RANGE_292_oRDR_DETECTION_289_292_oPCAN_RADAR_0f10fc89_Tx: ComBitPosition=360, ComBitSize=15, ComSignalInitValue=0, ComSignalType=UINT16, ComHandleId=6095, ComSystemTemplateSystemSignalRef=DET_RANGE_292
            DET_PROB_1STAZHYPO_291_oRDR_DETECTION_289_292_oPCAN_RADAR_605f6401_Tx: ComBitPosition=327, ComBitSize=1, ComSignalInitValue=0, ComSignalType=BOOLEAN, ComHandleId=6090, ComSystemTemplateSystemSignalRef=DET_PROB_1STAZHYPO_291
            DET_BELOW_RAIN_THOLD_291_oRDR_DETECTION_289_292_oPCAN_RADAR_ae6a670c_Tx: ComBitPosition=263, ComBitSize=1, ComSignalInitValue=0, ComSignalType=UINT8, ComHandleId=6047, ComSystemTemplateSystemSignalRef=DET_BELOW_RAIN_THOLD_291
            DET_IDM_289_oRDR_DETECTION_289_292_oPCAN_RADAR_65081826_Tx: ComBitPosition=63, ComBitSize=1, ComSignalInitValue=0, ComSignalType=UINT8, ComHandleId=6077, ComSystemTemplateSystemSignalRef=DET_IDM_289
            DET_IDM_291_oRDR_DETECTION_289_292_oPCAN_RADAR_9558be17_Tx: ComBitPosition=287, ComBitSize=1, ComSignalInitValue=0, ComSignalType=UINT8, ComHandleId=6079, ComSystemTemplateSystemSignalRef=DET_IDM_291
            DET_MTD_289_oRDR_DETECTION_289_292_oPCAN_RADAR_03bb2afd_Tx: ComBitPosition=47, ComBitSize=1, ComSignalInitValue=0, ComSignalType=UINT8, ComHandleId=6084, ComSystemTemplateSystemSignalRef=DET_MTD_289
            DET_BELOW_RAIN_THOLD_290_oRDR_DETECTION_289_292_oPCAN_RADAR_3b1ab399_Tx: ComBitPosition=151, ComBitSize=1, ComSignalInitValue=0, ComSignalType=UINT8, ComHandleId=6046, ComSystemTemplateSystemSignalRef=DET_BELOW_RAIN_THOLD_290
            DET_MTD_292_oRDR_DETECTION_289_292_oPCAN_RADAR_970bf732_Tx: ComBitPosition=383, ComBitSize=1, ComSignalInitValue=0, ComSignalType=UINT8, ComHandleId=6087, ComSystemTemplateSystemSignalRef=DET_MTD_292
            DET_IDM_290_oRDR_DETECTION_289_292_oPCAN_RADAR_00286a82_Tx: ComBitPosition=175, ComBitSize=1, ComSignalInitValue=0, ComSignalType=UINT8, ComHandleId=6078, ComSystemTemplateSystemSignalRef=DET_IDM_290
            DET_IDM_292_oRDR_DETECTION_289_292_oPCAN_RADAR_f1b8c5e9_Tx: ComBitPosition=399, ComBitSize=1, ComSignalInitValue=0, ComSignalType=UINT8, ComHandleId=6080, ComSystemTemplateSystemSignalRef=DET_IDM_292
            DET_BELOW_RAIN_THOLD_292_oRDR_DETECTION_289_292_oPCAN_RADAR_ca8a1cf2_Tx: ComBitPosition=375, ComBitSize=1, ComSignalInitValue=0, ComSignalType=UINT8, ComHandleId=6048, ComSystemTemplateSystemSignalRef=DET_BELOW_RAIN_THOLD_292
            DET_PROB_1STAZHYPO_292_oRDR_DETECTION_289_292_oPCAN_RADAR_04bf1fff_Tx: ComBitPosition=439, ComBitSize=1, ComSignalInitValue=0, ComSignalType=BOOLEAN, ComHandleId=6091, ComSystemTemplateSystemSignalRef=DET_PROB_1STAZHYPO_292
            DET_PROB_1STAZHYPO_290_oRDR_DETECTION_289_292_oPCAN_RADAR_f52fb094_Tx: ComBitPosition=215, ComBitSize=1, ComSignalInitValue=0, ComSignalType=BOOLEAN, ComHandleId=6089, ComSystemTemplateSystemSignalRef=DET_PROB_1STAZHYPO_290
            DET_BELOW_RAIN_THOLD_289_oRDR_DETECTION_289_292_oPCAN_RADAR_5e3ac13d_Tx: ComBitPosition=39, ComBitSize=1, ComSignalInitValue=0, ComSignalType=UINT8, ComHandleId=6045, ComSystemTemplateSystemSignalRef=DET_BELOW_RAIN_THOLD_289
            DET_MTD_291_oRDR_DETECTION_289_292_oPCAN_RADAR_f3eb8ccc_Tx: ComBitPosition=271, ComBitSize=1, ComSignalInitValue=0, ComSignalType=UINT8, ComHandleId=6086, ComSystemTemplateSystemSignalRef=DET_MTD_291
            DET_MTD_290_oRDR_DETECTION_289_292_oPCAN_RADAR_669b5859_Tx: ComBitPosition=159, ComBitSize=1, ComSignalInitValue=0, ComSignalType=UINT8, ComHandleId=6085, ComSystemTemplateSystemSignalRef=DET_MTD_290
            DET_PROB_1STAZHYPO_289_oRDR_DETECTION_289_292_oPCAN_RADAR_900fc230_Tx: ComBitPosition=103, ComBitSize=1, ComSignalInitValue=0, ComSignalType=BOOLEAN, ComHandleId=6088, ComSystemTemplateSystemSignalRef=DET_PROB_1STAZHYPO_289
        SG_Detections_189_192_oRDR_DETECTION_189_192_oPCAN_RADAR_a08f2678_Tx: ComTransferProperty=TRIGGERED, ComHandleId=49, ComSystemTemplateSignalGroupRef=SG_Detections_189_192
          83 x ComGroupSignal, all with ComSignalEndianness=LITTLE_ENDIAN, ComTransferProperty=PENDING, ComSignalAccess=ACCESS_NEEDED_BY_SWC_OR_COM:
            DET_RANGE_190_oRDR_DETECTION_189_192_oPCAN_RADAR_0143bf55_Tx: ComBitPosition=136, ComBitSize=15, ComSignalInitValue=0, ComSignalType=UINT16, ComHandleId=4018, ComSystemTemplateSystemSignalRef=DET_RANGE_190
            DET_AZIMUTH_191_oRDR_DETECTION_189_192_oPCAN_RADAR_84a8187b_Tx: ComBitPosition=312, ComBitSize=13, ComSignalInitValue=0, ComSignalType=UINT16, ComHandleId=3964, ComSystemTemplateSystemSignalRef=DET_AZIMUTH_191
            DET_ELEVATION_ERR_190_oRDR_DETECTION_189_192_oPCAN_RADAR_47528b97_Tx: ComBitPosition=192, ComBitSize=6, ComSignalInitValue=0, ComSignalType=UINT8, ComHandleId=3991, ComSystemTemplateSystemSignalRef=DET_ELEVATION_ERR_190
            DET_EXISTENCE_PROB_189_oRDR_DETECTION_189_192_oPCAN_RADAR_f0ed8c53_Tx: ComBitPosition=112, ComBitSize=6, ComSignalInitValue=0, ComSignalType=UINT8, ComHandleId=3994, ComSystemTemplateSystemSignalRef=DET_EXISTENCE_PROB_189
            DET_RCS_190_oRDR_DETECTION_189_192_oPCAN_RADAR_f3654a2a_Tx: ComBitPosition=240, ComBitSize=8, ComSignalInitValue=128, ComSignalType=UINT8, ComHandleId=4034, ComSystemTemplateSystemSignalRef=DET_RCS_190
            DET_CONFD_AZIMUTH_190_oRDR_DETECTION_189_192_oPCAN_RADAR_133ec624_Tx: ComBitPosition=230, ComBitSize=2, ComSignalInitValue=0, ComSignalType=UINT8, ComHandleId=3979, ComSystemTemplateSystemSignalRef=DET_CONFD_AZIMUTH_190
            DET_RANGE_ERR_192_oRDR_DETECTION_189_192_oPCAN_RADAR_573baa57_Tx: ComBitPosition=376, ComBitSize=7, ComSignalInitValue=0, ComSignalType=UINT8, ComHandleId=4024, ComSystemTemplateSystemSignalRef=DET_RANGE_ERR_192
            DET_BI_STATIC_FLAG_189_oRDR_DETECTION_189_192_oPCAN_RADAR_22d4fecf_Tx: ComBitPosition=104, ComBitSize=1, ComSignalInitValue=0, ComSignalType=BOOLEAN, ComHandleId=3974, ComSystemTemplateSystemSignalRef=DET_BI_STATIC_FLAG_189
            DET_HVC_FLAG_192_oRDR_DETECTION_189_192_oPCAN_RADAR_852912e3_Tx: ComBitPosition=422, ComBitSize=1, ComSignalInitValue=0, ComSignalType=BOOLEAN, ComHandleId=4001, ComSystemTemplateSystemSignalRef=DET_HVC_FLAG_192
            DET_AZIMUTH_ERR_189_oRDR_DETECTION_189_192_oPCAN_RADAR_d04d2bbf_Tx: ComBitPosition=105, ComBitSize=7, ComSignalInitValue=0, ComSignalType=UINT8, ComHandleId=3966, ComSystemTemplateSystemSignalRef=DET_AZIMUTH_ERR_189
            DET_AZIMUTH_190_oRDR_DETECTION_189_192_oPCAN_RADAR_11d8ccee_Tx: ComBitPosition=200, ComBitSize=13, ComSignalInitValue=0, ComSignalType=UINT16, ComHandleId=3963, ComSystemTemplateSystemSignalRef=DET_AZIMUTH_190
            DET_ELEVATION_ERR_189_oRDR_DETECTION_189_192_oPCAN_RADAR_2272f933_Tx: ComBitPosition=80, ComBitSize=6, ComSignalInitValue=0, ComSignalType=UINT8, ComHandleId=3990, ComSystemTemplateSystemSignalRef=DET_ELEVATION_ERR_189
            DET_CONFD_AZIMUTH_191_oRDR_DETECTION_189_192_oPCAN_RADAR_864e12b1_Tx: ComBitPosition=342, ComBitSize=2, ComSignalInitValue=0, ComSignalType=UINT8, ComHandleId=3980, ComSystemTemplateSystemSignalRef=DET_CONFD_AZIMUTH_191
            DET_HVC_FLAG_189_oRDR_DETECTION_189_192_oPCAN_RADAR_1199cf2c_Tx: ComBitPosition=86, ComBitSize=1, ComSignalInitValue=0, ComSignalType=BOOLEAN, ComHandleId=3998, ComSystemTemplateSystemSignalRef=DET_HVC_FLAG_189
            DET_ELEVATION_192_oRDR_DETECTION_189_192_oPCAN_RADAR_31fbbc89_Tx: ComBitPosition=408, ComBitSize=8, ComSignalInitValue=0, ComSignalType=UINT8, ComHandleId=3989, ComSystemTemplateSystemSignalRef=DET_ELEVATION_192
            DET_RANGE_VELOCITY_192_oRDR_DETECTION_189_192_oPCAN_RADAR_8575d21b_Tx: ComBitPosition=384, ComBitSize=15, ComSignalInitValue=16384, ComSignalType=UINT16, ComHandleId=4028, ComSystemTemplateSystemSignalRef=DET_RANGE_VELOCITY_192
            DET_MH_CRC16_189_192_oRDR_DETECTION_189_192_oPCAN_RADAR_2407f473_Tx: ComBitPosition=0, ComBitSize=16, ComSignalInitValue=0, ComSignalType=UINT16, ComHandleId=4006, ComSystemTemplateSystemSignalRef=DET_MH_CRC16_189_192
            DET_SUPER_RES_TARGET_192_oRDR_DETECTION_189_192_oPCAN_RADAR_eec29926_Tx: ComBitPosition=423, ComBitSize=1, ComSignalInitValue=0, ComSignalType=BOOLEAN, ComHandleId=4044, ComSystemTemplateSystemSignalRef=DET_SUPER_RES_TARGET_192
            DET_AZIMUTH_189_oRDR_DETECTION_189_192_oPCAN_RADAR_74f8be4a_Tx: ComBitPosition=88, ComBitSize=13, ComSignalInitValue=0, ComSignalType=UINT16, ComHandleId=3962, ComSystemTemplateSystemSignalRef=DET_AZIMUTH_189
            DET_CONFD_AZIMUTH_192_oRDR_DETECTION_189_192_oPCAN_RADAR_e2ae694f_Tx: ComBitPosition=454, ComBitSize=2, ComSignalInitValue=0, ComSignalType=UINT8, ComHandleId=3981, ComSystemTemplateSystemSignalRef=DET_CONFD_AZIMUTH_192
            DET_ELEVATION_189_oRDR_DETECTION_189_192_oPCAN_RADAR_a54b6146_Tx: ComBitPosition=72, ComBitSize=8, ComSignalInitValue=0, ComSignalType=UINT8, ComHandleId=3986, ComSystemTemplateSystemSignalRef=DET_ELEVATION_189
            DET_RANGE_ERR_191_oRDR_DETECTION_189_192_oPCAN_RADAR_33dbd1a9_Tx: ComBitPosition=264, ComBitSize=7, ComSignalInitValue=0, ComSignalType=UINT8, ComHandleId=4023, ComSystemTemplateSystemSignalRef=DET_RANGE_ERR_191
            DET_SUPER_RES_TARGET_189_oRDR_DETECTION_189_192_oPCAN_RADAR_7a7244e9_Tx: ComBitPosition=87, ComBitSize=1, ComSignalInitValue=0, ComSignalType=BOOLEAN, ComHandleId=4041, ComSystemTemplateSystemSignalRef=DET_SUPER_RES_TARGET_189
            DET_BI_STATIC_FLAG_192_oRDR_DETECTION_189_192_oPCAN_RADAR_b6642300_Tx: ComBitPosition=440, ComBitSize=1, ComSignalInitValue=0, ComSignalType=BOOLEAN, ComHandleId=3977, ComSystemTemplateSystemSignalRef=DET_BI_STATIC_FLAG_192
            DET_RANGE_189_oRDR_DETECTION_189_192_oPCAN_RADAR_6463cdf1_Tx: ComBitPosition=24, ComBitSize=15, ComSignalInitValue=0, ComSignalType=UINT16, ComHandleId=4017, ComSystemTemplateSystemSignalRef=DET_RANGE_189
            DET_ELEVATION_ERR_192_oRDR_DETECTION_189_192_oPCAN_RADAR_b6c224fc_Tx: ComBitPosition=416, ComBitSize=6, ComSignalInitValue=0, ComSignalType=UINT8, ComHandleId=3993, ComSystemTemplateSystemSignalRef=DET_ELEVATION_ERR_192
            DET_RANGE_VELOCITY_191_oRDR_DETECTION_189_192_oPCAN_RADAR_e195a9e5_Tx: ComBitPosition=272, ComBitSize=15, ComSignalInitValue=16384, ComSignalType=UINT16, ComHandleId=4027, ComSystemTemplateSystemSignalRef=DET_RANGE_VELOCITY_191
            DET_RANGE_192_oRDR_DETECTION_189_192_oPCAN_RADAR_f0d3103e_Tx: ComBitPosition=360, ComBitSize=15, ComSignalInitValue=0, ComSignalType=UINT16, ComHandleId=4020, ComSystemTemplateSystemSignalRef=DET_RANGE_192
            DET_RANGE_VELOCITY_ERR_191_oRDR_DETECTION_189_192_oPCAN_RADAR_ee2e5257_Tx: ComBitPosition=288, ComBitSize=8, ComSignalInitValue=0, ComSignalType=UINT8, ComHandleId=4031, ComSystemTemplateSystemSignalRef=DET_RANGE_VELOCITY_ERR_191
            DET_CONFD_ELEVATION_191_oRDR_DETECTION_189_192_oPCAN_RADAR_84db134b_Tx: ComBitPosition=325, ComBitSize=2, ComSignalInitValue=0, ComSignalType=UINT8, ComHandleId=3984, ComSystemTemplateSystemSignalRef=DET_CONFD_ELEVATION_191
            DET_BI_STATIC_FLAG_190_oRDR_DETECTION_189_192_oPCAN_RADAR_47f48c6b_Tx: ComBitPosition=216, ComBitSize=1, ComSignalInitValue=0, ComSignalType=BOOLEAN, ComHandleId=3975, ComSystemTemplateSystemSignalRef=DET_BI_STATIC_FLAG_190
            DET_HVC_FLAG_191_oRDR_DETECTION_189_192_oPCAN_RADAR_e1c9691d_Tx: ComBitPosition=310, ComBitSize=1, ComSignalInitValue=0, ComSignalType=BOOLEAN, ComHandleId=4000, ComSystemTemplateSystemSignalRef=DET_HVC_FLAG_191
            DET_SUPER_RES_TARGET_191_oRDR_DETECTION_189_192_oPCAN_RADAR_8a22e2d8_Tx: ComBitPosition=311, ComBitSize=1, ComSignalInitValue=0, ComSignalType=BOOLEAN, ComHandleId=4043, ComSystemTemplateSystemSignalRef=DET_SUPER_RES_TARGET_191
            DET_EXISTENCE_PROB_191_oRDR_DETECTION_189_192_oPCAN_RADAR_00bd2a62_Tx: ComBitPosition=336, ComBitSize=6, ComSignalInitValue=0, ComSignalType=UINT8, ComHandleId=3996, ComSystemTemplateSystemSignalRef=DET_EXISTENCE_PROB_191
            DET_ELEVATION_191_oRDR_DETECTION_189_192_oPCAN_RADAR_551bc777_Tx: ComBitPosition=296, ComBitSize=8, ComSignalInitValue=0, ComSignalType=UINT8, ComHandleId=3988, ComSystemTemplateSystemSignalRef=DET_ELEVATION_191
            DET_ELEVATION_ERR_191_oRDR_DETECTION_189_192_oPCAN_RADAR_d2225f02_Tx: ComBitPosition=304, ComBitSize=6, ComSignalInitValue=0, ComSignalType=UINT8, ComHandleId=3992, ComSystemTemplateSystemSignalRef=DET_ELEVATION_ERR_191
            DET_SNR_190_oRDR_DETECTION_189_192_oPCAN_RADAR_2ecb1e28_Tx: ComBitPosition=232, ComBitSize=8, ComSignalInitValue=0, ComSignalType=UINT8, ComHandleId=4038, ComSystemTemplateSystemSignalRef=DET_SNR_190
            DET_SNR_192_oRDR_DETECTION_189_192_oPCAN_RADAR_df5bb143_Tx: ComBitPosition=456, ComBitSize=8, ComSignalInitValue=0, ComSignalType=UINT8, ComHandleId=4040, ComSystemTemplateSystemSignalRef=DET_SNR_192
            DET_CONFD_ELEVATION_189_oRDR_DETECTION_189_192_oPCAN_RADAR_748bb57a_Tx: ComBitPosition=101, ComBitSize=2, ComSignalInitValue=0, ComSignalType=UINT8, ComHandleId=3982, ComSystemTemplateSystemSignalRef=DET_CONFD_ELEVATION_189
            DET_EXISTENCE_PROB_192_oRDR_DETECTION_189_192_oPCAN_RADAR_645d519c_Tx: ComBitPosition=448, ComBitSize=6, ComSignalInitValue=0, ComSignalType=UINT8, ComHandleId=3997, ComSystemTemplateSystemSignalRef=DET_EXISTENCE_PROB_192
            DET_MH_SCAN_INDEX_4LSB_189_192_oRDR_DETECTION_189_192_oPCAN_RADAR_6c5870c8_Tx: ComBitPosition=476, ComBitSize=4, ComSignalInitValue=0, ComSignalType=UINT8, ComHandleId=4008, ComSystemTemplateSystemSignalRef=DET_MH_SCAN_INDEX_4LSB_189_192
            DET_RANGE_VELOCITY_ERR_189_oRDR_DETECTION_189_192_oPCAN_RADAR_1e7ef466_Tx: ComBitPosition=64, ComBitSize=8, ComSignalInitValue=0, ComSignalType=UINT8, ComHandleId=4029, ComSystemTemplateSystemSignalRef=DET_RANGE_VELOCITY_ERR_189
            DET_ELEVATION_190_oRDR_DETECTION_189_192_oPCAN_RADAR_c06b13e2_Tx: ComBitPosition=184, ComBitSize=8, ComSignalInitValue=0, ComSignalType=UINT8, ComHandleId=3987, ComSystemTemplateSystemSignalRef=DET_ELEVATION_190
            DET_HVC_FLAG_190_oRDR_DETECTION_189_192_oPCAN_RADAR_74b9bd88_Tx: ComBitPosition=198, ComBitSize=1, ComSignalInitValue=0, ComSignalType=BOOLEAN, ComHandleId=3999, ComSystemTemplateSystemSignalRef=DET_HVC_FLAG_190
            DET_RANGE_VELOCITY_ERR_192_oRDR_DETECTION_189_192_oPCAN_RADAR_8ace29a9_Tx: ComBitPosition=400, ComBitSize=8, ComSignalInitValue=0, ComSignalType=UINT8, ComHandleId=4032, ComSystemTemplateSystemSignalRef=DET_RANGE_VELOCITY_ERR_192
            DET_SNR_191_oRDR_DETECTION_189_192_oPCAN_RADAR_bbbbcabd_Tx: ComBitPosition=344, ComBitSize=8, ComSignalInitValue=0, ComSignalType=UINT8, ComHandleId=4039, ComSystemTemplateSystemSignalRef=DET_SNR_191
            DET_AZIMUTH_ERR_190_oRDR_DETECTION_189_192_oPCAN_RADAR_b56d591b_Tx: ComBitPosition=217, ComBitSize=7, ComSignalInitValue=0, ComSignalType=UINT8, ComHandleId=3967, ComSystemTemplateSystemSignalRef=DET_AZIMUTH_ERR_190
            DET_BI_STATIC_FLAG_191_oRDR_DETECTION_189_192_oPCAN_RADAR_d28458fe_Tx: ComBitPosition=328, ComBitSize=1, ComSignalInitValue=0, ComSignalType=BOOLEAN, ComHandleId=3976, ComSystemTemplateSystemSignalRef=DET_BI_STATIC_FLAG_191
            DET_SNR_189_oRDR_DETECTION_189_192_oPCAN_RADAR_4beb6c8c_Tx: ComBitPosition=120, ComBitSize=8, ComSignalInitValue=0, ComSignalType=UINT8, ComHandleId=4037, ComSystemTemplateSystemSignalRef=DET_SNR_189
            DET_SUPER_RES_TARGET_190_oRDR_DETECTION_189_192_oPCAN_RADAR_1f52364d_Tx: ComBitPosition=199, ComBitSize=1, ComSignalInitValue=0, ComSignalType=BOOLEAN, ComHandleId=4042, ComSystemTemplateSystemSignalRef=DET_SUPER_RES_TARGET_190
            DET_MH_CYCLE_COUNTER_189_192_oRDR_DETECTION_189_192_oPCAN_RADAR_a0725544_Tx: ComBitPosition=16, ComBitSize=8, ComSignalInitValue=0, ComSignalType=UINT8, ComHandleId=4007, ComSystemTemplateSystemSignalRef=DET_MH_CYCLE_COUNTER_189_192
            DET_AZIMUTH_192_oRDR_DETECTION_189_192_oPCAN_RADAR_e0486385_Tx: ComBitPosition=424, ComBitSize=13, ComSignalInitValue=0, ComSignalType=UINT16, ComHandleId=3965, ComSystemTemplateSystemSignalRef=DET_AZIMUTH_192
            DET_RANGE_191_oRDR_DETECTION_189_192_oPCAN_RADAR_94336bc0_Tx: ComBitPosition=248, ComBitSize=15, ComSignalInitValue=0, ComSignalType=UINT16, ComHandleId=4019, ComSystemTemplateSystemSignalRef=DET_RANGE_191
            DET_RANGE_ERR_189_oRDR_DETECTION_189_192_oPCAN_RADAR_c38b7798_Tx: ComBitPosition=40, ComBitSize=7, ComSignalInitValue=0, ComSignalType=UINT8, ComHandleId=4021, ComSystemTemplateSystemSignalRef=DET_RANGE_ERR_189
            DET_AZIMUTH_ERR_191_oRDR_DETECTION_189_192_oPCAN_RADAR_201d8d8e_Tx: ComBitPosition=329, ComBitSize=7, ComSignalInitValue=0, ComSignalType=UINT8, ComHandleId=3968, ComSystemTemplateSystemSignalRef=DET_AZIMUTH_ERR_191
            DET_RCS_189_oRDR_DETECTION_189_192_oPCAN_RADAR_9645388e_Tx: ComBitPosition=128, ComBitSize=8, ComSignalInitValue=128, ComSignalType=UINT8, ComHandleId=4033, ComSystemTemplateSystemSignalRef=DET_RCS_189
            DET_CONFD_ELEVATION_190_oRDR_DETECTION_189_192_oPCAN_RADAR_11abc7de_Tx: ComBitPosition=213, ComBitSize=2, ComSignalInitValue=0, ComSignalType=UINT8, ComHandleId=3983, ComSystemTemplateSystemSignalRef=DET_CONFD_ELEVATION_190
            DET_EXISTENCE_PROB_190_oRDR_DETECTION_189_192_oPCAN_RADAR_95cdfef7_Tx: ComBitPosition=224, ComBitSize=6, ComSignalInitValue=0, ComSignalType=UINT8, ComHandleId=3995, ComSystemTemplateSystemSignalRef=DET_EXISTENCE_PROB_190
            DET_RCS_191_oRDR_DETECTION_189_192_oPCAN_RADAR_66159ebf_Tx: ComBitPosition=352, ComBitSize=8, ComSignalInitValue=128, ComSignalType=UINT8, ComHandleId=4035, ComSystemTemplateSystemSignalRef=DET_RCS_191
            DET_CONFD_AZIMUTH_189_oRDR_DETECTION_189_192_oPCAN_RADAR_761eb480_Tx: ComBitPosition=118, ComBitSize=2, ComSignalInitValue=0, ComSignalType=UINT8, ComHandleId=3978, ComSystemTemplateSystemSignalRef=DET_CONFD_AZIMUTH_189
            DET_AZIMUTH_ERR_192_oRDR_DETECTION_189_192_oPCAN_RADAR_44fdf670_Tx: ComBitPosition=441, ComBitSize=7, ComSignalInitValue=0, ComSignalType=UINT8, ComHandleId=3969, ComSystemTemplateSystemSignalRef=DET_AZIMUTH_ERR_192
            DET_RANGE_VELOCITY_ERR_190_oRDR_DETECTION_189_192_oPCAN_RADAR_7b5e86c2_Tx: ComBitPosition=176, ComBitSize=8, ComSignalInitValue=0, ComSignalType=UINT8, ComHandleId=4030, ComSystemTemplateSystemSignalRef=DET_RANGE_VELOCITY_ERR_190
            DET_RANGE_VELOCITY_189_oRDR_DETECTION_189_192_oPCAN_RADAR_11c50fd4_Tx: ComBitPosition=48, ComBitSize=15, ComSignalInitValue=16384, ComSignalType=UINT16, ComHandleId=4025, ComSystemTemplateSystemSignalRef=DET_RANGE_VELOCITY_189
            DET_RCS_192_oRDR_DETECTION_189_192_oPCAN_RADAR_02f5e541_Tx: ComBitPosition=464, ComBitSize=8, ComSignalInitValue=128, ComSignalType=UINT8, ComHandleId=4036, ComSystemTemplateSystemSignalRef=DET_RCS_192
            DET_CONFD_ELEVATION_192_oRDR_DETECTION_189_192_oPCAN_RADAR_e03b68b5_Tx: ComBitPosition=437, ComBitSize=2, ComSignalInitValue=0, ComSignalType=UINT8, ComHandleId=3985, ComSystemTemplateSystemSignalRef=DET_CONFD_ELEVATION_192
            DET_RANGE_ERR_190_oRDR_DETECTION_189_192_oPCAN_RADAR_a6ab053c_Tx: ComBitPosition=152, ComBitSize=7, ComSignalInitValue=0, ComSignalType=UINT8, ComHandleId=4022, ComSystemTemplateSystemSignalRef=DET_RANGE_ERR_190
            DET_RANGE_VELOCITY_190_oRDR_DETECTION_189_192_oPCAN_RADAR_74e57d70_Tx: ComBitPosition=160, ComBitSize=15, ComSignalInitValue=16384, ComSignalType=UINT16, ComHandleId=4026, ComSystemTemplateSystemSignalRef=DET_RANGE_VELOCITY_190
            DET_MTD_189_oRDR_DETECTION_189_192_oPCAN_RADAR_fc78c64a_Tx: ComBitPosition=47, ComBitSize=1, ComSignalInitValue=0, ComSignalType=UINT8, ComHandleId=4009, ComSystemTemplateSystemSignalRef=DET_MTD_189
            DET_BELOW_RAIN_THOLD_192_oRDR_DETECTION_189_192_oPCAN_RADAR_3549f045_Tx: ComBitPosition=375, ComBitSize=1, ComSignalInitValue=0, ComSignalType=UINT8, ComHandleId=3973, ComSystemTemplateSystemSignalRef=DET_BELOW_RAIN_THOLD_192
            DET_BELOW_RAIN_THOLD_190_oRDR_DETECTION_189_192_oPCAN_RADAR_c4d95f2e_Tx: ComBitPosition=151, ComBitSize=1, ComSignalInitValue=0, ComSignalType=UINT8, ComHandleId=3971, ComSystemTemplateSystemSignalRef=DET_BELOW_RAIN_THOLD_190
            DET_PROB_1STAZHYPO_191_oRDR_DETECTION_189_192_oPCAN_RADAR_9f9c88b6_Tx: ComBitPosition=327, ComBitSize=1, ComSignalInitValue=0, ComSignalType=BOOLEAN, ComHandleId=4015, ComSystemTemplateSystemSignalRef=DET_PROB_1STAZHYPO_191
            DET_MTD_191_oRDR_DETECTION_189_192_oPCAN_RADAR_0c28607b_Tx: ComBitPosition=271, ComBitSize=1, ComSignalInitValue=0, ComSignalType=UINT8, ComHandleId=4011, ComSystemTemplateSystemSignalRef=DET_MTD_191
            DET_IDM_190_oRDR_DETECTION_189_192_oPCAN_RADAR_ffeb8635_Tx: ComBitPosition=175, ComBitSize=1, ComSignalInitValue=0, ComSignalType=UINT8, ComHandleId=4003, ComSystemTemplateSystemSignalRef=DET_IDM_190
            DET_PROB_1STAZHYPO_190_oRDR_DETECTION_189_192_oPCAN_RADAR_0aec5c23_Tx: ComBitPosition=215, ComBitSize=1, ComSignalInitValue=0, ComSignalType=BOOLEAN, ComHandleId=4014, ComSystemTemplateSystemSignalRef=DET_PROB_1STAZHYPO_190
            DET_IDM_191_oRDR_DETECTION_189_192_oPCAN_RADAR_6a9b52a0_Tx: ComBitPosition=287, ComBitSize=1, ComSignalInitValue=0, ComSignalType=UINT8, ComHandleId=4004, ComSystemTemplateSystemSignalRef=DET_IDM_191
            DET_BELOW_RAIN_THOLD_189_oRDR_DETECTION_189_192_oPCAN_RADAR_a1f92d8a_Tx: ComBitPosition=39, ComBitSize=1, ComSignalInitValue=0, ComSignalType=UINT8, ComHandleId=3970, ComSystemTemplateSystemSignalRef=DET_BELOW_RAIN_THOLD_189
            DET_PROB_1STAZHYPO_189_oRDR_DETECTION_189_192_oPCAN_RADAR_6fcc2e87_Tx: ComBitPosition=103, ComBitSize=1, ComSignalInitValue=0, ComSignalType=BOOLEAN, ComHandleId=4013, ComSystemTemplateSystemSignalRef=DET_PROB_1STAZHYPO_189
            DET_BELOW_RAIN_THOLD_191_oRDR_DETECTION_189_192_oPCAN_RADAR_51a98bbb_Tx: ComBitPosition=263, ComBitSize=1, ComSignalInitValue=0, ComSignalType=UINT8, ComHandleId=3972, ComSystemTemplateSystemSignalRef=DET_BELOW_RAIN_THOLD_191
            DET_MTD_192_oRDR_DETECTION_189_192_oPCAN_RADAR_68c81b85_Tx: ComBitPosition=383, ComBitSize=1, ComSignalInitValue=0, ComSignalType=UINT8, ComHandleId=4012, ComSystemTemplateSystemSignalRef=DET_MTD_192
            DET_IDM_192_oRDR_DETECTION_189_192_oPCAN_RADAR_0e7b295e_Tx: ComBitPosition=399, ComBitSize=1, ComSignalInitValue=0, ComSignalType=UINT8, ComHandleId=4005, ComSystemTemplateSystemSignalRef=DET_IDM_192
            DET_MTD_190_oRDR_DETECTION_189_192_oPCAN_RADAR_9958b4ee_Tx: ComBitPosition=159, ComBitSize=1, ComSignalInitValue=0, ComSignalType=UINT8, ComHandleId=4010, ComSystemTemplateSystemSignalRef=DET_MTD_190
            DET_PROB_1STAZHYPO_192_oRDR_DETECTION_189_192_oPCAN_RADAR_fb7cf348_Tx: ComBitPosition=439, ComBitSize=1, ComSignalInitValue=0, ComSignalType=BOOLEAN, ComHandleId=4016, ComSystemTemplateSystemSignalRef=DET_PROB_1STAZHYPO_192
            DET_IDM_189_oRDR_DETECTION_189_192_oPCAN_RADAR_9acbf491_Tx: ComBitPosition=63, ComBitSize=1, ComSignalInitValue=0, ComSignalType=UINT8, ComHandleId=4002, ComSystemTemplateSystemSignalRef=DET_IDM_189
        SG_Detections_317_320_oRDR_DETECTION_317_320_oPCAN_RADAR_2eaedcea_Tx: ComTransferProperty=TRIGGERED, ComHandleId=81, ComSystemTemplateSignalGroupRef=SG_Detections_317_320
          83 x ComGroupSignal, all with ComSignalEndianness=LITTLE_ENDIAN, ComTransferProperty=PENDING, ComSignalAccess=ACCESS_NEEDED_BY_SWC_OR_COM:
            DET_EXISTENCE_PROB_320_oRDR_DETECTION_317_320_oPCAN_RADAR_991b48d1_Tx: ComBitPosition=448, ComBitSize=6, ComSignalInitValue=0, ComSignalType=UINT8, ComHandleId=6653, ComSystemTemplateSystemSignalRef=DET_EXISTENCE_PROB_320
            DET_CONFD_ELEVATION_318_oRDR_DETECTION_317_320_oPCAN_RADAR_37bcffb6_Tx: ComBitPosition=213, ComBitSize=2, ComSignalInitValue=0, ComSignalType=UINT8, ComHandleId=6639, ComSystemTemplateSystemSignalRef=DET_CONFD_ELEVATION_318
            DET_ELEVATION_318_oRDR_DETECTION_317_320_oPCAN_RADAR_e67c2b8a_Tx: ComBitPosition=184, ComBitSize=8, ComSignalInitValue=0, ComSignalType=UINT8, ComHandleId=6643, ComSystemTemplateSystemSignalRef=DET_ELEVATION_318
            DET_SUPER_RES_TARGET_320_oRDR_DETECTION_317_320_oPCAN_RADAR_1384806b_Tx: ComBitPosition=423, ComBitSize=1, ComSignalInitValue=0, ComSignalType=BOOLEAN, ComHandleId=6700, ComSystemTemplateSystemSignalRef=DET_SUPER_RES_TARGET_320
            DET_HVC_FLAG_320_oRDR_DETECTION_317_320_oPCAN_RADAR_786f0bae_Tx: ComBitPosition=422, ComBitSize=1, ComSignalInitValue=0, ComSignalType=BOOLEAN, ComHandleId=6657, ComSystemTemplateSystemSignalRef=DET_HVC_FLAG_320
            DET_AZIMUTH_320_oRDR_DETECTION_317_320_oPCAN_RADAR_1d0e7ac8_Tx: ComBitPosition=424, ComBitSize=13, ComSignalInitValue=0, ComSignalType=UINT16, ComHandleId=6621, ComSystemTemplateSystemSignalRef=DET_AZIMUTH_320
            DET_RANGE_319_oRDR_DETECTION_317_320_oPCAN_RADAR_b22453a8_Tx: ComBitPosition=248, ComBitSize=15, ComSignalInitValue=0, ComSignalType=UINT16, ComHandleId=6675, ComSystemTemplateSystemSignalRef=DET_RANGE_319
            DET_HVC_FLAG_319_oRDR_DETECTION_317_320_oPCAN_RADAR_c7de5175_Tx: ComBitPosition=310, ComBitSize=1, ComSignalInitValue=0, ComSignalType=BOOLEAN, ComHandleId=6656, ComSystemTemplateSystemSignalRef=DET_HVC_FLAG_319
            DET_SNR_320_oRDR_DETECTION_317_320_oPCAN_RADAR_221da80e_Tx: ComBitPosition=456, ComBitSize=8, ComSignalInitValue=0, ComSignalType=UINT8, ComHandleId=6696, ComSystemTemplateSystemSignalRef=DET_SNR_320
            DET_SUPER_RES_TARGET_319_oRDR_DETECTION_317_320_oPCAN_RADAR_ac35dab0_Tx: ComBitPosition=311, ComBitSize=1, ComSignalInitValue=0, ComSignalType=BOOLEAN, ComHandleId=6699, ComSystemTemplateSystemSignalRef=DET_SUPER_RES_TARGET_319
            DET_AZIMUTH_ERR_319_oRDR_DETECTION_317_320_oPCAN_RADAR_060ab5e6_Tx: ComBitPosition=329, ComBitSize=7, ComSignalInitValue=0, ComSignalType=UINT8, ComHandleId=6624, ComSystemTemplateSystemSignalRef=DET_AZIMUTH_ERR_319
            DET_ELEVATION_320_oRDR_DETECTION_317_320_oPCAN_RADAR_ccbda5c4_Tx: ComBitPosition=408, ComBitSize=8, ComSignalInitValue=0, ComSignalType=UINT8, ComHandleId=6645, ComSystemTemplateSystemSignalRef=DET_ELEVATION_320
            DET_RANGE_VELOCITY_317_oRDR_DETECTION_317_320_oPCAN_RADAR_7ee2d75f_Tx: ComBitPosition=48, ComBitSize=15, ComSignalInitValue=16384, ComSignalType=UINT16, ComHandleId=6681, ComSystemTemplateSystemSignalRef=DET_RANGE_VELOCITY_317
            DET_HVC_FLAG_317_oRDR_DETECTION_317_320_oPCAN_RADAR_7ebe17a7_Tx: ComBitPosition=86, ComBitSize=1, ComSignalInitValue=0, ComSignalType=BOOLEAN, ComHandleId=6654, ComSystemTemplateSystemSignalRef=DET_HVC_FLAG_317
            DET_CONFD_ELEVATION_320_oRDR_DETECTION_317_320_oPCAN_RADAR_1d7d71f8_Tx: ComBitPosition=437, ComBitSize=2, ComSignalInitValue=0, ComSignalType=UINT8, ComHandleId=6641, ComSystemTemplateSystemSignalRef=DET_CONFD_ELEVATION_320
            DET_ELEVATION_ERR_317_oRDR_DETECTION_317_320_oPCAN_RADAR_4d5521b8_Tx: ComBitPosition=80, ComBitSize=6, ComSignalInitValue=0, ComSignalType=UINT8, ComHandleId=6646, ComSystemTemplateSystemSignalRef=DET_ELEVATION_ERR_317
            DET_RCS_319_oRDR_DETECTION_317_320_oPCAN_RADAR_4002a6d7_Tx: ComBitPosition=352, ComBitSize=8, ComSignalInitValue=128, ComSignalType=UINT8, ComHandleId=6691, ComSystemTemplateSystemSignalRef=DET_RCS_319
            DET_AZIMUTH_ERR_318_oRDR_DETECTION_317_320_oPCAN_RADAR_937a6173_Tx: ComBitPosition=217, ComBitSize=7, ComSignalInitValue=0, ComSignalType=UINT8, ComHandleId=6623, ComSystemTemplateSystemSignalRef=DET_AZIMUTH_ERR_318
            DET_SNR_317_oRDR_DETECTION_317_320_oPCAN_RADAR_24ccb407_Tx: ComBitPosition=120, ComBitSize=8, ComSignalInitValue=0, ComSignalType=UINT8, ComHandleId=6693, ComSystemTemplateSystemSignalRef=DET_SNR_317
            DET_BI_STATIC_FLAG_318_oRDR_DETECTION_317_320_oPCAN_RADAR_61e3b403_Tx: ComBitPosition=216, ComBitSize=1, ComSignalInitValue=0, ComSignalType=BOOLEAN, ComHandleId=6631, ComSystemTemplateSystemSignalRef=DET_BI_STATIC_FLAG_318
            DET_RANGE_318_oRDR_DETECTION_317_320_oPCAN_RADAR_2754873d_Tx: ComBitPosition=136, ComBitSize=15, ComSignalInitValue=0, ComSignalType=UINT16, ComHandleId=6674, ComSystemTemplateSystemSignalRef=DET_RANGE_318
            DET_AZIMUTH_318_oRDR_DETECTION_317_320_oPCAN_RADAR_37cff486_Tx: ComBitPosition=200, ComBitSize=13, ComSignalInitValue=0, ComSignalType=UINT16, ComHandleId=6619, ComSystemTemplateSystemSignalRef=DET_AZIMUTH_318
            DET_CONFD_AZIMUTH_318_oRDR_DETECTION_317_320_oPCAN_RADAR_3529fe4c_Tx: ComBitPosition=230, ComBitSize=2, ComSignalInitValue=0, ComSignalType=UINT8, ComHandleId=6635, ComSystemTemplateSystemSignalRef=DET_CONFD_AZIMUTH_318
            DET_ELEVATION_319_oRDR_DETECTION_317_320_oPCAN_RADAR_730cff1f_Tx: ComBitPosition=296, ComBitSize=8, ComSignalInitValue=0, ComSignalType=UINT8, ComHandleId=6644, ComSystemTemplateSystemSignalRef=DET_ELEVATION_319
            DET_RANGE_320_oRDR_DETECTION_317_320_oPCAN_RADAR_0d950973_Tx: ComBitPosition=360, ComBitSize=15, ComSignalInitValue=0, ComSignalType=UINT16, ComHandleId=6676, ComSystemTemplateSystemSignalRef=DET_RANGE_320
            DET_CONFD_AZIMUTH_317_oRDR_DETECTION_317_320_oPCAN_RADAR_19396c0b_Tx: ComBitPosition=118, ComBitSize=2, ComSignalInitValue=0, ComSignalType=UINT8, ComHandleId=6634, ComSystemTemplateSystemSignalRef=DET_CONFD_AZIMUTH_317
            DET_ELEVATION_ERR_319_oRDR_DETECTION_317_320_oPCAN_RADAR_f435676a_Tx: ComBitPosition=304, ComBitSize=6, ComSignalInitValue=0, ComSignalType=UINT8, ComHandleId=6648, ComSystemTemplateSystemSignalRef=DET_ELEVATION_ERR_319
            DET_CONFD_AZIMUTH_320_oRDR_DETECTION_317_320_oPCAN_RADAR_1fe87002_Tx: ComBitPosition=454, ComBitSize=2, ComSignalInitValue=0, ComSignalType=UINT8, ComHandleId=6637, ComSystemTemplateSystemSignalRef=DET_CONFD_AZIMUTH_320
            DET_RCS_320_oRDR_DETECTION_317_320_oPCAN_RADAR_ffb3fc0c_Tx: ComBitPosition=464, ComBitSize=8, ComSignalInitValue=128, ComSignalType=UINT8, ComHandleId=6692, ComSystemTemplateSystemSignalRef=DET_RCS_320
            DET_HVC_FLAG_318_oRDR_DETECTION_317_320_oPCAN_RADAR_52ae85e0_Tx: ComBitPosition=198, ComBitSize=1, ComSignalInitValue=0, ComSignalType=BOOLEAN, ComHandleId=6655, ComSystemTemplateSystemSignalRef=DET_HVC_FLAG_318
            DET_CONFD_ELEVATION_317_oRDR_DETECTION_317_320_oPCAN_RADAR_1bac6df1_Tx: ComBitPosition=101, ComBitSize=2, ComSignalInitValue=0, ComSignalType=UINT8, ComHandleId=6638, ComSystemTemplateSystemSignalRef=DET_CONFD_ELEVATION_317
            DET_MH_SCAN_INDEX_4LSB_317_320_oRDR_DETECTION_317_320_oPCAN_RADAR_e2798a5a_Tx: ComBitPosition=476, ComBitSize=4, ComSignalInitValue=0, ComSignalType=UINT8, ComHandleId=6664, ComSystemTemplateSystemSignalRef=DET_MH_SCAN_INDEX_4LSB_317_320
            DET_ELEVATION_ERR_320_oRDR_DETECTION_317_320_oPCAN_RADAR_4b843db1_Tx: ComBitPosition=416, ComBitSize=6, ComSignalInitValue=0, ComSignalType=UINT8, ComHandleId=6649, ComSystemTemplateSystemSignalRef=DET_ELEVATION_ERR_320
            DET_BI_STATIC_FLAG_320_oRDR_DETECTION_317_320_oPCAN_RADAR_4b223a4d_Tx: ComBitPosition=440, ComBitSize=1, ComSignalInitValue=0, ComSignalType=BOOLEAN, ComHandleId=6633, ComSystemTemplateSystemSignalRef=DET_BI_STATIC_FLAG_320
            DET_BI_STATIC_FLAG_319_oRDR_DETECTION_317_320_oPCAN_RADAR_f4936096_Tx: ComBitPosition=328, ComBitSize=1, ComSignalInitValue=0, ComSignalType=BOOLEAN, ComHandleId=6632, ComSystemTemplateSystemSignalRef=DET_BI_STATIC_FLAG_319
            DET_ELEVATION_ERR_318_oRDR_DETECTION_317_320_oPCAN_RADAR_6145b3ff_Tx: ComBitPosition=192, ComBitSize=6, ComSignalInitValue=0, ComSignalType=UINT8, ComHandleId=6647, ComSystemTemplateSystemSignalRef=DET_ELEVATION_ERR_318
            DET_EXISTENCE_PROB_317_oRDR_DETECTION_317_320_oPCAN_RADAR_9fca54d8_Tx: ComBitPosition=112, ComBitSize=6, ComSignalInitValue=0, ComSignalType=UINT8, ComHandleId=6650, ComSystemTemplateSystemSignalRef=DET_EXISTENCE_PROB_317
            DET_MH_CRC16_317_320_oRDR_DETECTION_317_320_oPCAN_RADAR_aa260ee1_Tx: ComBitPosition=0, ComBitSize=16, ComSignalInitValue=0, ComSignalType=UINT16, ComHandleId=6662, ComSystemTemplateSystemSignalRef=DET_MH_CRC16_317_320
            DET_MH_CYCLE_COUNTER_317_320_oRDR_DETECTION_317_320_oPCAN_RADAR_2e53afd6_Tx: ComBitPosition=16, ComBitSize=8, ComSignalInitValue=0, ComSignalType=UINT8, ComHandleId=6663, ComSystemTemplateSystemSignalRef=DET_MH_CYCLE_COUNTER_317_320
            DET_RANGE_ERR_319_oRDR_DETECTION_317_320_oPCAN_RADAR_15cce9c1_Tx: ComBitPosition=264, ComBitSize=7, ComSignalInitValue=0, ComSignalType=UINT8, ComHandleId=6679, ComSystemTemplateSystemSignalRef=DET_RANGE_ERR_319
            DET_RANGE_VELOCITY_319_oRDR_DETECTION_317_320_oPCAN_RADAR_c782918d_Tx: ComBitPosition=272, ComBitSize=15, ComSignalInitValue=16384, ComSignalType=UINT16, ComHandleId=6683, ComSystemTemplateSystemSignalRef=DET_RANGE_VELOCITY_319
            DET_RCS_317_oRDR_DETECTION_317_320_oPCAN_RADAR_f962e005_Tx: ComBitPosition=128, ComBitSize=8, ComSignalInitValue=128, ComSignalType=UINT8, ComHandleId=6689, ComSystemTemplateSystemSignalRef=DET_RCS_317
            DET_CONFD_AZIMUTH_319_oRDR_DETECTION_317_320_oPCAN_RADAR_a0592ad9_Tx: ComBitPosition=342, ComBitSize=2, ComSignalInitValue=0, ComSignalType=UINT8, ComHandleId=6636, ComSystemTemplateSystemSignalRef=DET_CONFD_AZIMUTH_319
            DET_ELEVATION_317_oRDR_DETECTION_317_320_oPCAN_RADAR_ca6cb9cd_Tx: ComBitPosition=72, ComBitSize=8, ComSignalInitValue=0, ComSignalType=UINT8, ComHandleId=6642, ComSystemTemplateSystemSignalRef=DET_ELEVATION_317
            DET_RANGE_ERR_317_oRDR_DETECTION_317_320_oPCAN_RADAR_acacaf13_Tx: ComBitPosition=40, ComBitSize=7, ComSignalInitValue=0, ComSignalType=UINT8, ComHandleId=6677, ComSystemTemplateSystemSignalRef=DET_RANGE_ERR_317
            DET_RANGE_VELOCITY_318_oRDR_DETECTION_317_320_oPCAN_RADAR_52f24518_Tx: ComBitPosition=160, ComBitSize=15, ComSignalInitValue=16384, ComSignalType=UINT16, ComHandleId=6682, ComSystemTemplateSystemSignalRef=DET_RANGE_VELOCITY_318
            DET_AZIMUTH_ERR_317_oRDR_DETECTION_317_320_oPCAN_RADAR_bf6af334_Tx: ComBitPosition=105, ComBitSize=7, ComSignalInitValue=0, ComSignalType=UINT8, ComHandleId=6622, ComSystemTemplateSystemSignalRef=DET_AZIMUTH_ERR_317
            DET_RANGE_ERR_318_oRDR_DETECTION_317_320_oPCAN_RADAR_80bc3d54_Tx: ComBitPosition=152, ComBitSize=7, ComSignalInitValue=0, ComSignalType=UINT8, ComHandleId=6678, ComSystemTemplateSystemSignalRef=DET_RANGE_ERR_318
            DET_RANGE_ERR_320_oRDR_DETECTION_317_320_oPCAN_RADAR_aa7db31a_Tx: ComBitPosition=376, ComBitSize=7, ComSignalInitValue=0, ComSignalType=UINT8, ComHandleId=6680, ComSystemTemplateSystemSignalRef=DET_RANGE_ERR_320
            DET_RANGE_VELOCITY_320_oRDR_DETECTION_317_320_oPCAN_RADAR_7833cb56_Tx: ComBitPosition=384, ComBitSize=15, ComSignalInitValue=16384, ComSignalType=UINT16, ComHandleId=6684, ComSystemTemplateSystemSignalRef=DET_RANGE_VELOCITY_320
            DET_BI_STATIC_FLAG_317_oRDR_DETECTION_317_320_oPCAN_RADAR_4df32644_Tx: ComBitPosition=104, ComBitSize=1, ComSignalInitValue=0, ComSignalType=BOOLEAN, ComHandleId=6630, ComSystemTemplateSystemSignalRef=DET_BI_STATIC_FLAG_317
            DET_RANGE_VELOCITY_ERR_318_oRDR_DETECTION_317_320_oPCAN_RADAR_5d49beaa_Tx: ComBitPosition=176, ComBitSize=8, ComSignalInitValue=0, ComSignalType=UINT8, ComHandleId=6686, ComSystemTemplateSystemSignalRef=DET_RANGE_VELOCITY_ERR_318
            DET_EXISTENCE_PROB_318_oRDR_DETECTION_317_320_oPCAN_RADAR_b3dac69f_Tx: ComBitPosition=224, ComBitSize=6, ComSignalInitValue=0, ComSignalType=UINT8, ComHandleId=6651, ComSystemTemplateSystemSignalRef=DET_EXISTENCE_PROB_318
            DET_SUPER_RES_TARGET_318_oRDR_DETECTION_317_320_oPCAN_RADAR_39450e25_Tx: ComBitPosition=199, ComBitSize=1, ComSignalInitValue=0, ComSignalType=BOOLEAN, ComHandleId=6698, ComSystemTemplateSystemSignalRef=DET_SUPER_RES_TARGET_318
            DET_AZIMUTH_ERR_320_oRDR_DETECTION_317_320_oPCAN_RADAR_b9bbef3d_Tx: ComBitPosition=441, ComBitSize=7, ComSignalInitValue=0, ComSignalType=UINT8, ComHandleId=6625, ComSystemTemplateSystemSignalRef=DET_AZIMUTH_ERR_320
            DET_RANGE_VELOCITY_ERR_319_oRDR_DETECTION_317_320_oPCAN_RADAR_c8396a3f_Tx: ComBitPosition=288, ComBitSize=8, ComSignalInitValue=0, ComSignalType=UINT8, ComHandleId=6687, ComSystemTemplateSystemSignalRef=DET_RANGE_VELOCITY_ERR_319
            DET_RANGE_VELOCITY_ERR_317_oRDR_DETECTION_317_320_oPCAN_RADAR_71592ced_Tx: ComBitPosition=64, ComBitSize=8, ComSignalInitValue=0, ComSignalType=UINT8, ComHandleId=6685, ComSystemTemplateSystemSignalRef=DET_RANGE_VELOCITY_ERR_317
            DET_RCS_318_oRDR_DETECTION_317_320_oPCAN_RADAR_d5727242_Tx: ComBitPosition=240, ComBitSize=8, ComSignalInitValue=128, ComSignalType=UINT8, ComHandleId=6690, ComSystemTemplateSystemSignalRef=DET_RCS_318
            DET_SNR_319_oRDR_DETECTION_317_320_oPCAN_RADAR_9dacf2d5_Tx: ComBitPosition=344, ComBitSize=8, ComSignalInitValue=0, ComSignalType=UINT8, ComHandleId=6695, ComSystemTemplateSystemSignalRef=DET_SNR_319
            DET_EXISTENCE_PROB_319_oRDR_DETECTION_317_320_oPCAN_RADAR_26aa120a_Tx: ComBitPosition=336, ComBitSize=6, ComSignalInitValue=0, ComSignalType=UINT8, ComHandleId=6652, ComSystemTemplateSystemSignalRef=DET_EXISTENCE_PROB_319
            DET_SNR_318_oRDR_DETECTION_317_320_oPCAN_RADAR_08dc2640_Tx: ComBitPosition=232, ComBitSize=8, ComSignalInitValue=0, ComSignalType=UINT8, ComHandleId=6694, ComSystemTemplateSystemSignalRef=DET_SNR_318
            DET_AZIMUTH_319_oRDR_DETECTION_317_320_oPCAN_RADAR_a2bf2013_Tx: ComBitPosition=312, ComBitSize=13, ComSignalInitValue=0, ComSignalType=UINT16, ComHandleId=6620, ComSystemTemplateSystemSignalRef=DET_AZIMUTH_319
            DET_RANGE_VELOCITY_ERR_320_oRDR_DETECTION_317_320_oPCAN_RADAR_778830e4_Tx: ComBitPosition=400, ComBitSize=8, ComSignalInitValue=0, ComSignalType=UINT8, ComHandleId=6688, ComSystemTemplateSystemSignalRef=DET_RANGE_VELOCITY_ERR_320
            DET_AZIMUTH_317_oRDR_DETECTION_317_320_oPCAN_RADAR_1bdf66c1_Tx: ComBitPosition=88, ComBitSize=13, ComSignalInitValue=0, ComSignalType=UINT16, ComHandleId=6618, ComSystemTemplateSystemSignalRef=DET_AZIMUTH_317
            DET_RANGE_317_oRDR_DETECTION_317_320_oPCAN_RADAR_0b44157a_Tx: ComBitPosition=24, ComBitSize=15, ComSignalInitValue=0, ComSignalType=UINT16, ComHandleId=6673, ComSystemTemplateSystemSignalRef=DET_RANGE_317
            DET_CONFD_ELEVATION_319_oRDR_DETECTION_317_320_oPCAN_RADAR_a2cc2b23_Tx: ComBitPosition=325, ComBitSize=2, ComSignalInitValue=0, ComSignalType=UINT8, ComHandleId=6640, ComSystemTemplateSystemSignalRef=DET_CONFD_ELEVATION_319
            DET_SUPER_RES_TARGET_317_oRDR_DETECTION_317_320_oPCAN_RADAR_15559c62_Tx: ComBitPosition=87, ComBitSize=1, ComSignalInitValue=0, ComSignalType=BOOLEAN, ComHandleId=6697, ComSystemTemplateSystemSignalRef=DET_SUPER_RES_TARGET_317
            DET_BELOW_RAIN_THOLD_319_oRDR_DETECTION_317_320_oPCAN_RADAR_77beb3d3_Tx: ComBitPosition=263, ComBitSize=1, ComSignalInitValue=0, ComSignalType=UINT8, ComHandleId=6628, ComSystemTemplateSystemSignalRef=DET_BELOW_RAIN_THOLD_319
            DET_MTD_317_oRDR_DETECTION_317_320_oPCAN_RADAR_935f1ec1_Tx: ComBitPosition=47, ComBitSize=1, ComSignalInitValue=0, ComSignalType=UINT8, ComHandleId=6665, ComSystemTemplateSystemSignalRef=DET_MTD_317
            DET_PROB_1STAZHYPO_317_oRDR_DETECTION_317_320_oPCAN_RADAR_00ebf60c_Tx: ComBitPosition=103, ComBitSize=1, ComSignalInitValue=0, ComSignalType=BOOLEAN, ComHandleId=6669, ComSystemTemplateSystemSignalRef=DET_PROB_1STAZHYPO_317
            DET_IDM_318_oRDR_DETECTION_317_320_oPCAN_RADAR_d9fcbe5d_Tx: ComBitPosition=175, ComBitSize=1, ComSignalInitValue=0, ComSignalType=UINT8, ComHandleId=6659, ComSystemTemplateSystemSignalRef=DET_IDM_318
            DET_MTD_319_oRDR_DETECTION_317_320_oPCAN_RADAR_2a3f5813_Tx: ComBitPosition=271, ComBitSize=1, ComSignalInitValue=0, ComSignalType=UINT8, ComHandleId=6667, ComSystemTemplateSystemSignalRef=DET_MTD_319
            DET_BELOW_RAIN_THOLD_318_oRDR_DETECTION_317_320_oPCAN_RADAR_e2ce6746_Tx: ComBitPosition=151, ComBitSize=1, ComSignalInitValue=0, ComSignalType=UINT8, ComHandleId=6627, ComSystemTemplateSystemSignalRef=DET_BELOW_RAIN_THOLD_318
            DET_BELOW_RAIN_THOLD_317_oRDR_DETECTION_317_320_oPCAN_RADAR_cedef501_Tx: ComBitPosition=39, ComBitSize=1, ComSignalInitValue=0, ComSignalType=UINT8, ComHandleId=6626, ComSystemTemplateSystemSignalRef=DET_BELOW_RAIN_THOLD_317
            DET_PROB_1STAZHYPO_318_oRDR_DETECTION_317_320_oPCAN_RADAR_2cfb644b_Tx: ComBitPosition=215, ComBitSize=1, ComSignalInitValue=0, ComSignalType=BOOLEAN, ComHandleId=6670, ComSystemTemplateSystemSignalRef=DET_PROB_1STAZHYPO_318
            DET_IDM_319_oRDR_DETECTION_317_320_oPCAN_RADAR_4c8c6ac8_Tx: ComBitPosition=287, ComBitSize=1, ComSignalInitValue=0, ComSignalType=UINT8, ComHandleId=6660, ComSystemTemplateSystemSignalRef=DET_IDM_319
            DET_MTD_318_oRDR_DETECTION_317_320_oPCAN_RADAR_bf4f8c86_Tx: ComBitPosition=159, ComBitSize=1, ComSignalInitValue=0, ComSignalType=UINT8, ComHandleId=6666, ComSystemTemplateSystemSignalRef=DET_MTD_318
            DET_BELOW_RAIN_THOLD_320_oRDR_DETECTION_317_320_oPCAN_RADAR_c80fe908_Tx: ComBitPosition=375, ComBitSize=1, ComSignalInitValue=0, ComSignalType=UINT8, ComHandleId=6629, ComSystemTemplateSystemSignalRef=DET_BELOW_RAIN_THOLD_320
            DET_IDM_317_oRDR_DETECTION_317_320_oPCAN_RADAR_f5ec2c1a_Tx: ComBitPosition=63, ComBitSize=1, ComSignalInitValue=0, ComSignalType=UINT8, ComHandleId=6658, ComSystemTemplateSystemSignalRef=DET_IDM_317
            DET_PROB_1STAZHYPO_320_oRDR_DETECTION_317_320_oPCAN_RADAR_063aea05_Tx: ComBitPosition=439, ComBitSize=1, ComSignalInitValue=0, ComSignalType=BOOLEAN, ComHandleId=6672, ComSystemTemplateSystemSignalRef=DET_PROB_1STAZHYPO_320
            DET_PROB_1STAZHYPO_319_oRDR_DETECTION_317_320_oPCAN_RADAR_b98bb0de_Tx: ComBitPosition=327, ComBitSize=1, ComSignalInitValue=0, ComSignalType=BOOLEAN, ComHandleId=6671, ComSystemTemplateSystemSignalRef=DET_PROB_1STAZHYPO_319
            DET_IDM_320_oRDR_DETECTION_317_320_oPCAN_RADAR_f33d3013_Tx: ComBitPosition=399, ComBitSize=1, ComSignalInitValue=0, ComSignalType=UINT8, ComHandleId=6661, ComSystemTemplateSystemSignalRef=DET_IDM_320
            DET_MTD_320_oRDR_DETECTION_317_320_oPCAN_RADAR_958e02c8_Tx: ComBitPosition=383, ComBitSize=1, ComSignalInitValue=0, ComSignalType=UINT8, ComHandleId=6668, ComSystemTemplateSystemSignalRef=DET_MTD_320
