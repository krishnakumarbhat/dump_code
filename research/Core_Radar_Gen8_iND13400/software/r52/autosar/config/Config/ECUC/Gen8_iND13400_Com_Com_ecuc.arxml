[part 18 of 20: package /ActiveEcuC]
AUTOSAR XML (schema 00053)
package /ActiveEcuC  (continued)
  module config Com: implementation-config-variant=VARIANT-PRE-COMPILE, module-description=Com_Impl  (continued)
    ComConfig: ComConfigurationId=0, ComRxImmediateNotificationCacheSize=0, ComRxDeferredNotificationCacheSize=1  (continued)
      RDR_FUSION_DET_033_036_oPCAN_RADAR_f1197080_Rx (ComIPdu):
        ComIPduDirection = RECEIVE
        ComIPduType = NORMAL
        ComIPduCancellationSupport = false
        ComIPduHandleId = 30
        ComIPduSignalProcessing = DEFERRED
        ComIPduChannelRef = CN_PCAN_RADAR_458ff0f1
        ComIPduGroupRef = RDR01_oPCAN_RADAR_Rx_e0e717e1 if post-build-variant-condition{matching-criterion=RDR_POS, value=0}
        ComIPduSignalGroupRef = SG_Fusion_Detections_033_036_oRDR_FUSION_DET_033_036_oPCAN_RADAR_cce3d4c2_Rx
        ComPduIdRef = RDR_FUSION_DET_033_036_oPCAN_RADAR_f1197080_Rx
        ComIPduMainFunctionRef = ComMainFunctionRx
        ComIPduGroupRef = RDR02_oPCAN_RADAR_Rx_c92fa313 if post-build-variant-condition{matching-criterion=RDR_POS, value=1}
        ComIPduGroupRef = RDR03_oPCAN_RADAR_Rx_67473282 if post-build-variant-condition{matching-criterion=RDR_POS, value=2}
        ComIPduGroupRef = RDR04_oPCAN_RADAR_Rx_9abecaf7 if post-build-variant-condition{matching-criterion=RDR_POS, value=3}
        ComIPduGroupRef = RDR05_oPCAN_RADAR_Rx_34d65b66 if post-build-variant-condition{matching-criterion=RDR_POS, value=4}
        ComIPduGroupRef = RDR06_oPCAN_RADAR_Rx_1d1eef94 if post-build-variant-condition{matching-criterion=RDR_POS, value=5}
        ComIPduGroupRef = RDR07_oPCAN_RADAR_Rx_b3767e05 if post-build-variant-condition{matching-criterion=RDR_POS, value=6}
        ComIPduGroupRef = RDR08_oPCAN_RADAR_Rx_3d9c193f if post-build-variant-condition{matching-criterion=RDR_POS, value=7}
      SG_Fusion_Detections_009_012_oRDR_FUSION_DET_009_012_oPCAN_RADAR_85b0e384_Rx (ComSignalGroup):
        ComTimeout = 0
        ComTransferProperty = PENDING
        ComSignalGroupAccess = ACCESS_NEEDED_BY_SWC_OR_COM
        ComHandleId = 10
        ComSignalGroupArrayAccess = true
        ComSystemTemplateSignalGroupRef = SG_Fusion_Detections_009_012
        83 x ComGroupSignal, all with ComSignalEndianness=LITTLE_ENDIAN, ComSignalInitValue=0, ComSignalAccess=ACCESS_NEEDED_BY_SWC_OR_COM:
          DET_RANGE_ERR_012_Rx_oRDR_FUSION_DET_009_012_oPCAN_RADAR_03f63aca_Rx: ComBitPosition=376, ComBitSize=7, ComSignalType=UINT8, ComHandleId=302, ComSystemTemplateSystemSignalRef=DET_RANGE_ERR_012_Rx
          DET_AZIMUTH_011_Rx_oRDR_FUSION_DET_009_012_oPCAN_RADAR_6a7e5a85_Rx: ComBitPosition=312, ComBitSize=13, ComSignalType=UINT16, ComHandleId=242, ComSystemTemplateSystemSignalRef=DET_AZIMUTH_011_Rx
          DET_RCS_012_Rx_oRDR_FUSION_DET_009_012_oPCAN_RADAR_433aa7cf_Rx: ComBitPosition=464, ComBitSize=8, ComSignalType=UINT8, ComHandleId=314, ComSystemTemplateSystemSignalRef=DET_RCS_012_Rx
          DET_RCS_009_Rx_oRDR_FUSION_DET_009_012_oPCAN_RADAR_fbe20619_Rx: ComBitPosition=128, ComBitSize=8, ComSignalType=UINT8, ComHandleId=311, ComSystemTemplateSystemSignalRef=DET_RCS_009_Rx
          DET_BI_STATIC_FLAG_011_Rx_oRDR_FUSION_DET_009_012_oPCAN_RADAR_7b5a0e23_Rx: ComBitPosition=328, ComBitSize=1, ComSignalType=BOOLEAN, ComHandleId=254, ComSystemTemplateSystemSignalRef=DET_BI_STATIC_FLAG_011_Rx
          DET_IDM_011_Rx_oRDR_FUSION_DET_009_012_oPCAN_RADAR_55ffc644_Rx: ComBitPosition=287, ComBitSize=1, ComSignalType=BOOLEAN, ComHandleId=282, ComSystemTemplateSystemSignalRef=DET_IDM_011_Rx
          DET_RANGE_VELOCITY_009_Rx_oRDR_FUSION_DET_009_012_oPCAN_RADAR_36299402_Rx: ComBitPosition=48, ComBitSize=15, ComSignalType=UINT16, ComHandleId=303, ComSystemTemplateSystemSignalRef=DET_RANGE_VELOCITY_009_Rx
          DET_MTD_009_Rx_oRDR_FUSION_DET_009_012_oPCAN_RADAR_7a18e16a_Rx: ComBitPosition=47, ComBitSize=1, ComSignalType=BOOLEAN, ComHandleId=287, ComSystemTemplateSystemSignalRef=DET_MTD_009_Rx
          DET_ELEVATION_ERR_011_Rx_oRDR_FUSION_DET_009_012_oPCAN_RADAR_4af8aad6_Rx: ComBitPosition=304, ComBitSize=6, ComSignalType=UINT8, ComHandleId=270, ComSystemTemplateSystemSignalRef=DET_ELEVATION_ERR_011_Rx
          DET_AZIMUTH_012_Rx_oRDR_FUSION_DET_009_012_oPCAN_RADAR_40c2ea0d_Rx: ComBitPosition=424, ComBitSize=13, ComSignalType=UINT16, ComHandleId=243, ComSystemTemplateSystemSignalRef=DET_AZIMUTH_012_Rx
          DET_BELOW_RAIN_THOLD_012_Rx_oRDR_FUSION_DET_009_012_oPCAN_RADAR_267815b8_Rx: ComBitPosition=375, ComBitSize=1, ComSignalType=BOOLEAN, ComHandleId=251, ComSystemTemplateSystemSignalRef=DET_BELOW_RAIN_THOLD_012_Rx
          DET_SNR_011_Rx_oRDR_FUSION_DET_009_012_oPCAN_RADAR_60dc66ae_Rx: ComBitPosition=344, ComBitSize=8, ComSignalType=UINT8, ComHandleId=317, ComSystemTemplateSystemSignalRef=DET_SNR_011_Rx
          DET_EXISTENCE_PROB_010_Rx_oRDR_FUSION_DET_009_012_oPCAN_RADAR_12a44004_Rx: ComBitPosition=224, ComBitSize=6, ComSignalType=UINT8, ComHandleId=273, ComSystemTemplateSystemSignalRef=DET_EXISTENCE_PROB_010_Rx
          DET_RANGE_VELOCITY_ERR_009_Rx_oRDR_FUSION_DET_009_012_oPCAN_RADAR_af4de4c0_Rx: ComBitPosition=64, ComBitSize=8, ComSignalType=UINT8, ComHandleId=307, ComSystemTemplateSystemSignalRef=DET_RANGE_VELOCITY_ERR_009_Rx
          DET_RCS_010_Rx_oRDR_FUSION_DET_009_012_oPCAN_RADAR_c6c28500_Rx: ComBitPosition=240, ComBitSize=8, ComSignalType=UINT8, ComHandleId=312, ComSystemTemplateSystemSignalRef=DET_RCS_010_Rx
          DET_SUPER_RES_TARGET_012_Rx_oRDR_FUSION_DET_009_012_oPCAN_RADAR_819bf726_Rx: ComBitPosition=423, ComBitSize=1, ComSignalType=BOOLEAN, ComHandleId=322, ComSystemTemplateSystemSignalRef=DET_SUPER_RES_TARGET_012_Rx
          DET_CONFD_ELEVATION_012_Rx_oRDR_FUSION_DET_009_012_oPCAN_RADAR_b8aed778_Rx: ComBitPosition=437, ComBitSize=2, ComSignalType=UINT8, ComHandleId=263, ComSystemTemplateSystemSignalRef=DET_CONFD_ELEVATION_012_Rx
          DET_SUPER_RES_TARGET_009_Rx_oRDR_FUSION_DET_009_012_oPCAN_RADAR_394356f0_Rx: ComBitPosition=87, ComBitSize=1, ComSignalType=BOOLEAN, ComHandleId=319, ComSystemTemplateSystemSignalRef=DET_SUPER_RES_TARGET_009_Rx
          DET_ELEVATION_ERR_010_Rx_oRDR_FUSION_DET_009_012_oPCAN_RADAR_e5bc3891_Rx: ComBitPosition=192, ComBitSize=6, ComSignalType=UINT8, ComHandleId=269, ComSystemTemplateSystemSignalRef=DET_ELEVATION_ERR_010_Rx
          DET_AZIMUTH_ERR_010_Rx_oRDR_FUSION_DET_009_012_oPCAN_RADAR_c7536940_Rx: ComBitPosition=217, ComBitSize=7, ComSignalType=UINT8, ComHandleId=245, ComSystemTemplateSystemSignalRef=DET_AZIMUTH_ERR_010_Rx
          DET_CONFD_ELEVATION_009_Rx_oRDR_FUSION_DET_009_012_oPCAN_RADAR_007676ae_Rx: ComBitPosition=101, ComBitSize=2, ComSignalType=UINT8, ComHandleId=260, ComSystemTemplateSystemSignalRef=DET_CONFD_ELEVATION_009_Rx
          DET_BI_STATIC_FLAG_009_Rx_oRDR_FUSION_DET_009_012_oPCAN_RADAR_e93e1f7d_Rx: ComBitPosition=104, ComBitSize=1, ComSignalType=BOOLEAN, ComHandleId=252, ComSystemTemplateSystemSignalRef=DET_BI_STATIC_FLAG_009_Rx
          DET_MTD_010_Rx_oRDR_FUSION_DET_009_012_oPCAN_RADAR_47386273_Rx: ComBitPosition=159, ComBitSize=1, ComSignalType=BOOLEAN, ComHandleId=288, ComSystemTemplateSystemSignalRef=DET_MTD_010_Rx
          DET_HVC_FLAG_010_Rx_oRDR_FUSION_DET_009_012_oPCAN_RADAR_cf7aad4b_Rx: ComBitPosition=198, ComBitSize=1, ComSignalType=BOOLEAN, ComHandleId=277, ComSystemTemplateSystemSignalRef=DET_HVC_FLAG_010_Rx
          DET_RANGE_012_Rx_oRDR_FUSION_DET_009_012_oPCAN_RADAR_5304b62a_Rx: ComBitPosition=360, ComBitSize=15, ComSignalType=UINT16, ComHandleId=298, ComSystemTemplateSystemSignalRef=DET_RANGE_012_Rx
          DET_IDM_010_Rx_oRDR_FUSION_DET_009_012_oPCAN_RADAR_fabb5403_Rx: ComBitPosition=175, ComBitSize=1, ComSignalType=BOOLEAN, ComHandleId=281, ComSystemTemplateSystemSignalRef=DET_IDM_010_Rx
          DET_MH_CRC16_009_012_Rx_oRDR_FUSION_DET_009_012_oPCAN_RADAR_93549254_Rx: ComBitPosition=0, ComBitSize=16, ComSignalType=UINT16, ComHandleId=284, ComSystemTemplateSystemSignalRef=DET_MH_CRC16_009_012_Rx
          DET_CONFD_AZIMUTH_009_Rx_oRDR_FUSION_DET_009_012_oPCAN_RADAR_0a57f529_Rx: ComBitPosition=118, ComBitSize=2, ComSignalType=UINT8, ComHandleId=256, ComSystemTemplateSystemSignalRef=DET_CONFD_AZIMUTH_009_Rx
          DET_RANGE_ERR_010_Rx_oRDR_FUSION_DET_009_012_oPCAN_RADAR_860e1805_Rx: ComBitPosition=152, ComBitSize=7, ComSignalType=UINT8, ComHandleId=300, ComSystemTemplateSystemSignalRef=DET_RANGE_ERR_010_Rx
          DET_BI_STATIC_FLAG_012_Rx_oRDR_FUSION_DET_009_012_oPCAN_RADAR_51e6beab_Rx: ComBitPosition=440, ComBitSize=1, ComSignalType=BOOLEAN, ComHandleId=255, ComSystemTemplateSystemSignalRef=DET_BI_STATIC_FLAG_012_Rx
          DET_MH_SCAN_INDEX_4LSB_009_012_Rx_oRDR_FUSION_DET_009_012_oPCAN_RADAR_fa3f60aa_Rx: ComBitPosition=476, ComBitSize=4, ComSignalType=UINT8, ComHandleId=286, ComSystemTemplateSystemSignalRef=DET_MH_SCAN_INDEX_4LSB_009_012_Rx
          DET_AZIMUTH_ERR_009_Rx_oRDR_FUSION_DET_009_012_oPCAN_RADAR_fa73ea59_Rx: ComBitPosition=105, ComBitSize=7, ComSignalType=UINT8, ComHandleId=244, ComSystemTemplateSystemSignalRef=DET_AZIMUTH_ERR_009_Rx
          DET_RANGE_009_Rx_oRDR_FUSION_DET_009_012_oPCAN_RADAR_ebdc17fc_Rx: ComBitPosition=24, ComBitSize=15, ComSignalType=UINT16, ComHandleId=295, ComSystemTemplateSystemSignalRef=DET_RANGE_009_Rx
          DET_MTD_011_Rx_oRDR_FUSION_DET_009_012_oPCAN_RADAR_e87cf034_Rx: ComBitPosition=271, ComBitSize=1, ComSignalType=BOOLEAN, ComHandleId=289, ComSystemTemplateSystemSignalRef=DET_MTD_011_Rx
          DET_AZIMUTH_ERR_011_Rx_oRDR_FUSION_DET_009_012_oPCAN_RADAR_6817fb07_Rx: ComBitPosition=329, ComBitSize=7, ComSignalType=UINT8, ComHandleId=246, ComSystemTemplateSystemSignalRef=DET_AZIMUTH_ERR_011_Rx
          DET_ELEVATION_010_Rx_oRDR_FUSION_DET_009_012_oPCAN_RADAR_37051a4e_Rx: ComBitPosition=184, ComBitSize=8, ComSignalType=UINT8, ComHandleId=265, ComSystemTemplateSystemSignalRef=DET_ELEVATION_010_Rx
          DET_SNR_012_Rx_oRDR_FUSION_DET_009_012_oPCAN_RADAR_4a60d626_Rx: ComBitPosition=456, ComBitSize=8, ComSignalType=UINT8, ComHandleId=318, ComSystemTemplateSystemSignalRef=DET_SNR_012_Rx
          DET_RANGE_VELOCITY_ERR_012_Rx_oRDR_FUSION_DET_009_012_oPCAN_RADAR_17954516_Rx: ComBitPosition=400, ComBitSize=8, ComSignalType=UINT8, ComHandleId=310, ComSystemTemplateSystemSignalRef=DET_RANGE_VELOCITY_ERR_012_Rx
          DET_BELOW_RAIN_THOLD_010_Rx_oRDR_FUSION_DET_009_012_oPCAN_RADAR_a3803777_Rx: ComBitPosition=151, ComBitSize=1, ComSignalType=BOOLEAN, ComHandleId=249, ComSystemTemplateSystemSignalRef=DET_BELOW_RAIN_THOLD_010_Rx
          DET_ELEVATION_009_Rx_oRDR_FUSION_DET_009_012_oPCAN_RADAR_0a259957_Rx: ComBitPosition=72, ComBitSize=8, ComSignalType=UINT8, ComHandleId=264, ComSystemTemplateSystemSignalRef=DET_ELEVATION_009_Rx
          DET_IDM_009_Rx_oRDR_FUSION_DET_009_012_oPCAN_RADAR_c79bd71a_Rx: ComBitPosition=63, ComBitSize=1, ComSignalType=BOOLEAN, ComHandleId=280, ComSystemTemplateSystemSignalRef=DET_IDM_009_Rx
          DET_HVC_FLAG_012_Rx_oRDR_FUSION_DET_009_012_oPCAN_RADAR_4a828f84_Rx: ComBitPosition=422, ComBitSize=1, ComSignalType=BOOLEAN, ComHandleId=279, ComSystemTemplateSystemSignalRef=DET_HVC_FLAG_012_Rx
          DET_HVC_FLAG_009_Rx_oRDR_FUSION_DET_009_012_oPCAN_RADAR_f25a2e52_Rx: ComBitPosition=86, ComBitSize=1, ComSignalType=BOOLEAN, ComHandleId=276, ComSystemTemplateSystemSignalRef=DET_HVC_FLAG_009_Rx
          DET_PROB_1STAZHYPO_012_Rx_oRDR_FUSION_DET_009_012_oPCAN_RADAR_08b95e3d_Rx: ComBitPosition=439, ComBitSize=1, ComSignalType=BOOLEAN, ComHandleId=294, ComSystemTemplateSystemSignalRef=DET_PROB_1STAZHYPO_012_Rx
          DET_ELEVATION_012_Rx_oRDR_FUSION_DET_009_012_oPCAN_RADAR_b2fd3881_Rx: ComBitPosition=408, ComBitSize=8, ComSignalType=UINT8, ComHandleId=267, ComSystemTemplateSystemSignalRef=DET_ELEVATION_012_Rx
          DET_ELEVATION_ERR_012_Rx_oRDR_FUSION_DET_009_012_oPCAN_RADAR_60441a5e_Rx: ComBitPosition=416, ComBitSize=6, ComSignalType=UINT8, ComHandleId=271, ComSystemTemplateSystemSignalRef=DET_ELEVATION_ERR_012_Rx
          DET_MH_CYCLE_COUNTER_009_012_Rx_oRDR_FUSION_DET_009_012_oPCAN_RADAR_9e8faf91_Rx: ComBitPosition=16, ComBitSize=8, ComSignalType=UINT8, ComHandleId=285, ComSystemTemplateSystemSignalRef=DET_MH_CYCLE_COUNTER_009_012_Rx
          DET_RANGE_VELOCITY_010_Rx_oRDR_FUSION_DET_009_012_oPCAN_RADAR_0b09171b_Rx: ComBitPosition=160, ComBitSize=15, ComSignalType=UINT16, ComHandleId=304, ComSystemTemplateSystemSignalRef=DET_RANGE_VELOCITY_010_Rx
          DET_CONFD_ELEVATION_011_Rx_oRDR_FUSION_DET_009_012_oPCAN_RADAR_921267f0_Rx: ComBitPosition=325, ComBitSize=2, ComSignalType=UINT8, ComHandleId=262, ComSystemTemplateSystemSignalRef=DET_CONFD_ELEVATION_011_Rx
          DET_CONFD_AZIMUTH_011_Rx_oRDR_FUSION_DET_009_012_oPCAN_RADAR_9833e477_Rx: ComBitPosition=342, ComBitSize=2, ComSignalType=UINT8, ComHandleId=258, ComSystemTemplateSystemSignalRef=DET_CONFD_AZIMUTH_011_Rx
          DET_RCS_011_Rx_oRDR_FUSION_DET_009_012_oPCAN_RADAR_69861747_Rx: ComBitPosition=352, ComBitSize=8, ComSignalType=UINT8, ComHandleId=313, ComSystemTemplateSystemSignalRef=DET_RCS_011_Rx
          DET_CONFD_AZIMUTH_012_Rx_oRDR_FUSION_DET_009_012_oPCAN_RADAR_b28f54ff_Rx: ComBitPosition=454, ComBitSize=2, ComSignalType=UINT8, ComHandleId=259, ComSystemTemplateSystemSignalRef=DET_CONFD_AZIMUTH_012_Rx
          DET_EXISTENCE_PROB_011_Rx_oRDR_FUSION_DET_009_012_oPCAN_RADAR_bde0d243_Rx: ComBitPosition=336, ComBitSize=6, ComSignalType=UINT8, ComHandleId=274, ComSystemTemplateSystemSignalRef=DET_EXISTENCE_PROB_011_Rx
          DET_SUPER_RES_TARGET_010_Rx_oRDR_FUSION_DET_009_012_oPCAN_RADAR_0463d5e9_Rx: ComBitPosition=199, ComBitSize=1, ComSignalType=BOOLEAN, ComHandleId=320, ComSystemTemplateSystemSignalRef=DET_SUPER_RES_TARGET_010_Rx
          DET_RANGE_ERR_009_Rx_oRDR_FUSION_DET_009_012_oPCAN_RADAR_bb2e9b1c_Rx: ComBitPosition=40, ComBitSize=7, ComSignalType=UINT8, ComHandleId=299, ComSystemTemplateSystemSignalRef=DET_RANGE_ERR_009_Rx
          DET_CONFD_AZIMUTH_010_Rx_oRDR_FUSION_DET_009_012_oPCAN_RADAR_37777630_Rx: ComBitPosition=230, ComBitSize=2, ComSignalType=UINT8, ComHandleId=257, ComSystemTemplateSystemSignalRef=DET_CONFD_AZIMUTH_010_Rx
          DET_RANGE_VELOCITY_012_Rx_oRDR_FUSION_DET_009_012_oPCAN_RADAR_8ef135d4_Rx: ComBitPosition=384, ComBitSize=15, ComSignalType=UINT16, ComHandleId=306, ComSystemTemplateSystemSignalRef=DET_RANGE_VELOCITY_012_Rx
          DET_ELEVATION_011_Rx_oRDR_FUSION_DET_009_012_oPCAN_RADAR_98418809_Rx: ComBitPosition=296, ComBitSize=8, ComSignalType=UINT8, ComHandleId=266, ComSystemTemplateSystemSignalRef=DET_ELEVATION_011_Rx
          DET_SNR_009_Rx_oRDR_FUSION_DET_009_012_oPCAN_RADAR_f2b877f0_Rx: ComBitPosition=120, ComBitSize=8, ComSignalType=UINT8, ComHandleId=315, ComSystemTemplateSystemSignalRef=DET_SNR_009_Rx
          DET_AZIMUTH_ERR_012_Rx_oRDR_FUSION_DET_009_012_oPCAN_RADAR_42ab4b8f_Rx: ComBitPosition=441, ComBitSize=7, ComSignalType=UINT8, ComHandleId=247, ComSystemTemplateSystemSignalRef=DET_AZIMUTH_ERR_012_Rx
          DET_PROB_1STAZHYPO_010_Rx_oRDR_FUSION_DET_009_012_oPCAN_RADAR_8d417cf2_Rx: ComBitPosition=215, ComBitSize=1, ComSignalType=BOOLEAN, ComHandleId=292, ComSystemTemplateSystemSignalRef=DET_PROB_1STAZHYPO_010_Rx
          DET_RANGE_011_Rx_oRDR_FUSION_DET_009_012_oPCAN_RADAR_79b806a2_Rx: ComBitPosition=248, ComBitSize=15, ComSignalType=UINT16, ComHandleId=297, ComSystemTemplateSystemSignalRef=DET_RANGE_011_Rx
          DET_SNR_010_Rx_oRDR_FUSION_DET_009_012_oPCAN_RADAR_cf98f4e9_Rx: ComBitPosition=232, ComBitSize=8, ComSignalType=UINT8, ComHandleId=316, ComSystemTemplateSystemSignalRef=DET_SNR_010_Rx
          DET_PROB_1STAZHYPO_009_Rx_oRDR_FUSION_DET_009_012_oPCAN_RADAR_b061ffeb_Rx: ComBitPosition=103, ComBitSize=1, ComSignalType=BOOLEAN, ComHandleId=291, ComSystemTemplateSystemSignalRef=DET_PROB_1STAZHYPO_009_Rx
          DET_CONFD_ELEVATION_010_Rx_oRDR_FUSION_DET_009_012_oPCAN_RADAR_3d56f5b7_Rx: ComBitPosition=213, ComBitSize=2, ComSignalType=UINT8, ComHandleId=261, ComSystemTemplateSystemSignalRef=DET_CONFD_ELEVATION_010_Rx
          DET_RANGE_010_Rx_oRDR_FUSION_DET_009_012_oPCAN_RADAR_d6fc94e5_Rx: ComBitPosition=136, ComBitSize=15, ComSignalType=UINT16, ComHandleId=296, ComSystemTemplateSystemSignalRef=DET_RANGE_010_Rx
          DET_SUPER_RES_TARGET_011_Rx_oRDR_FUSION_DET_009_012_oPCAN_RADAR_ab2747ae_Rx: ComBitPosition=311, ComBitSize=1, ComSignalType=BOOLEAN, ComHandleId=321, ComSystemTemplateSystemSignalRef=DET_SUPER_RES_TARGET_011_Rx
          DET_BELOW_RAIN_THOLD_009_Rx_oRDR_FUSION_DET_009_012_oPCAN_RADAR_9ea0b46e_Rx: ComBitPosition=39, ComBitSize=1, ComSignalType=BOOLEAN, ComHandleId=248, ComSystemTemplateSystemSignalRef=DET_BELOW_RAIN_THOLD_009_Rx
          DET_AZIMUTH_010_Rx_oRDR_FUSION_DET_009_012_oPCAN_RADAR_c53ac8c2_Rx: ComBitPosition=200, ComBitSize=13, ComSignalType=UINT16, ComHandleId=241, ComSystemTemplateSystemSignalRef=DET_AZIMUTH_010_Rx
          DET_BI_STATIC_FLAG_010_Rx_oRDR_FUSION_DET_009_012_oPCAN_RADAR_d41e9c64_Rx: ComBitPosition=216, ComBitSize=1, ComSignalType=BOOLEAN, ComHandleId=253, ComSystemTemplateSystemSignalRef=DET_BI_STATIC_FLAG_010_Rx
          DET_BELOW_RAIN_THOLD_011_Rx_oRDR_FUSION_DET_009_012_oPCAN_RADAR_0cc4a530_Rx: ComBitPosition=263, ComBitSize=1, ComSignalType=BOOLEAN, ComHandleId=250, ComSystemTemplateSystemSignalRef=DET_BELOW_RAIN_THOLD_011_Rx
          DET_AZIMUTH_009_Rx_oRDR_FUSION_DET_009_012_oPCAN_RADAR_f81a4bdb_Rx: ComBitPosition=88, ComBitSize=13, ComSignalType=UINT16, ComHandleId=240, ComSystemTemplateSystemSignalRef=DET_AZIMUTH_009_Rx
          DET_PROB_1STAZHYPO_011_Rx_oRDR_FUSION_DET_009_012_oPCAN_RADAR_2205eeb5_Rx: ComBitPosition=327, ComBitSize=1, ComSignalType=BOOLEAN, ComHandleId=293, ComSystemTemplateSystemSignalRef=DET_PROB_1STAZHYPO_011_Rx
          DET_RANGE_VELOCITY_ERR_011_Rx_oRDR_FUSION_DET_009_012_oPCAN_RADAR_3d29f59e_Rx: ComBitPosition=288, ComBitSize=8, ComSignalType=UINT8, ComHandleId=309, ComSystemTemplateSystemSignalRef=DET_RANGE_VELOCITY_ERR_011_Rx
          DET_IDM_012_Rx_oRDR_FUSION_DET_009_012_oPCAN_RADAR_7f4376cc_Rx: ComBitPosition=399, ComBitSize=1, ComSignalType=BOOLEAN, ComHandleId=283, ComSystemTemplateSystemSignalRef=DET_IDM_012_Rx
          DET_RANGE_ERR_011_Rx_oRDR_FUSION_DET_009_012_oPCAN_RADAR_294a8a42_Rx: ComBitPosition=264, ComBitSize=7, ComSignalType=UINT8, ComHandleId=301, ComSystemTemplateSystemSignalRef=DET_RANGE_ERR_011_Rx
          DET_EXISTENCE_PROB_012_Rx_oRDR_FUSION_DET_009_012_oPCAN_RADAR_975c62cb_Rx: ComBitPosition=448, ComBitSize=6, ComSignalType=UINT8, ComHandleId=275, ComSystemTemplateSystemSignalRef=DET_EXISTENCE_PROB_012_Rx
          DET_RANGE_VELOCITY_011_Rx_oRDR_FUSION_DET_009_012_oPCAN_RADAR_a44d855c_Rx: ComBitPosition=272, ComBitSize=15, ComSignalType=UINT16, ComHandleId=305, ComSystemTemplateSystemSignalRef=DET_RANGE_VELOCITY_011_Rx
          DET_MTD_012_Rx_oRDR_FUSION_DET_009_012_oPCAN_RADAR_c2c040bc_Rx: ComBitPosition=383, ComBitSize=1, ComSignalType=BOOLEAN, ComHandleId=290, ComSystemTemplateSystemSignalRef=DET_MTD_012_Rx
          DET_ELEVATION_ERR_009_Rx_oRDR_FUSION_DET_009_012_oPCAN_RADAR_d89cbb88_Rx: ComBitPosition=80, ComBitSize=6, ComSignalType=UINT8, ComHandleId=268, ComSystemTemplateSystemSignalRef=DET_ELEVATION_ERR_009_Rx
          DET_EXISTENCE_PROB_009_Rx_oRDR_FUSION_DET_009_012_oPCAN_RADAR_2f84c31d_Rx: ComBitPosition=112, ComBitSize=6, ComSignalType=UINT8, ComHandleId=272, ComSystemTemplateSystemSignalRef=DET_EXISTENCE_PROB_009_Rx
          DET_HVC_FLAG_011_Rx_oRDR_FUSION_DET_009_012_oPCAN_RADAR_603e3f0c_Rx: ComBitPosition=310, ComBitSize=1, ComSignalType=BOOLEAN, ComHandleId=278, ComSystemTemplateSystemSignalRef=DET_HVC_FLAG_011_Rx
          DET_RANGE_VELOCITY_ERR_010_Rx_oRDR_FUSION_DET_009_012_oPCAN_RADAR_926d67d9_Rx: ComBitPosition=176, ComBitSize=8, ComSignalType=UINT8, ComHandleId=308, ComSystemTemplateSystemSignalRef=DET_RANGE_VELOCITY_ERR_010_Rx
      SG_Fusion_Detections_057_060_oRDR_FUSION_DET_057_060_oPCAN_RADAR_91e0d8b1_Rx (ComSignalGroup):
        ComTimeout = 0
        ComTransferProperty = PENDING
        ComSignalGroupAccess = ACCESS_NEEDED_BY_SWC_OR_COM
        ComHandleId = 22
        ComSignalGroupArrayAccess = true
        ComSystemTemplateSignalGroupRef = SG_Fusion_Detections_057_060
        83 x ComGroupSignal, all with ComSignalEndianness=LITTLE_ENDIAN, ComSignalInitValue=0, ComSignalAccess=ACCESS_NEEDED_BY_SWC_OR_COM:
          DET_ELEVATION_059_Rx_oRDR_FUSION_DET_057_060_oPCAN_RADAR_54c1c10a_Rx: ComBitPosition=296, ComBitSize=8, ComSignalType=UINT8, ComHandleId=1262, ComSystemTemplateSystemSignalRef=DET_ELEVATION_059_Rx
          DET_AZIMUTH_059_Rx_oRDR_FUSION_DET_057_060_oPCAN_RADAR_a6fe1386_Rx: ComBitPosition=312, ComBitSize=13, ComSignalType=UINT16, ComHandleId=1238, ComSystemTemplateSystemSignalRef=DET_AZIMUTH_059_Rx
          DET_ELEVATION_ERR_057_Rx_oRDR_FUSION_DET_057_060_oPCAN_RADAR_a972033a_Rx: ComBitPosition=80, ComBitSize=6, ComSignalType=UINT8, ComHandleId=1264, ComSystemTemplateSystemSignalRef=DET_ELEVATION_ERR_057_Rx
          DET_RANGE_VELOCITY_058_Rx_oRDR_FUSION_DET_057_060_oPCAN_RADAR_c7895e18_Rx: ComBitPosition=160, ComBitSize=15, ComSignalType=UINT16, ComHandleId=1300, ComSystemTemplateSystemSignalRef=DET_RANGE_VELOCITY_058_Rx
          DET_AZIMUTH_ERR_060_Rx_oRDR_FUSION_DET_057_060_oPCAN_RADAR_92e9161e_Rx: ComBitPosition=441, ComBitSize=7, ComSignalType=UINT8, ComHandleId=1243, ComSystemTemplateSystemSignalRef=DET_AZIMUTH_ERR_060_Rx
          DET_CONFD_ELEVATION_058_Rx_oRDR_FUSION_DET_057_060_oPCAN_RADAR_f1d6bcb4_Rx: ComBitPosition=213, ComBitSize=2, ComSignalType=UINT8, ComHandleId=1257, ComSystemTemplateSystemSignalRef=DET_CONFD_ELEVATION_058_Rx
          DET_PROB_1STAZHYPO_059_Rx_oRDR_FUSION_DET_057_060_oPCAN_RADAR_ee85a7b6_Rx: ComBitPosition=327, ComBitSize=1, ComSignalType=BOOLEAN, ComHandleId=1289, ComSystemTemplateSystemSignalRef=DET_PROB_1STAZHYPO_059_Rx
          DET_SUPER_RES_TARGET_059_Rx_oRDR_FUSION_DET_057_060_oPCAN_RADAR_67a70ead_Rx: ComBitPosition=311, ComBitSize=1, ComSignalType=BOOLEAN, ComHandleId=1317, ComSystemTemplateSystemSignalRef=DET_SUPER_RES_TARGET_059_Rx
          DET_RANGE_060_Rx_oRDR_FUSION_DET_057_060_oPCAN_RADAR_8346ebbb_Rx: ComBitPosition=360, ComBitSize=15, ComSignalType=UINT16, ComHandleId=1294, ComSystemTemplateSystemSignalRef=DET_RANGE_060_Rx
          DET_AZIMUTH_058_Rx_oRDR_FUSION_DET_057_060_oPCAN_RADAR_09ba81c1_Rx: ComBitPosition=200, ComBitSize=13, ComSignalType=UINT16, ComHandleId=1237, ComSystemTemplateSystemSignalRef=DET_AZIMUTH_058_Rx
          DET_RANGE_VELOCITY_ERR_058_Rx_oRDR_FUSION_DET_057_060_oPCAN_RADAR_5eed2eda_Rx: ComBitPosition=176, ComBitSize=8, ComSignalType=UINT8, ComHandleId=1304, ComSystemTemplateSystemSignalRef=DET_RANGE_VELOCITY_ERR_058_Rx
          DET_EXISTENCE_PROB_059_Rx_oRDR_FUSION_DET_057_060_oPCAN_RADAR_71609b40_Rx: ComBitPosition=336, ComBitSize=6, ComSignalType=UINT8, ComHandleId=1270, ComSystemTemplateSystemSignalRef=DET_EXISTENCE_PROB_059_Rx
          DET_CONFD_ELEVATION_060_Rx_oRDR_FUSION_DET_057_060_oPCAN_RADAR_68ec8ae9_Rx: ComBitPosition=437, ComBitSize=2, ComSignalType=UINT8, ComHandleId=1259, ComSystemTemplateSystemSignalRef=DET_CONFD_ELEVATION_060_Rx
          DET_SNR_059_Rx_oRDR_FUSION_DET_057_060_oPCAN_RADAR_ac5c2fad_Rx: ComBitPosition=344, ComBitSize=8, ComSignalType=UINT8, ComHandleId=1313, ComSystemTemplateSystemSignalRef=DET_SNR_059_Rx
          DET_SUPER_RES_TARGET_060_Rx_oRDR_FUSION_DET_057_060_oPCAN_RADAR_51d9aab7_Rx: ComBitPosition=423, ComBitSize=1, ComSignalType=BOOLEAN, ComHandleId=1318, ComSystemTemplateSystemSignalRef=DET_SUPER_RES_TARGET_060_Rx
          DET_MTD_057_Rx_oRDR_FUSION_DET_057_060_oPCAN_RADAR_0bf659d8_Rx: ComBitPosition=47, ComBitSize=1, ComSignalType=BOOLEAN, ComHandleId=1283, ComSystemTemplateSystemSignalRef=DET_MTD_057_Rx
          DET_PROB_1STAZHYPO_058_Rx_oRDR_FUSION_DET_057_060_oPCAN_RADAR_41c135f1_Rx: ComBitPosition=215, ComBitSize=1, ComSignalType=BOOLEAN, ComHandleId=1288, ComSystemTemplateSystemSignalRef=DET_PROB_1STAZHYPO_058_Rx
          DET_BELOW_RAIN_THOLD_058_Rx_oRDR_FUSION_DET_057_060_oPCAN_RADAR_6f007e74_Rx: ComBitPosition=151, ComBitSize=1, ComSignalType=BOOLEAN, ComHandleId=1245, ComSystemTemplateSystemSignalRef=DET_BELOW_RAIN_THOLD_058_Rx
          DET_BELOW_RAIN_THOLD_057_Rx_oRDR_FUSION_DET_057_060_oPCAN_RADAR_ef4e0cdc_Rx: ComBitPosition=39, ComBitSize=1, ComSignalType=BOOLEAN, ComHandleId=1244, ComSystemTemplateSystemSignalRef=DET_BELOW_RAIN_THOLD_057_Rx
          DET_SNR_058_Rx_oRDR_FUSION_DET_057_060_oPCAN_RADAR_0318bdea_Rx: ComBitPosition=232, ComBitSize=8, ComSignalType=UINT8, ComHandleId=1312, ComSystemTemplateSystemSignalRef=DET_SNR_058_Rx
          DET_CONFD_AZIMUTH_059_Rx_oRDR_FUSION_DET_057_060_oPCAN_RADAR_54b3ad74_Rx: ComBitPosition=342, ComBitSize=2, ComSignalType=UINT8, ComHandleId=1254, ComSystemTemplateSystemSignalRef=DET_CONFD_AZIMUTH_059_Rx
          DET_RCS_058_Rx_oRDR_FUSION_DET_057_060_oPCAN_RADAR_0a42cc03_Rx: ComBitPosition=240, ComBitSize=8, ComSignalType=UINT8, ComHandleId=1308, ComSystemTemplateSystemSignalRef=DET_RCS_058_Rx
          DET_RANGE_VELOCITY_057_Rx_oRDR_FUSION_DET_057_060_oPCAN_RADAR_47c72cb0_Rx: ComBitPosition=48, ComBitSize=15, ComSignalType=UINT16, ComHandleId=1299, ComSystemTemplateSystemSignalRef=DET_RANGE_VELOCITY_057_Rx
          DET_RANGE_057_Rx_oRDR_FUSION_DET_057_060_oPCAN_RADAR_9a32af4e_Rx: ComBitPosition=24, ComBitSize=15, ComSignalType=UINT16, ComHandleId=1291, ComSystemTemplateSystemSignalRef=DET_RANGE_057_Rx
          DET_MTD_060_Rx_oRDR_FUSION_DET_057_060_oPCAN_RADAR_12821d2d_Rx: ComBitPosition=383, ComBitSize=1, ComSignalType=BOOLEAN, ComHandleId=1286, ComSystemTemplateSystemSignalRef=DET_MTD_060_Rx
          DET_RANGE_VELOCITY_ERR_057_Rx_oRDR_FUSION_DET_057_060_oPCAN_RADAR_dea35c72_Rx: ComBitPosition=64, ComBitSize=8, ComSignalType=UINT8, ComHandleId=1303, ComSystemTemplateSystemSignalRef=DET_RANGE_VELOCITY_ERR_057_Rx
          DET_BELOW_RAIN_THOLD_059_Rx_oRDR_FUSION_DET_057_060_oPCAN_RADAR_c044ec33_Rx: ComBitPosition=263, ComBitSize=1, ComSignalType=BOOLEAN, ComHandleId=1246, ComSystemTemplateSystemSignalRef=DET_BELOW_RAIN_THOLD_059_Rx
          DET_BI_STATIC_FLAG_057_Rx_oRDR_FUSION_DET_057_060_oPCAN_RADAR_98d0a7cf_Rx: ComBitPosition=104, ComBitSize=1, ComSignalType=BOOLEAN, ComHandleId=1248, ComSystemTemplateSystemSignalRef=DET_BI_STATIC_FLAG_057_Rx
          DET_MTD_059_Rx_oRDR_FUSION_DET_057_060_oPCAN_RADAR_24fcb937_Rx: ComBitPosition=271, ComBitSize=1, ComSignalType=BOOLEAN, ComHandleId=1285, ComSystemTemplateSystemSignalRef=DET_MTD_059_Rx
          DET_HVC_FLAG_060_Rx_oRDR_FUSION_DET_057_060_oPCAN_RADAR_9ac0d215_Rx: ComBitPosition=422, ComBitSize=1, ComSignalType=BOOLEAN, ComHandleId=1275, ComSystemTemplateSystemSignalRef=DET_HVC_FLAG_060_Rx
          DET_BI_STATIC_FLAG_060_Rx_oRDR_FUSION_DET_057_060_oPCAN_RADAR_81a4e33a_Rx: ComBitPosition=440, ComBitSize=1, ComSignalType=BOOLEAN, ComHandleId=1251, ComSystemTemplateSystemSignalRef=DET_BI_STATIC_FLAG_060_Rx
          DET_RANGE_ERR_057_Rx_oRDR_FUSION_DET_057_060_oPCAN_RADAR_cac023ae_Rx: ComBitPosition=40, ComBitSize=7, ComSignalType=UINT8, ComHandleId=1295, ComSystemTemplateSystemSignalRef=DET_RANGE_ERR_057_Rx
          DET_RCS_057_Rx_oRDR_FUSION_DET_057_060_oPCAN_RADAR_8a0cbeab_Rx: ComBitPosition=128, ComBitSize=8, ComSignalType=UINT8, ComHandleId=1307, ComSystemTemplateSystemSignalRef=DET_RCS_057_Rx
          DET_SNR_060_Rx_oRDR_FUSION_DET_057_060_oPCAN_RADAR_9a228bb7_Rx: ComBitPosition=456, ComBitSize=8, ComSignalType=UINT8, ComHandleId=1314, ComSystemTemplateSystemSignalRef=DET_SNR_060_Rx
          DET_RANGE_ERR_059_Rx_oRDR_FUSION_DET_057_060_oPCAN_RADAR_e5cac341_Rx: ComBitPosition=264, ComBitSize=7, ComSignalType=UINT8, ComHandleId=1297, ComSystemTemplateSystemSignalRef=DET_RANGE_ERR_059_Rx
          DET_AZIMUTH_060_Rx_oRDR_FUSION_DET_057_060_oPCAN_RADAR_9080b79c_Rx: ComBitPosition=424, ComBitSize=13, ComSignalType=UINT16, ComHandleId=1239, ComSystemTemplateSystemSignalRef=DET_AZIMUTH_060_Rx
          DET_RANGE_ERR_060_Rx_oRDR_FUSION_DET_057_060_oPCAN_RADAR_d3b4675b_Rx: ComBitPosition=376, ComBitSize=7, ComSignalType=UINT8, ComHandleId=1298, ComSystemTemplateSystemSignalRef=DET_RANGE_ERR_060_Rx
          DET_EXISTENCE_PROB_060_Rx_oRDR_FUSION_DET_057_060_oPCAN_RADAR_471e3f5a_Rx: ComBitPosition=448, ComBitSize=6, ComSignalType=UINT8, ComHandleId=1271, ComSystemTemplateSystemSignalRef=DET_EXISTENCE_PROB_060_Rx
          DET_RANGE_VELOCITY_059_Rx_oRDR_FUSION_DET_057_060_oPCAN_RADAR_68cdcc5f_Rx: ComBitPosition=272, ComBitSize=15, ComSignalType=UINT16, ComHandleId=1301, ComSystemTemplateSystemSignalRef=DET_RANGE_VELOCITY_059_Rx
          DET_MH_CRC16_057_060_Rx_oRDR_FUSION_DET_057_060_oPCAN_RADAR_758b1867_Rx: ComBitPosition=0, ComBitSize=16, ComSignalType=UINT16, ComHandleId=1280, ComSystemTemplateSystemSignalRef=DET_MH_CRC16_057_060_Rx
          DET_RANGE_059_Rx_oRDR_FUSION_DET_057_060_oPCAN_RADAR_b5384fa1_Rx: ComBitPosition=248, ComBitSize=15, ComSignalType=UINT16, ComHandleId=1293, ComSystemTemplateSystemSignalRef=DET_RANGE_059_Rx
          DET_RCS_059_Rx_oRDR_FUSION_DET_057_060_oPCAN_RADAR_a5065e44_Rx: ComBitPosition=352, ComBitSize=8, ComSignalType=UINT8, ComHandleId=1309, ComSystemTemplateSystemSignalRef=DET_RCS_059_Rx
          DET_RCS_060_Rx_oRDR_FUSION_DET_057_060_oPCAN_RADAR_9378fa5e_Rx: ComBitPosition=464, ComBitSize=8, ComSignalType=UINT8, ComHandleId=1310, ComSystemTemplateSystemSignalRef=DET_RCS_060_Rx
          DET_ELEVATION_058_Rx_oRDR_FUSION_DET_057_060_oPCAN_RADAR_fb85534d_Rx: ComBitPosition=184, ComBitSize=8, ComSignalType=UINT8, ComHandleId=1261, ComSystemTemplateSystemSignalRef=DET_ELEVATION_058_Rx
          DET_ELEVATION_ERR_059_Rx_oRDR_FUSION_DET_057_060_oPCAN_RADAR_8678e3d5_Rx: ComBitPosition=304, ComBitSize=6, ComSignalType=UINT8, ComHandleId=1266, ComSystemTemplateSystemSignalRef=DET_ELEVATION_ERR_059_Rx
          DET_ELEVATION_ERR_060_Rx_oRDR_FUSION_DET_057_060_oPCAN_RADAR_b00647cf_Rx: ComBitPosition=416, ComBitSize=6, ComSignalType=UINT8, ComHandleId=1267, ComSystemTemplateSystemSignalRef=DET_ELEVATION_ERR_060_Rx
          DET_PROB_1STAZHYPO_060_Rx_oRDR_FUSION_DET_057_060_oPCAN_RADAR_d8fb03ac_Rx: ComBitPosition=439, ComBitSize=1, ComSignalType=BOOLEAN, ComHandleId=1290, ComSystemTemplateSystemSignalRef=DET_PROB_1STAZHYPO_060_Rx
          DET_IDM_057_Rx_oRDR_FUSION_DET_057_060_oPCAN_RADAR_b6756fa8_Rx: ComBitPosition=63, ComBitSize=1, ComSignalType=BOOLEAN, ComHandleId=1276, ComSystemTemplateSystemSignalRef=DET_IDM_057_Rx
          DET_MH_CYCLE_COUNTER_057_060_Rx_oRDR_FUSION_DET_057_060_oPCAN_RADAR_785025a2_Rx: ComBitPosition=16, ComBitSize=8, ComSignalType=UINT8, ComHandleId=1281, ComSystemTemplateSystemSignalRef=DET_MH_CYCLE_COUNTER_057_060_Rx
          DET_RANGE_VELOCITY_ERR_059_Rx_oRDR_FUSION_DET_057_060_oPCAN_RADAR_f1a9bc9d_Rx: ComBitPosition=288, ComBitSize=8, ComSignalType=UINT8, ComHandleId=1305, ComSystemTemplateSystemSignalRef=DET_RANGE_VELOCITY_ERR_059_Rx
          DET_CONFD_AZIMUTH_057_Rx_oRDR_FUSION_DET_057_060_oPCAN_RADAR_7bb94d9b_Rx: ComBitPosition=118, ComBitSize=2, ComSignalType=UINT8, ComHandleId=1252, ComSystemTemplateSystemSignalRef=DET_CONFD_AZIMUTH_057_Rx
          DET_MTD_058_Rx_oRDR_FUSION_DET_057_060_oPCAN_RADAR_8bb82b70_Rx: ComBitPosition=159, ComBitSize=1, ComSignalType=BOOLEAN, ComHandleId=1284, ComSystemTemplateSystemSignalRef=DET_MTD_058_Rx
          DET_ELEVATION_057_Rx_oRDR_FUSION_DET_057_060_oPCAN_RADAR_7bcb21e5_Rx: ComBitPosition=72, ComBitSize=8, ComSignalType=UINT8, ComHandleId=1260, ComSystemTemplateSystemSignalRef=DET_ELEVATION_057_Rx
          DET_SNR_057_Rx_oRDR_FUSION_DET_057_060_oPCAN_RADAR_8356cf42_Rx: ComBitPosition=120, ComBitSize=8, ComSignalType=UINT8, ComHandleId=1311, ComSystemTemplateSystemSignalRef=DET_SNR_057_Rx
          DET_EXISTENCE_PROB_058_Rx_oRDR_FUSION_DET_057_060_oPCAN_RADAR_de240907_Rx: ComBitPosition=224, ComBitSize=6, ComSignalType=UINT8, ComHandleId=1269, ComSystemTemplateSystemSignalRef=DET_EXISTENCE_PROB_058_Rx
          DET_RANGE_VELOCITY_060_Rx_oRDR_FUSION_DET_057_060_oPCAN_RADAR_5eb36845_Rx: ComBitPosition=384, ComBitSize=15, ComSignalType=UINT16, ComHandleId=1302, ComSystemTemplateSystemSignalRef=DET_RANGE_VELOCITY_060_Rx
          DET_ELEVATION_ERR_058_Rx_oRDR_FUSION_DET_057_060_oPCAN_RADAR_293c7192_Rx: ComBitPosition=192, ComBitSize=6, ComSignalType=UINT8, ComHandleId=1265, ComSystemTemplateSystemSignalRef=DET_ELEVATION_ERR_058_Rx
          DET_AZIMUTH_ERR_057_Rx_oRDR_FUSION_DET_057_060_oPCAN_RADAR_8b9d52eb_Rx: ComBitPosition=105, ComBitSize=7, ComSignalType=UINT8, ComHandleId=1240, ComSystemTemplateSystemSignalRef=DET_AZIMUTH_ERR_057_Rx
          DET_BI_STATIC_FLAG_059_Rx_oRDR_FUSION_DET_057_060_oPCAN_RADAR_b7da4720_Rx: ComBitPosition=328, ComBitSize=1, ComSignalType=BOOLEAN, ComHandleId=1250, ComSystemTemplateSystemSignalRef=DET_BI_STATIC_FLAG_059_Rx
          DET_CONFD_AZIMUTH_058_Rx_oRDR_FUSION_DET_057_060_oPCAN_RADAR_fbf73f33_Rx: ComBitPosition=230, ComBitSize=2, ComSignalType=UINT8, ComHandleId=1253, ComSystemTemplateSystemSignalRef=DET_CONFD_AZIMUTH_058_Rx
          DET_HVC_FLAG_057_Rx_oRDR_FUSION_DET_057_060_oPCAN_RADAR_83b496e0_Rx: ComBitPosition=86, ComBitSize=1, ComSignalType=BOOLEAN, ComHandleId=1272, ComSystemTemplateSystemSignalRef=DET_HVC_FLAG_057_Rx
          DET_AZIMUTH_ERR_059_Rx_oRDR_FUSION_DET_057_060_oPCAN_RADAR_a497b204_Rx: ComBitPosition=329, ComBitSize=7, ComSignalType=UINT8, ComHandleId=1242, ComSystemTemplateSystemSignalRef=DET_AZIMUTH_ERR_059_Rx
          DET_RANGE_VELOCITY_ERR_060_Rx_oRDR_FUSION_DET_057_060_oPCAN_RADAR_c7d71887_Rx: ComBitPosition=400, ComBitSize=8, ComSignalType=UINT8, ComHandleId=1306, ComSystemTemplateSystemSignalRef=DET_RANGE_VELOCITY_ERR_060_Rx
          DET_PROB_1STAZHYPO_057_Rx_oRDR_FUSION_DET_057_060_oPCAN_RADAR_c18f4759_Rx: ComBitPosition=103, ComBitSize=1, ComSignalType=BOOLEAN, ComHandleId=1287, ComSystemTemplateSystemSignalRef=DET_PROB_1STAZHYPO_057_Rx
          DET_SUPER_RES_TARGET_057_Rx_oRDR_FUSION_DET_057_060_oPCAN_RADAR_48adee42_Rx: ComBitPosition=87, ComBitSize=1, ComSignalType=BOOLEAN, ComHandleId=1315, ComSystemTemplateSystemSignalRef=DET_SUPER_RES_TARGET_057_Rx
          DET_MH_SCAN_INDEX_4LSB_057_060_Rx_oRDR_FUSION_DET_057_060_oPCAN_RADAR_1ce0ea99_Rx: ComBitPosition=476, ComBitSize=4, ComSignalType=UINT8, ComHandleId=1282, ComSystemTemplateSystemSignalRef=DET_MH_SCAN_INDEX_4LSB_057_060_Rx
          DET_CONFD_AZIMUTH_060_Rx_oRDR_FUSION_DET_057_060_oPCAN_RADAR_62cd096e_Rx: ComBitPosition=454, ComBitSize=2, ComSignalType=UINT8, ComHandleId=1255, ComSystemTemplateSystemSignalRef=DET_CONFD_AZIMUTH_060_Rx
          DET_HVC_FLAG_059_Rx_oRDR_FUSION_DET_057_060_oPCAN_RADAR_acbe760f_Rx: ComBitPosition=310, ComBitSize=1, ComSignalType=BOOLEAN, ComHandleId=1274, ComSystemTemplateSystemSignalRef=DET_HVC_FLAG_059_Rx
          DET_RANGE_ERR_058_Rx_oRDR_FUSION_DET_057_060_oPCAN_RADAR_4a8e5106_Rx: ComBitPosition=152, ComBitSize=7, ComSignalType=UINT8, ComHandleId=1296, ComSystemTemplateSystemSignalRef=DET_RANGE_ERR_058_Rx
          DET_ELEVATION_060_Rx_oRDR_FUSION_DET_057_060_oPCAN_RADAR_62bf6510_Rx: ComBitPosition=408, ComBitSize=8, ComSignalType=UINT8, ComHandleId=1263, ComSystemTemplateSystemSignalRef=DET_ELEVATION_060_Rx
          DET_BI_STATIC_FLAG_058_Rx_oRDR_FUSION_DET_057_060_oPCAN_RADAR_189ed567_Rx: ComBitPosition=216, ComBitSize=1, ComSignalType=BOOLEAN, ComHandleId=1249, ComSystemTemplateSystemSignalRef=DET_BI_STATIC_FLAG_058_Rx
          DET_HVC_FLAG_058_Rx_oRDR_FUSION_DET_057_060_oPCAN_RADAR_03fae448_Rx: ComBitPosition=198, ComBitSize=1, ComSignalType=BOOLEAN, ComHandleId=1273, ComSystemTemplateSystemSignalRef=DET_HVC_FLAG_058_Rx
          DET_RANGE_058_Rx_oRDR_FUSION_DET_057_060_oPCAN_RADAR_1a7cdde6_Rx: ComBitPosition=136, ComBitSize=15, ComSignalType=UINT16, ComHandleId=1292, ComSystemTemplateSystemSignalRef=DET_RANGE_058_Rx
          DET_CONFD_ELEVATION_057_Rx_oRDR_FUSION_DET_057_060_oPCAN_RADAR_7198ce1c_Rx: ComBitPosition=101, ComBitSize=2, ComSignalType=UINT8, ComHandleId=1256, ComSystemTemplateSystemSignalRef=DET_CONFD_ELEVATION_057_Rx
          DET_SUPER_RES_TARGET_058_Rx_oRDR_FUSION_DET_057_060_oPCAN_RADAR_c8e39cea_Rx: ComBitPosition=199, ComBitSize=1, ComSignalType=BOOLEAN, ComHandleId=1316, ComSystemTemplateSystemSignalRef=DET_SUPER_RES_TARGET_058_Rx
          DET_EXISTENCE_PROB_057_Rx_oRDR_FUSION_DET_057_060_oPCAN_RADAR_5e6a7baf_Rx: ComBitPosition=112, ComBitSize=6, ComSignalType=UINT8, ComHandleId=1268, ComSystemTemplateSystemSignalRef=DET_EXISTENCE_PROB_057_Rx
          DET_IDM_060_Rx_oRDR_FUSION_DET_057_060_oPCAN_RADAR_af012b5d_Rx: ComBitPosition=399, ComBitSize=1, ComSignalType=BOOLEAN, ComHandleId=1279, ComSystemTemplateSystemSignalRef=DET_IDM_060_Rx
          DET_AZIMUTH_ERR_058_Rx_oRDR_FUSION_DET_057_060_oPCAN_RADAR_0bd32043_Rx: ComBitPosition=217, ComBitSize=7, ComSignalType=UINT8, ComHandleId=1241, ComSystemTemplateSystemSignalRef=DET_AZIMUTH_ERR_058_Rx
          DET_BELOW_RAIN_THOLD_060_Rx_oRDR_FUSION_DET_057_060_oPCAN_RADAR_f63a4829_Rx: ComBitPosition=375, ComBitSize=1, ComSignalType=BOOLEAN, ComHandleId=1247, ComSystemTemplateSystemSignalRef=DET_BELOW_RAIN_THOLD_060_Rx
          DET_AZIMUTH_057_Rx_oRDR_FUSION_DET_057_060_oPCAN_RADAR_89f4f369_Rx: ComBitPosition=88, ComBitSize=13, ComSignalType=UINT16, ComHandleId=1236, ComSystemTemplateSystemSignalRef=DET_AZIMUTH_057_Rx
          DET_IDM_059_Rx_oRDR_FUSION_DET_057_060_oPCAN_RADAR_997f8f47_Rx: ComBitPosition=287, ComBitSize=1, ComSignalType=BOOLEAN, ComHandleId=1278, ComSystemTemplateSystemSignalRef=DET_IDM_059_Rx
          DET_CONFD_ELEVATION_059_Rx_oRDR_FUSION_DET_057_060_oPCAN_RADAR_5e922ef3_Rx: ComBitPosition=325, ComBitSize=2, ComSignalType=UINT8, ComHandleId=1258, ComSystemTemplateSystemSignalRef=DET_CONFD_ELEVATION_059_Rx
          DET_IDM_058_Rx_oRDR_FUSION_DET_057_060_oPCAN_RADAR_363b1d00_Rx: ComBitPosition=175, ComBitSize=1, ComSignalType=BOOLEAN, ComHandleId=1277, ComSystemTemplateSystemSignalRef=DET_IDM_058_Rx
      RDR_FUSION_DET_077_080_oPCAN_RADAR_66646479_Rx (ComIPdu):
        ComIPduDirection = RECEIVE
        ComIPduType = NORMAL
        ComIPduCancellationSupport = false
        ComIPduHandleId = 41
        ComIPduSignalProcessing = DEFERRED
        ComIPduChannelRef = CN_PCAN_RADAR_458ff0f1
        ComIPduGroupRef = RDR01_oPCAN_RADAR_Rx_e0e717e1 if post-build-variant-condition{matching-criterion=RDR_POS, value=0}
        ComIPduSignalGroupRef = SG_Fusion_Detections_077_080_oRDR_FUSION_DET_077_080_oPCAN_RADAR_ea1c1377_Rx
        ComPduIdRef = RDR_FUSION_DET_077_080_oPCAN_RADAR_66646479_Rx
        ComIPduMainFunctionRef = ComMainFunctionRx
        ComIPduGroupRef = RDR02_oPCAN_RADAR_Rx_c92fa313 if post-build-variant-condition{matching-criterion=RDR_POS, value=1}
        ComIPduGroupRef = RDR03_oPCAN_RADAR_Rx_67473282 if post-build-variant-condition{matching-criterion=RDR_POS, value=2}
        ComIPduGroupRef = RDR04_oPCAN_RADAR_Rx_9abecaf7 if post-build-variant-condition{matching-criterion=RDR_POS, value=3}
        ComIPduGroupRef = RDR05_oPCAN_RADAR_Rx_34d65b66 if post-build-variant-condition{matching-criterion=RDR_POS, value=4}
        ComIPduGroupRef = RDR06_oPCAN_RADAR_Rx_1d1eef94 if post-build-variant-condition{matching-criterion=RDR_POS, value=5}
        ComIPduGroupRef = RDR07_oPCAN_RADAR_Rx_b3767e05 if post-build-variant-condition{matching-criterion=RDR_POS, value=6}
        ComIPduGroupRef = RDR08_oPCAN_RADAR_Rx_3d9c193f if post-build-variant-condition{matching-criterion=RDR_POS, value=7}
      RDR_FUSION_DET_101_104_oPCAN_RADAR_bd87f605_Rx (ComIPdu):
        ComIPduDirection = RECEIVE
        ComIPduType = NORMAL
        ComIPduCancellationSupport = false
        ComIPduHandleId = 47
        ComIPduSignalProcessing = DEFERRED
        ComIPduChannelRef = CN_PCAN_RADAR_458ff0f1
        ComIPduGroupRef = RDR01_oPCAN_RADAR_Rx_e0e717e1 if post-build-variant-condition{matching-criterion=RDR_POS, value=0}
        ComIPduSignalGroupRef = SG_Fusion_Detections_101_104_oRDR_FUSION_DET_101_104_oPCAN_RADAR_2dfb2b7d_Rx
        ComPduIdRef = RDR_FUSION_DET_101_104_oPCAN_RADAR_bd87f605_Rx
        ComIPduMainFunctionRef = ComMainFunctionRx
        ComIPduGroupRef = RDR02_oPCAN_RADAR_Rx_c92fa313 if post-build-variant-condition{matching-criterion=RDR_POS, value=1}
        ComIPduGroupRef = RDR03_oPCAN_RADAR_Rx_67473282 if post-build-variant-condition{matching-criterion=RDR_POS, value=2}
        ComIPduGroupRef = RDR04_oPCAN_RADAR_Rx_9abecaf7 if post-build-variant-condition{matching-criterion=RDR_POS, value=3}
        ComIPduGroupRef = RDR05_oPCAN_RADAR_Rx_34d65b66 if post-build-variant-condition{matching-criterion=RDR_POS, value=4}
        ComIPduGroupRef = RDR06_oPCAN_RADAR_Rx_1d1eef94 if post-build-variant-condition{matching-criterion=RDR_POS, value=5}
        ComIPduGroupRef = RDR07_oPCAN_RADAR_Rx_b3767e05 if post-build-variant-condition{matching-criterion=RDR_POS, value=6}
        ComIPduGroupRef = RDR08_oPCAN_RADAR_Rx_3d9c193f if post-build-variant-condition{matching-criterion=RDR_POS, value=7}
      SG_Fusion_Detections_105_108_oRDR_FUSION_DET_105_108_oPCAN_RADAR_6000008e_Rx (ComSignalGroup):
        ComTimeout = 0
        ComTransferProperty = PENDING
        ComSignalGroupAccess = ACCESS_NEEDED_BY_SWC_OR_COM
        ComHandleId = 34
        ComSignalGroupArrayAccess = true
        ComSystemTemplateSignalGroupRef = SG_Fusion_Detections_105_108
        83 x ComGroupSignal, all with ComSignalEndianness=LITTLE_ENDIAN, ComSignalInitValue=0, ComSignalAccess=ACCESS_NEEDED_BY_SWC_OR_COM:
          DET_ELEVATION_ERR_105_Rx_oRDR_FUSION_DET_105_108_oPCAN_RADAR_8f0649f7_Rx: ComBitPosition=80, ComBitSize=6, ComSignalType=UINT8, ComHandleId=2260, ComSystemTemplateSystemSignalRef=DET_ELEVATION_ERR_105_Rx
          DET_PROB_1STAZHYPO_108_Rx_oRDR_FUSION_DET_105_108_oPCAN_RADAR_e24d5df3_Rx: ComBitPosition=439, ComBitSize=1, ComSignalType=BOOLEAN, ComHandleId=2286, ComSystemTemplateSystemSignalRef=DET_PROB_1STAZHYPO_108_Rx
          DET_AZIMUTH_ERR_107_Rx_oRDR_FUSION_DET_105_108_oPCAN_RADAR_28113ae9_Rx: ComBitPosition=329, ComBitSize=7, ComSignalType=UINT8, ComHandleId=2238, ComSystemTemplateSystemSignalRef=DET_AZIMUTH_ERR_107_Rx
          DET_RCS_107_Rx_oRDR_FUSION_DET_105_108_oPCAN_RADAR_2980d6a9_Rx: ComBitPosition=352, ComBitSize=8, ComSignalType=UINT8, ComHandleId=2305, ComSystemTemplateSystemSignalRef=DET_RCS_107_Rx
          DET_AZIMUTH_108_Rx_oRDR_FUSION_DET_105_108_oPCAN_RADAR_aa36e9c3_Rx: ComBitPosition=424, ComBitSize=13, ComSignalType=UINT16, ComHandleId=2235, ComSystemTemplateSystemSignalRef=DET_AZIMUTH_108_Rx
          DET_EXISTENCE_PROB_105_Rx_oRDR_FUSION_DET_105_108_oPCAN_RADAR_781e3162_Rx: ComBitPosition=112, ComBitSize=6, ComSignalType=UINT8, ComHandleId=2264, ComSystemTemplateSystemSignalRef=DET_EXISTENCE_PROB_105_Rx
          DET_RCS_106_Rx_oRDR_FUSION_DET_105_108_oPCAN_RADAR_86c444ee_Rx: ComBitPosition=240, ComBitSize=8, ComSignalType=UINT8, ComHandleId=2304, ComSystemTemplateSystemSignalRef=DET_RCS_106_Rx
          DET_EXISTENCE_PROB_108_Rx_oRDR_FUSION_DET_105_108_oPCAN_RADAR_7da86105_Rx: ComBitPosition=448, ComBitSize=6, ComSignalType=UINT8, ComHandleId=2267, ComSystemTemplateSystemSignalRef=DET_EXISTENCE_PROB_108_Rx
          DET_AZIMUTH_ERR_106_Rx_oRDR_FUSION_DET_105_108_oPCAN_RADAR_8755a8ae_Rx: ComBitPosition=217, ComBitSize=7, ComSignalType=UINT8, ComHandleId=2237, ComSystemTemplateSystemSignalRef=DET_AZIMUTH_ERR_106_Rx
          DET_BELOW_RAIN_THOLD_107_Rx_oRDR_FUSION_DET_105_108_oPCAN_RADAR_4cc264de_Rx: ComBitPosition=263, ComBitSize=1, ComSignalType=BOOLEAN, ComHandleId=2242, ComSystemTemplateSystemSignalRef=DET_BELOW_RAIN_THOLD_107_Rx
          DET_RANGE_ERR_105_Rx_oRDR_FUSION_DET_105_108_oPCAN_RADAR_ecb46963_Rx: ComBitPosition=40, ComBitSize=7, ComSignalType=UINT8, ComHandleId=2291, ComSystemTemplateSystemSignalRef=DET_RANGE_ERR_105_Rx
          DET_MTD_106_Rx_oRDR_FUSION_DET_105_108_oPCAN_RADAR_073ea39d_Rx: ComBitPosition=159, ComBitSize=1, ComSignalType=BOOLEAN, ComHandleId=2280, ComSystemTemplateSystemSignalRef=DET_MTD_106_Rx
          DET_RANGE_VELOCITY_ERR_105_Rx_oRDR_FUSION_DET_105_108_oPCAN_RADAR_f8d716bf_Rx: ComBitPosition=64, ComBitSize=8, ComSignalType=UINT8, ComHandleId=2299, ComSystemTemplateSystemSignalRef=DET_RANGE_VELOCITY_ERR_105_Rx
          DET_MTD_107_Rx_oRDR_FUSION_DET_105_108_oPCAN_RADAR_a87a31da_Rx: ComBitPosition=271, ComBitSize=1, ComSignalType=BOOLEAN, ComHandleId=2281, ComSystemTemplateSystemSignalRef=DET_MTD_107_Rx
          DET_SNR_107_Rx_oRDR_FUSION_DET_105_108_oPCAN_RADAR_20daa740_Rx: ComBitPosition=344, ComBitSize=8, ComSignalType=UINT8, ComHandleId=2309, ComSystemTemplateSystemSignalRef=DET_SNR_107_Rx
          DET_SNR_105_Rx_oRDR_FUSION_DET_105_108_oPCAN_RADAR_a522858f_Rx: ComBitPosition=120, ComBitSize=8, ComSignalType=UINT8, ComHandleId=2307, ComSystemTemplateSystemSignalRef=DET_SNR_105_Rx
          DET_ELEVATION_ERR_107_Rx_oRDR_FUSION_DET_105_108_oPCAN_RADAR_0afe6b38_Rx: ComBitPosition=304, ComBitSize=6, ComSignalType=UINT8, ComHandleId=2262, ComSystemTemplateSystemSignalRef=DET_ELEVATION_ERR_107_Rx
          DET_ELEVATION_ERR_108_Rx_oRDR_FUSION_DET_105_108_oPCAN_RADAR_8ab01990_Rx: ComBitPosition=416, ComBitSize=6, ComSignalType=UINT8, ComHandleId=2263, ComSystemTemplateSystemSignalRef=DET_ELEVATION_ERR_108_Rx
          DET_HVC_FLAG_108_Rx_oRDR_FUSION_DET_105_108_oPCAN_RADAR_a0768c4a_Rx: ComBitPosition=422, ComBitSize=1, ComSignalType=BOOLEAN, ComHandleId=2271, ComSystemTemplateSystemSignalRef=DET_HVC_FLAG_108_Rx
          DET_MH_CRC16_105_108_Rx_oRDR_FUSION_DET_105_108_oPCAN_RADAR_24f92ed0_Rx: ComBitPosition=0, ComBitSize=16, ComSignalType=UINT16, ComHandleId=2276, ComSystemTemplateSystemSignalRef=DET_MH_CRC16_105_108_Rx
          DET_MH_SCAN_INDEX_4LSB_105_108_Rx_oRDR_FUSION_DET_105_108_oPCAN_RADAR_4d92dc2e_Rx: ComBitPosition=476, ComBitSize=4, ComSignalType=UINT8, ComHandleId=2278, ComSystemTemplateSystemSignalRef=DET_MH_SCAN_INDEX_4LSB_105_108_Rx
          DET_RANGE_ERR_107_Rx_oRDR_FUSION_DET_105_108_oPCAN_RADAR_694c4bac_Rx: ComBitPosition=264, ComBitSize=7, ComSignalType=UINT8, ComHandleId=2293, ComSystemTemplateSystemSignalRef=DET_RANGE_ERR_107_Rx
          DET_AZIMUTH_106_Rx_oRDR_FUSION_DET_105_108_oPCAN_RADAR_853c092c_Rx: ComBitPosition=200, ComBitSize=13, ComSignalType=UINT16, ComHandleId=2233, ComSystemTemplateSystemSignalRef=DET_AZIMUTH_106_Rx
          DET_AZIMUTH_107_Rx_oRDR_FUSION_DET_105_108_oPCAN_RADAR_2a789b6b_Rx: ComBitPosition=312, ComBitSize=13, ComSignalType=UINT16, ComHandleId=2234, ComSystemTemplateSystemSignalRef=DET_AZIMUTH_107_Rx
          DET_HVC_FLAG_106_Rx_oRDR_FUSION_DET_105_108_oPCAN_RADAR_8f7c6ca5_Rx: ComBitPosition=198, ComBitSize=1, ComSignalType=BOOLEAN, ComHandleId=2269, ComSystemTemplateSystemSignalRef=DET_HVC_FLAG_106_Rx
          DET_RANGE_VELOCITY_ERR_108_Rx_oRDR_FUSION_DET_105_108_oPCAN_RADAR_fd6146d8_Rx: ComBitPosition=400, ComBitSize=8, ComSignalType=UINT8, ComHandleId=2302, ComSystemTemplateSystemSignalRef=DET_RANGE_VELOCITY_ERR_108_Rx
          DET_RANGE_ERR_106_Rx_oRDR_FUSION_DET_105_108_oPCAN_RADAR_c608d9eb_Rx: ComBitPosition=152, ComBitSize=7, ComSignalType=UINT8, ComHandleId=2292, ComSystemTemplateSystemSignalRef=DET_RANGE_ERR_106_Rx
          DET_PROB_1STAZHYPO_107_Rx_oRDR_FUSION_DET_105_108_oPCAN_RADAR_62032f5b_Rx: ComBitPosition=327, ComBitSize=1, ComSignalType=BOOLEAN, ComHandleId=2285, ComSystemTemplateSystemSignalRef=DET_PROB_1STAZHYPO_107_Rx
          DET_BI_STATIC_FLAG_107_Rx_oRDR_FUSION_DET_105_108_oPCAN_RADAR_3b5ccfcd_Rx: ComBitPosition=328, ComBitSize=1, ComSignalType=BOOLEAN, ComHandleId=2246, ComSystemTemplateSystemSignalRef=DET_BI_STATIC_FLAG_107_Rx
          DET_CONFD_AZIMUTH_105_Rx_oRDR_FUSION_DET_105_108_oPCAN_RADAR_5dcd0756_Rx: ComBitPosition=118, ComBitSize=2, ComSignalType=UINT8, ComHandleId=2248, ComSystemTemplateSystemSignalRef=DET_CONFD_AZIMUTH_105_Rx
          DET_RCS_105_Rx_oRDR_FUSION_DET_105_108_oPCAN_RADAR_ac78f466_Rx: ComBitPosition=128, ComBitSize=8, ComSignalType=UINT8, ComHandleId=2303, ComSystemTemplateSystemSignalRef=DET_RCS_105_Rx
          DET_MTD_105_Rx_oRDR_FUSION_DET_105_108_oPCAN_RADAR_2d821315_Rx: ComBitPosition=47, ComBitSize=1, ComSignalType=BOOLEAN, ComHandleId=2279, ComSystemTemplateSystemSignalRef=DET_MTD_105_Rx
          DET_PROB_1STAZHYPO_105_Rx_oRDR_FUSION_DET_105_108_oPCAN_RADAR_e7fb0d94_Rx: ComBitPosition=103, ComBitSize=1, ComSignalType=BOOLEAN, ComHandleId=2283, ComSystemTemplateSystemSignalRef=DET_PROB_1STAZHYPO_105_Rx
          DET_ELEVATION_106_Rx_oRDR_FUSION_DET_105_108_oPCAN_RADAR_7703dba0_Rx: ComBitPosition=184, ComBitSize=8, ComSignalType=UINT8, ComHandleId=2257, ComSystemTemplateSystemSignalRef=DET_ELEVATION_106_Rx
          DET_BELOW_RAIN_THOLD_108_Rx_oRDR_FUSION_DET_105_108_oPCAN_RADAR_cc8c1676_Rx: ComBitPosition=375, ComBitSize=1, ComSignalType=BOOLEAN, ComHandleId=2243, ComSystemTemplateSystemSignalRef=DET_BELOW_RAIN_THOLD_108_Rx
          DET_ELEVATION_105_Rx_oRDR_FUSION_DET_105_108_oPCAN_RADAR_5dbf6b28_Rx: ComBitPosition=72, ComBitSize=8, ComSignalType=UINT8, ComHandleId=2256, ComSystemTemplateSystemSignalRef=DET_ELEVATION_105_Rx
          DET_BI_STATIC_FLAG_105_Rx_oRDR_FUSION_DET_105_108_oPCAN_RADAR_bea4ed02_Rx: ComBitPosition=104, ComBitSize=1, ComSignalType=BOOLEAN, ComHandleId=2244, ComSystemTemplateSystemSignalRef=DET_BI_STATIC_FLAG_105_Rx
          DET_IDM_107_Rx_oRDR_FUSION_DET_105_108_oPCAN_RADAR_15f907aa_Rx: ComBitPosition=287, ComBitSize=1, ComSignalType=BOOLEAN, ComHandleId=2274, ComSystemTemplateSystemSignalRef=DET_IDM_107_Rx
          DET_AZIMUTH_ERR_108_Rx_oRDR_FUSION_DET_105_108_oPCAN_RADAR_a85f4841_Rx: ComBitPosition=441, ComBitSize=7, ComSignalType=UINT8, ComHandleId=2239, ComSystemTemplateSystemSignalRef=DET_AZIMUTH_ERR_108_Rx
          DET_SUPER_RES_TARGET_107_Rx_oRDR_FUSION_DET_105_108_oPCAN_RADAR_eb218640_Rx: ComBitPosition=311, ComBitSize=1, ComSignalType=BOOLEAN, ComHandleId=2313, ComSystemTemplateSystemSignalRef=DET_SUPER_RES_TARGET_107_Rx
          DET_RANGE_107_Rx_oRDR_FUSION_DET_105_108_oPCAN_RADAR_39bec74c_Rx: ComBitPosition=248, ComBitSize=15, ComSignalType=UINT16, ComHandleId=2289, ComSystemTemplateSystemSignalRef=DET_RANGE_107_Rx
          DET_ELEVATION_107_Rx_oRDR_FUSION_DET_105_108_oPCAN_RADAR_d84749e7_Rx: ComBitPosition=296, ComBitSize=8, ComSignalType=UINT8, ComHandleId=2258, ComSystemTemplateSystemSignalRef=DET_ELEVATION_107_Rx
          DET_EXISTENCE_PROB_106_Rx_oRDR_FUSION_DET_105_108_oPCAN_RADAR_52a281ea_Rx: ComBitPosition=224, ComBitSize=6, ComSignalType=UINT8, ComHandleId=2265, ComSystemTemplateSystemSignalRef=DET_EXISTENCE_PROB_106_Rx
          DET_CONFD_ELEVATION_107_Rx_oRDR_FUSION_DET_105_108_oPCAN_RADAR_d214a61e_Rx: ComBitPosition=325, ComBitSize=2, ComSignalType=UINT8, ComHandleId=2254, ComSystemTemplateSystemSignalRef=DET_CONFD_ELEVATION_107_Rx
          DET_SUPER_RES_TARGET_105_Rx_oRDR_FUSION_DET_105_108_oPCAN_RADAR_6ed9a48f_Rx: ComBitPosition=87, ComBitSize=1, ComSignalType=BOOLEAN, ComHandleId=2311, ComSystemTemplateSystemSignalRef=DET_SUPER_RES_TARGET_105_Rx
          DET_RANGE_VELOCITY_ERR_107_Rx_oRDR_FUSION_DET_105_108_oPCAN_RADAR_7d2f3470_Rx: ComBitPosition=288, ComBitSize=8, ComSignalType=UINT8, ComHandleId=2301, ComSystemTemplateSystemSignalRef=DET_RANGE_VELOCITY_ERR_107_Rx
          DET_SUPER_RES_TARGET_108_Rx_oRDR_FUSION_DET_105_108_oPCAN_RADAR_6b6ff4e8_Rx: ComBitPosition=423, ComBitSize=1, ComSignalType=BOOLEAN, ComHandleId=2314, ComSystemTemplateSystemSignalRef=DET_SUPER_RES_TARGET_108_Rx
          DET_CONFD_AZIMUTH_106_Rx_oRDR_FUSION_DET_105_108_oPCAN_RADAR_7771b7de_Rx: ComBitPosition=230, ComBitSize=2, ComSignalType=UINT8, ComHandleId=2249, ComSystemTemplateSystemSignalRef=DET_CONFD_AZIMUTH_106_Rx
          DET_RANGE_108_Rx_oRDR_FUSION_DET_105_108_oPCAN_RADAR_b9f0b5e4_Rx: ComBitPosition=360, ComBitSize=15, ComSignalType=UINT16, ComHandleId=2290, ComSystemTemplateSystemSignalRef=DET_RANGE_108_Rx
          DET_RANGE_106_Rx_oRDR_FUSION_DET_105_108_oPCAN_RADAR_96fa550b_Rx: ComBitPosition=136, ComBitSize=15, ComSignalType=UINT16, ComHandleId=2288, ComSystemTemplateSystemSignalRef=DET_RANGE_106_Rx
          DET_AZIMUTH_105_Rx_oRDR_FUSION_DET_105_108_oPCAN_RADAR_af80b9a4_Rx: ComBitPosition=88, ComBitSize=13, ComSignalType=UINT16, ComHandleId=2232, ComSystemTemplateSystemSignalRef=DET_AZIMUTH_105_Rx
          DET_CONFD_ELEVATION_105_Rx_oRDR_FUSION_DET_105_108_oPCAN_RADAR_57ec84d1_Rx: ComBitPosition=101, ComBitSize=2, ComSignalType=UINT8, ComHandleId=2252, ComSystemTemplateSystemSignalRef=DET_CONFD_ELEVATION_105_Rx
          DET_CONFD_AZIMUTH_107_Rx_oRDR_FUSION_DET_105_108_oPCAN_RADAR_d8352599_Rx: ComBitPosition=342, ComBitSize=2, ComSignalType=UINT8, ComHandleId=2250, ComSystemTemplateSystemSignalRef=DET_CONFD_AZIMUTH_107_Rx
          DET_RANGE_VELOCITY_107_Rx_oRDR_FUSION_DET_105_108_oPCAN_RADAR_e44b44b2_Rx: ComBitPosition=272, ComBitSize=15, ComSignalType=UINT16, ComHandleId=2297, ComSystemTemplateSystemSignalRef=DET_RANGE_VELOCITY_107_Rx
          DET_EXISTENCE_PROB_107_Rx_oRDR_FUSION_DET_105_108_oPCAN_RADAR_fde613ad_Rx: ComBitPosition=336, ComBitSize=6, ComSignalType=UINT8, ComHandleId=2266, ComSystemTemplateSystemSignalRef=DET_EXISTENCE_PROB_107_Rx
          DET_HVC_FLAG_107_Rx_oRDR_FUSION_DET_105_108_oPCAN_RADAR_2038fee2_Rx: ComBitPosition=310, ComBitSize=1, ComSignalType=BOOLEAN, ComHandleId=2270, ComSystemTemplateSystemSignalRef=DET_HVC_FLAG_107_Rx
          DET_RANGE_ERR_108_Rx_oRDR_FUSION_DET_105_108_oPCAN_RADAR_e9023904_Rx: ComBitPosition=376, ComBitSize=7, ComSignalType=UINT8, ComHandleId=2294, ComSystemTemplateSystemSignalRef=DET_RANGE_ERR_108_Rx
          DET_SUPER_RES_TARGET_106_Rx_oRDR_FUSION_DET_105_108_oPCAN_RADAR_44651407_Rx: ComBitPosition=199, ComBitSize=1, ComSignalType=BOOLEAN, ComHandleId=2312, ComSystemTemplateSystemSignalRef=DET_SUPER_RES_TARGET_106_Rx
          DET_ELEVATION_108_Rx_oRDR_FUSION_DET_105_108_oPCAN_RADAR_58093b4f_Rx: ComBitPosition=408, ComBitSize=8, ComSignalType=UINT8, ComHandleId=2259, ComSystemTemplateSystemSignalRef=DET_ELEVATION_108_Rx
          DET_SNR_106_Rx_oRDR_FUSION_DET_105_108_oPCAN_RADAR_8f9e3507_Rx: ComBitPosition=232, ComBitSize=8, ComSignalType=UINT8, ComHandleId=2308, ComSystemTemplateSystemSignalRef=DET_SNR_106_Rx
          DET_HVC_FLAG_105_Rx_oRDR_FUSION_DET_105_108_oPCAN_RADAR_a5c0dc2d_Rx: ComBitPosition=86, ComBitSize=1, ComSignalType=BOOLEAN, ComHandleId=2268, ComSystemTemplateSystemSignalRef=DET_HVC_FLAG_105_Rx
          DET_MH_CYCLE_COUNTER_105_108_Rx_oRDR_FUSION_DET_105_108_oPCAN_RADAR_29221315_Rx: ComBitPosition=16, ComBitSize=8, ComSignalType=UINT8, ComHandleId=2277, ComSystemTemplateSystemSignalRef=DET_MH_CYCLE_COUNTER_105_108_Rx
          DET_MTD_108_Rx_oRDR_FUSION_DET_105_108_oPCAN_RADAR_28344372_Rx: ComBitPosition=383, ComBitSize=1, ComSignalType=BOOLEAN, ComHandleId=2282, ComSystemTemplateSystemSignalRef=DET_MTD_108_Rx
          DET_BELOW_RAIN_THOLD_106_Rx_oRDR_FUSION_DET_105_108_oPCAN_RADAR_e386f699_Rx: ComBitPosition=151, ComBitSize=1, ComSignalType=BOOLEAN, ComHandleId=2241, ComSystemTemplateSystemSignalRef=DET_BELOW_RAIN_THOLD_106_Rx
          DET_RANGE_105_Rx_oRDR_FUSION_DET_105_108_oPCAN_RADAR_bc46e583_Rx: ComBitPosition=24, ComBitSize=15, ComSignalType=UINT16, ComHandleId=2287, ComSystemTemplateSystemSignalRef=DET_RANGE_105_Rx
          DET_BELOW_RAIN_THOLD_105_Rx_oRDR_FUSION_DET_105_108_oPCAN_RADAR_c93a4611_Rx: ComBitPosition=39, ComBitSize=1, ComSignalType=BOOLEAN, ComHandleId=2240, ComSystemTemplateSystemSignalRef=DET_BELOW_RAIN_THOLD_105_Rx
          DET_BI_STATIC_FLAG_108_Rx_oRDR_FUSION_DET_105_108_oPCAN_RADAR_bb12bd65_Rx: ComBitPosition=440, ComBitSize=1, ComSignalType=BOOLEAN, ComHandleId=2247, ComSystemTemplateSystemSignalRef=DET_BI_STATIC_FLAG_108_Rx
          DET_RANGE_VELOCITY_105_Rx_oRDR_FUSION_DET_105_108_oPCAN_RADAR_61b3667d_Rx: ComBitPosition=48, ComBitSize=15, ComSignalType=UINT16, ComHandleId=2295, ComSystemTemplateSystemSignalRef=DET_RANGE_VELOCITY_105_Rx
          DET_IDM_108_Rx_oRDR_FUSION_DET_105_108_oPCAN_RADAR_95b77502_Rx: ComBitPosition=399, ComBitSize=1, ComSignalType=BOOLEAN, ComHandleId=2275, ComSystemTemplateSystemSignalRef=DET_IDM_108_Rx
          DET_IDM_105_Rx_oRDR_FUSION_DET_105_108_oPCAN_RADAR_90012565_Rx: ComBitPosition=63, ComBitSize=1, ComSignalType=BOOLEAN, ComHandleId=2272, ComSystemTemplateSystemSignalRef=DET_IDM_105_Rx
          DET_AZIMUTH_ERR_105_Rx_oRDR_FUSION_DET_105_108_oPCAN_RADAR_ade91826_Rx: ComBitPosition=105, ComBitSize=7, ComSignalType=UINT8, ComHandleId=2236, ComSystemTemplateSystemSignalRef=DET_AZIMUTH_ERR_105_Rx
          DET_ELEVATION_ERR_106_Rx_oRDR_FUSION_DET_105_108_oPCAN_RADAR_a5baf97f_Rx: ComBitPosition=192, ComBitSize=6, ComSignalType=UINT8, ComHandleId=2261, ComSystemTemplateSystemSignalRef=DET_ELEVATION_ERR_106_Rx
          DET_CONFD_AZIMUTH_108_Rx_oRDR_FUSION_DET_105_108_oPCAN_RADAR_587b5731_Rx: ComBitPosition=454, ComBitSize=2, ComSignalType=UINT8, ComHandleId=2251, ComSystemTemplateSystemSignalRef=DET_CONFD_AZIMUTH_108_Rx
          DET_RCS_108_Rx_oRDR_FUSION_DET_105_108_oPCAN_RADAR_a9cea401_Rx: ComBitPosition=464, ComBitSize=8, ComSignalType=UINT8, ComHandleId=2306, ComSystemTemplateSystemSignalRef=DET_RCS_108_Rx
          DET_IDM_106_Rx_oRDR_FUSION_DET_105_108_oPCAN_RADAR_babd95ed_Rx: ComBitPosition=175, ComBitSize=1, ComSignalType=BOOLEAN, ComHandleId=2273, ComSystemTemplateSystemSignalRef=DET_IDM_106_Rx
          DET_SNR_108_Rx_oRDR_FUSION_DET_105_108_oPCAN_RADAR_a094d5e8_Rx: ComBitPosition=456, ComBitSize=8, ComSignalType=UINT8, ComHandleId=2310, ComSystemTemplateSystemSignalRef=DET_SNR_108_Rx
          DET_RANGE_VELOCITY_ERR_106_Rx_oRDR_FUSION_DET_105_108_oPCAN_RADAR_d26ba637_Rx: ComBitPosition=176, ComBitSize=8, ComSignalType=UINT8, ComHandleId=2300, ComSystemTemplateSystemSignalRef=DET_RANGE_VELOCITY_ERR_106_Rx
          DET_CONFD_ELEVATION_108_Rx_oRDR_FUSION_DET_105_108_oPCAN_RADAR_525ad4b6_Rx: ComBitPosition=437, ComBitSize=2, ComSignalType=UINT8, ComHandleId=2255, ComSystemTemplateSystemSignalRef=DET_CONFD_ELEVATION_108_Rx
          DET_RANGE_VELOCITY_106_Rx_oRDR_FUSION_DET_105_108_oPCAN_RADAR_4b0fd6f5_Rx: ComBitPosition=160, ComBitSize=15, ComSignalType=UINT16, ComHandleId=2296, ComSystemTemplateSystemSignalRef=DET_RANGE_VELOCITY_106_Rx
          DET_RANGE_VELOCITY_108_Rx_oRDR_FUSION_DET_105_108_oPCAN_RADAR_6405361a_Rx: ComBitPosition=384, ComBitSize=15, ComSignalType=UINT16, ComHandleId=2298, ComSystemTemplateSystemSignalRef=DET_RANGE_VELOCITY_108_Rx
          DET_PROB_1STAZHYPO_106_Rx_oRDR_FUSION_DET_105_108_oPCAN_RADAR_cd47bd1c_Rx: ComBitPosition=215, ComBitSize=1, ComSignalType=BOOLEAN, ComHandleId=2284, ComSystemTemplateSystemSignalRef=DET_PROB_1STAZHYPO_106_Rx
          DET_BI_STATIC_FLAG_106_Rx_oRDR_FUSION_DET_105_108_oPCAN_RADAR_94185d8a_Rx: ComBitPosition=216, ComBitSize=1, ComSignalType=BOOLEAN, ComHandleId=2245, ComSystemTemplateSystemSignalRef=DET_BI_STATIC_FLAG_106_Rx
          DET_CONFD_ELEVATION_106_Rx_oRDR_FUSION_DET_105_108_oPCAN_RADAR_7d503459_Rx: ComBitPosition=213, ComBitSize=2, ComSignalType=UINT8, ComHandleId=2253, ComSystemTemplateSystemSignalRef=DET_CONFD_ELEVATION_106_Rx
      SG_Fusion_Detections_005_008_oRDR_FUSION_DET_005_008_oPCAN_RADAR_0783a66c_Rx (ComSignalGroup):
        ComTimeout = 0
        ComTransferProperty = PENDING
        ComSignalGroupAccess = ACCESS_NEEDED_BY_SWC_OR_COM
        ComHandleId = 9
        ComSignalGroupArrayAccess = true
        ComSystemTemplateSignalGroupRef = SG_Fusion_Detections_005_008
        83 x ComGroupSignal, all with ComSignalEndianness=LITTLE_ENDIAN, ComSignalInitValue=0, ComSignalAccess=ACCESS_NEEDED_BY_SWC_OR_COM:
          DET_SUPER_RES_TARGET_006_Rx_oRDR_FUSION_DET_005_008_oPCAN_RADAR_8b45cb59_Rx: ComBitPosition=199, ComBitSize=1, ComSignalType=BOOLEAN, ComHandleId=237, ComSystemTemplateSystemSignalRef=DET_SUPER_RES_TARGET_006_Rx
          DET_CONFD_ELEVATION_007_Rx_oRDR_FUSION_DET_005_008_oPCAN_RADAR_1d347940_Rx: ComBitPosition=325, ComBitSize=2, ComSignalType=UINT8, ComHandleId=179, ComSystemTemplateSystemSignalRef=DET_CONFD_ELEVATION_007_Rx
          DET_MTD_008_Rx_oRDR_FUSION_DET_005_008_oPCAN_RADAR_e7149c2c_Rx: ComBitPosition=383, ComBitSize=1, ComSignalType=BOOLEAN, ComHandleId=207, ComSystemTemplateSystemSignalRef=DET_MTD_008_Rx
          DET_CONFD_ELEVATION_006_Rx_oRDR_FUSION_DET_005_008_oPCAN_RADAR_b270eb07_Rx: ComBitPosition=213, ComBitSize=2, ComSignalType=UINT8, ComHandleId=178, ComSystemTemplateSystemSignalRef=DET_CONFD_ELEVATION_006_Rx
          DET_EXISTENCE_PROB_006_Rx_oRDR_FUSION_DET_005_008_oPCAN_RADAR_9d825eb4_Rx: ComBitPosition=224, ComBitSize=6, ComSignalType=UINT8, ComHandleId=190, ComSystemTemplateSystemSignalRef=DET_EXISTENCE_PROB_006_Rx
          DET_SNR_006_Rx_oRDR_FUSION_DET_005_008_oPCAN_RADAR_40beea59_Rx: ComBitPosition=232, ComBitSize=8, ComSignalType=UINT8, ComHandleId=233, ComSystemTemplateSystemSignalRef=DET_SNR_006_Rx
          DET_HVC_FLAG_005_Rx_oRDR_FUSION_DET_005_008_oPCAN_RADAR_6ae00373_Rx: ComBitPosition=86, ComBitSize=1, ComSignalType=BOOLEAN, ComHandleId=193, ComSystemTemplateSystemSignalRef=DET_HVC_FLAG_005_Rx
          DET_MTD_005_Rx_oRDR_FUSION_DET_005_008_oPCAN_RADAR_e2a2cc4b_Rx: ComBitPosition=47, ComBitSize=1, ComSignalType=BOOLEAN, ComHandleId=204, ComSystemTemplateSystemSignalRef=DET_MTD_005_Rx
          DET_BELOW_RAIN_THOLD_005_Rx_oRDR_FUSION_DET_005_008_oPCAN_RADAR_061a994f_Rx: ComBitPosition=39, ComBitSize=1, ComSignalType=BOOLEAN, ComHandleId=165, ComSystemTemplateSystemSignalRef=DET_BELOW_RAIN_THOLD_005_Rx
          DET_BI_STATIC_FLAG_008_Rx_oRDR_FUSION_DET_005_008_oPCAN_RADAR_7432623b_Rx: ComBitPosition=440, ComBitSize=1, ComSignalType=BOOLEAN, ComHandleId=172, ComSystemTemplateSystemSignalRef=DET_BI_STATIC_FLAG_008_Rx
          DET_AZIMUTH_ERR_005_Rx_oRDR_FUSION_DET_005_008_oPCAN_RADAR_62c9c778_Rx: ComBitPosition=105, ComBitSize=7, ComSignalType=UINT8, ComHandleId=161, ComSystemTemplateSystemSignalRef=DET_AZIMUTH_ERR_005_Rx
          DET_CONFD_AZIMUTH_007_Rx_oRDR_FUSION_DET_005_008_oPCAN_RADAR_1715fac7_Rx: ComBitPosition=342, ComBitSize=2, ComSignalType=UINT8, ComHandleId=175, ComSystemTemplateSystemSignalRef=DET_CONFD_AZIMUTH_007_Rx
          DET_CONFD_ELEVATION_008_Rx_oRDR_FUSION_DET_005_008_oPCAN_RADAR_9d7a0be8_Rx: ComBitPosition=437, ComBitSize=2, ComSignalType=UINT8, ComHandleId=180, ComSystemTemplateSystemSignalRef=DET_CONFD_ELEVATION_008_Rx
          DET_AZIMUTH_ERR_006_Rx_oRDR_FUSION_DET_005_008_oPCAN_RADAR_487577f0_Rx: ComBitPosition=217, ComBitSize=7, ComSignalType=UINT8, ComHandleId=162, ComSystemTemplateSystemSignalRef=DET_AZIMUTH_ERR_006_Rx
          DET_BELOW_RAIN_THOLD_007_Rx_oRDR_FUSION_DET_005_008_oPCAN_RADAR_83e2bb80_Rx: ComBitPosition=263, ComBitSize=1, ComSignalType=BOOLEAN, ComHandleId=167, ComSystemTemplateSystemSignalRef=DET_BELOW_RAIN_THOLD_007_Rx
          DET_RANGE_VELOCITY_ERR_007_Rx_oRDR_FUSION_DET_005_008_oPCAN_RADAR_b20feb2e_Rx: ComBitPosition=288, ComBitSize=8, ComSignalType=UINT8, ComHandleId=226, ComSystemTemplateSystemSignalRef=DET_RANGE_VELOCITY_ERR_007_Rx
          DET_CONFD_AZIMUTH_005_Rx_oRDR_FUSION_DET_005_008_oPCAN_RADAR_92edd808_Rx: ComBitPosition=118, ComBitSize=2, ComSignalType=UINT8, ComHandleId=173, ComSystemTemplateSystemSignalRef=DET_CONFD_AZIMUTH_005_Rx
          DET_AZIMUTH_007_Rx_oRDR_FUSION_DET_005_008_oPCAN_RADAR_e5584435_Rx: ComBitPosition=312, ComBitSize=13, ComSignalType=UINT16, ComHandleId=159, ComSystemTemplateSystemSignalRef=DET_AZIMUTH_007_Rx
          DET_AZIMUTH_ERR_007_Rx_oRDR_FUSION_DET_005_008_oPCAN_RADAR_e731e5b7_Rx: ComBitPosition=329, ComBitSize=7, ComSignalType=UINT8, ComHandleId=163, ComSystemTemplateSystemSignalRef=DET_AZIMUTH_ERR_007_Rx
          DET_EXISTENCE_PROB_005_Rx_oRDR_FUSION_DET_005_008_oPCAN_RADAR_b73eee3c_Rx: ComBitPosition=112, ComBitSize=6, ComSignalType=UINT8, ComHandleId=189, ComSystemTemplateSystemSignalRef=DET_EXISTENCE_PROB_005_Rx
          DET_CONFD_AZIMUTH_006_Rx_oRDR_FUSION_DET_005_008_oPCAN_RADAR_b8516880_Rx: ComBitPosition=230, ComBitSize=2, ComSignalType=UINT8, ComHandleId=174, ComSystemTemplateSystemSignalRef=DET_CONFD_AZIMUTH_006_Rx
          DET_ELEVATION_ERR_007_Rx_oRDR_FUSION_DET_005_008_oPCAN_RADAR_c5deb466_Rx: ComBitPosition=304, ComBitSize=6, ComSignalType=UINT8, ComHandleId=187, ComSystemTemplateSystemSignalRef=DET_ELEVATION_ERR_007_Rx
          DET_SNR_007_Rx_oRDR_FUSION_DET_005_008_oPCAN_RADAR_effa781e_Rx: ComBitPosition=344, ComBitSize=8, ComSignalType=UINT8, ComHandleId=234, ComSystemTemplateSystemSignalRef=DET_SNR_007_Rx
          DET_ELEVATION_006_Rx_oRDR_FUSION_DET_005_008_oPCAN_RADAR_b82304fe_Rx: ComBitPosition=184, ComBitSize=8, ComSignalType=UINT8, ComHandleId=182, ComSystemTemplateSystemSignalRef=DET_ELEVATION_006_Rx
          DET_SNR_005_Rx_oRDR_FUSION_DET_005_008_oPCAN_RADAR_6a025ad1_Rx: ComBitPosition=120, ComBitSize=8, ComSignalType=UINT8, ComHandleId=232, ComSystemTemplateSystemSignalRef=DET_SNR_005_Rx
          DET_RANGE_007_Rx_oRDR_FUSION_DET_005_008_oPCAN_RADAR_f69e1812_Rx: ComBitPosition=248, ComBitSize=15, ComSignalType=UINT16, ComHandleId=214, ComSystemTemplateSystemSignalRef=DET_RANGE_007_Rx
          DET_CONFD_AZIMUTH_008_Rx_oRDR_FUSION_DET_005_008_oPCAN_RADAR_975b886f_Rx: ComBitPosition=454, ComBitSize=2, ComSignalType=UINT8, ComHandleId=176, ComSystemTemplateSystemSignalRef=DET_CONFD_AZIMUTH_008_Rx
          DET_IDM_008_Rx_oRDR_FUSION_DET_005_008_oPCAN_RADAR_5a97aa5c_Rx: ComBitPosition=399, ComBitSize=1, ComSignalType=BOOLEAN, ComHandleId=200, ComSystemTemplateSystemSignalRef=DET_IDM_008_Rx
          DET_EXISTENCE_PROB_008_Rx_oRDR_FUSION_DET_005_008_oPCAN_RADAR_b288be5b_Rx: ComBitPosition=448, ComBitSize=6, ComSignalType=UINT8, ComHandleId=192, ComSystemTemplateSystemSignalRef=DET_EXISTENCE_PROB_008_Rx
          DET_RANGE_VELOCITY_008_Rx_oRDR_FUSION_DET_005_008_oPCAN_RADAR_ab25e944_Rx: ComBitPosition=384, ComBitSize=15, ComSignalType=UINT16, ComHandleId=223, ComSystemTemplateSystemSignalRef=DET_RANGE_VELOCITY_008_Rx
          DET_AZIMUTH_008_Rx_oRDR_FUSION_DET_005_008_oPCAN_RADAR_6516369d_Rx: ComBitPosition=424, ComBitSize=13, ComSignalType=UINT16, ComHandleId=160, ComSystemTemplateSystemSignalRef=DET_AZIMUTH_008_Rx
          DET_ELEVATION_008_Rx_oRDR_FUSION_DET_005_008_oPCAN_RADAR_9729e411_Rx: ComBitPosition=408, ComBitSize=8, ComSignalType=UINT8, ComHandleId=184, ComSystemTemplateSystemSignalRef=DET_ELEVATION_008_Rx
          DET_RANGE_VELOCITY_005_Rx_oRDR_FUSION_DET_005_008_oPCAN_RADAR_ae93b923_Rx: ComBitPosition=48, ComBitSize=15, ComSignalType=UINT16, ComHandleId=220, ComSystemTemplateSystemSignalRef=DET_RANGE_VELOCITY_005_Rx
          DET_RCS_006_Rx_oRDR_FUSION_DET_005_008_oPCAN_RADAR_49e49bb0_Rx: ComBitPosition=240, ComBitSize=8, ComSignalType=UINT8, ComHandleId=229, ComSystemTemplateSystemSignalRef=DET_RCS_006_Rx
          DET_RANGE_VELOCITY_ERR_006_Rx_oRDR_FUSION_DET_005_008_oPCAN_RADAR_1d4b7969_Rx: ComBitPosition=176, ComBitSize=8, ComSignalType=UINT8, ComHandleId=225, ComSystemTemplateSystemSignalRef=DET_RANGE_VELOCITY_ERR_006_Rx
          DET_RCS_008_Rx_oRDR_FUSION_DET_005_008_oPCAN_RADAR_66ee7b5f_Rx: ComBitPosition=464, ComBitSize=8, ComSignalType=UINT8, ComHandleId=231, ComSystemTemplateSystemSignalRef=DET_RCS_008_Rx
          DET_MH_CRC16_005_008_Rx_oRDR_FUSION_DET_005_008_oPCAN_RADAR_94106a1d_Rx: ComBitPosition=0, ComBitSize=16, ComSignalType=UINT16, ComHandleId=201, ComSystemTemplateSystemSignalRef=DET_MH_CRC16_005_008_Rx
          DET_PROB_1STAZHYPO_007_Rx_oRDR_FUSION_DET_005_008_oPCAN_RADAR_ad23f005_Rx: ComBitPosition=327, ComBitSize=1, ComSignalType=BOOLEAN, ComHandleId=210, ComSystemTemplateSystemSignalRef=DET_PROB_1STAZHYPO_007_Rx
          DET_CONFD_ELEVATION_005_Rx_oRDR_FUSION_DET_005_008_oPCAN_RADAR_98cc5b8f_Rx: ComBitPosition=101, ComBitSize=2, ComSignalType=UINT8, ComHandleId=177, ComSystemTemplateSystemSignalRef=DET_CONFD_ELEVATION_005_Rx
          DET_ELEVATION_007_Rx_oRDR_FUSION_DET_005_008_oPCAN_RADAR_176796b9_Rx: ComBitPosition=296, ComBitSize=8, ComSignalType=UINT8, ComHandleId=183, ComSystemTemplateSystemSignalRef=DET_ELEVATION_007_Rx
          DET_BI_STATIC_FLAG_007_Rx_oRDR_FUSION_DET_005_008_oPCAN_RADAR_f47c1093_Rx: ComBitPosition=328, ComBitSize=1, ComSignalType=BOOLEAN, ComHandleId=171, ComSystemTemplateSystemSignalRef=DET_BI_STATIC_FLAG_007_Rx
          DET_SUPER_RES_TARGET_007_Rx_oRDR_FUSION_DET_005_008_oPCAN_RADAR_2401591e_Rx: ComBitPosition=311, ComBitSize=1, ComSignalType=BOOLEAN, ComHandleId=238, ComSystemTemplateSystemSignalRef=DET_SUPER_RES_TARGET_007_Rx
          DET_RANGE_VELOCITY_ERR_005_Rx_oRDR_FUSION_DET_005_008_oPCAN_RADAR_37f7c9e1_Rx: ComBitPosition=64, ComBitSize=8, ComSignalType=UINT8, ComHandleId=224, ComSystemTemplateSystemSignalRef=DET_RANGE_VELOCITY_ERR_005_Rx
          DET_RANGE_ERR_006_Rx_oRDR_FUSION_DET_005_008_oPCAN_RADAR_092806b5_Rx: ComBitPosition=152, ComBitSize=7, ComSignalType=UINT8, ComHandleId=217, ComSystemTemplateSystemSignalRef=DET_RANGE_ERR_006_Rx
          DET_SUPER_RES_TARGET_005_Rx_oRDR_FUSION_DET_005_008_oPCAN_RADAR_a1f97bd1_Rx: ComBitPosition=87, ComBitSize=1, ComSignalType=BOOLEAN, ComHandleId=236, ComSystemTemplateSystemSignalRef=DET_SUPER_RES_TARGET_005_Rx
          DET_PROB_1STAZHYPO_006_Rx_oRDR_FUSION_DET_005_008_oPCAN_RADAR_02676242_Rx: ComBitPosition=215, ComBitSize=1, ComSignalType=BOOLEAN, ComHandleId=209, ComSystemTemplateSystemSignalRef=DET_PROB_1STAZHYPO_006_Rx
          DET_AZIMUTH_ERR_008_Rx_oRDR_FUSION_DET_005_008_oPCAN_RADAR_677f971f_Rx: ComBitPosition=441, ComBitSize=7, ComSignalType=UINT8, ComHandleId=164, ComSystemTemplateSystemSignalRef=DET_AZIMUTH_ERR_008_Rx
          DET_ELEVATION_ERR_008_Rx_oRDR_FUSION_DET_005_008_oPCAN_RADAR_4590c6ce_Rx: ComBitPosition=416, ComBitSize=6, ComSignalType=UINT8, ComHandleId=188, ComSystemTemplateSystemSignalRef=DET_ELEVATION_ERR_008_Rx
          DET_PROB_1STAZHYPO_005_Rx_oRDR_FUSION_DET_005_008_oPCAN_RADAR_28dbd2ca_Rx: ComBitPosition=103, ComBitSize=1, ComSignalType=BOOLEAN, ComHandleId=208, ComSystemTemplateSystemSignalRef=DET_PROB_1STAZHYPO_005_Rx
          DET_HVC_FLAG_007_Rx_oRDR_FUSION_DET_005_008_oPCAN_RADAR_ef1821bc_Rx: ComBitPosition=310, ComBitSize=1, ComSignalType=BOOLEAN, ComHandleId=195, ComSystemTemplateSystemSignalRef=DET_HVC_FLAG_007_Rx
          DET_EXISTENCE_PROB_007_Rx_oRDR_FUSION_DET_005_008_oPCAN_RADAR_32c6ccf3_Rx: ComBitPosition=336, ComBitSize=6, ComSignalType=UINT8, ComHandleId=191, ComSystemTemplateSystemSignalRef=DET_EXISTENCE_PROB_007_Rx
          DET_HVC_FLAG_006_Rx_oRDR_FUSION_DET_005_008_oPCAN_RADAR_405cb3fb_Rx: ComBitPosition=198, ComBitSize=1, ComSignalType=BOOLEAN, ComHandleId=194, ComSystemTemplateSystemSignalRef=DET_HVC_FLAG_006_Rx
          DET_MTD_006_Rx_oRDR_FUSION_DET_005_008_oPCAN_RADAR_c81e7cc3_Rx: ComBitPosition=159, ComBitSize=1, ComSignalType=BOOLEAN, ComHandleId=205, ComSystemTemplateSystemSignalRef=DET_MTD_006_Rx
          DET_BI_STATIC_FLAG_006_Rx_oRDR_FUSION_DET_005_008_oPCAN_RADAR_5b3882d4_Rx: ComBitPosition=216, ComBitSize=1, ComSignalType=BOOLEAN, ComHandleId=170, ComSystemTemplateSystemSignalRef=DET_BI_STATIC_FLAG_006_Rx
          DET_HVC_FLAG_008_Rx_oRDR_FUSION_DET_005_008_oPCAN_RADAR_6f565314_Rx: ComBitPosition=422, ComBitSize=1, ComSignalType=BOOLEAN, ComHandleId=196, ComSystemTemplateSystemSignalRef=DET_HVC_FLAG_008_Rx
          DET_IDM_006_Rx_oRDR_FUSION_DET_005_008_oPCAN_RADAR_759d4ab3_Rx: ComBitPosition=175, ComBitSize=1, ComSignalType=BOOLEAN, ComHandleId=198, ComSystemTemplateSystemSignalRef=DET_IDM_006_Rx
          DET_RANGE_005_Rx_oRDR_FUSION_DET_005_008_oPCAN_RADAR_73663add_Rx: ComBitPosition=24, ComBitSize=15, ComSignalType=UINT16, ComHandleId=212, ComSystemTemplateSystemSignalRef=DET_RANGE_005_Rx
          DET_BELOW_RAIN_THOLD_006_Rx_oRDR_FUSION_DET_005_008_oPCAN_RADAR_2ca629c7_Rx: ComBitPosition=151, ComBitSize=1, ComSignalType=BOOLEAN, ComHandleId=166, ComSystemTemplateSystemSignalRef=DET_BELOW_RAIN_THOLD_006_Rx
          DET_MTD_007_Rx_oRDR_FUSION_DET_005_008_oPCAN_RADAR_675aee84_Rx: ComBitPosition=271, ComBitSize=1, ComSignalType=BOOLEAN, ComHandleId=206, ComSystemTemplateSystemSignalRef=DET_MTD_007_Rx
          DET_ELEVATION_ERR_005_Rx_oRDR_FUSION_DET_005_008_oPCAN_RADAR_402696a9_Rx: ComBitPosition=80, ComBitSize=6, ComSignalType=UINT8, ComHandleId=185, ComSystemTemplateSystemSignalRef=DET_ELEVATION_ERR_005_Rx
          DET_RANGE_VELOCITY_ERR_008_Rx_oRDR_FUSION_DET_005_008_oPCAN_RADAR_32419986_Rx: ComBitPosition=400, ComBitSize=8, ComSignalType=UINT8, ComHandleId=227, ComSystemTemplateSystemSignalRef=DET_RANGE_VELOCITY_ERR_008_Rx
          DET_IDM_007_Rx_oRDR_FUSION_DET_005_008_oPCAN_RADAR_dad9d8f4_Rx: ComBitPosition=287, ComBitSize=1, ComSignalType=BOOLEAN, ComHandleId=199, ComSystemTemplateSystemSignalRef=DET_IDM_007_Rx
          DET_AZIMUTH_006_Rx_oRDR_FUSION_DET_005_008_oPCAN_RADAR_4a1cd672_Rx: ComBitPosition=200, ComBitSize=13, ComSignalType=UINT16, ComHandleId=158, ComSystemTemplateSystemSignalRef=DET_AZIMUTH_006_Rx
          DET_BI_STATIC_FLAG_005_Rx_oRDR_FUSION_DET_005_008_oPCAN_RADAR_7184325c_Rx: ComBitPosition=104, ComBitSize=1, ComSignalType=BOOLEAN, ComHandleId=169, ComSystemTemplateSystemSignalRef=DET_BI_STATIC_FLAG_005_Rx
          DET_RANGE_ERR_005_Rx_oRDR_FUSION_DET_005_008_oPCAN_RADAR_2394b63d_Rx: ComBitPosition=40, ComBitSize=7, ComSignalType=UINT8, ComHandleId=216, ComSystemTemplateSystemSignalRef=DET_RANGE_ERR_005_Rx
          DET_AZIMUTH_005_Rx_oRDR_FUSION_DET_005_008_oPCAN_RADAR_60a066fa_Rx: ComBitPosition=88, ComBitSize=13, ComSignalType=UINT16, ComHandleId=157, ComSystemTemplateSystemSignalRef=DET_AZIMUTH_005_Rx
          DET_MH_CYCLE_COUNTER_005_008_Rx_oRDR_FUSION_DET_005_008_oPCAN_RADAR_99cb57d8_Rx: ComBitPosition=16, ComBitSize=8, ComSignalType=UINT8, ComHandleId=202, ComSystemTemplateSystemSignalRef=DET_MH_CYCLE_COUNTER_005_008_Rx
          DET_RANGE_VELOCITY_006_Rx_oRDR_FUSION_DET_005_008_oPCAN_RADAR_842f09ab_Rx: ComBitPosition=160, ComBitSize=15, ComSignalType=UINT16, ComHandleId=221, ComSystemTemplateSystemSignalRef=DET_RANGE_VELOCITY_006_Rx
          DET_RANGE_008_Rx_oRDR_FUSION_DET_005_008_oPCAN_RADAR_76d06aba_Rx: ComBitPosition=360, ComBitSize=15, ComSignalType=UINT16, ComHandleId=215, ComSystemTemplateSystemSignalRef=DET_RANGE_008_Rx
          DET_BELOW_RAIN_THOLD_008_Rx_oRDR_FUSION_DET_005_008_oPCAN_RADAR_03acc928_Rx: ComBitPosition=375, ComBitSize=1, ComSignalType=BOOLEAN, ComHandleId=168, ComSystemTemplateSystemSignalRef=DET_BELOW_RAIN_THOLD_008_Rx
          DET_RANGE_ERR_007_Rx_oRDR_FUSION_DET_005_008_oPCAN_RADAR_a66c94f2_Rx: ComBitPosition=264, ComBitSize=7, ComSignalType=UINT8, ComHandleId=218, ComSystemTemplateSystemSignalRef=DET_RANGE_ERR_007_Rx
          DET_IDM_005_Rx_oRDR_FUSION_DET_005_008_oPCAN_RADAR_5f21fa3b_Rx: ComBitPosition=63, ComBitSize=1, ComSignalType=BOOLEAN, ComHandleId=197, ComSystemTemplateSystemSignalRef=DET_IDM_005_Rx
          DET_MH_SCAN_INDEX_4LSB_005_008_Rx_oRDR_FUSION_DET_005_008_oPCAN_RADAR_fd7b98e3_Rx: ComBitPosition=476, ComBitSize=4, ComSignalType=UINT8, ComHandleId=203, ComSystemTemplateSystemSignalRef=DET_MH_SCAN_INDEX_4LSB_005_008_Rx
          DET_RCS_007_Rx_oRDR_FUSION_DET_005_008_oPCAN_RADAR_e6a009f7_Rx: ComBitPosition=352, ComBitSize=8, ComSignalType=UINT8, ComHandleId=230, ComSystemTemplateSystemSignalRef=DET_RCS_007_Rx
          DET_SNR_008_Rx_oRDR_FUSION_DET_005_008_oPCAN_RADAR_6fb40ab6_Rx: ComBitPosition=456, ComBitSize=8, ComSignalType=UINT8, ComHandleId=235, ComSystemTemplateSystemSignalRef=DET_SNR_008_Rx
          DET_RANGE_VELOCITY_007_Rx_oRDR_FUSION_DET_005_008_oPCAN_RADAR_2b6b9bec_Rx: ComBitPosition=272, ComBitSize=15, ComSignalType=UINT16, ComHandleId=222, ComSystemTemplateSystemSignalRef=DET_RANGE_VELOCITY_007_Rx
          DET_PROB_1STAZHYPO_008_Rx_oRDR_FUSION_DET_005_008_oPCAN_RADAR_2d6d82ad_Rx: ComBitPosition=439, ComBitSize=1, ComSignalType=BOOLEAN, ComHandleId=211, ComSystemTemplateSystemSignalRef=DET_PROB_1STAZHYPO_008_Rx
          DET_RANGE_ERR_008_Rx_oRDR_FUSION_DET_005_008_oPCAN_RADAR_2622e65a_Rx: ComBitPosition=376, ComBitSize=7, ComSignalType=UINT8, ComHandleId=219, ComSystemTemplateSystemSignalRef=DET_RANGE_ERR_008_Rx
          DET_RCS_005_Rx_oRDR_FUSION_DET_005_008_oPCAN_RADAR_63582b38_Rx: ComBitPosition=128, ComBitSize=8, ComSignalType=UINT8, ComHandleId=228, ComSystemTemplateSystemSignalRef=DET_RCS_005_Rx
          DET_ELEVATION_005_Rx_oRDR_FUSION_DET_005_008_oPCAN_RADAR_929fb476_Rx: ComBitPosition=72, ComBitSize=8, ComSignalType=UINT8, ComHandleId=181, ComSystemTemplateSystemSignalRef=DET_ELEVATION_005_Rx
          DET_ELEVATION_ERR_006_Rx_oRDR_FUSION_DET_005_008_oPCAN_RADAR_6a9a2621_Rx: ComBitPosition=192, ComBitSize=6, ComSignalType=UINT8, ComHandleId=186, ComSystemTemplateSystemSignalRef=DET_ELEVATION_ERR_006_Rx
          DET_SUPER_RES_TARGET_008_Rx_oRDR_FUSION_DET_005_008_oPCAN_RADAR_a44f2bb6_Rx: ComBitPosition=423, ComBitSize=1, ComSignalType=BOOLEAN, ComHandleId=239, ComSystemTemplateSystemSignalRef=DET_SUPER_RES_TARGET_008_Rx
          DET_RANGE_006_Rx_oRDR_FUSION_DET_005_008_oPCAN_RADAR_59da8a55_Rx: ComBitPosition=136, ComBitSize=15, ComSignalType=UINT16, ComHandleId=213, ComSystemTemplateSystemSignalRef=DET_RANGE_006_Rx
      7 x ComIPdu, all with ComIPduDirection=RECEIVE, ComIPduType=NORMAL, ComIPduCancellationSupport=false, ComIPduSignalProcessing=DEFERRED, ComIPduChannelRef=CN_PCAN_RADAR_458ff0f1, ComIPduGroupRef=RDR01_oPCAN_RADAR_Rx_e0e717e1 if post-build-variant-condition{matching-criterion=RDR_POS, value=0}, ComIPduMainFunctionRef=ComMainFunctionRx, ComIPduGroupRef=RDR02_oPCAN_RADAR_Rx_c92fa313 if post-build-variant-condition{matching-criterion=RDR_POS, value=1}, ComIPduGroupRef=RDR03_oPCAN_RADAR_Rx_67473282 if post-build-variant-condition{matching-criterion=RDR_POS, value=2}, ComIPduGroupRef=RDR04_oPCAN_RADAR_Rx_9abecaf7 if post-build-variant-condition{matching-criterion=RDR_POS, value=3}, ComIPduGroupRef=RDR05_oPCAN_RADAR_Rx_34d65b66 if post-build-variant-condition{matching-criterion=RDR_POS, value=4}, ComIPduGroupRef=RDR06_oPCAN_RADAR_Rx_1d1eef94 if post-build-variant-condition{matching-criterion=RDR_POS, value=5}, ComIPduGroupRef=RDR07_oPCAN_RADAR_Rx_b3767e05 if post-build-variant-condition{matching-criterion=RDR_POS, value=6}, ComIPduGroupRef=RDR08_oPCAN_RADAR_Rx_3d9c193f if post-build-variant-condition{matching-criterion=RDR_POS, value=7}:
        RDR_FUSION_DET_037_040_oPCAN_RADAR_47392252_Rx: ComIPduHandleId=31, ComIPduSignalGroupRef=SG_Fusion_Detections_037_040_oRDR_FUSION_DET_037_040_oPCAN_RADAR_cee54bfa_Rx, ComPduIdRef=RDR_FUSION_DET_037_040_oPCAN_RADAR_47392252_Rx
        RDR_FUSION_DET_009_012_oPCAN_RADAR_0864dc80_Rx: ComIPduHandleId=24, ComIPduSignalGroupRef=SG_Fusion_Detections_009_012_oRDR_FUSION_DET_009_012_oPCAN_RADAR_85b0e384_Rx, ComPduIdRef=RDR_FUSION_DET_009_012_oPCAN_RADAR_0864dc80_Rx
        RDR_FUSION_DET_025_028_oPCAN_RADAR_de969caf_Rx: ComIPduHandleId=28, ComIPduSignalGroupRef=SG_Fusion_Detections_025_028_oRDR_FUSION_DET_025_028_oPCAN_RADAR_ba5bfb5a_Rx, ComPduIdRef=RDR_FUSION_DET_025_028_oPCAN_RADAR_de969caf_Rx
        RDR_FUSION_DET_105_108_oPCAN_RADAR_54356831_Rx: ComIPduHandleId=48, ComIPduSignalGroupRef=SG_Fusion_Detections_105_108_oRDR_FUSION_DET_105_108_oPCAN_RADAR_6000008e_Rx, ComPduIdRef=RDR_FUSION_DET_105_108_oPCAN_RADAR_54356831_Rx
        RDR_FUSION_DET_069_072_oPCAN_RADAR_feda2bb3_Rx: ComIPduHandleId=39, ComIPduSignalGroupRef=SG_Fusion_Detections_069_072_oRDR_FUSION_DET_069_072_oPCAN_RADAR_98a9029f_Rx, ComPduIdRef=RDR_FUSION_DET_069_072_oPCAN_RADAR_feda2bb3_Rx
        RDR_FUSION_DET_117_120_oPCAN_RADAR_d43659d7_Rx: ComIPduHandleId=51, ComIPduSignalGroupRef=SG_Fusion_Detections_117_120_oRDR_FUSION_DET_117_120_oPCAN_RADAR_56a2c27e_Rx, ComPduIdRef=RDR_FUSION_DET_117_120_oPCAN_RADAR_d43659d7_Rx
        RDR_FUSION_DET_085_088_oPCAN_RADAR_1e2483bb_Rx: ComIPduHandleId=43, ComIPduSignalGroupRef=SG_Fusion_Detections_085_088_oRDR_FUSION_DET_085_088_oPCAN_RADAR_9d71d877_Rx, ComPduIdRef=RDR_FUSION_DET_085_088_oPCAN_RADAR_1e2483bb_Rx
      3 x ComSignalGroup, all with ComTimeout=0, ComTransferProperty=PENDING, ComSignalGroupAccess=ACCESS_NEEDED_BY_SWC_OR_COM, ComSignalGroupArrayAccess=true:
        SG_Fusion_Detections_125_128_oRDR_FUSION_DET_125_128_oPCAN_RADAR_ddd85db8_Rx: ComHandleId=39, ComSystemTemplateSignalGroupRef=SG_Fusion_Detections_125_128
          83 x ComGroupSignal, all with ComSignalEndianness=LITTLE_ENDIAN, ComSignalInitValue=0, ComSignalAccess=ACCESS_NEEDED_BY_SWC_OR_COM:
            DET_CONFD_ELEVATION_126_Rx_oRDR_FUSION_DET_125_128_oPCAN_RADAR_92b4bc74_Rx: ComBitPosition=213, ComBitSize=2, ComSignalType=UINT8, ComHandleId=2668, ComSystemTemplateSystemSignalRef=DET_CONFD_ELEVATION_126_Rx
            DET_RANGE_ERR_126_Rx_oRDR_FUSION_DET_125_128_oPCAN_RADAR_29ec51c6_Rx: ComBitPosition=152, ComBitSize=7, ComSignalType=UINT8, ComHandleId=2707, ComSystemTemplateSystemSignalRef=DET_RANGE_ERR_126_Rx
            DET_SNR_126_Rx_oRDR_FUSION_DET_125_128_oPCAN_RADAR_607abd2a_Rx: ComBitPosition=232, ComBitSize=8, ComSignalType=UINT8, ComHandleId=2723, ComSystemTemplateSystemSignalRef=DET_SNR_126_Rx
            DET_SUPER_RES_TARGET_125_Rx_oRDR_FUSION_DET_125_128_oPCAN_RADAR_813d2ca2_Rx: ComBitPosition=87, ComBitSize=1, ComSignalType=BOOLEAN, ComHandleId=2726, ComSystemTemplateSystemSignalRef=DET_SUPER_RES_TARGET_125_Rx
            DET_RANGE_VELOCITY_127_Rx_oRDR_FUSION_DET_125_128_oPCAN_RADAR_0bafcc9f_Rx: ComBitPosition=272, ComBitSize=15, ComSignalType=UINT16, ComHandleId=2712, ComSystemTemplateSystemSignalRef=DET_RANGE_VELOCITY_127_Rx
            DET_ELEVATION_126_Rx_oRDR_FUSION_DET_125_128_oPCAN_RADAR_98e7538d_Rx: ComBitPosition=184, ComBitSize=8, ComSignalType=UINT8, ComHandleId=2672, ComSystemTemplateSystemSignalRef=DET_ELEVATION_126_Rx
            DET_IDM_128_Rx_oRDR_FUSION_DET_125_128_oPCAN_RADAR_7a53fd2f_Rx: ComBitPosition=399, ComBitSize=1, ComSignalType=BOOLEAN, ComHandleId=2690, ComSystemTemplateSystemSignalRef=DET_IDM_128_Rx
            DET_RANGE_VELOCITY_ERR_128_Rx_oRDR_FUSION_DET_125_128_oPCAN_RADAR_1285cef5_Rx: ComBitPosition=400, ComBitSize=8, ComSignalType=UINT8, ComHandleId=2717, ComSystemTemplateSystemSignalRef=DET_RANGE_VELOCITY_ERR_128_Rx
            DET_SUPER_RES_TARGET_126_Rx_oRDR_FUSION_DET_125_128_oPCAN_RADAR_ab819c2a_Rx: ComBitPosition=199, ComBitSize=1, ComSignalType=BOOLEAN, ComHandleId=2727, ComSystemTemplateSystemSignalRef=DET_SUPER_RES_TARGET_126_Rx
            DET_HVC_FLAG_126_Rx_oRDR_FUSION_DET_125_128_oPCAN_RADAR_6098e488_Rx: ComBitPosition=198, ComBitSize=1, ComSignalType=BOOLEAN, ComHandleId=2684, ComSystemTemplateSystemSignalRef=DET_HVC_FLAG_126_Rx
            DET_RANGE_125_Rx_oRDR_FUSION_DET_125_128_oPCAN_RADAR_53a26dae_Rx: ComBitPosition=24, ComBitSize=15, ComSignalType=UINT16, ComHandleId=2702, ComSystemTemplateSystemSignalRef=DET_RANGE_125_Rx
            DET_MTD_128_Rx_oRDR_FUSION_DET_125_128_oPCAN_RADAR_c7d0cb5f_Rx: ComBitPosition=383, ComBitSize=1, ComSignalType=BOOLEAN, ComHandleId=2697, ComSystemTemplateSystemSignalRef=DET_MTD_128_Rx
            DET_BI_STATIC_FLAG_127_Rx_oRDR_FUSION_DET_125_128_oPCAN_RADAR_d4b847e0_Rx: ComBitPosition=328, ComBitSize=1, ComSignalType=BOOLEAN, ComHandleId=2661, ComSystemTemplateSystemSignalRef=DET_BI_STATIC_FLAG_127_Rx
            DET_SNR_127_Rx_oRDR_FUSION_DET_125_128_oPCAN_RADAR_cf3e2f6d_Rx: ComBitPosition=344, ComBitSize=8, ComSignalType=UINT8, ComHandleId=2724, ComSystemTemplateSystemSignalRef=DET_SNR_127_Rx
            DET_BELOW_RAIN_THOLD_125_Rx_oRDR_FUSION_DET_125_128_oPCAN_RADAR_26dece3c_Rx: ComBitPosition=39, ComBitSize=1, ComSignalType=BOOLEAN, ComHandleId=2655, ComSystemTemplateSystemSignalRef=DET_BELOW_RAIN_THOLD_125_Rx
            DET_ELEVATION_ERR_128_Rx_oRDR_FUSION_DET_125_128_oPCAN_RADAR_655491bd_Rx: ComBitPosition=416, ComBitSize=6, ComSignalType=UINT8, ComHandleId=2678, ComSystemTemplateSystemSignalRef=DET_ELEVATION_ERR_128_Rx
            DET_PROB_1STAZHYPO_125_Rx_oRDR_FUSION_DET_125_128_oPCAN_RADAR_081f85b9_Rx: ComBitPosition=103, ComBitSize=1, ComSignalType=BOOLEAN, ComHandleId=2698, ComSystemTemplateSystemSignalRef=DET_PROB_1STAZHYPO_125_Rx
            DET_RANGE_ERR_127_Rx_oRDR_FUSION_DET_125_128_oPCAN_RADAR_86a8c381_Rx: ComBitPosition=264, ComBitSize=7, ComSignalType=UINT8, ComHandleId=2708, ComSystemTemplateSystemSignalRef=DET_RANGE_ERR_127_Rx
            DET_SNR_128_Rx_oRDR_FUSION_DET_125_128_oPCAN_RADAR_4f705dc5_Rx: ComBitPosition=456, ComBitSize=8, ComSignalType=UINT8, ComHandleId=2725, ComSystemTemplateSystemSignalRef=DET_SNR_128_Rx
            DET_AZIMUTH_ERR_126_Rx_oRDR_FUSION_DET_125_128_oPCAN_RADAR_68b12083_Rx: ComBitPosition=217, ComBitSize=7, ComSignalType=UINT8, ComHandleId=2652, ComSystemTemplateSystemSignalRef=DET_AZIMUTH_ERR_126_Rx
            DET_MH_SCAN_INDEX_4LSB_125_128_Rx_oRDR_FUSION_DET_125_128_oPCAN_RADAR_3e2b02da_Rx: ComBitPosition=476, ComBitSize=4, ComSignalType=UINT8, ComHandleId=2693, ComSystemTemplateSystemSignalRef=DET_MH_SCAN_INDEX_4LSB_125_128_Rx
            DET_MTD_126_Rx_oRDR_FUSION_DET_125_128_oPCAN_RADAR_e8da2bb0_Rx: ComBitPosition=159, ComBitSize=1, ComSignalType=BOOLEAN, ComHandleId=2695, ComSystemTemplateSystemSignalRef=DET_MTD_126_Rx
            DET_AZIMUTH_126_Rx_oRDR_FUSION_DET_125_128_oPCAN_RADAR_6ad88101_Rx: ComBitPosition=200, ComBitSize=13, ComSignalType=UINT16, ComHandleId=2648, ComSystemTemplateSystemSignalRef=DET_AZIMUTH_126_Rx
            DET_EXISTENCE_PROB_128_Rx_oRDR_FUSION_DET_125_128_oPCAN_RADAR_924ce928_Rx: ComBitPosition=448, ComBitSize=6, ComSignalType=UINT8, ComHandleId=2682, ComSystemTemplateSystemSignalRef=DET_EXISTENCE_PROB_128_Rx
            DET_RCS_125_Rx_oRDR_FUSION_DET_125_128_oPCAN_RADAR_439c7c4b_Rx: ComBitPosition=128, ComBitSize=8, ComSignalType=UINT8, ComHandleId=2718, ComSystemTemplateSystemSignalRef=DET_RCS_125_Rx
            DET_RCS_126_Rx_oRDR_FUSION_DET_125_128_oPCAN_RADAR_6920ccc3_Rx: ComBitPosition=240, ComBitSize=8, ComSignalType=UINT8, ComHandleId=2719, ComSystemTemplateSystemSignalRef=DET_RCS_126_Rx
            DET_BELOW_RAIN_THOLD_126_Rx_oRDR_FUSION_DET_125_128_oPCAN_RADAR_0c627eb4_Rx: ComBitPosition=151, ComBitSize=1, ComSignalType=BOOLEAN, ComHandleId=2656, ComSystemTemplateSystemSignalRef=DET_BELOW_RAIN_THOLD_126_Rx
            DET_SNR_125_Rx_oRDR_FUSION_DET_125_128_oPCAN_RADAR_4ac60da2_Rx: ComBitPosition=120, ComBitSize=8, ComSignalType=UINT8, ComHandleId=2722, ComSystemTemplateSystemSignalRef=DET_SNR_125_Rx
            DET_RANGE_VELOCITY_ERR_126_Rx_oRDR_FUSION_DET_125_128_oPCAN_RADAR_3d8f2e1a_Rx: ComBitPosition=176, ComBitSize=8, ComSignalType=UINT8, ComHandleId=2715, ComSystemTemplateSystemSignalRef=DET_RANGE_VELOCITY_ERR_126_Rx
            DET_CONFD_ELEVATION_125_Rx_oRDR_FUSION_DET_125_128_oPCAN_RADAR_b8080cfc_Rx: ComBitPosition=101, ComBitSize=2, ComSignalType=UINT8, ComHandleId=2667, ComSystemTemplateSystemSignalRef=DET_CONFD_ELEVATION_125_Rx
            DET_EXISTENCE_PROB_126_Rx_oRDR_FUSION_DET_125_128_oPCAN_RADAR_bd4609c7_Rx: ComBitPosition=224, ComBitSize=6, ComSignalType=UINT8, ComHandleId=2680, ComSystemTemplateSystemSignalRef=DET_EXISTENCE_PROB_126_Rx
            DET_PROB_1STAZHYPO_127_Rx_oRDR_FUSION_DET_125_128_oPCAN_RADAR_8de7a776_Rx: ComBitPosition=327, ComBitSize=1, ComSignalType=BOOLEAN, ComHandleId=2700, ComSystemTemplateSystemSignalRef=DET_PROB_1STAZHYPO_127_Rx
            DET_CONFD_AZIMUTH_125_Rx_oRDR_FUSION_DET_125_128_oPCAN_RADAR_b2298f7b_Rx: ComBitPosition=118, ComBitSize=2, ComSignalType=UINT8, ComHandleId=2663, ComSystemTemplateSystemSignalRef=DET_CONFD_AZIMUTH_125_Rx
            DET_ELEVATION_ERR_127_Rx_oRDR_FUSION_DET_125_128_oPCAN_RADAR_e51ae315_Rx: ComBitPosition=304, ComBitSize=6, ComSignalType=UINT8, ComHandleId=2677, ComSystemTemplateSystemSignalRef=DET_ELEVATION_ERR_127_Rx
            DET_AZIMUTH_ERR_125_Rx_oRDR_FUSION_DET_125_128_oPCAN_RADAR_420d900b_Rx: ComBitPosition=105, ComBitSize=7, ComSignalType=UINT8, ComHandleId=2651, ComSystemTemplateSystemSignalRef=DET_AZIMUTH_ERR_125_Rx
            DET_ELEVATION_125_Rx_oRDR_FUSION_DET_125_128_oPCAN_RADAR_b25be305_Rx: ComBitPosition=72, ComBitSize=8, ComSignalType=UINT8, ComHandleId=2671, ComSystemTemplateSystemSignalRef=DET_ELEVATION_125_Rx
            DET_AZIMUTH_125_Rx_oRDR_FUSION_DET_125_128_oPCAN_RADAR_40643189_Rx: ComBitPosition=88, ComBitSize=13, ComSignalType=UINT16, ComHandleId=2647, ComSystemTemplateSystemSignalRef=DET_AZIMUTH_125_Rx
            DET_RANGE_VELOCITY_ERR_127_Rx_oRDR_FUSION_DET_125_128_oPCAN_RADAR_92cbbc5d_Rx: ComBitPosition=288, ComBitSize=8, ComSignalType=UINT8, ComHandleId=2716, ComSystemTemplateSystemSignalRef=DET_RANGE_VELOCITY_ERR_127_Rx
            DET_AZIMUTH_127_Rx_oRDR_FUSION_DET_125_128_oPCAN_RADAR_c59c1346_Rx: ComBitPosition=312, ComBitSize=13, ComSignalType=UINT16, ComHandleId=2649, ComSystemTemplateSystemSignalRef=DET_AZIMUTH_127_Rx
            DET_BI_STATIC_FLAG_126_Rx_oRDR_FUSION_DET_125_128_oPCAN_RADAR_7bfcd5a7_Rx: ComBitPosition=216, ComBitSize=1, ComSignalType=BOOLEAN, ComHandleId=2660, ComSystemTemplateSystemSignalRef=DET_BI_STATIC_FLAG_126_Rx
            DET_AZIMUTH_ERR_128_Rx_oRDR_FUSION_DET_125_128_oPCAN_RADAR_47bbc06c_Rx: ComBitPosition=441, ComBitSize=7, ComSignalType=UINT8, ComHandleId=2654, ComSystemTemplateSystemSignalRef=DET_AZIMUTH_ERR_128_Rx
            DET_CONFD_AZIMUTH_128_Rx_oRDR_FUSION_DET_125_128_oPCAN_RADAR_b79fdf1c_Rx: ComBitPosition=454, ComBitSize=2, ComSignalType=UINT8, ComHandleId=2666, ComSystemTemplateSystemSignalRef=DET_CONFD_AZIMUTH_128_Rx
            DET_SUPER_RES_TARGET_127_Rx_oRDR_FUSION_DET_125_128_oPCAN_RADAR_04c50e6d_Rx: ComBitPosition=311, ComBitSize=1, ComSignalType=BOOLEAN, ComHandleId=2728, ComSystemTemplateSystemSignalRef=DET_SUPER_RES_TARGET_127_Rx
            DET_CONFD_AZIMUTH_127_Rx_oRDR_FUSION_DET_125_128_oPCAN_RADAR_37d1adb4_Rx: ComBitPosition=342, ComBitSize=2, ComSignalType=UINT8, ComHandleId=2665, ComSystemTemplateSystemSignalRef=DET_CONFD_AZIMUTH_127_Rx
            DET_IDM_125_Rx_oRDR_FUSION_DET_125_128_oPCAN_RADAR_7fe5ad48_Rx: ComBitPosition=63, ComBitSize=1, ComSignalType=BOOLEAN, ComHandleId=2687, ComSystemTemplateSystemSignalRef=DET_IDM_125_Rx
            DET_ELEVATION_ERR_126_Rx_oRDR_FUSION_DET_125_128_oPCAN_RADAR_4a5e7152_Rx: ComBitPosition=192, ComBitSize=6, ComSignalType=UINT8, ComHandleId=2676, ComSystemTemplateSystemSignalRef=DET_ELEVATION_ERR_126_Rx
            DET_MH_CYCLE_COUNTER_125_128_Rx_oRDR_FUSION_DET_125_128_oPCAN_RADAR_5a9bcde1_Rx: ComBitPosition=16, ComBitSize=8, ComSignalType=UINT8, ComHandleId=2692, ComSystemTemplateSystemSignalRef=DET_MH_CYCLE_COUNTER_125_128_Rx
            DET_PROB_1STAZHYPO_128_Rx_oRDR_FUSION_DET_125_128_oPCAN_RADAR_0da9d5de_Rx: ComBitPosition=439, ComBitSize=1, ComSignalType=BOOLEAN, ComHandleId=2701, ComSystemTemplateSystemSignalRef=DET_PROB_1STAZHYPO_128_Rx
            DET_SUPER_RES_TARGET_128_Rx_oRDR_FUSION_DET_125_128_oPCAN_RADAR_848b7cc5_Rx: ComBitPosition=423, ComBitSize=1, ComSignalType=BOOLEAN, ComHandleId=2729, ComSystemTemplateSystemSignalRef=DET_SUPER_RES_TARGET_128_Rx
            DET_RANGE_126_Rx_oRDR_FUSION_DET_125_128_oPCAN_RADAR_791edd26_Rx: ComBitPosition=136, ComBitSize=15, ComSignalType=UINT16, ComHandleId=2703, ComSystemTemplateSystemSignalRef=DET_RANGE_126_Rx
            DET_RCS_128_Rx_oRDR_FUSION_DET_125_128_oPCAN_RADAR_462a2c2c_Rx: ComBitPosition=464, ComBitSize=8, ComSignalType=UINT8, ComHandleId=2721, ComSystemTemplateSystemSignalRef=DET_RCS_128_Rx
            DET_AZIMUTH_ERR_127_Rx_oRDR_FUSION_DET_125_128_oPCAN_RADAR_c7f5b2c4_Rx: ComBitPosition=329, ComBitSize=7, ComSignalType=UINT8, ComHandleId=2653, ComSystemTemplateSystemSignalRef=DET_AZIMUTH_ERR_127_Rx
            DET_ELEVATION_ERR_125_Rx_oRDR_FUSION_DET_125_128_oPCAN_RADAR_60e2c1da_Rx: ComBitPosition=80, ComBitSize=6, ComSignalType=UINT8, ComHandleId=2675, ComSystemTemplateSystemSignalRef=DET_ELEVATION_ERR_125_Rx
            DET_RANGE_VELOCITY_ERR_125_Rx_oRDR_FUSION_DET_125_128_oPCAN_RADAR_17339e92_Rx: ComBitPosition=64, ComBitSize=8, ComSignalType=UINT8, ComHandleId=2714, ComSystemTemplateSystemSignalRef=DET_RANGE_VELOCITY_ERR_125_Rx
            DET_ELEVATION_128_Rx_oRDR_FUSION_DET_125_128_oPCAN_RADAR_b7edb362_Rx: ComBitPosition=408, ComBitSize=8, ComSignalType=UINT8, ComHandleId=2674, ComSystemTemplateSystemSignalRef=DET_ELEVATION_128_Rx
            DET_BELOW_RAIN_THOLD_128_Rx_oRDR_FUSION_DET_125_128_oPCAN_RADAR_23689e5b_Rx: ComBitPosition=375, ComBitSize=1, ComSignalType=BOOLEAN, ComHandleId=2658, ComSystemTemplateSystemSignalRef=DET_BELOW_RAIN_THOLD_128_Rx
            DET_RANGE_127_Rx_oRDR_FUSION_DET_125_128_oPCAN_RADAR_d65a4f61_Rx: ComBitPosition=248, ComBitSize=15, ComSignalType=UINT16, ComHandleId=2704, ComSystemTemplateSystemSignalRef=DET_RANGE_127_Rx
            DET_RANGE_ERR_128_Rx_oRDR_FUSION_DET_125_128_oPCAN_RADAR_06e6b129_Rx: ComBitPosition=376, ComBitSize=7, ComSignalType=UINT8, ComHandleId=2709, ComSystemTemplateSystemSignalRef=DET_RANGE_ERR_128_Rx
            DET_MH_CRC16_125_128_Rx_oRDR_FUSION_DET_125_128_oPCAN_RADAR_5740f024_Rx: ComBitPosition=0, ComBitSize=16, ComSignalType=UINT16, ComHandleId=2691, ComSystemTemplateSystemSignalRef=DET_MH_CRC16_125_128_Rx
            DET_RCS_127_Rx_oRDR_FUSION_DET_125_128_oPCAN_RADAR_c6645e84_Rx: ComBitPosition=352, ComBitSize=8, ComSignalType=UINT8, ComHandleId=2720, ComSystemTemplateSystemSignalRef=DET_RCS_127_Rx
            DET_MTD_127_Rx_oRDR_FUSION_DET_125_128_oPCAN_RADAR_479eb9f7_Rx: ComBitPosition=271, ComBitSize=1, ComSignalType=BOOLEAN, ComHandleId=2696, ComSystemTemplateSystemSignalRef=DET_MTD_127_Rx
            DET_RANGE_128_Rx_oRDR_FUSION_DET_125_128_oPCAN_RADAR_56143dc9_Rx: ComBitPosition=360, ComBitSize=15, ComSignalType=UINT16, ComHandleId=2705, ComSystemTemplateSystemSignalRef=DET_RANGE_128_Rx
            DET_PROB_1STAZHYPO_126_Rx_oRDR_FUSION_DET_125_128_oPCAN_RADAR_22a33531_Rx: ComBitPosition=215, ComBitSize=1, ComSignalType=BOOLEAN, ComHandleId=2699, ComSystemTemplateSystemSignalRef=DET_PROB_1STAZHYPO_126_Rx
            DET_HVC_FLAG_128_Rx_oRDR_FUSION_DET_125_128_oPCAN_RADAR_4f920467_Rx: ComBitPosition=422, ComBitSize=1, ComSignalType=BOOLEAN, ComHandleId=2686, ComSystemTemplateSystemSignalRef=DET_HVC_FLAG_128_Rx
            DET_CONFD_AZIMUTH_126_Rx_oRDR_FUSION_DET_125_128_oPCAN_RADAR_98953ff3_Rx: ComBitPosition=230, ComBitSize=2, ComSignalType=UINT8, ComHandleId=2664, ComSystemTemplateSystemSignalRef=DET_CONFD_AZIMUTH_126_Rx
            DET_EXISTENCE_PROB_125_Rx_oRDR_FUSION_DET_125_128_oPCAN_RADAR_97fab94f_Rx: ComBitPosition=112, ComBitSize=6, ComSignalType=UINT8, ComHandleId=2679, ComSystemTemplateSystemSignalRef=DET_EXISTENCE_PROB_125_Rx
            DET_BELOW_RAIN_THOLD_127_Rx_oRDR_FUSION_DET_125_128_oPCAN_RADAR_a326ecf3_Rx: ComBitPosition=263, ComBitSize=1, ComSignalType=BOOLEAN, ComHandleId=2657, ComSystemTemplateSystemSignalRef=DET_BELOW_RAIN_THOLD_127_Rx
            DET_IDM_126_Rx_oRDR_FUSION_DET_125_128_oPCAN_RADAR_55591dc0_Rx: ComBitPosition=175, ComBitSize=1, ComSignalType=BOOLEAN, ComHandleId=2688, ComSystemTemplateSystemSignalRef=DET_IDM_126_Rx
            DET_RANGE_VELOCITY_126_Rx_oRDR_FUSION_DET_125_128_oPCAN_RADAR_a4eb5ed8_Rx: ComBitPosition=160, ComBitSize=15, ComSignalType=UINT16, ComHandleId=2711, ComSystemTemplateSystemSignalRef=DET_RANGE_VELOCITY_126_Rx
            DET_HVC_FLAG_125_Rx_oRDR_FUSION_DET_125_128_oPCAN_RADAR_4a245400_Rx: ComBitPosition=86, ComBitSize=1, ComSignalType=BOOLEAN, ComHandleId=2683, ComSystemTemplateSystemSignalRef=DET_HVC_FLAG_125_Rx
            DET_MTD_125_Rx_oRDR_FUSION_DET_125_128_oPCAN_RADAR_c2669b38_Rx: ComBitPosition=47, ComBitSize=1, ComSignalType=BOOLEAN, ComHandleId=2694, ComSystemTemplateSystemSignalRef=DET_MTD_125_Rx
            DET_EXISTENCE_PROB_127_Rx_oRDR_FUSION_DET_125_128_oPCAN_RADAR_12029b80_Rx: ComBitPosition=336, ComBitSize=6, ComSignalType=UINT8, ComHandleId=2681, ComSystemTemplateSystemSignalRef=DET_EXISTENCE_PROB_127_Rx
            DET_BI_STATIC_FLAG_125_Rx_oRDR_FUSION_DET_125_128_oPCAN_RADAR_5140652f_Rx: ComBitPosition=104, ComBitSize=1, ComSignalType=BOOLEAN, ComHandleId=2659, ComSystemTemplateSystemSignalRef=DET_BI_STATIC_FLAG_125_Rx
            DET_HVC_FLAG_127_Rx_oRDR_FUSION_DET_125_128_oPCAN_RADAR_cfdc76cf_Rx: ComBitPosition=310, ComBitSize=1, ComSignalType=BOOLEAN, ComHandleId=2685, ComSystemTemplateSystemSignalRef=DET_HVC_FLAG_127_Rx
            DET_ELEVATION_127_Rx_oRDR_FUSION_DET_125_128_oPCAN_RADAR_37a3c1ca_Rx: ComBitPosition=296, ComBitSize=8, ComSignalType=UINT8, ComHandleId=2673, ComSystemTemplateSystemSignalRef=DET_ELEVATION_127_Rx
            DET_RANGE_ERR_125_Rx_oRDR_FUSION_DET_125_128_oPCAN_RADAR_0350e14e_Rx: ComBitPosition=40, ComBitSize=7, ComSignalType=UINT8, ComHandleId=2706, ComSystemTemplateSystemSignalRef=DET_RANGE_ERR_125_Rx
            DET_CONFD_ELEVATION_128_Rx_oRDR_FUSION_DET_125_128_oPCAN_RADAR_bdbe5c9b_Rx: ComBitPosition=437, ComBitSize=2, ComSignalType=UINT8, ComHandleId=2670, ComSystemTemplateSystemSignalRef=DET_CONFD_ELEVATION_128_Rx
            DET_CONFD_ELEVATION_127_Rx_oRDR_FUSION_DET_125_128_oPCAN_RADAR_3df02e33_Rx: ComBitPosition=325, ComBitSize=2, ComSignalType=UINT8, ComHandleId=2669, ComSystemTemplateSystemSignalRef=DET_CONFD_ELEVATION_127_Rx
            DET_RANGE_VELOCITY_125_Rx_oRDR_FUSION_DET_125_128_oPCAN_RADAR_8e57ee50_Rx: ComBitPosition=48, ComBitSize=15, ComSignalType=UINT16, ComHandleId=2710, ComSystemTemplateSystemSignalRef=DET_RANGE_VELOCITY_125_Rx
            DET_IDM_127_Rx_oRDR_FUSION_DET_125_128_oPCAN_RADAR_fa1d8f87_Rx: ComBitPosition=287, ComBitSize=1, ComSignalType=BOOLEAN, ComHandleId=2689, ComSystemTemplateSystemSignalRef=DET_IDM_127_Rx
            DET_AZIMUTH_128_Rx_oRDR_FUSION_DET_125_128_oPCAN_RADAR_45d261ee_Rx: ComBitPosition=424, ComBitSize=13, ComSignalType=UINT16, ComHandleId=2650, ComSystemTemplateSystemSignalRef=DET_AZIMUTH_128_Rx
            DET_BI_STATIC_FLAG_128_Rx_oRDR_FUSION_DET_125_128_oPCAN_RADAR_54f63548_Rx: ComBitPosition=440, ComBitSize=1, ComSignalType=BOOLEAN, ComHandleId=2662, ComSystemTemplateSystemSignalRef=DET_BI_STATIC_FLAG_128_Rx
            DET_RANGE_VELOCITY_128_Rx_oRDR_FUSION_DET_125_128_oPCAN_RADAR_8be1be37_Rx: ComBitPosition=384, ComBitSize=15, ComSignalType=UINT16, ComHandleId=2713, ComSystemTemplateSystemSignalRef=DET_RANGE_VELOCITY_128_Rx
        SG_Fusion_Detections_029_032_oRDR_FUSION_DET_029_032_oPCAN_RADAR_3868beb2_Rx: ComHandleId=15, ComSystemTemplateSignalGroupRef=SG_Fusion_Detections_029_032
          83 x ComGroupSignal, all with ComSignalEndianness=LITTLE_ENDIAN, ComSignalInitValue=0, ComSignalAccess=ACCESS_NEEDED_BY_SWC_OR_COM:
            DET_EXISTENCE_PROB_030_Rx_oRDR_FUSION_DET_029_032_oPCAN_RADAR_fd40c829_Rx: ComBitPosition=224, ComBitSize=6, ComSignalType=UINT8, ComHandleId=688, ComSystemTemplateSystemSignalRef=DET_EXISTENCE_PROB_030_Rx
            DET_RANGE_VELOCITY_032_Rx_oRDR_FUSION_DET_029_032_oPCAN_RADAR_6115bdf9_Rx: ComBitPosition=384, ComBitSize=15, ComSignalType=UINT16, ComHandleId=721, ComSystemTemplateSystemSignalRef=DET_RANGE_VELOCITY_032_Rx
            DET_AZIMUTH_ERR_031_Rx_oRDR_FUSION_DET_029_032_oPCAN_RADAR_87f3732a_Rx: ComBitPosition=329, ComBitSize=7, ComSignalType=UINT8, ComHandleId=661, ComSystemTemplateSystemSignalRef=DET_AZIMUTH_ERR_031_Rx
            DET_CONFD_AZIMUTH_029_Rx_oRDR_FUSION_DET_029_032_oPCAN_RADAR_e5b37d04_Rx: ComBitPosition=118, ComBitSize=2, ComSignalType=UINT8, ComHandleId=671, ComSystemTemplateSystemSignalRef=DET_CONFD_AZIMUTH_029_Rx
            DET_ELEVATION_ERR_031_Rx_oRDR_FUSION_DET_029_032_oPCAN_RADAR_a51c22fb_Rx: ComBitPosition=304, ComBitSize=6, ComSignalType=UINT8, ComHandleId=685, ComSystemTemplateSystemSignalRef=DET_ELEVATION_ERR_031_Rx
            DET_RANGE_029_Rx_oRDR_FUSION_DET_029_032_oPCAN_RADAR_04389fd1_Rx: ComBitPosition=24, ComBitSize=15, ComSignalType=UINT16, ComHandleId=710, ComSystemTemplateSystemSignalRef=DET_RANGE_029_Rx
            DET_AZIMUTH_ERR_029_Rx_oRDR_FUSION_DET_029_032_oPCAN_RADAR_15976274_Rx: ComBitPosition=105, ComBitSize=7, ComSignalType=UINT8, ComHandleId=659, ComSystemTemplateSystemSignalRef=DET_AZIMUTH_ERR_029_Rx
            DET_IDM_031_Rx_oRDR_FUSION_DET_029_032_oPCAN_RADAR_ba1b4e69_Rx: ComBitPosition=287, ComBitSize=1, ComSignalType=BOOLEAN, ComHandleId=697, ComSystemTemplateSystemSignalRef=DET_IDM_031_Rx
            DET_AZIMUTH_ERR_030_Rx_oRDR_FUSION_DET_029_032_oPCAN_RADAR_28b7e16d_Rx: ComBitPosition=217, ComBitSize=7, ComSignalType=UINT8, ComHandleId=660, ComSystemTemplateSystemSignalRef=DET_AZIMUTH_ERR_030_Rx
            DET_HVC_FLAG_031_Rx_oRDR_FUSION_DET_029_032_oPCAN_RADAR_8fdab721_Rx: ComBitPosition=310, ComBitSize=1, ComSignalType=BOOLEAN, ComHandleId=693, ComSystemTemplateSystemSignalRef=DET_HVC_FLAG_031_Rx
            DET_PROB_1STAZHYPO_032_Rx_oRDR_FUSION_DET_029_032_oPCAN_RADAR_e75dd610_Rx: ComBitPosition=439, ComBitSize=1, ComSignalType=BOOLEAN, ComHandleId=709, ComSystemTemplateSystemSignalRef=DET_PROB_1STAZHYPO_032_Rx
            DET_SUPER_RES_TARGET_029_Rx_oRDR_FUSION_DET_029_032_oPCAN_RADAR_d6a7dedd_Rx: ComBitPosition=87, ComBitSize=1, ComSignalType=BOOLEAN, ComHandleId=734, ComSystemTemplateSystemSignalRef=DET_SUPER_RES_TARGET_029_Rx
            DET_RANGE_VELOCITY_029_Rx_oRDR_FUSION_DET_029_032_oPCAN_RADAR_d9cd1c2f_Rx: ComBitPosition=48, ComBitSize=15, ComSignalType=UINT16, ComHandleId=718, ComSystemTemplateSystemSignalRef=DET_RANGE_VELOCITY_029_Rx
            DET_AZIMUTH_029_Rx_oRDR_FUSION_DET_029_032_oPCAN_RADAR_17fec3f6_Rx: ComBitPosition=88, ComBitSize=13, ComSignalType=UINT16, ComHandleId=655, ComSystemTemplateSystemSignalRef=DET_AZIMUTH_029_Rx
            DET_BELOW_RAIN_THOLD_029_Rx_oRDR_FUSION_DET_029_032_oPCAN_RADAR_71443c43_Rx: ComBitPosition=39, ComBitSize=1, ComSignalType=BOOLEAN, ComHandleId=663, ComSystemTemplateSystemSignalRef=DET_BELOW_RAIN_THOLD_029_Rx
            DET_ELEVATION_ERR_032_Rx_oRDR_FUSION_DET_029_032_oPCAN_RADAR_8fa09273_Rx: ComBitPosition=416, ComBitSize=6, ComSignalType=UINT8, ComHandleId=686, ComSystemTemplateSystemSignalRef=DET_ELEVATION_ERR_032_Rx
            DET_BI_STATIC_FLAG_029_Rx_oRDR_FUSION_DET_029_032_oPCAN_RADAR_06da9750_Rx: ComBitPosition=104, ComBitSize=1, ComSignalType=BOOLEAN, ComHandleId=667, ComSystemTemplateSystemSignalRef=DET_BI_STATIC_FLAG_029_Rx
            DET_ELEVATION_031_Rx_oRDR_FUSION_DET_029_032_oPCAN_RADAR_77a50024_Rx: ComBitPosition=296, ComBitSize=8, ComSignalType=UINT8, ComHandleId=681, ComSystemTemplateSystemSignalRef=DET_ELEVATION_031_Rx
            DET_IDM_030_Rx_oRDR_FUSION_DET_029_032_oPCAN_RADAR_155fdc2e_Rx: ComBitPosition=175, ComBitSize=1, ComSignalType=BOOLEAN, ComHandleId=696, ComSystemTemplateSystemSignalRef=DET_IDM_030_Rx
            DET_PROB_1STAZHYPO_031_Rx_oRDR_FUSION_DET_029_032_oPCAN_RADAR_cde16698_Rx: ComBitPosition=327, ComBitSize=1, ComSignalType=BOOLEAN, ComHandleId=708, ComSystemTemplateSystemSignalRef=DET_PROB_1STAZHYPO_031_Rx
            DET_ELEVATION_029_Rx_oRDR_FUSION_DET_029_032_oPCAN_RADAR_e5c1117a_Rx: ComBitPosition=72, ComBitSize=8, ComSignalType=UINT8, ComHandleId=679, ComSystemTemplateSystemSignalRef=DET_ELEVATION_029_Rx
            DET_MH_SCAN_INDEX_4LSB_029_032_Rx_oRDR_FUSION_DET_029_032_oPCAN_RADAR_8986be5e_Rx: ComBitPosition=476, ComBitSize=4, ComSignalType=UINT8, ComHandleId=701, ComSystemTemplateSystemSignalRef=DET_MH_SCAN_INDEX_4LSB_029_032_Rx
            DET_BI_STATIC_FLAG_032_Rx_oRDR_FUSION_DET_029_032_oPCAN_RADAR_be023686_Rx: ComBitPosition=440, ComBitSize=1, ComSignalType=BOOLEAN, ComHandleId=670, ComSystemTemplateSystemSignalRef=DET_BI_STATIC_FLAG_032_Rx
            DET_SUPER_RES_TARGET_031_Rx_oRDR_FUSION_DET_029_032_oPCAN_RADAR_44c3cf83_Rx: ComBitPosition=311, ComBitSize=1, ComSignalType=BOOLEAN, ComHandleId=736, ComSystemTemplateSystemSignalRef=DET_SUPER_RES_TARGET_031_Rx
            DET_PROB_1STAZHYPO_029_Rx_oRDR_FUSION_DET_029_032_oPCAN_RADAR_5f8577c6_Rx: ComBitPosition=103, ComBitSize=1, ComSignalType=BOOLEAN, ComHandleId=706, ComSystemTemplateSystemSignalRef=DET_PROB_1STAZHYPO_029_Rx
            DET_RANGE_032_Rx_oRDR_FUSION_DET_029_032_oPCAN_RADAR_bce03e07_Rx: ComBitPosition=360, ComBitSize=15, ComSignalType=UINT16, ComHandleId=713, ComSystemTemplateSystemSignalRef=DET_RANGE_032_Rx
            DET_MTD_032_Rx_oRDR_FUSION_DET_029_032_oPCAN_RADAR_2d24c891_Rx: ComBitPosition=383, ComBitSize=1, ComSignalType=BOOLEAN, ComHandleId=705, ComSystemTemplateSystemSignalRef=DET_MTD_032_Rx
            DET_RCS_029_Rx_oRDR_FUSION_DET_029_032_oPCAN_RADAR_14068e34_Rx: ComBitPosition=128, ComBitSize=8, ComSignalType=UINT8, ComHandleId=726, ComSystemTemplateSystemSignalRef=DET_RCS_029_Rx
            DET_BELOW_RAIN_THOLD_030_Rx_oRDR_FUSION_DET_029_032_oPCAN_RADAR_4c64bf5a_Rx: ComBitPosition=151, ComBitSize=1, ComSignalType=BOOLEAN, ComHandleId=664, ComSystemTemplateSystemSignalRef=DET_BELOW_RAIN_THOLD_030_Rx
            DET_PROB_1STAZHYPO_030_Rx_oRDR_FUSION_DET_029_032_oPCAN_RADAR_62a5f4df_Rx: ComBitPosition=215, ComBitSize=1, ComSignalType=BOOLEAN, ComHandleId=707, ComSystemTemplateSystemSignalRef=DET_PROB_1STAZHYPO_030_Rx
            DET_RANGE_VELOCITY_ERR_031_Rx_oRDR_FUSION_DET_029_032_oPCAN_RADAR_d2cd7db3_Rx: ComBitPosition=288, ComBitSize=8, ComSignalType=UINT8, ComHandleId=724, ComSystemTemplateSystemSignalRef=DET_RANGE_VELOCITY_ERR_031_Rx
            DET_RANGE_VELOCITY_ERR_030_Rx_oRDR_FUSION_DET_029_032_oPCAN_RADAR_7d89eff4_Rx: ComBitPosition=176, ComBitSize=8, ComSignalType=UINT8, ComHandleId=723, ComSystemTemplateSystemSignalRef=DET_RANGE_VELOCITY_ERR_030_Rx
            DET_BI_STATIC_FLAG_031_Rx_oRDR_FUSION_DET_029_032_oPCAN_RADAR_94be860e_Rx: ComBitPosition=328, ComBitSize=1, ComSignalType=BOOLEAN, ComHandleId=669, ComSystemTemplateSystemSignalRef=DET_BI_STATIC_FLAG_031_Rx
            DET_CONFD_ELEVATION_029_Rx_oRDR_FUSION_DET_029_032_oPCAN_RADAR_ef92fe83_Rx: ComBitPosition=101, ComBitSize=2, ComSignalType=UINT8, ComHandleId=675, ComSystemTemplateSystemSignalRef=DET_CONFD_ELEVATION_029_Rx
            DET_EXISTENCE_PROB_031_Rx_oRDR_FUSION_DET_029_032_oPCAN_RADAR_52045a6e_Rx: ComBitPosition=336, ComBitSize=6, ComSignalType=UINT8, ComHandleId=689, ComSystemTemplateSystemSignalRef=DET_EXISTENCE_PROB_031_Rx
            DET_ELEVATION_032_Rx_oRDR_FUSION_DET_029_032_oPCAN_RADAR_5d19b0ac_Rx: ComBitPosition=408, ComBitSize=8, ComSignalType=UINT8, ComHandleId=682, ComSystemTemplateSystemSignalRef=DET_ELEVATION_032_Rx
            DET_ELEVATION_ERR_029_Rx_oRDR_FUSION_DET_029_032_oPCAN_RADAR_377833a5_Rx: ComBitPosition=80, ComBitSize=6, ComSignalType=UINT8, ComHandleId=683, ComSystemTemplateSystemSignalRef=DET_ELEVATION_ERR_029_Rx
            DET_SNR_030_Rx_oRDR_FUSION_DET_029_032_oPCAN_RADAR_207c7cc4_Rx: ComBitPosition=232, ComBitSize=8, ComSignalType=UINT8, ComHandleId=731, ComSystemTemplateSystemSignalRef=DET_SNR_030_Rx
            DET_CONFD_AZIMUTH_030_Rx_oRDR_FUSION_DET_029_032_oPCAN_RADAR_d893fe1d_Rx: ComBitPosition=230, ComBitSize=2, ComSignalType=UINT8, ComHandleId=672, ComSystemTemplateSystemSignalRef=DET_CONFD_AZIMUTH_030_Rx
            DET_SUPER_RES_TARGET_030_Rx_oRDR_FUSION_DET_029_032_oPCAN_RADAR_eb875dc4_Rx: ComBitPosition=199, ComBitSize=1, ComSignalType=BOOLEAN, ComHandleId=735, ComSystemTemplateSystemSignalRef=DET_SUPER_RES_TARGET_030_Rx
            DET_AZIMUTH_032_Rx_oRDR_FUSION_DET_029_032_oPCAN_RADAR_af266220_Rx: ComBitPosition=424, ComBitSize=13, ComSignalType=UINT16, ComHandleId=658, ComSystemTemplateSystemSignalRef=DET_AZIMUTH_032_Rx
            DET_BI_STATIC_FLAG_030_Rx_oRDR_FUSION_DET_029_032_oPCAN_RADAR_3bfa1449_Rx: ComBitPosition=216, ComBitSize=1, ComSignalType=BOOLEAN, ComHandleId=668, ComSystemTemplateSystemSignalRef=DET_BI_STATIC_FLAG_030_Rx
            DET_CONFD_ELEVATION_032_Rx_oRDR_FUSION_DET_029_032_oPCAN_RADAR_574a5f55_Rx: ComBitPosition=437, ComBitSize=2, ComSignalType=UINT8, ComHandleId=678, ComSystemTemplateSystemSignalRef=DET_CONFD_ELEVATION_032_Rx
            DET_RCS_031_Rx_oRDR_FUSION_DET_029_032_oPCAN_RADAR_86629f6a_Rx: ComBitPosition=352, ComBitSize=8, ComSignalType=UINT8, ComHandleId=728, ComSystemTemplateSystemSignalRef=DET_RCS_031_Rx
            DET_AZIMUTH_030_Rx_oRDR_FUSION_DET_029_032_oPCAN_RADAR_2ade40ef_Rx: ComBitPosition=200, ComBitSize=13, ComSignalType=UINT16, ComHandleId=656, ComSystemTemplateSystemSignalRef=DET_AZIMUTH_030_Rx
            DET_HVC_FLAG_030_Rx_oRDR_FUSION_DET_029_032_oPCAN_RADAR_209e2566_Rx: ComBitPosition=198, ComBitSize=1, ComSignalType=BOOLEAN, ComHandleId=692, ComSystemTemplateSystemSignalRef=DET_HVC_FLAG_030_Rx
            DET_SNR_032_Rx_oRDR_FUSION_DET_029_032_oPCAN_RADAR_a5845e0b_Rx: ComBitPosition=456, ComBitSize=8, ComSignalType=UINT8, ComHandleId=733, ComSystemTemplateSystemSignalRef=DET_SNR_032_Rx
            DET_BELOW_RAIN_THOLD_031_Rx_oRDR_FUSION_DET_029_032_oPCAN_RADAR_e3202d1d_Rx: ComBitPosition=263, ComBitSize=1, ComSignalType=BOOLEAN, ComHandleId=665, ComSystemTemplateSystemSignalRef=DET_BELOW_RAIN_THOLD_031_Rx
            DET_RANGE_VELOCITY_031_Rx_oRDR_FUSION_DET_029_032_oPCAN_RADAR_4ba90d71_Rx: ComBitPosition=272, ComBitSize=15, ComSignalType=UINT16, ComHandleId=720, ComSystemTemplateSystemSignalRef=DET_RANGE_VELOCITY_031_Rx
            DET_AZIMUTH_031_Rx_oRDR_FUSION_DET_029_032_oPCAN_RADAR_859ad2a8_Rx: ComBitPosition=312, ComBitSize=13, ComSignalType=UINT16, ComHandleId=657, ComSystemTemplateSystemSignalRef=DET_AZIMUTH_031_Rx
            DET_RCS_032_Rx_oRDR_FUSION_DET_029_032_oPCAN_RADAR_acde2fe2_Rx: ComBitPosition=464, ComBitSize=8, ComSignalType=UINT8, ComHandleId=729, ComSystemTemplateSystemSignalRef=DET_RCS_032_Rx
            DET_RANGE_031_Rx_oRDR_FUSION_DET_029_032_oPCAN_RADAR_965c8e8f_Rx: ComBitPosition=248, ComBitSize=15, ComSignalType=UINT16, ComHandleId=712, ComSystemTemplateSystemSignalRef=DET_RANGE_031_Rx
            DET_HVC_FLAG_029_Rx_oRDR_FUSION_DET_029_032_oPCAN_RADAR_1dbea67f_Rx: ComBitPosition=86, ComBitSize=1, ComSignalType=BOOLEAN, ComHandleId=691, ComSystemTemplateSystemSignalRef=DET_HVC_FLAG_029_Rx
            DET_CONFD_ELEVATION_031_Rx_oRDR_FUSION_DET_029_032_oPCAN_RADAR_7df6efdd_Rx: ComBitPosition=325, ComBitSize=2, ComSignalType=UINT8, ComHandleId=677, ComSystemTemplateSystemSignalRef=DET_CONFD_ELEVATION_031_Rx
            DET_CONFD_AZIMUTH_031_Rx_oRDR_FUSION_DET_029_032_oPCAN_RADAR_77d76c5a_Rx: ComBitPosition=342, ComBitSize=2, ComSignalType=UINT8, ComHandleId=673, ComSystemTemplateSystemSignalRef=DET_CONFD_AZIMUTH_031_Rx
            DET_EXISTENCE_PROB_032_Rx_oRDR_FUSION_DET_029_032_oPCAN_RADAR_78b8eae6_Rx: ComBitPosition=448, ComBitSize=6, ComSignalType=UINT8, ComHandleId=690, ComSystemTemplateSystemSignalRef=DET_EXISTENCE_PROB_032_Rx
            DET_RANGE_ERR_030_Rx_oRDR_FUSION_DET_029_032_oPCAN_RADAR_69ea9028_Rx: ComBitPosition=152, ComBitSize=7, ComSignalType=UINT8, ComHandleId=715, ComSystemTemplateSystemSignalRef=DET_RANGE_ERR_030_Rx
            DET_SNR_031_Rx_oRDR_FUSION_DET_029_032_oPCAN_RADAR_8f38ee83_Rx: ComBitPosition=344, ComBitSize=8, ComSignalType=UINT8, ComHandleId=732, ComSystemTemplateSystemSignalRef=DET_SNR_031_Rx
            DET_ELEVATION_ERR_030_Rx_oRDR_FUSION_DET_029_032_oPCAN_RADAR_0a58b0bc_Rx: ComBitPosition=192, ComBitSize=6, ComSignalType=UINT8, ComHandleId=684, ComSystemTemplateSystemSignalRef=DET_ELEVATION_ERR_030_Rx
            DET_RANGE_VELOCITY_ERR_029_Rx_oRDR_FUSION_DET_029_032_oPCAN_RADAR_40a96ced_Rx: ComBitPosition=64, ComBitSize=8, ComSignalType=UINT8, ComHandleId=722, ComSystemTemplateSystemSignalRef=DET_RANGE_VELOCITY_ERR_029_Rx
            DET_EXISTENCE_PROB_029_Rx_oRDR_FUSION_DET_029_032_oPCAN_RADAR_c0604b30_Rx: ComBitPosition=112, ComBitSize=6, ComSignalType=UINT8, ComHandleId=687, ComSystemTemplateSystemSignalRef=DET_EXISTENCE_PROB_029_Rx
            DET_MTD_029_Rx_oRDR_FUSION_DET_029_032_oPCAN_RADAR_95fc6947_Rx: ComBitPosition=47, ComBitSize=1, ComSignalType=BOOLEAN, ComHandleId=702, ComSystemTemplateSystemSignalRef=DET_MTD_029_Rx
            DET_RANGE_VELOCITY_030_Rx_oRDR_FUSION_DET_029_032_oPCAN_RADAR_e4ed9f36_Rx: ComBitPosition=160, ComBitSize=15, ComSignalType=UINT16, ComHandleId=719, ComSystemTemplateSystemSignalRef=DET_RANGE_VELOCITY_030_Rx
            DET_SNR_029_Rx_oRDR_FUSION_DET_029_032_oPCAN_RADAR_1d5cffdd_Rx: ComBitPosition=120, ComBitSize=8, ComSignalType=UINT8, ComHandleId=730, ComSystemTemplateSystemSignalRef=DET_SNR_029_Rx
            DET_MTD_030_Rx_oRDR_FUSION_DET_029_032_oPCAN_RADAR_a8dcea5e_Rx: ComBitPosition=159, ComBitSize=1, ComSignalType=BOOLEAN, ComHandleId=703, ComSystemTemplateSystemSignalRef=DET_MTD_030_Rx
            DET_RANGE_ERR_031_Rx_oRDR_FUSION_DET_029_032_oPCAN_RADAR_c6ae026f_Rx: ComBitPosition=264, ComBitSize=7, ComSignalType=UINT8, ComHandleId=716, ComSystemTemplateSystemSignalRef=DET_RANGE_ERR_031_Rx
            DET_ELEVATION_030_Rx_oRDR_FUSION_DET_029_032_oPCAN_RADAR_d8e19263_Rx: ComBitPosition=184, ComBitSize=8, ComSignalType=UINT8, ComHandleId=680, ComSystemTemplateSystemSignalRef=DET_ELEVATION_030_Rx
            DET_RANGE_ERR_029_Rx_oRDR_FUSION_DET_029_032_oPCAN_RADAR_54ca1331_Rx: ComBitPosition=40, ComBitSize=7, ComSignalType=UINT8, ComHandleId=714, ComSystemTemplateSystemSignalRef=DET_RANGE_ERR_029_Rx
            DET_CONFD_ELEVATION_030_Rx_oRDR_FUSION_DET_029_032_oPCAN_RADAR_d2b27d9a_Rx: ComBitPosition=213, ComBitSize=2, ComSignalType=UINT8, ComHandleId=676, ComSystemTemplateSystemSignalRef=DET_CONFD_ELEVATION_030_Rx
            DET_RANGE_ERR_032_Rx_oRDR_FUSION_DET_029_032_oPCAN_RADAR_ec12b2e7_Rx: ComBitPosition=376, ComBitSize=7, ComSignalType=UINT8, ComHandleId=717, ComSystemTemplateSystemSignalRef=DET_RANGE_ERR_032_Rx
            DET_IDM_029_Rx_oRDR_FUSION_DET_029_032_oPCAN_RADAR_287f5f37_Rx: ComBitPosition=63, ComBitSize=1, ComSignalType=BOOLEAN, ComHandleId=695, ComSystemTemplateSystemSignalRef=DET_IDM_029_Rx
            DET_MH_CRC16_029_032_Rx_oRDR_FUSION_DET_029_032_oPCAN_RADAR_e0ed4ca0_Rx: ComBitPosition=0, ComBitSize=16, ComSignalType=UINT16, ComHandleId=699, ComSystemTemplateSystemSignalRef=DET_MH_CRC16_029_032_Rx
            DET_MTD_031_Rx_oRDR_FUSION_DET_029_032_oPCAN_RADAR_07987819_Rx: ComBitPosition=271, ComBitSize=1, ComSignalType=BOOLEAN, ComHandleId=704, ComSystemTemplateSystemSignalRef=DET_MTD_031_Rx
            DET_IDM_032_Rx_oRDR_FUSION_DET_029_032_oPCAN_RADAR_90a7fee1_Rx: ComBitPosition=399, ComBitSize=1, ComSignalType=BOOLEAN, ComHandleId=698, ComSystemTemplateSystemSignalRef=DET_IDM_032_Rx
            DET_RANGE_VELOCITY_ERR_032_Rx_oRDR_FUSION_DET_029_032_oPCAN_RADAR_f871cd3b_Rx: ComBitPosition=400, ComBitSize=8, ComSignalType=UINT8, ComHandleId=725, ComSystemTemplateSystemSignalRef=DET_RANGE_VELOCITY_ERR_032_Rx
            DET_CONFD_AZIMUTH_032_Rx_oRDR_FUSION_DET_029_032_oPCAN_RADAR_5d6bdcd2_Rx: ComBitPosition=454, ComBitSize=2, ComSignalType=UINT8, ComHandleId=674, ComSystemTemplateSystemSignalRef=DET_CONFD_AZIMUTH_032_Rx
            DET_RCS_030_Rx_oRDR_FUSION_DET_029_032_oPCAN_RADAR_29260d2d_Rx: ComBitPosition=240, ComBitSize=8, ComSignalType=UINT8, ComHandleId=727, ComSystemTemplateSystemSignalRef=DET_RCS_030_Rx
            DET_MH_CYCLE_COUNTER_029_032_Rx_oRDR_FUSION_DET_029_032_oPCAN_RADAR_ed367165_Rx: ComBitPosition=16, ComBitSize=8, ComSignalType=UINT8, ComHandleId=700, ComSystemTemplateSystemSignalRef=DET_MH_CYCLE_COUNTER_029_032_Rx
            DET_AZIMUTH_ERR_032_Rx_oRDR_FUSION_DET_029_032_oPCAN_RADAR_ad4fc3a2_Rx: ComBitPosition=441, ComBitSize=7, ComSignalType=UINT8, ComHandleId=662, ComSystemTemplateSystemSignalRef=DET_AZIMUTH_ERR_032_Rx
            DET_BELOW_RAIN_THOLD_032_Rx_oRDR_FUSION_DET_029_032_oPCAN_RADAR_c99c9d95_Rx: ComBitPosition=375, ComBitSize=1, ComSignalType=BOOLEAN, ComHandleId=666, ComSystemTemplateSystemSignalRef=DET_BELOW_RAIN_THOLD_032_Rx
            DET_SUPER_RES_TARGET_032_Rx_oRDR_FUSION_DET_029_032_oPCAN_RADAR_6e7f7f0b_Rx: ComBitPosition=423, ComBitSize=1, ComSignalType=BOOLEAN, ComHandleId=737, ComSystemTemplateSystemSignalRef=DET_SUPER_RES_TARGET_032_Rx
            DET_HVC_FLAG_032_Rx_oRDR_FUSION_DET_029_032_oPCAN_RADAR_a56607a9_Rx: ComBitPosition=422, ComBitSize=1, ComSignalType=BOOLEAN, ComHandleId=694, ComSystemTemplateSystemSignalRef=DET_HVC_FLAG_032_Rx
            DET_RANGE_030_Rx_oRDR_FUSION_DET_029_032_oPCAN_RADAR_39181cc8_Rx: ComBitPosition=136, ComBitSize=15, ComSignalType=UINT16, ComHandleId=711, ComSystemTemplateSystemSignalRef=DET_RANGE_030_Rx
        SG_Fusion_Detections_093_096_oRDR_FUSION_DET_093_096_oPCAN_RADAR_ebc9f7ef_Rx: ComHandleId=31, ComSystemTemplateSignalGroupRef=SG_Fusion_Detections_093_096
          83 x ComGroupSignal, all with ComSignalEndianness=LITTLE_ENDIAN, ComSignalInitValue=0, ComSignalAccess=ACCESS_NEEDED_BY_SWC_OR_COM:
            DET_CONFD_AZIMUTH_095_Rx_oRDR_FUSION_DET_093_096_oPCAN_RADAR_5c0588b0_Rx: ComBitPosition=342, ComBitSize=2, ComSignalType=UINT8, ComHandleId=2001, ComSystemTemplateSystemSignalRef=DET_CONFD_AZIMUTH_095_Rx
            DET_SUPER_RES_TARGET_093_Rx_oRDR_FUSION_DET_093_096_oPCAN_RADAR_3a684a79_Rx: ComBitPosition=87, ComBitSize=1, ComSignalType=BOOLEAN, ComHandleId=2062, ComSystemTemplateSystemSignalRef=DET_SUPER_RES_TARGET_093_Rx
            DET_RCS_093_Rx_oRDR_FUSION_DET_093_096_oPCAN_RADAR_f8c91a90_Rx: ComBitPosition=128, ComBitSize=8, ComSignalType=UINT8, ComHandleId=2054, ComSystemTemplateSystemSignalRef=DET_RCS_093_Rx
            DET_RANGE_VELOCITY_095_Rx_oRDR_FUSION_DET_093_096_oPCAN_RADAR_607be99b_Rx: ComBitPosition=272, ComBitSize=15, ComSignalType=UINT16, ComHandleId=2048, ComSystemTemplateSystemSignalRef=DET_RANGE_VELOCITY_095_Rx
            DET_BELOW_RAIN_THOLD_093_Rx_oRDR_FUSION_DET_093_096_oPCAN_RADAR_9d8ba8e7_Rx: ComBitPosition=39, ComBitSize=1, ComSignalType=BOOLEAN, ComHandleId=1991, ComSystemTemplateSystemSignalRef=DET_BELOW_RAIN_THOLD_093_Rx
            DET_HVC_FLAG_094_Rx_oRDR_FUSION_DET_093_096_oPCAN_RADAR_0b4cc18c_Rx: ComBitPosition=198, ComBitSize=1, ComSignalType=BOOLEAN, ComHandleId=2020, ComSystemTemplateSystemSignalRef=DET_HVC_FLAG_094_Rx
            DET_IDM_096_Rx_oRDR_FUSION_DET_093_096_oPCAN_RADAR_bb751a0b_Rx: ComBitPosition=399, ComBitSize=1, ComSignalType=BOOLEAN, ComHandleId=2026, ComSystemTemplateSystemSignalRef=DET_IDM_096_Rx
            DET_AZIMUTH_ERR_093_Rx_oRDR_FUSION_DET_093_096_oPCAN_RADAR_f958f6d0_Rx: ComBitPosition=105, ComBitSize=7, ComSignalType=UINT8, ComHandleId=1987, ComSystemTemplateSystemSignalRef=DET_AZIMUTH_ERR_093_Rx
            DET_AZIMUTH_ERR_094_Rx_oRDR_FUSION_DET_093_096_oPCAN_RADAR_03650587_Rx: ComBitPosition=217, ComBitSize=7, ComSignalType=UINT8, ComHandleId=1988, ComSystemTemplateSystemSignalRef=DET_AZIMUTH_ERR_094_Rx
            DET_RANGE_ERR_094_Rx_oRDR_FUSION_DET_093_096_oPCAN_RADAR_423874c2_Rx: ComBitPosition=152, ComBitSize=7, ComSignalType=UINT8, ComHandleId=2043, ComSystemTemplateSystemSignalRef=DET_RANGE_ERR_094_Rx
            DET_RANGE_VELOCITY_ERR_096_Rx_oRDR_FUSION_DET_093_096_oPCAN_RADAR_d3a329d1_Rx: ComBitPosition=400, ComBitSize=8, ComSignalType=UINT8, ComHandleId=2053, ComSystemTemplateSystemSignalRef=DET_RANGE_VELOCITY_ERR_096_Rx
            DET_CONFD_ELEVATION_096_Rx_oRDR_FUSION_DET_093_096_oPCAN_RADAR_7c98bbbf_Rx: ComBitPosition=437, ComBitSize=2, ComSignalType=UINT8, ComHandleId=2006, ComSystemTemplateSystemSignalRef=DET_CONFD_ELEVATION_096_Rx
            DET_CONFD_ELEVATION_093_Rx_oRDR_FUSION_DET_093_096_oPCAN_RADAR_035d6a27_Rx: ComBitPosition=101, ComBitSize=2, ComSignalType=UINT8, ComHandleId=2003, ComSystemTemplateSystemSignalRef=DET_CONFD_ELEVATION_093_Rx
            DET_AZIMUTH_094_Rx_oRDR_FUSION_DET_093_096_oPCAN_RADAR_010ca405_Rx: ComBitPosition=200, ComBitSize=13, ComSignalType=UINT16, ComHandleId=1984, ComSystemTemplateSystemSignalRef=DET_AZIMUTH_094_Rx
            DET_PROB_1STAZHYPO_093_Rx_oRDR_FUSION_DET_093_096_oPCAN_RADAR_b34ae362_Rx: ComBitPosition=103, ComBitSize=1, ComSignalType=BOOLEAN, ComHandleId=2034, ComSystemTemplateSystemSignalRef=DET_PROB_1STAZHYPO_093_Rx
            DET_RCS_095_Rx_oRDR_FUSION_DET_093_096_oPCAN_RADAR_adb07b80_Rx: ComBitPosition=352, ComBitSize=8, ComSignalType=UINT8, ComHandleId=2056, ComSystemTemplateSystemSignalRef=DET_RCS_095_Rx
            DET_BELOW_RAIN_THOLD_096_Rx_oRDR_FUSION_DET_093_096_oPCAN_RADAR_e24e797f_Rx: ComBitPosition=375, ComBitSize=1, ComSignalType=BOOLEAN, ComHandleId=1994, ComSystemTemplateSystemSignalRef=DET_BELOW_RAIN_THOLD_096_Rx
            DET_ELEVATION_094_Rx_oRDR_FUSION_DET_093_096_oPCAN_RADAR_f3337689_Rx: ComBitPosition=184, ComBitSize=8, ComSignalType=UINT8, ComHandleId=2008, ComSystemTemplateSystemSignalRef=DET_ELEVATION_094_Rx
            DET_MTD_094_Rx_oRDR_FUSION_DET_093_096_oPCAN_RADAR_830e0eb4_Rx: ComBitPosition=159, ComBitSize=1, ComSignalType=BOOLEAN, ComHandleId=2031, ComSystemTemplateSystemSignalRef=DET_MTD_094_Rx
            DET_SUPER_RES_TARGET_094_Rx_oRDR_FUSION_DET_093_096_oPCAN_RADAR_c055b92e_Rx: ComBitPosition=199, ComBitSize=1, ComSignalType=BOOLEAN, ComHandleId=2063, ComSystemTemplateSystemSignalRef=DET_SUPER_RES_TARGET_094_Rx
            DET_SUPER_RES_TARGET_096_Rx_oRDR_FUSION_DET_093_096_oPCAN_RADAR_45ad9be1_Rx: ComBitPosition=423, ComBitSize=1, ComSignalType=BOOLEAN, ComHandleId=2065, ComSystemTemplateSystemSignalRef=DET_SUPER_RES_TARGET_096_Rx
            DET_RANGE_VELOCITY_093_Rx_oRDR_FUSION_DET_093_096_oPCAN_RADAR_3502888b_Rx: ComBitPosition=48, ComBitSize=15, ComSignalType=UINT16, ComHandleId=2046, ComSystemTemplateSystemSignalRef=DET_RANGE_VELOCITY_093_Rx
            DET_SNR_096_Rx_oRDR_FUSION_DET_093_096_oPCAN_RADAR_8e56bae1_Rx: ComBitPosition=456, ComBitSize=8, ComSignalType=UINT8, ComHandleId=2061, ComSystemTemplateSystemSignalRef=DET_SNR_096_Rx
            DET_ELEVATION_096_Rx_oRDR_FUSION_DET_093_096_oPCAN_RADAR_76cb5446_Rx: ComBitPosition=408, ComBitSize=8, ComSignalType=UINT8, ComHandleId=2010, ComSystemTemplateSystemSignalRef=DET_ELEVATION_096_Rx
            DET_RCS_094_Rx_oRDR_FUSION_DET_093_096_oPCAN_RADAR_02f4e9c7_Rx: ComBitPosition=240, ComBitSize=8, ComSignalType=UINT8, ComHandleId=2055, ComSystemTemplateSystemSignalRef=DET_RCS_094_Rx
            DET_RANGE_VELOCITY_096_Rx_oRDR_FUSION_DET_093_096_oPCAN_RADAR_4ac75913_Rx: ComBitPosition=384, ComBitSize=15, ComSignalType=UINT16, ComHandleId=2049, ComSystemTemplateSystemSignalRef=DET_RANGE_VELOCITY_096_Rx
            DET_AZIMUTH_ERR_095_Rx_oRDR_FUSION_DET_093_096_oPCAN_RADAR_ac2197c0_Rx: ComBitPosition=329, ComBitSize=7, ComSignalType=UINT8, ComHandleId=1989, ComSystemTemplateSystemSignalRef=DET_AZIMUTH_ERR_095_Rx
            DET_BI_STATIC_FLAG_096_Rx_oRDR_FUSION_DET_093_096_oPCAN_RADAR_95d0d26c_Rx: ComBitPosition=440, ComBitSize=1, ComSignalType=BOOLEAN, ComHandleId=1998, ComSystemTemplateSystemSignalRef=DET_BI_STATIC_FLAG_096_Rx
            DET_EXISTENCE_PROB_096_Rx_oRDR_FUSION_DET_093_096_oPCAN_RADAR_536a0e0c_Rx: ComBitPosition=448, ComBitSize=6, ComSignalType=UINT8, ComHandleId=2018, ComSystemTemplateSystemSignalRef=DET_EXISTENCE_PROB_096_Rx
            DET_AZIMUTH_096_Rx_oRDR_FUSION_DET_093_096_oPCAN_RADAR_84f486ca_Rx: ComBitPosition=424, ComBitSize=13, ComSignalType=UINT16, ComHandleId=1986, ComSystemTemplateSystemSignalRef=DET_AZIMUTH_096_Rx
            DET_SNR_093_Rx_oRDR_FUSION_DET_093_096_oPCAN_RADAR_f1936b79_Rx: ComBitPosition=120, ComBitSize=8, ComSignalType=UINT8, ComHandleId=2058, ComSystemTemplateSystemSignalRef=DET_SNR_093_Rx
            DET_SNR_095_Rx_oRDR_FUSION_DET_093_096_oPCAN_RADAR_a4ea0a69_Rx: ComBitPosition=344, ComBitSize=8, ComSignalType=UINT8, ComHandleId=2060, ComSystemTemplateSystemSignalRef=DET_SNR_095_Rx
            DET_PROB_1STAZHYPO_094_Rx_oRDR_FUSION_DET_093_096_oPCAN_RADAR_49771035_Rx: ComBitPosition=215, ComBitSize=1, ComSignalType=BOOLEAN, ComHandleId=2035, ComSystemTemplateSystemSignalRef=DET_PROB_1STAZHYPO_094_Rx
            DET_RANGE_093_Rx_oRDR_FUSION_DET_093_096_oPCAN_RADAR_e8f70b75_Rx: ComBitPosition=24, ComBitSize=15, ComSignalType=UINT16, ComHandleId=2038, ComSystemTemplateSystemSignalRef=DET_RANGE_093_Rx
            DET_IDM_095_Rx_oRDR_FUSION_DET_093_096_oPCAN_RADAR_91c9aa83_Rx: ComBitPosition=287, ComBitSize=1, ComSignalType=BOOLEAN, ComHandleId=2025, ComSystemTemplateSystemSignalRef=DET_IDM_095_Rx
            DET_SUPER_RES_TARGET_095_Rx_oRDR_FUSION_DET_093_096_oPCAN_RADAR_6f112b69_Rx: ComBitPosition=311, ComBitSize=1, ComSignalType=BOOLEAN, ComHandleId=2064, ComSystemTemplateSystemSignalRef=DET_SUPER_RES_TARGET_095_Rx
            DET_PROB_1STAZHYPO_095_Rx_oRDR_FUSION_DET_093_096_oPCAN_RADAR_e6338272_Rx: ComBitPosition=327, ComBitSize=1, ComSignalType=BOOLEAN, ComHandleId=2036, ComSystemTemplateSystemSignalRef=DET_PROB_1STAZHYPO_095_Rx
            DET_HVC_FLAG_093_Rx_oRDR_FUSION_DET_093_096_oPCAN_RADAR_f17132db_Rx: ComBitPosition=86, ComBitSize=1, ComSignalType=BOOLEAN, ComHandleId=2019, ComSystemTemplateSystemSignalRef=DET_HVC_FLAG_093_Rx
            DET_BELOW_RAIN_THOLD_094_Rx_oRDR_FUSION_DET_093_096_oPCAN_RADAR_67b65bb0_Rx: ComBitPosition=151, ComBitSize=1, ComSignalType=BOOLEAN, ComHandleId=1992, ComSystemTemplateSystemSignalRef=DET_BELOW_RAIN_THOLD_094_Rx
            DET_BI_STATIC_FLAG_094_Rx_oRDR_FUSION_DET_093_096_oPCAN_RADAR_1028f0a3_Rx: ComBitPosition=216, ComBitSize=1, ComSignalType=BOOLEAN, ComHandleId=1996, ComSystemTemplateSystemSignalRef=DET_BI_STATIC_FLAG_094_Rx
            DET_RANGE_ERR_093_Rx_oRDR_FUSION_DET_093_096_oPCAN_RADAR_b8058795_Rx: ComBitPosition=40, ComBitSize=7, ComSignalType=UINT8, ComHandleId=2042, ComSystemTemplateSystemSignalRef=DET_RANGE_ERR_093_Rx
            DET_RANGE_VELOCITY_ERR_095_Rx_oRDR_FUSION_DET_093_096_oPCAN_RADAR_f91f9959_Rx: ComBitPosition=288, ComBitSize=8, ComSignalType=UINT8, ComHandleId=2052, ComSystemTemplateSystemSignalRef=DET_RANGE_VELOCITY_ERR_095_Rx
            DET_ELEVATION_ERR_096_Rx_oRDR_FUSION_DET_093_096_oPCAN_RADAR_a4727699_Rx: ComBitPosition=416, ComBitSize=6, ComSignalType=UINT8, ComHandleId=2014, ComSystemTemplateSystemSignalRef=DET_ELEVATION_ERR_096_Rx
            DET_PROB_1STAZHYPO_096_Rx_oRDR_FUSION_DET_093_096_oPCAN_RADAR_cc8f32fa_Rx: ComBitPosition=439, ComBitSize=1, ComSignalType=BOOLEAN, ComHandleId=2037, ComSystemTemplateSystemSignalRef=DET_PROB_1STAZHYPO_096_Rx
            DET_EXISTENCE_PROB_094_Rx_oRDR_FUSION_DET_093_096_oPCAN_RADAR_d6922cc3_Rx: ComBitPosition=224, ComBitSize=6, ComSignalType=UINT8, ComHandleId=2016, ComSystemTemplateSystemSignalRef=DET_EXISTENCE_PROB_094_Rx
            DET_RANGE_095_Rx_oRDR_FUSION_DET_093_096_oPCAN_RADAR_bd8e6a65_Rx: ComBitPosition=248, ComBitSize=15, ComSignalType=UINT16, ComHandleId=2040, ComSystemTemplateSystemSignalRef=DET_RANGE_095_Rx
            DET_RANGE_096_Rx_oRDR_FUSION_DET_093_096_oPCAN_RADAR_9732daed_Rx: ComBitPosition=360, ComBitSize=15, ComSignalType=UINT16, ComHandleId=2041, ComSystemTemplateSystemSignalRef=DET_RANGE_096_Rx
            DET_SNR_094_Rx_oRDR_FUSION_DET_093_096_oPCAN_RADAR_0bae982e_Rx: ComBitPosition=232, ComBitSize=8, ComSignalType=UINT8, ComHandleId=2059, ComSystemTemplateSystemSignalRef=DET_SNR_094_Rx
            DET_RANGE_ERR_096_Rx_oRDR_FUSION_DET_093_096_oPCAN_RADAR_c7c0560d_Rx: ComBitPosition=376, ComBitSize=7, ComSignalType=UINT8, ComHandleId=2045, ComSystemTemplateSystemSignalRef=DET_RANGE_ERR_096_Rx
            DET_ELEVATION_093_Rx_oRDR_FUSION_DET_093_096_oPCAN_RADAR_090e85de_Rx: ComBitPosition=72, ComBitSize=8, ComSignalType=UINT8, ComHandleId=2007, ComSystemTemplateSystemSignalRef=DET_ELEVATION_093_Rx
            DET_EXISTENCE_PROB_095_Rx_oRDR_FUSION_DET_093_096_oPCAN_RADAR_79d6be84_Rx: ComBitPosition=336, ComBitSize=6, ComSignalType=UINT8, ComHandleId=2017, ComSystemTemplateSystemSignalRef=DET_EXISTENCE_PROB_095_Rx
            DET_HVC_FLAG_096_Rx_oRDR_FUSION_DET_093_096_oPCAN_RADAR_8eb4e343_Rx: ComBitPosition=422, ComBitSize=1, ComSignalType=BOOLEAN, ComHandleId=2022, ComSystemTemplateSystemSignalRef=DET_HVC_FLAG_096_Rx
            DET_RCS_096_Rx_oRDR_FUSION_DET_093_096_oPCAN_RADAR_870ccb08_Rx: ComBitPosition=464, ComBitSize=8, ComSignalType=UINT8, ComHandleId=2057, ComSystemTemplateSystemSignalRef=DET_RCS_096_Rx
            DET_BI_STATIC_FLAG_093_Rx_oRDR_FUSION_DET_093_096_oPCAN_RADAR_ea1503f4_Rx: ComBitPosition=104, ComBitSize=1, ComSignalType=BOOLEAN, ComHandleId=1995, ComSystemTemplateSystemSignalRef=DET_BI_STATIC_FLAG_093_Rx
            DET_RANGE_094_Rx_oRDR_FUSION_DET_093_096_oPCAN_RADAR_12caf822_Rx: ComBitPosition=136, ComBitSize=15, ComSignalType=UINT16, ComHandleId=2039, ComSystemTemplateSystemSignalRef=DET_RANGE_094_Rx
            DET_AZIMUTH_095_Rx_oRDR_FUSION_DET_093_096_oPCAN_RADAR_ae483642_Rx: ComBitPosition=312, ComBitSize=13, ComSignalType=UINT16, ComHandleId=1985, ComSystemTemplateSystemSignalRef=DET_AZIMUTH_095_Rx
            DET_AZIMUTH_093_Rx_oRDR_FUSION_DET_093_096_oPCAN_RADAR_fb315752_Rx: ComBitPosition=88, ComBitSize=13, ComSignalType=UINT16, ComHandleId=1983, ComSystemTemplateSystemSignalRef=DET_AZIMUTH_093_Rx
            DET_ELEVATION_ERR_094_Rx_oRDR_FUSION_DET_093_096_oPCAN_RADAR_218a5456_Rx: ComBitPosition=192, ComBitSize=6, ComSignalType=UINT8, ComHandleId=2012, ComSystemTemplateSystemSignalRef=DET_ELEVATION_ERR_094_Rx
            DET_CONFD_AZIMUTH_093_Rx_oRDR_FUSION_DET_093_096_oPCAN_RADAR_097ce9a0_Rx: ComBitPosition=118, ComBitSize=2, ComSignalType=UINT8, ComHandleId=1999, ComSystemTemplateSystemSignalRef=DET_CONFD_AZIMUTH_093_Rx
            DET_CONFD_ELEVATION_095_Rx_oRDR_FUSION_DET_093_096_oPCAN_RADAR_56240b37_Rx: ComBitPosition=325, ComBitSize=2, ComSignalType=UINT8, ComHandleId=2005, ComSystemTemplateSystemSignalRef=DET_CONFD_ELEVATION_095_Rx
            DET_ELEVATION_095_Rx_oRDR_FUSION_DET_093_096_oPCAN_RADAR_5c77e4ce_Rx: ComBitPosition=296, ComBitSize=8, ComSignalType=UINT8, ComHandleId=2009, ComSystemTemplateSystemSignalRef=DET_ELEVATION_095_Rx
            DET_MH_CYCLE_COUNTER_093_096_Rx_oRDR_FUSION_DET_093_096_oPCAN_RADAR_3ba90f28_Rx: ComBitPosition=16, ComBitSize=8, ComSignalType=UINT8, ComHandleId=2028, ComSystemTemplateSystemSignalRef=DET_MH_CYCLE_COUNTER_093_096_Rx
            DET_HVC_FLAG_095_Rx_oRDR_FUSION_DET_093_096_oPCAN_RADAR_a40853cb_Rx: ComBitPosition=310, ComBitSize=1, ComSignalType=BOOLEAN, ComHandleId=2021, ComSystemTemplateSystemSignalRef=DET_HVC_FLAG_095_Rx
            DET_MH_CRC16_093_096_Rx_oRDR_FUSION_DET_093_096_oPCAN_RADAR_367232ed_Rx: ComBitPosition=0, ComBitSize=16, ComSignalType=UINT16, ComHandleId=2027, ComSystemTemplateSystemSignalRef=DET_MH_CRC16_093_096_Rx
            DET_RANGE_VELOCITY_ERR_094_Rx_oRDR_FUSION_DET_093_096_oPCAN_RADAR_565b0b1e_Rx: ComBitPosition=176, ComBitSize=8, ComSignalType=UINT8, ComHandleId=2051, ComSystemTemplateSystemSignalRef=DET_RANGE_VELOCITY_ERR_094_Rx
            DET_MH_SCAN_INDEX_4LSB_093_096_Rx_oRDR_FUSION_DET_093_096_oPCAN_RADAR_5f19c013_Rx: ComBitPosition=476, ComBitSize=4, ComSignalType=UINT8, ComHandleId=2029, ComSystemTemplateSystemSignalRef=DET_MH_SCAN_INDEX_4LSB_093_096_Rx
            DET_MTD_093_Rx_oRDR_FUSION_DET_093_096_oPCAN_RADAR_7933fde3_Rx: ComBitPosition=47, ComBitSize=1, ComSignalType=BOOLEAN, ComHandleId=2030, ComSystemTemplateSystemSignalRef=DET_MTD_093_Rx
            DET_BI_STATIC_FLAG_095_Rx_oRDR_FUSION_DET_093_096_oPCAN_RADAR_bf6c62e4_Rx: ComBitPosition=328, ComBitSize=1, ComSignalType=BOOLEAN, ComHandleId=1997, ComSystemTemplateSystemSignalRef=DET_BI_STATIC_FLAG_095_Rx
            DET_ELEVATION_ERR_095_Rx_oRDR_FUSION_DET_093_096_oPCAN_RADAR_8ecec611_Rx: ComBitPosition=304, ComBitSize=6, ComSignalType=UINT8, ComHandleId=2013, ComSystemTemplateSystemSignalRef=DET_ELEVATION_ERR_095_Rx
            DET_RANGE_VELOCITY_094_Rx_oRDR_FUSION_DET_093_096_oPCAN_RADAR_cf3f7bdc_Rx: ComBitPosition=160, ComBitSize=15, ComSignalType=UINT16, ComHandleId=2047, ComSystemTemplateSystemSignalRef=DET_RANGE_VELOCITY_094_Rx
            DET_CONFD_ELEVATION_094_Rx_oRDR_FUSION_DET_093_096_oPCAN_RADAR_f9609970_Rx: ComBitPosition=213, ComBitSize=2, ComSignalType=UINT8, ComHandleId=2004, ComSystemTemplateSystemSignalRef=DET_CONFD_ELEVATION_094_Rx
            DET_BELOW_RAIN_THOLD_095_Rx_oRDR_FUSION_DET_093_096_oPCAN_RADAR_c8f2c9f7_Rx: ComBitPosition=263, ComBitSize=1, ComSignalType=BOOLEAN, ComHandleId=1993, ComSystemTemplateSystemSignalRef=DET_BELOW_RAIN_THOLD_095_Rx
            DET_MTD_095_Rx_oRDR_FUSION_DET_093_096_oPCAN_RADAR_2c4a9cf3_Rx: ComBitPosition=271, ComBitSize=1, ComSignalType=BOOLEAN, ComHandleId=2032, ComSystemTemplateSystemSignalRef=DET_MTD_095_Rx
            DET_IDM_093_Rx_oRDR_FUSION_DET_093_096_oPCAN_RADAR_c4b0cb93_Rx: ComBitPosition=63, ComBitSize=1, ComSignalType=BOOLEAN, ComHandleId=2023, ComSystemTemplateSystemSignalRef=DET_IDM_093_Rx
            DET_RANGE_ERR_095_Rx_oRDR_FUSION_DET_093_096_oPCAN_RADAR_ed7ce685_Rx: ComBitPosition=264, ComBitSize=7, ComSignalType=UINT8, ComHandleId=2044, ComSystemTemplateSystemSignalRef=DET_RANGE_ERR_095_Rx
            DET_RANGE_VELOCITY_ERR_093_Rx_oRDR_FUSION_DET_093_096_oPCAN_RADAR_ac66f849_Rx: ComBitPosition=64, ComBitSize=8, ComSignalType=UINT8, ComHandleId=2050, ComSystemTemplateSystemSignalRef=DET_RANGE_VELOCITY_ERR_093_Rx
            DET_MTD_096_Rx_oRDR_FUSION_DET_093_096_oPCAN_RADAR_06f62c7b_Rx: ComBitPosition=383, ComBitSize=1, ComSignalType=BOOLEAN, ComHandleId=2033, ComSystemTemplateSystemSignalRef=DET_MTD_096_Rx
            DET_IDM_094_Rx_oRDR_FUSION_DET_093_096_oPCAN_RADAR_3e8d38c4_Rx: ComBitPosition=175, ComBitSize=1, ComSignalType=BOOLEAN, ComHandleId=2024, ComSystemTemplateSystemSignalRef=DET_IDM_094_Rx
            DET_AZIMUTH_ERR_096_Rx_oRDR_FUSION_DET_093_096_oPCAN_RADAR_869d2748_Rx: ComBitPosition=441, ComBitSize=7, ComSignalType=UINT8, ComHandleId=1990, ComSystemTemplateSystemSignalRef=DET_AZIMUTH_ERR_096_Rx
            DET_EXISTENCE_PROB_093_Rx_oRDR_FUSION_DET_093_096_oPCAN_RADAR_2cafdf94_Rx: ComBitPosition=112, ComBitSize=6, ComSignalType=UINT8, ComHandleId=2015, ComSystemTemplateSystemSignalRef=DET_EXISTENCE_PROB_093_Rx
            DET_CONFD_AZIMUTH_096_Rx_oRDR_FUSION_DET_093_096_oPCAN_RADAR_76b93838_Rx: ComBitPosition=454, ComBitSize=2, ComSignalType=UINT8, ComHandleId=2002, ComSystemTemplateSystemSignalRef=DET_CONFD_AZIMUTH_096_Rx
            DET_ELEVATION_ERR_093_Rx_oRDR_FUSION_DET_093_096_oPCAN_RADAR_dbb7a701_Rx: ComBitPosition=80, ComBitSize=6, ComSignalType=UINT8, ComHandleId=2011, ComSystemTemplateSystemSignalRef=DET_ELEVATION_ERR_093_Rx
            DET_CONFD_AZIMUTH_094_Rx_oRDR_FUSION_DET_093_096_oPCAN_RADAR_f3411af7_Rx: ComBitPosition=230, ComBitSize=2, ComSignalType=UINT8, ComHandleId=2000, ComSystemTemplateSystemSignalRef=DET_CONFD_AZIMUTH_094_Rx
      RDR_FUSION_DET_125_128_oPCAN_RADAR_b08fc71f_Rx (ComIPdu):
        ComIPduDirection = RECEIVE
        ComIPduType = NORMAL
        ComIPduCancellationSupport = false
        ComIPduHandleId = 53
        ComIPduSignalProcessing = DEFERRED
        ComIPduChannelRef = CN_PCAN_RADAR_458ff0f1
        ComIPduGroupRef = RDR01_oPCAN_RADAR_Rx_e0e717e1 if post-build-variant-condition{matching-criterion=RDR_POS, value=0}
        ComIPduSignalGroupRef = SG_Fusion_Detections_125_128_oRDR_FUSION_DET_125_128_oPCAN_RADAR_ddd85db8_Rx
        ComPduIdRef = RDR_FUSION_DET_125_128_oPCAN_RADAR_b08fc71f_Rx
        ComIPduMainFunctionRef = ComMainFunctionRx
        ComIPduGroupRef = RDR02_oPCAN_RADAR_Rx_c92fa313 if post-build-variant-condition{matching-criterion=RDR_POS, value=1}
        ComIPduGroupRef = RDR03_oPCAN_RADAR_Rx_67473282 if post-build-variant-condition{matching-criterion=RDR_POS, value=2}
        ComIPduGroupRef = RDR04_oPCAN_RADAR_Rx_9abecaf7 if post-build-variant-condition{matching-criterion=RDR_POS, value=3}
        ComIPduGroupRef = RDR05_oPCAN_RADAR_Rx_34d65b66 if post-build-variant-condition{matching-criterion=RDR_POS, value=4}
        ComIPduGroupRef = RDR06_oPCAN_RADAR_Rx_1d1eef94 if post-build-variant-condition{matching-criterion=RDR_POS, value=5}
        ComIPduGroupRef = RDR07_oPCAN_RADAR_Rx_b3767e05 if post-build-variant-condition{matching-criterion=RDR_POS, value=6}
        ComIPduGroupRef = RDR08_oPCAN_RADAR_Rx_3d9c193f if post-build-variant-condition{matching-criterion=RDR_POS, value=7}
      SG_Fusion_Detections_101_104_oRDR_FUSION_DET_101_104_oPCAN_RADAR_2dfb2b7d_Rx (ComSignalGroup):
        ComTimeout = 0
        ComTransferProperty = PENDING
        ComSignalGroupAccess = ACCESS_NEEDED_BY_SWC_OR_COM
        ComHandleId = 33
        ComSignalGroupArrayAccess = true
        ComSystemTemplateSignalGroupRef = SG_Fusion_Detections_101_104
        83 x ComGroupSignal, all with ComSignalEndianness=LITTLE_ENDIAN, ComSignalInitValue=0, ComSignalAccess=ACCESS_NEEDED_BY_SWC_OR_COM:
          DET_MTD_103_Rx_oRDR_FUSION_DET_101_104_oPCAN_RADAR_9149ec31_Rx: ComBitPosition=271, ComBitSize=1, ComSignalType=BOOLEAN, ComHandleId=2198, ComSystemTemplateSystemSignalRef=DET_MTD_103_Rx
          DET_ELEVATION_103_Rx_oRDR_FUSION_DET_101_104_oPCAN_RADAR_e174940c_Rx: ComBitPosition=296, ComBitSize=8, ComSignalType=UINT8, ComHandleId=2175, ComSystemTemplateSystemSignalRef=DET_ELEVATION_103_Rx
          DET_IDM_102_Rx_oRDR_FUSION_DET_101_104_oPCAN_RADAR_838e4806_Rx: ComBitPosition=175, ComBitSize=1, ComSignalType=BOOLEAN, ComHandleId=2190, ComSystemTemplateSystemSignalRef=DET_IDM_102_Rx
          DET_PROB_1STAZHYPO_103_Rx_oRDR_FUSION_DET_101_104_oPCAN_RADAR_5b30f2b0_Rx: ComBitPosition=327, ComBitSize=1, ComSignalType=BOOLEAN, ComHandleId=2202, ComSystemTemplateSystemSignalRef=DET_PROB_1STAZHYPO_103_Rx
          DET_SUPER_RES_TARGET_104_Rx_oRDR_FUSION_DET_101_104_oPCAN_RADAR_282fa8fc_Rx: ComBitPosition=423, ComBitSize=1, ComSignalType=BOOLEAN, ComHandleId=2231, ComSystemTemplateSystemSignalRef=DET_SUPER_RES_TARGET_104_Rx
          DET_MTD_102_Rx_oRDR_FUSION_DET_101_104_oPCAN_RADAR_3e0d7e76_Rx: ComBitPosition=159, ComBitSize=1, ComSignalType=BOOLEAN, ComHandleId=2197, ComSystemTemplateSystemSignalRef=DET_MTD_102_Rx
          DET_AZIMUTH_ERR_104_Rx_oRDR_FUSION_DET_101_104_oPCAN_RADAR_eb1f1455_Rx: ComBitPosition=441, ComBitSize=7, ComSignalType=UINT8, ComHandleId=2156, ComSystemTemplateSystemSignalRef=DET_AZIMUTH_ERR_104_Rx
          DET_RANGE_VELOCITY_ERR_104_Rx_oRDR_FUSION_DET_101_104_oPCAN_RADAR_be211acc_Rx: ComBitPosition=400, ComBitSize=8, ComSignalType=UINT8, ComHandleId=2219, ComSystemTemplateSystemSignalRef=DET_RANGE_VELOCITY_ERR_104_Rx
          DET_AZIMUTH_103_Rx_oRDR_FUSION_DET_101_104_oPCAN_RADAR_134b4680_Rx: ComBitPosition=312, ComBitSize=13, ComSignalType=UINT16, ComHandleId=2151, ComSystemTemplateSystemSignalRef=DET_AZIMUTH_103_Rx
          DET_AZIMUTH_ERR_102_Rx_oRDR_FUSION_DET_101_104_oPCAN_RADAR_be667545_Rx: ComBitPosition=217, ComBitSize=7, ComSignalType=UINT8, ComHandleId=2154, ComSystemTemplateSystemSignalRef=DET_AZIMUTH_ERR_102_Rx
          DET_BI_STATIC_FLAG_104_Rx_oRDR_FUSION_DET_101_104_oPCAN_RADAR_f852e171_Rx: ComBitPosition=440, ComBitSize=1, ComSignalType=BOOLEAN, ComHandleId=2164, ComSystemTemplateSystemSignalRef=DET_BI_STATIC_FLAG_104_Rx
          DET_CONFD_AZIMUTH_101_Rx_oRDR_FUSION_DET_101_104_oPCAN_RADAR_64fedabd_Rx: ComBitPosition=118, ComBitSize=2, ComSignalType=UINT8, ComHandleId=2165, ComSystemTemplateSystemSignalRef=DET_CONFD_AZIMUTH_101_Rx
          DET_SUPER_RES_TARGET_101_Rx_oRDR_FUSION_DET_101_104_oPCAN_RADAR_57ea7964_Rx: ComBitPosition=87, ComBitSize=1, ComSignalType=BOOLEAN, ComHandleId=2228, ComSystemTemplateSystemSignalRef=DET_SUPER_RES_TARGET_101_Rx
          DET_RANGE_VELOCITY_ERR_101_Rx_oRDR_FUSION_DET_101_104_oPCAN_RADAR_c1e4cb54_Rx: ComBitPosition=64, ComBitSize=8, ComSignalType=UINT8, ComHandleId=2216, ComSystemTemplateSystemSignalRef=DET_RANGE_VELOCITY_ERR_101_Rx
          DET_SUPER_RES_TARGET_103_Rx_oRDR_FUSION_DET_101_104_oPCAN_RADAR_d2125bab_Rx: ComBitPosition=311, ComBitSize=1, ComSignalType=BOOLEAN, ComHandleId=2230, ComSystemTemplateSystemSignalRef=DET_SUPER_RES_TARGET_103_Rx
          DET_RANGE_VELOCITY_ERR_103_Rx_oRDR_FUSION_DET_101_104_oPCAN_RADAR_441ce99b_Rx: ComBitPosition=288, ComBitSize=8, ComSignalType=UINT8, ComHandleId=2218, ComSystemTemplateSystemSignalRef=DET_RANGE_VELOCITY_ERR_103_Rx
          DET_AZIMUTH_ERR_101_Rx_oRDR_FUSION_DET_101_104_oPCAN_RADAR_94dac5cd_Rx: ComBitPosition=105, ComBitSize=7, ComSignalType=UINT8, ComHandleId=2153, ComSystemTemplateSystemSignalRef=DET_AZIMUTH_ERR_101_Rx
          DET_ELEVATION_ERR_102_Rx_oRDR_FUSION_DET_101_104_oPCAN_RADAR_9c892494_Rx: ComBitPosition=192, ComBitSize=6, ComSignalType=UINT8, ComHandleId=2178, ComSystemTemplateSystemSignalRef=DET_ELEVATION_ERR_102_Rx
          DET_RANGE_VELOCITY_103_Rx_oRDR_FUSION_DET_101_104_oPCAN_RADAR_dd789959_Rx: ComBitPosition=272, ComBitSize=15, ComSignalType=UINT16, ComHandleId=2214, ComSystemTemplateSystemSignalRef=DET_RANGE_VELOCITY_103_Rx
          DET_BI_STATIC_FLAG_102_Rx_oRDR_FUSION_DET_101_104_oPCAN_RADAR_ad2b8061_Rx: ComBitPosition=216, ComBitSize=1, ComSignalType=BOOLEAN, ComHandleId=2162, ComSystemTemplateSystemSignalRef=DET_BI_STATIC_FLAG_102_Rx
          DET_BELOW_RAIN_THOLD_102_Rx_oRDR_FUSION_DET_101_104_oPCAN_RADAR_dab52b72_Rx: ComBitPosition=151, ComBitSize=1, ComSignalType=BOOLEAN, ComHandleId=2158, ComSystemTemplateSystemSignalRef=DET_BELOW_RAIN_THOLD_102_Rx
          DET_CONFD_AZIMUTH_102_Rx_oRDR_FUSION_DET_101_104_oPCAN_RADAR_4e426a35_Rx: ComBitPosition=230, ComBitSize=2, ComSignalType=UINT8, ComHandleId=2166, ComSystemTemplateSystemSignalRef=DET_CONFD_AZIMUTH_102_Rx
          DET_RANGE_VELOCITY_ERR_102_Rx_oRDR_FUSION_DET_101_104_oPCAN_RADAR_eb587bdc_Rx: ComBitPosition=176, ComBitSize=8, ComSignalType=UINT8, ComHandleId=2217, ComSystemTemplateSystemSignalRef=DET_RANGE_VELOCITY_ERR_102_Rx
          DET_RANGE_ERR_103_Rx_oRDR_FUSION_DET_101_104_oPCAN_RADAR_507f9647_Rx: ComBitPosition=264, ComBitSize=7, ComSignalType=UINT8, ComHandleId=2210, ComSystemTemplateSystemSignalRef=DET_RANGE_ERR_103_Rx
          DET_SNR_103_Rx_oRDR_FUSION_DET_101_104_oPCAN_RADAR_19e97aab_Rx: ComBitPosition=344, ComBitSize=8, ComSignalType=UINT8, ComHandleId=2226, ComSystemTemplateSystemSignalRef=DET_SNR_103_Rx
          DET_MH_CYCLE_COUNTER_101_104_Rx_oRDR_FUSION_DET_101_104_oPCAN_RADAR_c2c2ae89_Rx: ComBitPosition=16, ComBitSize=8, ComSignalType=UINT8, ComHandleId=2194, ComSystemTemplateSystemSignalRef=DET_MH_CYCLE_COUNTER_101_104_Rx
          DET_RANGE_VELOCITY_104_Rx_oRDR_FUSION_DET_101_104_oPCAN_RADAR_27456a0e_Rx: ComBitPosition=384, ComBitSize=15, ComSignalType=UINT16, ComHandleId=2215, ComSystemTemplateSystemSignalRef=DET_RANGE_VELOCITY_104_Rx
          DET_BI_STATIC_FLAG_103_Rx_oRDR_FUSION_DET_101_104_oPCAN_RADAR_026f1226_Rx: ComBitPosition=328, ComBitSize=1, ComSignalType=BOOLEAN, ComHandleId=2163, ComSystemTemplateSystemSignalRef=DET_BI_STATIC_FLAG_103_Rx
          DET_ELEVATION_ERR_103_Rx_oRDR_FUSION_DET_101_104_oPCAN_RADAR_33cdb6d3_Rx: ComBitPosition=304, ComBitSize=6, ComSignalType=UINT8, ComHandleId=2179, ComSystemTemplateSystemSignalRef=DET_ELEVATION_ERR_103_Rx
          DET_IDM_101_Rx_oRDR_FUSION_DET_101_104_oPCAN_RADAR_a932f88e_Rx: ComBitPosition=63, ComBitSize=1, ComSignalType=BOOLEAN, ComHandleId=2189, ComSystemTemplateSystemSignalRef=DET_IDM_101_Rx
          DET_IDM_103_Rx_oRDR_FUSION_DET_101_104_oPCAN_RADAR_2ccada41_Rx: ComBitPosition=287, ComBitSize=1, ComSignalType=BOOLEAN, ComHandleId=2191, ComSystemTemplateSystemSignalRef=DET_IDM_103_Rx
          DET_RANGE_VELOCITY_102_Rx_oRDR_FUSION_DET_101_104_oPCAN_RADAR_723c0b1e_Rx: ComBitPosition=160, ComBitSize=15, ComSignalType=UINT16, ComHandleId=2213, ComSystemTemplateSystemSignalRef=DET_RANGE_VELOCITY_102_Rx
          DET_BI_STATIC_FLAG_101_Rx_oRDR_FUSION_DET_101_104_oPCAN_RADAR_879730e9_Rx: ComBitPosition=104, ComBitSize=1, ComSignalType=BOOLEAN, ComHandleId=2161, ComSystemTemplateSystemSignalRef=DET_BI_STATIC_FLAG_101_Rx
          DET_AZIMUTH_101_Rx_oRDR_FUSION_DET_101_104_oPCAN_RADAR_96b3644f_Rx: ComBitPosition=88, ComBitSize=13, ComSignalType=UINT16, ComHandleId=2149, ComSystemTemplateSystemSignalRef=DET_AZIMUTH_101_Rx
          DET_SUPER_RES_TARGET_102_Rx_oRDR_FUSION_DET_101_104_oPCAN_RADAR_7d56c9ec_Rx: ComBitPosition=199, ComBitSize=1, ComSignalType=BOOLEAN, ComHandleId=2229, ComSystemTemplateSystemSignalRef=DET_SUPER_RES_TARGET_102_Rx
          DET_BELOW_RAIN_THOLD_103_Rx_oRDR_FUSION_DET_101_104_oPCAN_RADAR_75f1b935_Rx: ComBitPosition=263, ComBitSize=1, ComSignalType=BOOLEAN, ComHandleId=2159, ComSystemTemplateSystemSignalRef=DET_BELOW_RAIN_THOLD_103_Rx
          DET_CONFD_AZIMUTH_104_Rx_oRDR_FUSION_DET_101_104_oPCAN_RADAR_1b3b0b25_Rx: ComBitPosition=454, ComBitSize=2, ComSignalType=UINT8, ComHandleId=2168, ComSystemTemplateSystemSignalRef=DET_CONFD_AZIMUTH_104_Rx
          DET_CONFD_ELEVATION_103_Rx_oRDR_FUSION_DET_101_104_oPCAN_RADAR_eb277bf5_Rx: ComBitPosition=325, ComBitSize=2, ComSignalType=UINT8, ComHandleId=2171, ComSystemTemplateSystemSignalRef=DET_CONFD_ELEVATION_103_Rx
          DET_PROB_1STAZHYPO_104_Rx_oRDR_FUSION_DET_101_104_oPCAN_RADAR_a10d01e7_Rx: ComBitPosition=439, ComBitSize=1, ComSignalType=BOOLEAN, ComHandleId=2203, ComSystemTemplateSystemSignalRef=DET_PROB_1STAZHYPO_104_Rx
          DET_MTD_101_Rx_oRDR_FUSION_DET_101_104_oPCAN_RADAR_14b1cefe_Rx: ComBitPosition=47, ComBitSize=1, ComSignalType=BOOLEAN, ComHandleId=2196, ComSystemTemplateSystemSignalRef=DET_MTD_101_Rx
          DET_EXISTENCE_PROB_104_Rx_oRDR_FUSION_DET_101_104_oPCAN_RADAR_3ee83d11_Rx: ComBitPosition=448, ComBitSize=6, ComSignalType=UINT8, ComHandleId=2184, ComSystemTemplateSystemSignalRef=DET_EXISTENCE_PROB_104_Rx
          DET_SNR_104_Rx_oRDR_FUSION_DET_101_104_oPCAN_RADAR_e3d489fc_Rx: ComBitPosition=456, ComBitSize=8, ComSignalType=UINT8, ComHandleId=2227, ComSystemTemplateSystemSignalRef=DET_SNR_104_Rx
          DET_EXISTENCE_PROB_102_Rx_oRDR_FUSION_DET_101_104_oPCAN_RADAR_6b915c01_Rx: ComBitPosition=224, ComBitSize=6, ComSignalType=UINT8, ComHandleId=2182, ComSystemTemplateSystemSignalRef=DET_EXISTENCE_PROB_102_Rx
          DET_PROB_1STAZHYPO_102_Rx_oRDR_FUSION_DET_101_104_oPCAN_RADAR_f47460f7_Rx: ComBitPosition=215, ComBitSize=1, ComSignalType=BOOLEAN, ComHandleId=2201, ComSystemTemplateSystemSignalRef=DET_PROB_1STAZHYPO_102_Rx
          DET_CONFD_ELEVATION_101_Rx_oRDR_FUSION_DET_101_104_oPCAN_RADAR_6edf593a_Rx: ComBitPosition=101, ComBitSize=2, ComSignalType=UINT8, ComHandleId=2169, ComSystemTemplateSystemSignalRef=DET_CONFD_ELEVATION_101_Rx
          DET_AZIMUTH_102_Rx_oRDR_FUSION_DET_101_104_oPCAN_RADAR_bc0fd4c7_Rx: ComBitPosition=200, ComBitSize=13, ComSignalType=UINT16, ComHandleId=2150, ComSystemTemplateSystemSignalRef=DET_AZIMUTH_102_Rx
          DET_PROB_1STAZHYPO_101_Rx_oRDR_FUSION_DET_101_104_oPCAN_RADAR_dec8d07f_Rx: ComBitPosition=103, ComBitSize=1, ComSignalType=BOOLEAN, ComHandleId=2200, ComSystemTemplateSystemSignalRef=DET_PROB_1STAZHYPO_101_Rx
          DET_ELEVATION_ERR_104_Rx_oRDR_FUSION_DET_101_104_oPCAN_RADAR_c9f04584_Rx: ComBitPosition=416, ComBitSize=6, ComSignalType=UINT8, ComHandleId=2180, ComSystemTemplateSystemSignalRef=DET_ELEVATION_ERR_104_Rx
          DET_MH_SCAN_INDEX_4LSB_101_104_Rx_oRDR_FUSION_DET_101_104_oPCAN_RADAR_a67261b2_Rx: ComBitPosition=476, ComBitSize=4, ComSignalType=UINT8, ComHandleId=2195, ComSystemTemplateSystemSignalRef=DET_MH_SCAN_INDEX_4LSB_101_104_Rx
          DET_BELOW_RAIN_THOLD_101_Rx_oRDR_FUSION_DET_101_104_oPCAN_RADAR_f0099bfa_Rx: ComBitPosition=39, ComBitSize=1, ComSignalType=BOOLEAN, ComHandleId=2157, ComSystemTemplateSystemSignalRef=DET_BELOW_RAIN_THOLD_101_Rx
          DET_ELEVATION_ERR_101_Rx_oRDR_FUSION_DET_101_104_oPCAN_RADAR_b635941c_Rx: ComBitPosition=80, ComBitSize=6, ComSignalType=UINT8, ComHandleId=2177, ComSystemTemplateSystemSignalRef=DET_ELEVATION_ERR_101_Rx
          DET_IDM_104_Rx_oRDR_FUSION_DET_101_104_oPCAN_RADAR_d6f72916_Rx: ComBitPosition=399, ComBitSize=1, ComSignalType=BOOLEAN, ComHandleId=2192, ComSystemTemplateSystemSignalRef=DET_IDM_104_Rx
          DET_AZIMUTH_ERR_103_Rx_oRDR_FUSION_DET_101_104_oPCAN_RADAR_1122e702_Rx: ComBitPosition=329, ComBitSize=7, ComSignalType=UINT8, ComHandleId=2155, ComSystemTemplateSystemSignalRef=DET_AZIMUTH_ERR_103_Rx
          DET_RCS_101_Rx_oRDR_FUSION_DET_101_104_oPCAN_RADAR_954b298d_Rx: ComBitPosition=128, ComBitSize=8, ComSignalType=UINT8, ComHandleId=2220, ComSystemTemplateSystemSignalRef=DET_RCS_101_Rx
          DET_HVC_FLAG_102_Rx_oRDR_FUSION_DET_101_104_oPCAN_RADAR_b64fb14e_Rx: ComBitPosition=198, ComBitSize=1, ComSignalType=BOOLEAN, ComHandleId=2186, ComSystemTemplateSystemSignalRef=DET_HVC_FLAG_102_Rx
          DET_RANGE_ERR_102_Rx_oRDR_FUSION_DET_101_104_oPCAN_RADAR_ff3b0400_Rx: ComBitPosition=152, ComBitSize=7, ComSignalType=UINT8, ComHandleId=2209, ComSystemTemplateSystemSignalRef=DET_RANGE_ERR_102_Rx
          DET_RANGE_102_Rx_oRDR_FUSION_DET_101_104_oPCAN_RADAR_afc988e0_Rx: ComBitPosition=136, ComBitSize=15, ComSignalType=UINT16, ComHandleId=2205, ComSystemTemplateSystemSignalRef=DET_RANGE_102_Rx
          DET_SNR_102_Rx_oRDR_FUSION_DET_101_104_oPCAN_RADAR_b6ade8ec_Rx: ComBitPosition=232, ComBitSize=8, ComSignalType=UINT8, ComHandleId=2225, ComSystemTemplateSystemSignalRef=DET_SNR_102_Rx
          DET_EXISTENCE_PROB_101_Rx_oRDR_FUSION_DET_101_104_oPCAN_RADAR_412dec89_Rx: ComBitPosition=112, ComBitSize=6, ComSignalType=UINT8, ComHandleId=2181, ComSystemTemplateSystemSignalRef=DET_EXISTENCE_PROB_101_Rx
          DET_RANGE_101_Rx_oRDR_FUSION_DET_101_104_oPCAN_RADAR_85753868_Rx: ComBitPosition=24, ComBitSize=15, ComSignalType=UINT16, ComHandleId=2204, ComSystemTemplateSystemSignalRef=DET_RANGE_101_Rx
          DET_CONFD_AZIMUTH_103_Rx_oRDR_FUSION_DET_101_104_oPCAN_RADAR_e106f872_Rx: ComBitPosition=342, ComBitSize=2, ComSignalType=UINT8, ComHandleId=2167, ComSystemTemplateSystemSignalRef=DET_CONFD_AZIMUTH_103_Rx
          DET_CONFD_ELEVATION_104_Rx_oRDR_FUSION_DET_101_104_oPCAN_RADAR_111a88a2_Rx: ComBitPosition=437, ComBitSize=2, ComSignalType=UINT8, ComHandleId=2172, ComSystemTemplateSystemSignalRef=DET_CONFD_ELEVATION_104_Rx
          DET_HVC_FLAG_103_Rx_oRDR_FUSION_DET_101_104_oPCAN_RADAR_190b2309_Rx: ComBitPosition=310, ComBitSize=1, ComSignalType=BOOLEAN, ComHandleId=2187, ComSystemTemplateSystemSignalRef=DET_HVC_FLAG_103_Rx
          DET_RANGE_VELOCITY_101_Rx_oRDR_FUSION_DET_101_104_oPCAN_RADAR_5880bb96_Rx: ComBitPosition=48, ComBitSize=15, ComSignalType=UINT16, ComHandleId=2212, ComSystemTemplateSystemSignalRef=DET_RANGE_VELOCITY_101_Rx
          DET_AZIMUTH_104_Rx_oRDR_FUSION_DET_101_104_oPCAN_RADAR_e976b5d7_Rx: ComBitPosition=424, ComBitSize=13, ComSignalType=UINT16, ComHandleId=2152, ComSystemTemplateSystemSignalRef=DET_AZIMUTH_104_Rx
          DET_RANGE_ERR_101_Rx_oRDR_FUSION_DET_101_104_oPCAN_RADAR_d587b488_Rx: ComBitPosition=40, ComBitSize=7, ComSignalType=UINT8, ComHandleId=2208, ComSystemTemplateSystemSignalRef=DET_RANGE_ERR_101_Rx
          DET_HVC_FLAG_101_Rx_oRDR_FUSION_DET_101_104_oPCAN_RADAR_9cf301c6_Rx: ComBitPosition=86, ComBitSize=1, ComSignalType=BOOLEAN, ComHandleId=2185, ComSystemTemplateSystemSignalRef=DET_HVC_FLAG_101_Rx
          DET_ELEVATION_101_Rx_oRDR_FUSION_DET_101_104_oPCAN_RADAR_648cb6c3_Rx: ComBitPosition=72, ComBitSize=8, ComSignalType=UINT8, ComHandleId=2173, ComSystemTemplateSystemSignalRef=DET_ELEVATION_101_Rx
          DET_RANGE_ERR_104_Rx_oRDR_FUSION_DET_101_104_oPCAN_RADAR_aa426510_Rx: ComBitPosition=376, ComBitSize=7, ComSignalType=UINT8, ComHandleId=2211, ComSystemTemplateSystemSignalRef=DET_RANGE_ERR_104_Rx
          DET_ELEVATION_102_Rx_oRDR_FUSION_DET_101_104_oPCAN_RADAR_4e30064b_Rx: ComBitPosition=184, ComBitSize=8, ComSignalType=UINT8, ComHandleId=2174, ComSystemTemplateSystemSignalRef=DET_ELEVATION_102_Rx
          DET_MH_CRC16_101_104_Rx_oRDR_FUSION_DET_101_104_oPCAN_RADAR_cf19934c_Rx: ComBitPosition=0, ComBitSize=16, ComSignalType=UINT16, ComHandleId=2193, ComSystemTemplateSystemSignalRef=DET_MH_CRC16_101_104_Rx
          DET_RANGE_103_Rx_oRDR_FUSION_DET_101_104_oPCAN_RADAR_008d1aa7_Rx: ComBitPosition=248, ComBitSize=15, ComSignalType=UINT16, ComHandleId=2206, ComSystemTemplateSystemSignalRef=DET_RANGE_103_Rx
          DET_BELOW_RAIN_THOLD_104_Rx_oRDR_FUSION_DET_101_104_oPCAN_RADAR_8fcc4a62_Rx: ComBitPosition=375, ComBitSize=1, ComSignalType=BOOLEAN, ComHandleId=2160, ComSystemTemplateSystemSignalRef=DET_BELOW_RAIN_THOLD_104_Rx
          DET_CONFD_ELEVATION_102_Rx_oRDR_FUSION_DET_101_104_oPCAN_RADAR_4463e9b2_Rx: ComBitPosition=213, ComBitSize=2, ComSignalType=UINT8, ComHandleId=2170, ComSystemTemplateSystemSignalRef=DET_CONFD_ELEVATION_102_Rx
          DET_HVC_FLAG_104_Rx_oRDR_FUSION_DET_101_104_oPCAN_RADAR_e336d05e_Rx: ComBitPosition=422, ComBitSize=1, ComSignalType=BOOLEAN, ComHandleId=2188, ComSystemTemplateSystemSignalRef=DET_HVC_FLAG_104_Rx
          DET_RANGE_104_Rx_oRDR_FUSION_DET_101_104_oPCAN_RADAR_fab0e9f0_Rx: ComBitPosition=360, ComBitSize=15, ComSignalType=UINT16, ComHandleId=2207, ComSystemTemplateSystemSignalRef=DET_RANGE_104_Rx
          DET_MTD_104_Rx_oRDR_FUSION_DET_101_104_oPCAN_RADAR_6b741f66_Rx: ComBitPosition=383, ComBitSize=1, ComSignalType=BOOLEAN, ComHandleId=2199, ComSystemTemplateSystemSignalRef=DET_MTD_104_Rx
          DET_RCS_102_Rx_oRDR_FUSION_DET_101_104_oPCAN_RADAR_bff79905_Rx: ComBitPosition=240, ComBitSize=8, ComSignalType=UINT8, ComHandleId=2221, ComSystemTemplateSystemSignalRef=DET_RCS_102_Rx
          DET_RCS_103_Rx_oRDR_FUSION_DET_101_104_oPCAN_RADAR_10b30b42_Rx: ComBitPosition=352, ComBitSize=8, ComSignalType=UINT8, ComHandleId=2222, ComSystemTemplateSystemSignalRef=DET_RCS_103_Rx
          DET_ELEVATION_104_Rx_oRDR_FUSION_DET_101_104_oPCAN_RADAR_1b49675b_Rx: ComBitPosition=408, ComBitSize=8, ComSignalType=UINT8, ComHandleId=2176, ComSystemTemplateSystemSignalRef=DET_ELEVATION_104_Rx
          DET_EXISTENCE_PROB_103_Rx_oRDR_FUSION_DET_101_104_oPCAN_RADAR_c4d5ce46_Rx: ComBitPosition=336, ComBitSize=6, ComSignalType=UINT8, ComHandleId=2183, ComSystemTemplateSystemSignalRef=DET_EXISTENCE_PROB_103_Rx
          DET_SNR_101_Rx_oRDR_FUSION_DET_101_104_oPCAN_RADAR_9c115864_Rx: ComBitPosition=120, ComBitSize=8, ComSignalType=UINT8, ComHandleId=2224, ComSystemTemplateSystemSignalRef=DET_SNR_101_Rx
          DET_RCS_104_Rx_oRDR_FUSION_DET_101_104_oPCAN_RADAR_ea8ef815_Rx: ComBitPosition=464, ComBitSize=8, ComSignalType=UINT8, ComHandleId=2223, ComSystemTemplateSystemSignalRef=DET_RCS_104_Rx
      SG_Fusion_Detections_017_020_oRDR_FUSION_DET_017_020_oPCAN_RADAR_3121649c_Rx (ComSignalGroup):
        ComTimeout = 0
        ComTransferProperty = PENDING
        ComSignalGroupAccess = ACCESS_NEEDED_BY_SWC_OR_COM
        ComHandleId = 12
        ComSignalGroupArrayAccess = true
        ComSystemTemplateSignalGroupRef = SG_Fusion_Detections_017_020
        83 x ComGroupSignal, all with ComSignalEndianness=LITTLE_ENDIAN, ComSignalInitValue=0, ComSignalAccess=ACCESS_NEEDED_BY_SWC_OR_COM:
          DET_AZIMUTH_018_Rx_oRDR_FUSION_DET_017_020_oPCAN_RADAR_0d0297da_Rx: ComBitPosition=200, ComBitSize=13, ComSignalType=UINT16, ComHandleId=407, ComSystemTemplateSystemSignalRef=DET_AZIMUTH_018_Rx
          DET_BI_STATIC_FLAG_018_Rx_oRDR_FUSION_DET_017_020_oPCAN_RADAR_1c26c37c_Rx: ComBitPosition=216, ComBitSize=1, ComSignalType=BOOLEAN, ComHandleId=419, ComSystemTemplateSystemSignalRef=DET_BI_STATIC_FLAG_018_Rx
          DET_RCS_017_Rx_oRDR_FUSION_DET_017_020_oPCAN_RADAR_8eb4a8b0_Rx: ComBitPosition=128, ComBitSize=8, ComSignalType=UINT8, ComHandleId=477, ComSystemTemplateSystemSignalRef=DET_RCS_017_Rx
          DET_PROB_1STAZHYPO_019_Rx_oRDR_FUSION_DET_017_020_oPCAN_RADAR_ea3db1ad_Rx: ComBitPosition=327, ComBitSize=1, ComSignalType=BOOLEAN, ComHandleId=459, ComSystemTemplateSystemSignalRef=DET_PROB_1STAZHYPO_019_Rx
          DET_CONFD_AZIMUTH_017_Rx_oRDR_FUSION_DET_017_020_oPCAN_RADAR_7f015b80_Rx: ComBitPosition=118, ComBitSize=2, ComSignalType=UINT8, ComHandleId=422, ComSystemTemplateSystemSignalRef=DET_CONFD_AZIMUTH_017_Rx
          DET_SUPER_RES_TARGET_017_Rx_oRDR_FUSION_DET_017_020_oPCAN_RADAR_4c15f859_Rx: ComBitPosition=87, ComBitSize=1, ComSignalType=BOOLEAN, ComHandleId=485, ComSystemTemplateSystemSignalRef=DET_SUPER_RES_TARGET_017_Rx
          DET_IDM_018_Rx_oRDR_FUSION_DET_017_020_oPCAN_RADAR_32830b1b_Rx: ComBitPosition=175, ComBitSize=1, ComSignalType=BOOLEAN, ComHandleId=447, ComSystemTemplateSystemSignalRef=DET_IDM_018_Rx
          DET_AZIMUTH_ERR_018_Rx_oRDR_FUSION_DET_017_020_oPCAN_RADAR_0f6b3658_Rx: ComBitPosition=217, ComBitSize=7, ComSignalType=UINT8, ComHandleId=411, ComSystemTemplateSystemSignalRef=DET_AZIMUTH_ERR_018_Rx
          DET_MH_SCAN_INDEX_4LSB_017_020_Rx_oRDR_FUSION_DET_017_020_oPCAN_RADAR_fb935771_Rx: ComBitPosition=476, ComBitSize=4, ComSignalType=UINT8, ComHandleId=452, ComSystemTemplateSystemSignalRef=DET_MH_SCAN_INDEX_4LSB_017_020_Rx
          DET_RANGE_VELOCITY_ERR_017_Rx_oRDR_FUSION_DET_017_020_oPCAN_RADAR_da1b4a69_Rx: ComBitPosition=64, ComBitSize=8, ComSignalType=UINT8, ComHandleId=473, ComSystemTemplateSystemSignalRef=DET_RANGE_VELOCITY_ERR_017_Rx
          DET_CONFD_AZIMUTH_020_Rx_oRDR_FUSION_DET_017_020_oPCAN_RADAR_66751f75_Rx: ComBitPosition=454, ComBitSize=2, ComSignalType=UINT8, ComHandleId=425, ComSystemTemplateSystemSignalRef=DET_CONFD_AZIMUTH_020_Rx
          DET_HVC_FLAG_019_Rx_oRDR_FUSION_DET_017_020_oPCAN_RADAR_a8066014_Rx: ComBitPosition=310, ComBitSize=1, ComSignalType=BOOLEAN, ComHandleId=444, ComSystemTemplateSystemSignalRef=DET_HVC_FLAG_019_Rx
          DET_CONFD_ELEVATION_020_Rx_oRDR_FUSION_DET_017_020_oPCAN_RADAR_6c549cf2_Rx: ComBitPosition=437, ComBitSize=2, ComSignalType=UINT8, ComHandleId=429, ComSystemTemplateSystemSignalRef=DET_CONFD_ELEVATION_020_Rx
          DET_BELOW_RAIN_THOLD_019_Rx_oRDR_FUSION_DET_017_020_oPCAN_RADAR_c4fcfa28_Rx: ComBitPosition=263, ComBitSize=1, ComSignalType=BOOLEAN, ComHandleId=416, ComSystemTemplateSystemSignalRef=DET_BELOW_RAIN_THOLD_019_Rx
          DET_EXISTENCE_PROB_019_Rx_oRDR_FUSION_DET_017_020_oPCAN_RADAR_75d88d5b_Rx: ComBitPosition=336, ComBitSize=6, ComSignalType=UINT8, ComHandleId=440, ComSystemTemplateSystemSignalRef=DET_EXISTENCE_PROB_019_Rx
          DET_BI_STATIC_FLAG_017_Rx_oRDR_FUSION_DET_017_020_oPCAN_RADAR_9c68b1d4_Rx: ComBitPosition=104, ComBitSize=1, ComSignalType=BOOLEAN, ComHandleId=418, ComSystemTemplateSystemSignalRef=DET_BI_STATIC_FLAG_017_Rx
          DET_BELOW_RAIN_THOLD_020_Rx_oRDR_FUSION_DET_017_020_oPCAN_RADAR_f2825e32_Rx: ComBitPosition=375, ComBitSize=1, ComSignalType=BOOLEAN, ComHandleId=417, ComSystemTemplateSystemSignalRef=DET_BELOW_RAIN_THOLD_020_Rx
          DET_ELEVATION_ERR_018_Rx_oRDR_FUSION_DET_017_020_oPCAN_RADAR_2d846789_Rx: ComBitPosition=192, ComBitSize=6, ComSignalType=UINT8, ComHandleId=435, ComSystemTemplateSystemSignalRef=DET_ELEVATION_ERR_018_Rx
          DET_RANGE_VELOCITY_020_Rx_oRDR_FUSION_DET_017_020_oPCAN_RADAR_5a0b7e5e_Rx: ComBitPosition=384, ComBitSize=15, ComSignalType=UINT16, ComHandleId=472, ComSystemTemplateSystemSignalRef=DET_RANGE_VELOCITY_020_Rx
          DET_RANGE_020_Rx_oRDR_FUSION_DET_017_020_oPCAN_RADAR_87fefda0_Rx: ComBitPosition=360, ComBitSize=15, ComSignalType=UINT16, ComHandleId=464, ComSystemTemplateSystemSignalRef=DET_RANGE_020_Rx
          DET_RANGE_019_Rx_oRDR_FUSION_DET_017_020_oPCAN_RADAR_b18059ba_Rx: ComBitPosition=248, ComBitSize=15, ComSignalType=UINT16, ComHandleId=463, ComSystemTemplateSystemSignalRef=DET_RANGE_019_Rx
          DET_ELEVATION_018_Rx_oRDR_FUSION_DET_017_020_oPCAN_RADAR_ff3d4556_Rx: ComBitPosition=184, ComBitSize=8, ComSignalType=UINT8, ComHandleId=431, ComSystemTemplateSystemSignalRef=DET_ELEVATION_018_Rx
          DET_PROB_1STAZHYPO_018_Rx_oRDR_FUSION_DET_017_020_oPCAN_RADAR_457923ea_Rx: ComBitPosition=215, ComBitSize=1, ComSignalType=BOOLEAN, ComHandleId=458, ComSystemTemplateSystemSignalRef=DET_PROB_1STAZHYPO_018_Rx
          DET_RANGE_018_Rx_oRDR_FUSION_DET_017_020_oPCAN_RADAR_1ec4cbfd_Rx: ComBitPosition=136, ComBitSize=15, ComSignalType=UINT16, ComHandleId=462, ComSystemTemplateSystemSignalRef=DET_RANGE_018_Rx
          DET_HVC_FLAG_020_Rx_oRDR_FUSION_DET_017_020_oPCAN_RADAR_9e78c40e_Rx: ComBitPosition=422, ComBitSize=1, ComSignalType=BOOLEAN, ComHandleId=445, ComSystemTemplateSystemSignalRef=DET_HVC_FLAG_020_Rx
          DET_SUPER_RES_TARGET_020_Rx_oRDR_FUSION_DET_017_020_oPCAN_RADAR_5561bcac_Rx: ComBitPosition=423, ComBitSize=1, ComSignalType=BOOLEAN, ComHandleId=488, ComSystemTemplateSystemSignalRef=DET_SUPER_RES_TARGET_020_Rx
          DET_BELOW_RAIN_THOLD_018_Rx_oRDR_FUSION_DET_017_020_oPCAN_RADAR_6bb8686f_Rx: ComBitPosition=151, ComBitSize=1, ComSignalType=BOOLEAN, ComHandleId=415, ComSystemTemplateSystemSignalRef=DET_BELOW_RAIN_THOLD_018_Rx
          DET_SUPER_RES_TARGET_019_Rx_oRDR_FUSION_DET_017_020_oPCAN_RADAR_631f18b6_Rx: ComBitPosition=311, ComBitSize=1, ComSignalType=BOOLEAN, ComHandleId=487, ComSystemTemplateSystemSignalRef=DET_SUPER_RES_TARGET_019_Rx
          DET_RANGE_VELOCITY_ERR_020_Rx_oRDR_FUSION_DET_017_020_oPCAN_RADAR_c36f0e9c_Rx: ComBitPosition=400, ComBitSize=8, ComSignalType=UINT8, ComHandleId=476, ComSystemTemplateSystemSignalRef=DET_RANGE_VELOCITY_ERR_020_Rx
          DET_ELEVATION_ERR_019_Rx_oRDR_FUSION_DET_017_020_oPCAN_RADAR_82c0f5ce_Rx: ComBitPosition=304, ComBitSize=6, ComSignalType=UINT8, ComHandleId=436, ComSystemTemplateSystemSignalRef=DET_ELEVATION_ERR_019_Rx
          DET_EXISTENCE_PROB_018_Rx_oRDR_FUSION_DET_017_020_oPCAN_RADAR_da9c1f1c_Rx: ComBitPosition=224, ComBitSize=6, ComSignalType=UINT8, ComHandleId=439, ComSystemTemplateSystemSignalRef=DET_EXISTENCE_PROB_018_Rx
          DET_AZIMUTH_017_Rx_oRDR_FUSION_DET_017_020_oPCAN_RADAR_8d4ce572_Rx: ComBitPosition=88, ComBitSize=13, ComSignalType=UINT16, ComHandleId=406, ComSystemTemplateSystemSignalRef=DET_AZIMUTH_017_Rx
          DET_BELOW_RAIN_THOLD_017_Rx_oRDR_FUSION_DET_017_020_oPCAN_RADAR_ebf61ac7_Rx: ComBitPosition=39, ComBitSize=1, ComSignalType=BOOLEAN, ComHandleId=414, ComSystemTemplateSystemSignalRef=DET_BELOW_RAIN_THOLD_017_Rx
          DET_PROB_1STAZHYPO_020_Rx_oRDR_FUSION_DET_017_020_oPCAN_RADAR_dc4315b7_Rx: ComBitPosition=439, ComBitSize=1, ComSignalType=BOOLEAN, ComHandleId=460, ComSystemTemplateSystemSignalRef=DET_PROB_1STAZHYPO_020_Rx
          DET_AZIMUTH_ERR_020_Rx_oRDR_FUSION_DET_017_020_oPCAN_RADAR_96510005_Rx: ComBitPosition=441, ComBitSize=7, ComSignalType=UINT8, ComHandleId=413, ComSystemTemplateSystemSignalRef=DET_AZIMUTH_ERR_020_Rx
          DET_ELEVATION_017_Rx_oRDR_FUSION_DET_017_020_oPCAN_RADAR_7f7337fe_Rx: ComBitPosition=72, ComBitSize=8, ComSignalType=UINT8, ComHandleId=430, ComSystemTemplateSystemSignalRef=DET_ELEVATION_017_Rx
          DET_MTD_020_Rx_oRDR_FUSION_DET_017_020_oPCAN_RADAR_163a0b36_Rx: ComBitPosition=383, ComBitSize=1, ComSignalType=BOOLEAN, ComHandleId=456, ComSystemTemplateSystemSignalRef=DET_MTD_020_Rx
          DET_RANGE_017_Rx_oRDR_FUSION_DET_017_020_oPCAN_RADAR_9e8ab955_Rx: ComBitPosition=24, ComBitSize=15, ComSignalType=UINT16, ComHandleId=461, ComSystemTemplateSystemSignalRef=DET_RANGE_017_Rx
          DET_RCS_019_Rx_oRDR_FUSION_DET_017_020_oPCAN_RADAR_a1be485f_Rx: ComBitPosition=352, ComBitSize=8, ComSignalType=UINT8, ComHandleId=479, ComSystemTemplateSystemSignalRef=DET_RCS_019_Rx
          DET_SNR_020_Rx_oRDR_FUSION_DET_017_020_oPCAN_RADAR_9e9a9dac_Rx: ComBitPosition=456, ComBitSize=8, ComSignalType=UINT8, ComHandleId=484, ComSystemTemplateSystemSignalRef=DET_SNR_020_Rx
          DET_ELEVATION_ERR_017_Rx_oRDR_FUSION_DET_017_020_oPCAN_RADAR_adca1521_Rx: ComBitPosition=80, ComBitSize=6, ComSignalType=UINT8, ComHandleId=434, ComSystemTemplateSystemSignalRef=DET_ELEVATION_ERR_017_Rx
          DET_HVC_FLAG_017_Rx_oRDR_FUSION_DET_017_020_oPCAN_RADAR_870c80fb_Rx: ComBitPosition=86, ComBitSize=1, ComSignalType=BOOLEAN, ComHandleId=442, ComSystemTemplateSystemSignalRef=DET_HVC_FLAG_017_Rx
          DET_ELEVATION_020_Rx_oRDR_FUSION_DET_017_020_oPCAN_RADAR_6607730b_Rx: ComBitPosition=408, ComBitSize=8, ComSignalType=UINT8, ComHandleId=433, ComSystemTemplateSystemSignalRef=DET_ELEVATION_020_Rx
          DET_RANGE_VELOCITY_018_Rx_oRDR_FUSION_DET_017_020_oPCAN_RADAR_c3314803_Rx: ComBitPosition=160, ComBitSize=15, ComSignalType=UINT16, ComHandleId=470, ComSystemTemplateSystemSignalRef=DET_RANGE_VELOCITY_018_Rx
          DET_MTD_019_Rx_oRDR_FUSION_DET_017_020_oPCAN_RADAR_2044af2c_Rx: ComBitPosition=271, ComBitSize=1, ComSignalType=BOOLEAN, ComHandleId=455, ComSystemTemplateSystemSignalRef=DET_MTD_019_Rx
          DET_SUPER_RES_TARGET_018_Rx_oRDR_FUSION_DET_017_020_oPCAN_RADAR_cc5b8af1_Rx: ComBitPosition=199, ComBitSize=1, ComSignalType=BOOLEAN, ComHandleId=486, ComSystemTemplateSystemSignalRef=DET_SUPER_RES_TARGET_018_Rx
          DET_SNR_017_Rx_oRDR_FUSION_DET_017_020_oPCAN_RADAR_87eed959_Rx: ComBitPosition=120, ComBitSize=8, ComSignalType=UINT8, ComHandleId=481, ComSystemTemplateSystemSignalRef=DET_SNR_017_Rx
          DET_RCS_018_Rx_oRDR_FUSION_DET_017_020_oPCAN_RADAR_0efada18_Rx: ComBitPosition=240, ComBitSize=8, ComSignalType=UINT8, ComHandleId=478, ComSystemTemplateSystemSignalRef=DET_RCS_018_Rx
          DET_HVC_FLAG_018_Rx_oRDR_FUSION_DET_017_020_oPCAN_RADAR_0742f253_Rx: ComBitPosition=198, ComBitSize=1, ComSignalType=BOOLEAN, ComHandleId=443, ComSystemTemplateSystemSignalRef=DET_HVC_FLAG_018_Rx
          DET_RANGE_ERR_019_Rx_oRDR_FUSION_DET_017_020_oPCAN_RADAR_e172d55a_Rx: ComBitPosition=264, ComBitSize=7, ComSignalType=UINT8, ComHandleId=467, ComSystemTemplateSystemSignalRef=DET_RANGE_ERR_019_Rx
          DET_ELEVATION_019_Rx_oRDR_FUSION_DET_017_020_oPCAN_RADAR_5079d711_Rx: ComBitPosition=296, ComBitSize=8, ComSignalType=UINT8, ComHandleId=432, ComSystemTemplateSystemSignalRef=DET_ELEVATION_019_Rx
          DET_RANGE_VELOCITY_ERR_019_Rx_oRDR_FUSION_DET_017_020_oPCAN_RADAR_f511aa86_Rx: ComBitPosition=288, ComBitSize=8, ComSignalType=UINT8, ComHandleId=475, ComSystemTemplateSystemSignalRef=DET_RANGE_VELOCITY_ERR_019_Rx
          DET_MTD_017_Rx_oRDR_FUSION_DET_017_020_oPCAN_RADAR_0f4e4fc3_Rx: ComBitPosition=47, ComBitSize=1, ComSignalType=BOOLEAN, ComHandleId=453, ComSystemTemplateSystemSignalRef=DET_MTD_017_Rx
          DET_BI_STATIC_FLAG_020_Rx_oRDR_FUSION_DET_017_020_oPCAN_RADAR_851cf521_Rx: ComBitPosition=440, ComBitSize=1, ComSignalType=BOOLEAN, ComHandleId=421, ComSystemTemplateSystemSignalRef=DET_BI_STATIC_FLAG_020_Rx
          DET_AZIMUTH_019_Rx_oRDR_FUSION_DET_017_020_oPCAN_RADAR_a246059d_Rx: ComBitPosition=312, ComBitSize=13, ComSignalType=UINT16, ComHandleId=408, ComSystemTemplateSystemSignalRef=DET_AZIMUTH_019_Rx
          DET_CONFD_ELEVATION_017_Rx_oRDR_FUSION_DET_017_020_oPCAN_RADAR_7520d807_Rx: ComBitPosition=101, ComBitSize=2, ComSignalType=UINT8, ComHandleId=426, ComSystemTemplateSystemSignalRef=DET_CONFD_ELEVATION_017_Rx
          DET_RCS_020_Rx_oRDR_FUSION_DET_017_020_oPCAN_RADAR_97c0ec45_Rx: ComBitPosition=464, ComBitSize=8, ComSignalType=UINT8, ComHandleId=480, ComSystemTemplateSystemSignalRef=DET_RCS_020_Rx
          DET_RANGE_VELOCITY_ERR_018_Rx_oRDR_FUSION_DET_017_020_oPCAN_RADAR_5a5538c1_Rx: ComBitPosition=176, ComBitSize=8, ComSignalType=UINT8, ComHandleId=474, ComSystemTemplateSystemSignalRef=DET_RANGE_VELOCITY_ERR_018_Rx
          DET_RANGE_ERR_020_Rx_oRDR_FUSION_DET_017_020_oPCAN_RADAR_d70c7140_Rx: ComBitPosition=376, ComBitSize=7, ComSignalType=UINT8, ComHandleId=468, ComSystemTemplateSystemSignalRef=DET_RANGE_ERR_020_Rx
          DET_RANGE_VELOCITY_017_Rx_oRDR_FUSION_DET_017_020_oPCAN_RADAR_437f3aab_Rx: ComBitPosition=48, ComBitSize=15, ComSignalType=UINT16, ComHandleId=469, ComSystemTemplateSystemSignalRef=DET_RANGE_VELOCITY_017_Rx
          DET_RANGE_VELOCITY_019_Rx_oRDR_FUSION_DET_017_020_oPCAN_RADAR_6c75da44_Rx: ComBitPosition=272, ComBitSize=15, ComSignalType=UINT16, ComHandleId=471, ComSystemTemplateSystemSignalRef=DET_RANGE_VELOCITY_019_Rx
          DET_PROB_1STAZHYPO_017_Rx_oRDR_FUSION_DET_017_020_oPCAN_RADAR_c5375142_Rx: ComBitPosition=103, ComBitSize=1, ComSignalType=BOOLEAN, ComHandleId=457, ComSystemTemplateSystemSignalRef=DET_PROB_1STAZHYPO_017_Rx
          DET_RANGE_ERR_017_Rx_oRDR_FUSION_DET_017_020_oPCAN_RADAR_ce7835b5_Rx: ComBitPosition=40, ComBitSize=7, ComSignalType=UINT8, ComHandleId=465, ComSystemTemplateSystemSignalRef=DET_RANGE_ERR_017_Rx
          DET_BI_STATIC_FLAG_019_Rx_oRDR_FUSION_DET_017_020_oPCAN_RADAR_b362513b_Rx: ComBitPosition=328, ComBitSize=1, ComSignalType=BOOLEAN, ComHandleId=420, ComSystemTemplateSystemSignalRef=DET_BI_STATIC_FLAG_019_Rx
          DET_SNR_018_Rx_oRDR_FUSION_DET_017_020_oPCAN_RADAR_07a0abf1_Rx: ComBitPosition=232, ComBitSize=8, ComSignalType=UINT8, ComHandleId=482, ComSystemTemplateSystemSignalRef=DET_SNR_018_Rx
          DET_AZIMUTH_020_Rx_oRDR_FUSION_DET_017_020_oPCAN_RADAR_9438a187_Rx: ComBitPosition=424, ComBitSize=13, ComSignalType=UINT16, ComHandleId=409, ComSystemTemplateSystemSignalRef=DET_AZIMUTH_020_Rx
          DET_CONFD_AZIMUTH_019_Rx_oRDR_FUSION_DET_017_020_oPCAN_RADAR_500bbb6f_Rx: ComBitPosition=342, ComBitSize=2, ComSignalType=UINT8, ComHandleId=424, ComSystemTemplateSystemSignalRef=DET_CONFD_AZIMUTH_019_Rx
          DET_ELEVATION_ERR_020_Rx_oRDR_FUSION_DET_017_020_oPCAN_RADAR_b4be51d4_Rx: ComBitPosition=416, ComBitSize=6, ComSignalType=UINT8, ComHandleId=437, ComSystemTemplateSystemSignalRef=DET_ELEVATION_ERR_020_Rx
          DET_AZIMUTH_ERR_019_Rx_oRDR_FUSION_DET_017_020_oPCAN_RADAR_a02fa41f_Rx: ComBitPosition=329, ComBitSize=7, ComSignalType=UINT8, ComHandleId=412, ComSystemTemplateSystemSignalRef=DET_AZIMUTH_ERR_019_Rx
          DET_AZIMUTH_ERR_017_Rx_oRDR_FUSION_DET_017_020_oPCAN_RADAR_8f2544f0_Rx: ComBitPosition=105, ComBitSize=7, ComSignalType=UINT8, ComHandleId=410, ComSystemTemplateSystemSignalRef=DET_AZIMUTH_ERR_017_Rx
          DET_MTD_018_Rx_oRDR_FUSION_DET_017_020_oPCAN_RADAR_8f003d6b_Rx: ComBitPosition=159, ComBitSize=1, ComSignalType=BOOLEAN, ComHandleId=454, ComSystemTemplateSystemSignalRef=DET_MTD_018_Rx
          DET_CONFD_AZIMUTH_018_Rx_oRDR_FUSION_DET_017_020_oPCAN_RADAR_ff4f2928_Rx: ComBitPosition=230, ComBitSize=2, ComSignalType=UINT8, ComHandleId=423, ComSystemTemplateSystemSignalRef=DET_CONFD_AZIMUTH_018_Rx
          DET_IDM_019_Rx_oRDR_FUSION_DET_017_020_oPCAN_RADAR_9dc7995c_Rx: ComBitPosition=287, ComBitSize=1, ComSignalType=BOOLEAN, ComHandleId=448, ComSystemTemplateSystemSignalRef=DET_IDM_019_Rx
          DET_CONFD_ELEVATION_018_Rx_oRDR_FUSION_DET_017_020_oPCAN_RADAR_f56eaaaf_Rx: ComBitPosition=213, ComBitSize=2, ComSignalType=UINT8, ComHandleId=427, ComSystemTemplateSystemSignalRef=DET_CONFD_ELEVATION_018_Rx
          DET_IDM_020_Rx_oRDR_FUSION_DET_017_020_oPCAN_RADAR_abb93d46_Rx: ComBitPosition=399, ComBitSize=1, ComSignalType=BOOLEAN, ComHandleId=449, ComSystemTemplateSystemSignalRef=DET_IDM_020_Rx
          DET_EXISTENCE_PROB_017_Rx_oRDR_FUSION_DET_017_020_oPCAN_RADAR_5ad26db4_Rx: ComBitPosition=112, ComBitSize=6, ComSignalType=UINT8, ComHandleId=438, ComSystemTemplateSystemSignalRef=DET_EXISTENCE_PROB_017_Rx
          DET_RANGE_ERR_018_Rx_oRDR_FUSION_DET_017_020_oPCAN_RADAR_4e36471d_Rx: ComBitPosition=152, ComBitSize=7, ComSignalType=UINT8, ComHandleId=466, ComSystemTemplateSystemSignalRef=DET_RANGE_ERR_018_Rx
          DET_SNR_019_Rx_oRDR_FUSION_DET_017_020_oPCAN_RADAR_a8e439b6_Rx: ComBitPosition=344, ComBitSize=8, ComSignalType=UINT8, ComHandleId=483, ComSystemTemplateSystemSignalRef=DET_SNR_019_Rx
          DET_MH_CRC16_017_020_Rx_oRDR_FUSION_DET_017_020_oPCAN_RADAR_92f8a58f_Rx: ComBitPosition=0, ComBitSize=16, ComSignalType=UINT16, ComHandleId=450, ComSystemTemplateSystemSignalRef=DET_MH_CRC16_017_020_Rx
          DET_CONFD_ELEVATION_019_Rx_oRDR_FUSION_DET_017_020_oPCAN_RADAR_5a2a38e8_Rx: ComBitPosition=325, ComBitSize=2, ComSignalType=UINT8, ComHandleId=428, ComSystemTemplateSystemSignalRef=DET_CONFD_ELEVATION_019_Rx
          DET_MH_CYCLE_COUNTER_017_020_Rx_oRDR_FUSION_DET_017_020_oPCAN_RADAR_9f23984a_Rx: ComBitPosition=16, ComBitSize=8, ComSignalType=UINT8, ComHandleId=451, ComSystemTemplateSystemSignalRef=DET_MH_CYCLE_COUNTER_017_020_Rx
          DET_EXISTENCE_PROB_020_Rx_oRDR_FUSION_DET_017_020_oPCAN_RADAR_43a62941_Rx: ComBitPosition=448, ComBitSize=6, ComSignalType=UINT8, ComHandleId=441, ComSystemTemplateSystemSignalRef=DET_EXISTENCE_PROB_020_Rx
          DET_IDM_017_Rx_oRDR_FUSION_DET_017_020_oPCAN_RADAR_b2cd79b3_Rx: ComBitPosition=63, ComBitSize=1, ComSignalType=BOOLEAN, ComHandleId=446, ComSystemTemplateSystemSignalRef=DET_IDM_017_Rx
      RDR_FUSION_DET_041_044_oPCAN_RADAR_c19af5a8_Rx (ComIPdu):
        ComIPduDirection = RECEIVE
        ComIPduType = NORMAL
        ComIPduCancellationSupport = false
        ComIPduHandleId = 32
        ComIPduSignalProcessing = DEFERRED
        ComIPduChannelRef = CN_PCAN_RADAR_458ff0f1
        ComIPduGroupRef = RDR01_oPCAN_RADAR_Rx_e0e717e1 if post-build-variant-condition{matching-criterion=RDR_POS, value=0}
        ComIPduSignalGroupRef = SG_Fusion_Detections_041_044_oRDR_FUSION_DET_041_044_oPCAN_RADAR_eab931b2_Rx
        ComPduIdRef = RDR_FUSION_DET_041_044_oPCAN_RADAR_c19af5a8_Rx
        ComIPduMainFunctionRef = ComMainFunctionRx
        ComIPduGroupRef = RDR02_oPCAN_RADAR_Rx_c92fa313 if post-build-variant-condition{matching-criterion=RDR_POS, value=1}
        ComIPduGroupRef = RDR03_oPCAN_RADAR_Rx_67473282 if post-build-variant-condition{matching-criterion=RDR_POS, value=2}
        ComIPduGroupRef = RDR04_oPCAN_RADAR_Rx_9abecaf7 if post-build-variant-condition{matching-criterion=RDR_POS, value=3}
        ComIPduGroupRef = RDR05_oPCAN_RADAR_Rx_34d65b66 if post-build-variant-condition{matching-criterion=RDR_POS, value=4}
        ComIPduGroupRef = RDR06_oPCAN_RADAR_Rx_1d1eef94 if post-build-variant-condition{matching-criterion=RDR_POS, value=5}
        ComIPduGroupRef = RDR07_oPCAN_RADAR_Rx_b3767e05 if post-build-variant-condition{matching-criterion=RDR_POS, value=6}
        ComIPduGroupRef = RDR08_oPCAN_RADAR_Rx_3d9c193f if post-build-variant-condition{matching-criterion=RDR_POS, value=7}
      RDR_FUSION_DET_017_020_oPCAN_RADAR_ba2f0267_Rx (ComIPdu):
        ComIPduDirection = RECEIVE
        ComIPduType = NORMAL
        ComIPduCancellationSupport = false
        ComIPduHandleId = 26
        ComIPduSignalProcessing = DEFERRED
        ComIPduChannelRef = CN_PCAN_RADAR_458ff0f1
        ComIPduGroupRef = RDR01_oPCAN_RADAR_Rx_e0e717e1 if post-build-variant-condition{matching-criterion=RDR_POS, value=0}
        ComIPduSignalGroupRef = SG_Fusion_Detections_017_020_oRDR_FUSION_DET_017_020_oPCAN_RADAR_3121649c_Rx
        ComPduIdRef = RDR_FUSION_DET_017_020_oPCAN_RADAR_ba2f0267_Rx
        ComIPduMainFunctionRef = ComMainFunctionRx
        ComIPduGroupRef = RDR02_oPCAN_RADAR_Rx_c92fa313 if post-build-variant-condition{matching-criterion=RDR_POS, value=1}
        ComIPduGroupRef = RDR03_oPCAN_RADAR_Rx_67473282 if post-build-variant-condition{matching-criterion=RDR_POS, value=2}
        ComIPduGroupRef = RDR04_oPCAN_RADAR_Rx_9abecaf7 if post-build-variant-condition{matching-criterion=RDR_POS, value=3}
        ComIPduGroupRef = RDR05_oPCAN_RADAR_Rx_34d65b66 if post-build-variant-condition{matching-criterion=RDR_POS, value=4}
        ComIPduGroupRef = RDR06_oPCAN_RADAR_Rx_1d1eef94 if post-build-variant-condition{matching-criterion=RDR_POS, value=5}
        ComIPduGroupRef = RDR07_oPCAN_RADAR_Rx_b3767e05 if post-build-variant-condition{matching-criterion=RDR_POS, value=6}
        ComIPduGroupRef = RDR08_oPCAN_RADAR_Rx_3d9c193f if post-build-variant-condition{matching-criterion=RDR_POS, value=7}
