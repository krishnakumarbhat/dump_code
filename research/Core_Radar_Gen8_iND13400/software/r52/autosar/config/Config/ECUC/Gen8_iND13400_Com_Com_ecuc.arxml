[part 5 of 20: package /ActiveEcuC]
AUTOSAR XML (schema 00053)
package /ActiveEcuC  (continued)
  module config Com: implementation-config-variant=VARIANT-PRE-COMPILE, module-description=Com_Impl  (continued)
    ComConfig: ComConfigurationId=0, ComRxImmediateNotificationCacheSize=0, ComRxDeferredNotificationCacheSize=1  (continued)
      SG_TrackerObject031_oRDR_TRACKER_OBJ_031_oPCAN_RADAR_520c655f_Tx (ComSignalGroup):
        ComTransferProperty = TRIGGERED
        ComSignalGroupAccess = ACCESS_NEEDED_BY_SWC_OR_COM
        ComHandleId = 140
        ComSignalGroupArrayAccess = true
        ComSystemTemplateSignalGroupRef = SG_TrackerObject031
        49 x ComGroupSignal, all with ComSignalEndianness=BIG_ENDIAN, ComSignalInitValue=0, ComTransferProperty=PENDING, ComSignalAccess=ACCESS_NEEDED_BY_SWC_OR_COM:
          OBJ_CLS_TYPE4_PROB_031_oRDR_TRACKER_OBJ_031_oPCAN_RADAR_f11731f7_Tx: ComBitPosition=327, ComBitSize=8, ComSignalType=UINT8, ComHandleId=10012, ComSystemTemplateSystemSignalRef=OBJ_CLS_TYPE4_PROB_031
          OBJ_GROUP_ID_031_oRDR_TRACKER_OBJ_031_oPCAN_RADAR_3afcf92b_Tx: ComBitPosition=405, ComBitSize=6, ComSignalType=UINT8, ComHandleId=10022, ComSystemTemplateSystemSignalRef=OBJ_GROUP_ID_031
          OBJ_TIMESTAMP_OFFSET_031_oRDR_TRACKER_OBJ_031_oPCAN_RADAR_c91d5efa_Tx: ComBitPosition=247, ComBitSize=8, ComSignalType=UINT8, ComHandleId=10036, ComSystemTemplateSystemSignalRef=OBJ_TIMESTAMP_OFFSET_031
          OBJ_CLS_TYPE3_PROB_031_oRDR_TRACKER_OBJ_031_oPCAN_RADAR_ff1df757_Tx: ComBitPosition=319, ComBitSize=8, ComSignalType=UINT8, ComHandleId=10010, ComSystemTemplateSystemSignalRef=OBJ_CLS_TYPE3_PROB_031
          OBJ_MEASUREMENT_STATUS_031_oRDR_TRACKER_OBJ_031_oPCAN_RADAR_b600a091_Tx: ComBitPosition=14, ComBitSize=3, ComSignalType=UINT8, ComHandleId=10024, ComSystemTemplateSystemSignalRef=OBJ_MEASUREMENT_STATUS_031
          OBJ_ACCEL_ERR_CRR_COEF_031_oRDR_TRACKER_OBJ_031_oPCAN_RADAR_36da805a_Tx: ComBitPosition=431, ComBitSize=8, ComSignalType=UINT8, ComHandleId=10003, ComSystemTemplateSystemSignalRef=OBJ_ACCEL_ERR_CRR_COEF_031
          OBJ_POS_LAT_ERR_031_oRDR_TRACKER_OBJ_031_oPCAN_RADAR_ef32589c_Tx: ComBitPosition=103, ComBitSize=8, ComSignalType=UINT8, ComHandleId=10030, ComSystemTemplateSystemSignalRef=OBJ_POS_LAT_ERR_031
          OBJ_CLS_TYPE3_031_oRDR_TRACKER_OBJ_031_oPCAN_RADAR_190230d7_Tx: ComBitPosition=279, ComBitSize=4, ComSignalType=UINT8, ComHandleId=10009, ComSystemTemplateSystemSignalRef=OBJ_CLS_TYPE3_031
          OBJ_POS_LONG_ERR_031_oRDR_TRACKER_OBJ_031_oPCAN_RADAR_76caa67e_Tx: ComBitPosition=95, ComBitSize=8, ComSignalType=UINT8, ComHandleId=10032, ComSystemTemplateSystemSignalRef=OBJ_POS_LONG_ERR_031
          OBJ_VELOCITY_LAT_ERR_031_oRDR_TRACKER_OBJ_031_oPCAN_RADAR_9be73ddd_Tx: ComBitPosition=151, ComBitSize=8, ComSignalType=UINT8, ComHandleId=10041, ComSystemTemplateSystemSignalRef=OBJ_VELOCITY_LAT_ERR_031
          OBJ_YAW_RATE_ERR_031_oRDR_TRACKER_OBJ_031_oPCAN_RADAR_59f6bb57_Tx: ComBitPosition=388, ComBitSize=5, ComSignalType=UINT8, ComHandleId=10047, ComSystemTemplateSystemSignalRef=OBJ_YAW_RATE_ERR_031
          OBJ_CLS_TYPE5_PROB_031_oRDR_TRACKER_OBJ_031_oPCAN_RADAR_b604c70c_Tx: ComBitPosition=335, ComBitSize=8, ComSignalType=UINT8, ComHandleId=10014, ComSystemTemplateSystemSignalRef=OBJ_CLS_TYPE5_PROB_031
          OBJ_MOVEMENT_STATUS_031_oRDR_TRACKER_OBJ_031_oPCAN_RADAR_99ae35dd_Tx: ComBitPosition=196, ComBitSize=3, ComSignalType=UINT8, ComHandleId=10027, ComSystemTemplateSystemSignalRef=OBJ_MOVEMENT_STATUS_031
          OBJ_POS_LONG_031_oRDR_TRACKER_OBJ_031_oPCAN_RADAR_5adee364_Tx: ComBitPosition=63, ComBitSize=16, ComSignalType=UINT16, ComHandleId=10031, ComSystemTemplateSystemSignalRef=OBJ_POS_LONG_031
          OBJ_YAW_ANGLE_ERR_031_oRDR_TRACKER_OBJ_031_oPCAN_RADAR_96ac0f1b_Tx: ComBitPosition=175, ComBitSize=7, ComSignalType=UINT8, ComHandleId=10045, ComSystemTemplateSystemSignalRef=OBJ_YAW_ANGLE_ERR_031
          OBJ_CLS_TYPE6_031_oRDR_TRACKER_OBJ_031_oPCAN_RADAR_cf3a307e_Tx: ComBitPosition=282, ComBitSize=4, ComSignalType=UINT8, ComHandleId=10015, ComSystemTemplateSystemSignalRef=OBJ_CLS_TYPE6_031
          OBJ_CLS_TYPE4_031_oRDR_TRACKER_OBJ_031_oPCAN_RADAR_0f5acdfb_Tx: ComBitPosition=275, ComBitSize=4, ComSignalType=UINT8, ComHandleId=10011, ComSystemTemplateSystemSignalRef=OBJ_CLS_TYPE4_031
          OBJ_POS_LAT_031_oRDR_TRACKER_OBJ_031_oPCAN_RADAR_eb7e08ab_Tx: ComBitPosition=79, ComBitSize=16, ComSignalType=UINT16, ComHandleId=10029, ComSystemTemplateSystemSignalRef=OBJ_POS_LAT_031
          OBJ_ACCELERATION_LONG_031_oRDR_TRACKER_OBJ_031_oPCAN_RADAR_2ed867c8_Tx: ComBitPosition=193, ComBitSize=10, ComSignalType=UINT16, ComHandleId=10001, ComSystemTemplateSystemSignalRef=OBJ_ACCELERATION_LONG_031
          OBJ_ACCELERATION_LAT_ERR_031_oRDR_TRACKER_OBJ_031_oPCAN_RADAR_89dc0496_Tx: ComBitPosition=223, ComBitSize=8, ComSignalType=UINT8, ComHandleId=10000, ComSystemTemplateSystemSignalRef=OBJ_ACCELERATION_LAT_ERR_031
          OBJ_TRACK_MOTION_MODEL_031_oRDR_TRACKER_OBJ_031_oPCAN_RADAR_051e5f27_Tx: ComBitPosition=9, ComBitSize=2, ComSignalType=UINT8, ComHandleId=10037, ComSystemTemplateSystemSignalRef=OBJ_TRACK_MOTION_MODEL_031
          OBJ_ACCELERATION_LONG_ERR_031_oRDR_TRACKER_OBJ_031_oPCAN_RADAR_9679a13c_Tx: ComBitPosition=215, ComBitSize=8, ComSignalType=UINT8, ComHandleId=10002, ComSystemTemplateSystemSignalRef=OBJ_ACCELERATION_LONG_ERR_031
          OBJ_ACCELERATION_LAT_031_oRDR_TRACKER_OBJ_031_oPCAN_RADAR_5c283e28_Tx: ComBitPosition=177, ComBitSize=10, ComSignalType=UINT16, ComHandleId=9999, ComSystemTemplateSystemSignalRef=OBJ_ACCELERATION_LAT_031
          OBJ_DIMENSION_WIDTH_ERR_031_oRDR_TRACKER_OBJ_031_oPCAN_RADAR_5890ae53_Tx: ComBitPosition=23, ComBitSize=6, ComSignalType=UINT8, ComHandleId=10020, ComSystemTemplateSystemSignalRef=OBJ_DIMENSION_WIDTH_ERR_031
          OBJ_YAW_RATE_031_oRDR_TRACKER_OBJ_031_oPCAN_RADAR_662e2c8b_Tx: ComBitPosition=399, ComBitSize=10, ComSignalType=UINT16, ComHandleId=10046, ComSystemTemplateSystemSignalRef=OBJ_YAW_RATE_031
          OBJ_CLS_TYPE2_PROB_031_oRDR_TRACKER_OBJ_031_oPCAN_RADAR_b80e01ac_Tx: ComBitPosition=311, ComBitSize=8, ComSignalType=UINT8, ComHandleId=10008, ComSystemTemplateSystemSignalRef=OBJ_CLS_TYPE2_PROB_031
          OBJ_CLS_TYPE2_031_oRDR_TRACKER_OBJ_031_oPCAN_RADAR_948acd35_Tx: ComBitPosition=267, ComBitSize=4, ComSignalType=UINT8, ComHandleId=10007, ComSystemTemplateSystemSignalRef=OBJ_CLS_TYPE2_031
          OBJ_DIMENSION_WIDTH_031_oRDR_TRACKER_OBJ_031_oPCAN_RADAR_b83269bb_Tx: ComBitPosition=17, ComBitSize=10, ComSignalType=UINT16, ComHandleId=10019, ComSystemTemplateSystemSignalRef=OBJ_DIMENSION_WIDTH_031
          OBJ_REF_PT_LONG_OFFSET_031_oRDR_TRACKER_OBJ_031_oPCAN_RADAR_73dec5da_Tx: ComBitPosition=357, ComBitSize=14, ComSignalType=UINT16, ComHandleId=10035, ComSystemTemplateSystemSignalRef=OBJ_REF_PT_LONG_OFFSET_031
          OBJ_ALIVE_TIME_031_oRDR_TRACKER_OBJ_031_oPCAN_RADAR_4eb92c74_Tx: ComBitPosition=255, ComBitSize=16, ComSignalType=UINT16, ComHandleId=10004, ComSystemTemplateSystemSignalRef=OBJ_ALIVE_TIME_031
          OBJ_CLS_TYPE1_PROB_031_oRDR_TRACKER_OBJ_031_oPCAN_RADAR_713a1aa1_Tx: ComBitPosition=303, ComBitSize=8, ComSignalType=UINT8, ComHandleId=10006, ComSystemTemplateSystemSignalRef=OBJ_CLS_TYPE1_PROB_031
          OBJ_ID_031_oRDR_TRACKER_OBJ_031_oPCAN_RADAR_c9d2d22c_Tx: ComBitPosition=7, ComBitSize=8, ComSignalType=UINT8, ComHandleId=10023, ComSystemTemplateSystemSignalRef=OBJ_ID_031
          OBJ_POS_ERR_CRR_COEF_031_oRDR_TRACKER_OBJ_031_oPCAN_RADAR_09d1f5e7_Tx: ComBitPosition=415, ComBitSize=8, ComSignalType=UINT8, ComHandleId=10028, ComSystemTemplateSystemSignalRef=OBJ_POS_ERR_CRR_COEF_031
          OBJ_VEH_TRACK_FLAG_031_oRDR_TRACKER_OBJ_031_oPCAN_RADAR_8734a97a_Tx: ComBitPosition=10, ComBitSize=1, ComSignalType=BOOLEAN, ComHandleId=10038, ComSystemTemplateSystemSignalRef=OBJ_VEH_TRACK_FLAG_031
          OBJ_VELOCITY_LONG_ERR_031_oRDR_TRACKER_OBJ_031_oPCAN_RADAR_7765021d_Tx: ComBitPosition=143, ComBitSize=8, ComSignalType=UINT8, ComHandleId=10043, ComSystemTemplateSystemSignalRef=OBJ_VELOCITY_LONG_ERR_031
          OBJ_YAW_ANGLE_031_oRDR_TRACKER_OBJ_031_oPCAN_RADAR_43a109cc_Tx: ComBitPosition=155, ComBitSize=12, ComSignalType=UINT16, ComHandleId=10044, ComSystemTemplateSystemSignalRef=OBJ_YAW_ANGLE_031
          OBJ_VELOCITY_LAT_031_oRDR_TRACKER_OBJ_031_oPCAN_RADAR_af1d4d8c_Tx: ComBitPosition=126, ComBitSize=15, ComSignalType=UINT16, ComHandleId=10040, ComSystemTemplateSystemSignalRef=OBJ_VELOCITY_LAT_031
          OBJ_VELOCITY_ERR_CRR_COEF_031_oRDR_TRACKER_OBJ_031_oPCAN_RADAR_a0abc806_Tx: ComBitPosition=423, ComBitSize=8, ComSignalType=UINT8, ComHandleId=10039, ComSystemTemplateSystemSignalRef=OBJ_VELOCITY_ERR_CRR_COEF_031
          OBJ_EXISTENCE_PROB_031_oRDR_TRACKER_OBJ_031_oPCAN_RADAR_b38eed86_Tx: ComBitPosition=229, ComBitSize=14, ComSignalType=UINT16, ComHandleId=10021, ComSystemTemplateSystemSignalRef=OBJ_EXISTENCE_PROB_031
          OBJ_RCS_031_oRDR_TRACKER_OBJ_031_oPCAN_RADAR_c9b15eac_Tx: ComBitPosition=351, ComBitSize=7, ComSignalType=UINT8, ComHandleId=10033, ComSystemTemplateSystemSignalRef=OBJ_RCS_031
          OBJ_REF_PT_LAT_OFFSET_031_oRDR_TRACKER_OBJ_031_oPCAN_RADAR_3c8c35d9_Tx: ComBitPosition=370, ComBitSize=14, ComSignalType=UINT16, ComHandleId=10034, ComSystemTemplateSystemSignalRef=OBJ_REF_PT_LAT_OFFSET_031
          OBJ_DIMENSION_LENGTH_031_oRDR_TRACKER_OBJ_031_oPCAN_RADAR_9bfc9e16_Tx: ComBitPosition=37, ComBitSize=12, ComSignalType=UINT16, ComHandleId=10017, ComSystemTemplateSystemSignalRef=OBJ_DIMENSION_LENGTH_031
          OBJ_VELOCITY_LONG_031_oRDR_TRACKER_OBJ_031_oPCAN_RADAR_ff90354a_Tx: ComBitPosition=110, ComBitSize=15, ComSignalType=UINT16, ComHandleId=10042, ComSystemTemplateSystemSignalRef=OBJ_VELOCITY_LONG_031
          OBJ_CLS_TYPE1_031_oRDR_TRACKER_OBJ_031_oPCAN_RADAR_d962cd52_Tx: ComBitPosition=271, ComBitSize=4, ComSignalType=UINT8, ComHandleId=10005, ComSystemTemplateSystemSignalRef=OBJ_CLS_TYPE1_031
          OBJ_CLS_TYPE5_031_oRDR_TRACKER_OBJ_031_oPCAN_RADAR_82d23019_Tx: ComBitPosition=287, ComBitSize=4, ComSignalType=UINT8, ComHandleId=10013, ComSystemTemplateSystemSignalRef=OBJ_CLS_TYPE5_031
          OBJ_CLS_TYPE6_PROB_031_oRDR_TRACKER_OBJ_031_oPCAN_RADAR_7f30dc01_Tx: ComBitPosition=343, ComBitSize=8, ComSignalType=UINT8, ComHandleId=10016, ComSystemTemplateSystemSignalRef=OBJ_CLS_TYPE6_PROB_031
          OBJ_DIMENSION_LENGTH_ERR_031_oRDR_TRACKER_OBJ_031_oPCAN_RADAR_a004816c_Tx: ComBitPosition=41, ComBitSize=10, ComSignalType=UINT16, ComHandleId=10018, ComSystemTemplateSystemSignalRef=OBJ_DIMENSION_LENGTH_ERR_031
          OBJ_MH_CRC16_031_oRDR_TRACKER_OBJ_031_oPCAN_RADAR_ca6017ad_Tx: ComBitPosition=495, ComBitSize=16, ComSignalType=UINT16, ComHandleId=10025, ComSystemTemplateSystemSignalRef=OBJ_MH_CRC16_031
          OBJ_MH_CYCLE_COUNTER_031_oRDR_TRACKER_OBJ_031_oPCAN_RADAR_bb844d4c_Tx: ComBitPosition=487, ComBitSize=8, ComSignalType=UINT8, ComHandleId=10026, ComSystemTemplateSystemSignalRef=OBJ_MH_CYCLE_COUNTER_031
      RDR_DETECTION_245_248_oPCAN_RADAR_97c67109_Tx (ComIPdu):
        ComIPduDirection = SEND
        ComIPduType = NORMAL
        ComIPduCancellationSupport = false
        ComIPduHandleId = 67
        ComIPduSignalProcessing = DEFERRED
        ComIPduChannelRef = CN_PCAN_RADAR_458ff0f1
        ComIPduGroupRef = RDR01_oPCAN_RADAR_Tx_b6bdb067 if post-build-variant-condition{matching-criterion=RDR_POS, value=0}
        ComIPduSignalGroupRef = SG_Detections_245_248_oRDR_DETECTION_245_248_oPCAN_RADAR_4130a42b_Tx
        ComPduIdRef = RDR_DETECTION_245_248_oPCAN_RADAR_97c67109_Tx
        ComIPduMainFunctionRef = ComMainFunctionTx_Event
        ComIPduGroupRef = RDR02_oPCAN_RADAR_Tx_9f750495 if post-build-variant-condition{matching-criterion=RDR_POS, value=1}
        ComIPduGroupRef = RDR03_oPCAN_RADAR_Tx_311d9504 if post-build-variant-condition{matching-criterion=RDR_POS, value=2}
        ComIPduGroupRef = RDR04_oPCAN_RADAR_Tx_cce46d71 if post-build-variant-condition{matching-criterion=RDR_POS, value=3}
        ComIPduGroupRef = RDR05_oPCAN_RADAR_Tx_628cfce0 if post-build-variant-condition{matching-criterion=RDR_POS, value=4}
        ComIPduGroupRef = RDR06_oPCAN_RADAR_Tx_4b444812 if post-build-variant-condition{matching-criterion=RDR_POS, value=5}
        ComIPduGroupRef = RDR07_oPCAN_RADAR_Tx_e52cd983 if post-build-variant-condition{matching-criterion=RDR_POS, value=6}
        ComIPduGroupRef = RDR08_oPCAN_RADAR_Tx_6bc6beb9 if post-build-variant-condition{matching-criterion=RDR_POS, value=7}
        ComTxIPdu: ComMinimumDelayTime=0, ComTxIPduUnusedAreasDefault=0
          ComTxModeTrue
            ComTxMode: ComTxModeMode=DIRECT, ComTxModeNumberOfRepetitions=0
          ComTxModeFalse
            ComTxMode: ComTxModeMode=NONE
      SG_TrackerObject064_oRDR_TRACKER_OBJ_064_oPCAN_RADAR_3a0fe9a5_Tx (ComSignalGroup):
        ComTransferProperty = TRIGGERED
        ComSignalGroupAccess = ACCESS_NEEDED_BY_SWC_OR_COM
        ComHandleId = 173
        ComSignalGroupArrayAccess = true
        ComSystemTemplateSignalGroupRef = SG_TrackerObject064
        49 x ComGroupSignal, all with ComSignalEndianness=BIG_ENDIAN, ComSignalInitValue=0, ComTransferProperty=PENDING, ComSignalAccess=ACCESS_NEEDED_BY_SWC_OR_COM:
          OBJ_VELOCITY_LAT_ERR_064_oRDR_TRACKER_OBJ_064_oPCAN_RADAR_f3e4b127_Tx: ComBitPosition=151, ComBitSize=8, ComSignalType=UINT8, ComHandleId=11658, ComSystemTemplateSystemSignalRef=OBJ_VELOCITY_LAT_ERR_064
          OBJ_YAW_RATE_ERR_064_oRDR_TRACKER_OBJ_064_oPCAN_RADAR_31f537ad_Tx: ComBitPosition=388, ComBitSize=5, ComSignalType=UINT8, ComHandleId=11664, ComSystemTemplateSystemSignalRef=OBJ_YAW_RATE_ERR_064
          OBJ_DIMENSION_WIDTH_ERR_064_oRDR_TRACKER_OBJ_064_oPCAN_RADAR_309322a9_Tx: ComBitPosition=23, ComBitSize=6, ComSignalType=UINT8, ComHandleId=11637, ComSystemTemplateSystemSignalRef=OBJ_DIMENSION_WIDTH_ERR_064
          OBJ_ACCEL_ERR_CRR_COEF_064_oRDR_TRACKER_OBJ_064_oPCAN_RADAR_5ed90ca0_Tx: ComBitPosition=431, ComBitSize=8, ComSignalType=UINT8, ComHandleId=11620, ComSystemTemplateSystemSignalRef=OBJ_ACCEL_ERR_CRR_COEF_064
          OBJ_POS_LAT_064_oRDR_TRACKER_OBJ_064_oPCAN_RADAR_837d8451_Tx: ComBitPosition=79, ComBitSize=16, ComSignalType=UINT16, ComHandleId=11646, ComSystemTemplateSystemSignalRef=OBJ_POS_LAT_064
          OBJ_DIMENSION_WIDTH_064_oRDR_TRACKER_OBJ_064_oPCAN_RADAR_d031e541_Tx: ComBitPosition=17, ComBitSize=10, ComSignalType=UINT16, ComHandleId=11636, ComSystemTemplateSystemSignalRef=OBJ_DIMENSION_WIDTH_064
          OBJ_CLS_TYPE4_PROB_064_oRDR_TRACKER_OBJ_064_oPCAN_RADAR_9914bd0d_Tx: ComBitPosition=327, ComBitSize=8, ComSignalType=UINT8, ComHandleId=11629, ComSystemTemplateSystemSignalRef=OBJ_CLS_TYPE4_PROB_064
          OBJ_ALIVE_TIME_064_oRDR_TRACKER_OBJ_064_oPCAN_RADAR_26baa08e_Tx: ComBitPosition=255, ComBitSize=16, ComSignalType=UINT16, ComHandleId=11621, ComSystemTemplateSystemSignalRef=OBJ_ALIVE_TIME_064
          OBJ_CLS_TYPE6_PROB_064_oRDR_TRACKER_OBJ_064_oPCAN_RADAR_173350fb_Tx: ComBitPosition=343, ComBitSize=8, ComSignalType=UINT8, ComHandleId=11633, ComSystemTemplateSystemSignalRef=OBJ_CLS_TYPE6_PROB_064
          OBJ_EXISTENCE_PROB_064_oRDR_TRACKER_OBJ_064_oPCAN_RADAR_db8d617c_Tx: ComBitPosition=229, ComBitSize=14, ComSignalType=UINT16, ComHandleId=11638, ComSystemTemplateSystemSignalRef=OBJ_EXISTENCE_PROB_064
          OBJ_GROUP_ID_064_oRDR_TRACKER_OBJ_064_oPCAN_RADAR_52ff75d1_Tx: ComBitPosition=405, ComBitSize=6, ComSignalType=UINT8, ComHandleId=11639, ComSystemTemplateSystemSignalRef=OBJ_GROUP_ID_064
          OBJ_ACCELERATION_LAT_064_oRDR_TRACKER_OBJ_064_oPCAN_RADAR_342bb2d2_Tx: ComBitPosition=177, ComBitSize=10, ComSignalType=UINT16, ComHandleId=11616, ComSystemTemplateSystemSignalRef=OBJ_ACCELERATION_LAT_064
          OBJ_CLS_TYPE2_064_oRDR_TRACKER_OBJ_064_oPCAN_RADAR_fc8941cf_Tx: ComBitPosition=267, ComBitSize=4, ComSignalType=UINT8, ComHandleId=11624, ComSystemTemplateSystemSignalRef=OBJ_CLS_TYPE2_064
          OBJ_REF_PT_LONG_OFFSET_064_oRDR_TRACKER_OBJ_064_oPCAN_RADAR_1bdd4920_Tx: ComBitPosition=357, ComBitSize=14, ComSignalType=UINT16, ComHandleId=11652, ComSystemTemplateSystemSignalRef=OBJ_REF_PT_LONG_OFFSET_064
          OBJ_DIMENSION_LENGTH_ERR_064_oRDR_TRACKER_OBJ_064_oPCAN_RADAR_c8070d96_Tx: ComBitPosition=41, ComBitSize=10, ComSignalType=UINT16, ComHandleId=11635, ComSystemTemplateSystemSignalRef=OBJ_DIMENSION_LENGTH_ERR_064
          OBJ_REF_PT_LAT_OFFSET_064_oRDR_TRACKER_OBJ_064_oPCAN_RADAR_548fb923_Tx: ComBitPosition=370, ComBitSize=14, ComSignalType=UINT16, ComHandleId=11651, ComSystemTemplateSystemSignalRef=OBJ_REF_PT_LAT_OFFSET_064
          OBJ_MEASUREMENT_STATUS_064_oRDR_TRACKER_OBJ_064_oPCAN_RADAR_de032c6b_Tx: ComBitPosition=14, ComBitSize=3, ComSignalType=UINT8, ComHandleId=11641, ComSystemTemplateSystemSignalRef=OBJ_MEASUREMENT_STATUS_064
          OBJ_TRACK_MOTION_MODEL_064_oRDR_TRACKER_OBJ_064_oPCAN_RADAR_6d1dd3dd_Tx: ComBitPosition=9, ComBitSize=2, ComSignalType=UINT8, ComHandleId=11654, ComSystemTemplateSystemSignalRef=OBJ_TRACK_MOTION_MODEL_064
          OBJ_VELOCITY_ERR_CRR_COEF_064_oRDR_TRACKER_OBJ_064_oPCAN_RADAR_c8a844fc_Tx: ComBitPosition=423, ComBitSize=8, ComSignalType=UINT8, ComHandleId=11656, ComSystemTemplateSystemSignalRef=OBJ_VELOCITY_ERR_CRR_COEF_064
          OBJ_CLS_TYPE4_064_oRDR_TRACKER_OBJ_064_oPCAN_RADAR_67594101_Tx: ComBitPosition=275, ComBitSize=4, ComSignalType=UINT8, ComHandleId=11628, ComSystemTemplateSystemSignalRef=OBJ_CLS_TYPE4_064
          OBJ_VELOCITY_LONG_ERR_064_oRDR_TRACKER_OBJ_064_oPCAN_RADAR_1f668ee7_Tx: ComBitPosition=143, ComBitSize=8, ComSignalType=UINT8, ComHandleId=11660, ComSystemTemplateSystemSignalRef=OBJ_VELOCITY_LONG_ERR_064
          OBJ_CLS_TYPE5_PROB_064_oRDR_TRACKER_OBJ_064_oPCAN_RADAR_de074bf6_Tx: ComBitPosition=335, ComBitSize=8, ComSignalType=UINT8, ComHandleId=11631, ComSystemTemplateSystemSignalRef=OBJ_CLS_TYPE5_PROB_064
          OBJ_CLS_TYPE3_PROB_064_oRDR_TRACKER_OBJ_064_oPCAN_RADAR_971e7bad_Tx: ComBitPosition=319, ComBitSize=8, ComSignalType=UINT8, ComHandleId=11627, ComSystemTemplateSystemSignalRef=OBJ_CLS_TYPE3_PROB_064
          OBJ_POS_LONG_064_oRDR_TRACKER_OBJ_064_oPCAN_RADAR_32dd6f9e_Tx: ComBitPosition=63, ComBitSize=16, ComSignalType=UINT16, ComHandleId=11648, ComSystemTemplateSystemSignalRef=OBJ_POS_LONG_064
          OBJ_DIMENSION_LENGTH_064_oRDR_TRACKER_OBJ_064_oPCAN_RADAR_f3ff12ec_Tx: ComBitPosition=37, ComBitSize=12, ComSignalType=UINT16, ComHandleId=11634, ComSystemTemplateSystemSignalRef=OBJ_DIMENSION_LENGTH_064
          OBJ_VELOCITY_LONG_064_oRDR_TRACKER_OBJ_064_oPCAN_RADAR_9793b9b0_Tx: ComBitPosition=110, ComBitSize=15, ComSignalType=UINT16, ComHandleId=11659, ComSystemTemplateSystemSignalRef=OBJ_VELOCITY_LONG_064
          OBJ_CLS_TYPE1_PROB_064_oRDR_TRACKER_OBJ_064_oPCAN_RADAR_1939965b_Tx: ComBitPosition=303, ComBitSize=8, ComSignalType=UINT8, ComHandleId=11623, ComSystemTemplateSystemSignalRef=OBJ_CLS_TYPE1_PROB_064
          OBJ_RCS_064_oRDR_TRACKER_OBJ_064_oPCAN_RADAR_a1b2d256_Tx: ComBitPosition=351, ComBitSize=7, ComSignalType=UINT8, ComHandleId=11650, ComSystemTemplateSystemSignalRef=OBJ_RCS_064
          OBJ_POS_LONG_ERR_064_oRDR_TRACKER_OBJ_064_oPCAN_RADAR_1ec92a84_Tx: ComBitPosition=95, ComBitSize=8, ComSignalType=UINT8, ComHandleId=11649, ComSystemTemplateSystemSignalRef=OBJ_POS_LONG_ERR_064
          OBJ_ACCELERATION_LONG_064_oRDR_TRACKER_OBJ_064_oPCAN_RADAR_46dbeb32_Tx: ComBitPosition=193, ComBitSize=10, ComSignalType=UINT16, ComHandleId=11618, ComSystemTemplateSystemSignalRef=OBJ_ACCELERATION_LONG_064
          OBJ_CLS_TYPE2_PROB_064_oRDR_TRACKER_OBJ_064_oPCAN_RADAR_d00d8d56_Tx: ComBitPosition=311, ComBitSize=8, ComSignalType=UINT8, ComHandleId=11625, ComSystemTemplateSystemSignalRef=OBJ_CLS_TYPE2_PROB_064
          OBJ_TIMESTAMP_OFFSET_064_oRDR_TRACKER_OBJ_064_oPCAN_RADAR_a11ed200_Tx: ComBitPosition=247, ComBitSize=8, ComSignalType=UINT8, ComHandleId=11653, ComSystemTemplateSystemSignalRef=OBJ_TIMESTAMP_OFFSET_064
          OBJ_ACCELERATION_LONG_ERR_064_oRDR_TRACKER_OBJ_064_oPCAN_RADAR_fe7a2dc6_Tx: ComBitPosition=215, ComBitSize=8, ComSignalType=UINT8, ComHandleId=11619, ComSystemTemplateSystemSignalRef=OBJ_ACCELERATION_LONG_ERR_064
          OBJ_VEH_TRACK_FLAG_064_oRDR_TRACKER_OBJ_064_oPCAN_RADAR_ef372580_Tx: ComBitPosition=10, ComBitSize=1, ComSignalType=BOOLEAN, ComHandleId=11655, ComSystemTemplateSystemSignalRef=OBJ_VEH_TRACK_FLAG_064
          OBJ_VELOCITY_LAT_064_oRDR_TRACKER_OBJ_064_oPCAN_RADAR_c71ec176_Tx: ComBitPosition=126, ComBitSize=15, ComSignalType=UINT16, ComHandleId=11657, ComSystemTemplateSystemSignalRef=OBJ_VELOCITY_LAT_064
          OBJ_CLS_TYPE1_064_oRDR_TRACKER_OBJ_064_oPCAN_RADAR_b16141a8_Tx: ComBitPosition=271, ComBitSize=4, ComSignalType=UINT8, ComHandleId=11622, ComSystemTemplateSystemSignalRef=OBJ_CLS_TYPE1_064
          OBJ_ACCELERATION_LAT_ERR_064_oRDR_TRACKER_OBJ_064_oPCAN_RADAR_e1df886c_Tx: ComBitPosition=223, ComBitSize=8, ComSignalType=UINT8, ComHandleId=11617, ComSystemTemplateSystemSignalRef=OBJ_ACCELERATION_LAT_ERR_064
          OBJ_YAW_ANGLE_ERR_064_oRDR_TRACKER_OBJ_064_oPCAN_RADAR_feaf83e1_Tx: ComBitPosition=175, ComBitSize=7, ComSignalType=UINT8, ComHandleId=11662, ComSystemTemplateSystemSignalRef=OBJ_YAW_ANGLE_ERR_064
          OBJ_YAW_RATE_064_oRDR_TRACKER_OBJ_064_oPCAN_RADAR_0e2da071_Tx: ComBitPosition=399, ComBitSize=10, ComSignalType=UINT16, ComHandleId=11663, ComSystemTemplateSystemSignalRef=OBJ_YAW_RATE_064
          OBJ_POS_ERR_CRR_COEF_064_oRDR_TRACKER_OBJ_064_oPCAN_RADAR_61d2791d_Tx: ComBitPosition=415, ComBitSize=8, ComSignalType=UINT8, ComHandleId=11645, ComSystemTemplateSystemSignalRef=OBJ_POS_ERR_CRR_COEF_064
          OBJ_CLS_TYPE3_064_oRDR_TRACKER_OBJ_064_oPCAN_RADAR_7101bc2d_Tx: ComBitPosition=279, ComBitSize=4, ComSignalType=UINT8, ComHandleId=11626, ComSystemTemplateSystemSignalRef=OBJ_CLS_TYPE3_064
          OBJ_MOVEMENT_STATUS_064_oRDR_TRACKER_OBJ_064_oPCAN_RADAR_f1adb927_Tx: ComBitPosition=196, ComBitSize=3, ComSignalType=UINT8, ComHandleId=11644, ComSystemTemplateSystemSignalRef=OBJ_MOVEMENT_STATUS_064
          OBJ_ID_064_oRDR_TRACKER_OBJ_064_oPCAN_RADAR_a1d15ed6_Tx: ComBitPosition=7, ComBitSize=8, ComSignalType=UINT8, ComHandleId=11640, ComSystemTemplateSystemSignalRef=OBJ_ID_064
          OBJ_YAW_ANGLE_064_oRDR_TRACKER_OBJ_064_oPCAN_RADAR_2ba28536_Tx: ComBitPosition=155, ComBitSize=12, ComSignalType=UINT16, ComHandleId=11661, ComSystemTemplateSystemSignalRef=OBJ_YAW_ANGLE_064
          OBJ_CLS_TYPE5_064_oRDR_TRACKER_OBJ_064_oPCAN_RADAR_ead1bce3_Tx: ComBitPosition=287, ComBitSize=4, ComSignalType=UINT8, ComHandleId=11630, ComSystemTemplateSystemSignalRef=OBJ_CLS_TYPE5_064
          OBJ_CLS_TYPE6_064_oRDR_TRACKER_OBJ_064_oPCAN_RADAR_a739bc84_Tx: ComBitPosition=282, ComBitSize=4, ComSignalType=UINT8, ComHandleId=11632, ComSystemTemplateSystemSignalRef=OBJ_CLS_TYPE6_064
          OBJ_POS_LAT_ERR_064_oRDR_TRACKER_OBJ_064_oPCAN_RADAR_8731d466_Tx: ComBitPosition=103, ComBitSize=8, ComSignalType=UINT8, ComHandleId=11647, ComSystemTemplateSystemSignalRef=OBJ_POS_LAT_ERR_064
          OBJ_MH_CRC16_064_oRDR_TRACKER_OBJ_064_oPCAN_RADAR_a2639b57_Tx: ComBitPosition=495, ComBitSize=16, ComSignalType=UINT16, ComHandleId=11642, ComSystemTemplateSystemSignalRef=OBJ_MH_CRC16_064
          OBJ_MH_CYCLE_COUNTER_064_oRDR_TRACKER_OBJ_064_oPCAN_RADAR_d387c1b6_Tx: ComBitPosition=487, ComBitSize=8, ComSignalType=UINT8, ComHandleId=11643, ComSystemTemplateSystemSignalRef=OBJ_MH_CYCLE_COUNTER_064
      RDR_TRACKER_OBJ_025_oPCAN_RADAR_0f50556d_Tx (ComIPdu):
        ComIPduDirection = SEND
        ComIPduType = NORMAL
        ComIPduCancellationSupport = false
        ComIPduHandleId = 135
        ComIPduSignalProcessing = DEFERRED
        ComIPduChannelRef = CN_PCAN_RADAR_458ff0f1
        ComIPduGroupRef = RDR01_oPCAN_RADAR_Tx_b6bdb067 if post-build-variant-condition{matching-criterion=RDR_POS, value=0}
        ComIPduSignalGroupRef = SG_TrackerObject025_oRDR_TRACKER_OBJ_025_oPCAN_RADAR_522dbdaf_Tx
        ComPduIdRef = RDR_TRACKER_OBJ_025_oPCAN_RADAR_0f50556d_Tx
        ComIPduMainFunctionRef = ComMainFunctionTx_Event
        ComIPduGroupRef = RDR02_oPCAN_RADAR_Tx_9f750495 if post-build-variant-condition{matching-criterion=RDR_POS, value=1}
        ComIPduGroupRef = RDR03_oPCAN_RADAR_Tx_311d9504 if post-build-variant-condition{matching-criterion=RDR_POS, value=2}
        ComIPduGroupRef = RDR04_oPCAN_RADAR_Tx_cce46d71 if post-build-variant-condition{matching-criterion=RDR_POS, value=3}
        ComIPduGroupRef = RDR05_oPCAN_RADAR_Tx_628cfce0 if post-build-variant-condition{matching-criterion=RDR_POS, value=4}
        ComIPduGroupRef = RDR06_oPCAN_RADAR_Tx_4b444812 if post-build-variant-condition{matching-criterion=RDR_POS, value=5}
        ComIPduGroupRef = RDR07_oPCAN_RADAR_Tx_e52cd983 if post-build-variant-condition{matching-criterion=RDR_POS, value=6}
        ComIPduGroupRef = RDR08_oPCAN_RADAR_Tx_6bc6beb9 if post-build-variant-condition{matching-criterion=RDR_POS, value=7}
        ComTxIPdu: ComMinimumDelayTime=0, ComTxIPduUnusedAreasDefault=0
          ComTxModeTrue
            ComTxMode: ComTxModeMode=DIRECT, ComTxModeNumberOfRepetitions=0
          ComTxModeFalse
            ComTxMode: ComTxModeMode=NONE
      RDR_DETECTION_057_060_oPCAN_RADAR_cbf7f78f_Tx (ComIPdu):
        ComIPduDirection = SEND
        ComIPduType = NORMAL
        ComIPduCancellationSupport = false
        ComIPduHandleId = 20
        ComIPduSignalProcessing = DEFERRED
        ComIPduChannelRef = CN_PCAN_RADAR_458ff0f1
        ComIPduGroupRef = RDR01_oPCAN_RADAR_Tx_b6bdb067 if post-build-variant-condition{matching-criterion=RDR_POS, value=0}
        ComIPduSignalGroupRef = SG_Detections_057_060_oRDR_DETECTION_057_060_oPCAN_RADAR_83bdfb8a_Tx
        ComPduIdRef = RDR_DETECTION_057_060_oPCAN_RADAR_cbf7f78f_Tx
        ComIPduMainFunctionRef = ComMainFunctionTx_Event
        ComIPduGroupRef = RDR02_oPCAN_RADAR_Tx_9f750495 if post-build-variant-condition{matching-criterion=RDR_POS, value=1}
        ComIPduGroupRef = RDR03_oPCAN_RADAR_Tx_311d9504 if post-build-variant-condition{matching-criterion=RDR_POS, value=2}
        ComIPduGroupRef = RDR04_oPCAN_RADAR_Tx_cce46d71 if post-build-variant-condition{matching-criterion=RDR_POS, value=3}
        ComIPduGroupRef = RDR05_oPCAN_RADAR_Tx_628cfce0 if post-build-variant-condition{matching-criterion=RDR_POS, value=4}
        ComIPduGroupRef = RDR06_oPCAN_RADAR_Tx_4b444812 if post-build-variant-condition{matching-criterion=RDR_POS, value=5}
        ComIPduGroupRef = RDR07_oPCAN_RADAR_Tx_e52cd983 if post-build-variant-condition{matching-criterion=RDR_POS, value=6}
        ComIPduGroupRef = RDR08_oPCAN_RADAR_Tx_6bc6beb9 if post-build-variant-condition{matching-criterion=RDR_POS, value=7}
        ComTxIPdu: ComMinimumDelayTime=0, ComTxIPduUnusedAreasDefault=0
          ComTxModeTrue
            ComTxMode: ComTxModeMode=DIRECT, ComTxModeNumberOfRepetitions=0
          ComTxModeFalse
            ComTxMode: ComTxModeMode=NONE
      SG_TrackerObject042_oRDR_TRACKER_OBJ_042_oPCAN_RADAR_e4c43db0_Tx (ComSignalGroup):
        ComTransferProperty = TRIGGERED
        ComSignalGroupAccess = ACCESS_NEEDED_BY_SWC_OR_COM
        ComHandleId = 151
        ComSignalGroupArrayAccess = true
        ComSystemTemplateSignalGroupRef = SG_TrackerObject042
        49 x ComGroupSignal, all with ComSignalEndianness=BIG_ENDIAN, ComSignalInitValue=0, ComTransferProperty=PENDING, ComSignalAccess=ACCESS_NEEDED_BY_SWC_OR_COM:
          OBJ_YAW_RATE_ERR_042_oRDR_TRACKER_OBJ_042_oPCAN_RADAR_ef3ee3b8_Tx: ComBitPosition=388, ComBitSize=5, ComSignalType=UINT8, ComHandleId=10586, ComSystemTemplateSystemSignalRef=OBJ_YAW_RATE_ERR_042
          OBJ_ACCEL_ERR_CRR_COEF_042_oRDR_TRACKER_OBJ_042_oPCAN_RADAR_8012d8b5_Tx: ComBitPosition=431, ComBitSize=8, ComSignalType=UINT8, ComHandleId=10542, ComSystemTemplateSystemSignalRef=OBJ_ACCEL_ERR_CRR_COEF_042
          OBJ_CLS_TYPE4_042_oRDR_TRACKER_OBJ_042_oPCAN_RADAR_b9929514_Tx: ComBitPosition=275, ComBitSize=4, ComSignalType=UINT8, ComHandleId=10550, ComSystemTemplateSystemSignalRef=OBJ_CLS_TYPE4_042
          OBJ_DIMENSION_WIDTH_042_oRDR_TRACKER_OBJ_042_oPCAN_RADAR_0efa3154_Tx: ComBitPosition=17, ComBitSize=10, ComSignalType=UINT16, ComHandleId=10558, ComSystemTemplateSystemSignalRef=OBJ_DIMENSION_WIDTH_042
          OBJ_POS_LAT_042_oRDR_TRACKER_OBJ_042_oPCAN_RADAR_5db65044_Tx: ComBitPosition=79, ComBitSize=16, ComSignalType=UINT16, ComHandleId=10568, ComSystemTemplateSystemSignalRef=OBJ_POS_LAT_042
          OBJ_VELOCITY_ERR_CRR_COEF_042_oRDR_TRACKER_OBJ_042_oPCAN_RADAR_166390e9_Tx: ComBitPosition=423, ComBitSize=8, ComSignalType=UINT8, ComHandleId=10578, ComSystemTemplateSystemSignalRef=OBJ_VELOCITY_ERR_CRR_COEF_042
          OBJ_CLS_TYPE5_PROB_042_oRDR_TRACKER_OBJ_042_oPCAN_RADAR_00cc9fe3_Tx: ComBitPosition=335, ComBitSize=8, ComSignalType=UINT8, ComHandleId=10553, ComSystemTemplateSystemSignalRef=OBJ_CLS_TYPE5_PROB_042
          OBJ_ACCELERATION_LONG_042_oRDR_TRACKER_OBJ_042_oPCAN_RADAR_98103f27_Tx: ComBitPosition=193, ComBitSize=10, ComSignalType=UINT16, ComHandleId=10540, ComSystemTemplateSystemSignalRef=OBJ_ACCELERATION_LONG_042
          OBJ_CLS_TYPE6_042_oRDR_TRACKER_OBJ_042_oPCAN_RADAR_79f26891_Tx: ComBitPosition=282, ComBitSize=4, ComSignalType=UINT8, ComHandleId=10554, ComSystemTemplateSystemSignalRef=OBJ_CLS_TYPE6_042
          OBJ_CLS_TYPE2_042_oRDR_TRACKER_OBJ_042_oPCAN_RADAR_224295da_Tx: ComBitPosition=267, ComBitSize=4, ComSignalType=UINT8, ComHandleId=10546, ComSystemTemplateSystemSignalRef=OBJ_CLS_TYPE2_042
          OBJ_TRACK_MOTION_MODEL_042_oRDR_TRACKER_OBJ_042_oPCAN_RADAR_b3d607c8_Tx: ComBitPosition=9, ComBitSize=2, ComSignalType=UINT8, ComHandleId=10576, ComSystemTemplateSystemSignalRef=OBJ_TRACK_MOTION_MODEL_042
          OBJ_EXISTENCE_PROB_042_oRDR_TRACKER_OBJ_042_oPCAN_RADAR_0546b569_Tx: ComBitPosition=229, ComBitSize=14, ComSignalType=UINT16, ComHandleId=10560, ComSystemTemplateSystemSignalRef=OBJ_EXISTENCE_PROB_042
          OBJ_CLS_TYPE6_PROB_042_oRDR_TRACKER_OBJ_042_oPCAN_RADAR_c9f884ee_Tx: ComBitPosition=343, ComBitSize=8, ComSignalType=UINT8, ComHandleId=10555, ComSystemTemplateSystemSignalRef=OBJ_CLS_TYPE6_PROB_042
          OBJ_DIMENSION_LENGTH_ERR_042_oRDR_TRACKER_OBJ_042_oPCAN_RADAR_16ccd983_Tx: ComBitPosition=41, ComBitSize=10, ComSignalType=UINT16, ComHandleId=10557, ComSystemTemplateSystemSignalRef=OBJ_DIMENSION_LENGTH_ERR_042
          OBJ_GROUP_ID_042_oRDR_TRACKER_OBJ_042_oPCAN_RADAR_8c34a1c4_Tx: ComBitPosition=405, ComBitSize=6, ComSignalType=UINT8, ComHandleId=10561, ComSystemTemplateSystemSignalRef=OBJ_GROUP_ID_042
          OBJ_VELOCITY_LAT_ERR_042_oRDR_TRACKER_OBJ_042_oPCAN_RADAR_2d2f6532_Tx: ComBitPosition=151, ComBitSize=8, ComSignalType=UINT8, ComHandleId=10580, ComSystemTemplateSystemSignalRef=OBJ_VELOCITY_LAT_ERR_042
          OBJ_YAW_ANGLE_ERR_042_oRDR_TRACKER_OBJ_042_oPCAN_RADAR_206457f4_Tx: ComBitPosition=175, ComBitSize=7, ComSignalType=UINT8, ComHandleId=10584, ComSystemTemplateSystemSignalRef=OBJ_YAW_ANGLE_ERR_042
          OBJ_POS_LONG_042_oRDR_TRACKER_OBJ_042_oPCAN_RADAR_ec16bb8b_Tx: ComBitPosition=63, ComBitSize=16, ComSignalType=UINT16, ComHandleId=10570, ComSystemTemplateSystemSignalRef=OBJ_POS_LONG_042
          OBJ_CLS_TYPE1_PROB_042_oRDR_TRACKER_OBJ_042_oPCAN_RADAR_c7f2424e_Tx: ComBitPosition=303, ComBitSize=8, ComSignalType=UINT8, ComHandleId=10545, ComSystemTemplateSystemSignalRef=OBJ_CLS_TYPE1_PROB_042
          OBJ_ACCELERATION_LONG_ERR_042_oRDR_TRACKER_OBJ_042_oPCAN_RADAR_20b1f9d3_Tx: ComBitPosition=215, ComBitSize=8, ComSignalType=UINT8, ComHandleId=10541, ComSystemTemplateSystemSignalRef=OBJ_ACCELERATION_LONG_ERR_042
          OBJ_YAW_RATE_042_oRDR_TRACKER_OBJ_042_oPCAN_RADAR_d0e67464_Tx: ComBitPosition=399, ComBitSize=10, ComSignalType=UINT16, ComHandleId=10585, ComSystemTemplateSystemSignalRef=OBJ_YAW_RATE_042
          OBJ_DIMENSION_WIDTH_ERR_042_oRDR_TRACKER_OBJ_042_oPCAN_RADAR_ee58f6bc_Tx: ComBitPosition=23, ComBitSize=6, ComSignalType=UINT8, ComHandleId=10559, ComSystemTemplateSystemSignalRef=OBJ_DIMENSION_WIDTH_ERR_042
          OBJ_CLS_TYPE5_042_oRDR_TRACKER_OBJ_042_oPCAN_RADAR_341a68f6_Tx: ComBitPosition=287, ComBitSize=4, ComSignalType=UINT8, ComHandleId=10552, ComSystemTemplateSystemSignalRef=OBJ_CLS_TYPE5_042
          OBJ_ID_042_oRDR_TRACKER_OBJ_042_oPCAN_RADAR_7f1a8ac3_Tx: ComBitPosition=7, ComBitSize=8, ComSignalType=UINT8, ComHandleId=10562, ComSystemTemplateSystemSignalRef=OBJ_ID_042
          OBJ_MOVEMENT_STATUS_042_oRDR_TRACKER_OBJ_042_oPCAN_RADAR_2f666d32_Tx: ComBitPosition=196, ComBitSize=3, ComSignalType=UINT8, ComHandleId=10566, ComSystemTemplateSystemSignalRef=OBJ_MOVEMENT_STATUS_042
          OBJ_CLS_TYPE4_PROB_042_oRDR_TRACKER_OBJ_042_oPCAN_RADAR_47df6918_Tx: ComBitPosition=327, ComBitSize=8, ComSignalType=UINT8, ComHandleId=10551, ComSystemTemplateSystemSignalRef=OBJ_CLS_TYPE4_PROB_042
          OBJ_REF_PT_LAT_OFFSET_042_oRDR_TRACKER_OBJ_042_oPCAN_RADAR_8a446d36_Tx: ComBitPosition=370, ComBitSize=14, ComSignalType=UINT16, ComHandleId=10573, ComSystemTemplateSystemSignalRef=OBJ_REF_PT_LAT_OFFSET_042
          OBJ_VEH_TRACK_FLAG_042_oRDR_TRACKER_OBJ_042_oPCAN_RADAR_31fcf195_Tx: ComBitPosition=10, ComBitSize=1, ComSignalType=BOOLEAN, ComHandleId=10577, ComSystemTemplateSystemSignalRef=OBJ_VEH_TRACK_FLAG_042
          OBJ_VELOCITY_LAT_042_oRDR_TRACKER_OBJ_042_oPCAN_RADAR_19d51563_Tx: ComBitPosition=126, ComBitSize=15, ComSignalType=UINT16, ComHandleId=10579, ComSystemTemplateSystemSignalRef=OBJ_VELOCITY_LAT_042
          OBJ_POS_LONG_ERR_042_oRDR_TRACKER_OBJ_042_oPCAN_RADAR_c002fe91_Tx: ComBitPosition=95, ComBitSize=8, ComSignalType=UINT8, ComHandleId=10571, ComSystemTemplateSystemSignalRef=OBJ_POS_LONG_ERR_042
          OBJ_DIMENSION_LENGTH_042_oRDR_TRACKER_OBJ_042_oPCAN_RADAR_2d34c6f9_Tx: ComBitPosition=37, ComBitSize=12, ComSignalType=UINT16, ComHandleId=10556, ComSystemTemplateSystemSignalRef=OBJ_DIMENSION_LENGTH_042
          OBJ_TIMESTAMP_OFFSET_042_oRDR_TRACKER_OBJ_042_oPCAN_RADAR_7fd50615_Tx: ComBitPosition=247, ComBitSize=8, ComSignalType=UINT8, ComHandleId=10575, ComSystemTemplateSystemSignalRef=OBJ_TIMESTAMP_OFFSET_042
          OBJ_CLS_TYPE1_042_oRDR_TRACKER_OBJ_042_oPCAN_RADAR_6faa95bd_Tx: ComBitPosition=271, ComBitSize=4, ComSignalType=UINT8, ComHandleId=10544, ComSystemTemplateSystemSignalRef=OBJ_CLS_TYPE1_042
          OBJ_POS_ERR_CRR_COEF_042_oRDR_TRACKER_OBJ_042_oPCAN_RADAR_bf19ad08_Tx: ComBitPosition=415, ComBitSize=8, ComSignalType=UINT8, ComHandleId=10567, ComSystemTemplateSystemSignalRef=OBJ_POS_ERR_CRR_COEF_042
          OBJ_REF_PT_LONG_OFFSET_042_oRDR_TRACKER_OBJ_042_oPCAN_RADAR_c5169d35_Tx: ComBitPosition=357, ComBitSize=14, ComSignalType=UINT16, ComHandleId=10574, ComSystemTemplateSystemSignalRef=OBJ_REF_PT_LONG_OFFSET_042
          OBJ_POS_LAT_ERR_042_oRDR_TRACKER_OBJ_042_oPCAN_RADAR_59fa0073_Tx: ComBitPosition=103, ComBitSize=8, ComSignalType=UINT8, ComHandleId=10569, ComSystemTemplateSystemSignalRef=OBJ_POS_LAT_ERR_042
          OBJ_VELOCITY_LONG_042_oRDR_TRACKER_OBJ_042_oPCAN_RADAR_49586da5_Tx: ComBitPosition=110, ComBitSize=15, ComSignalType=UINT16, ComHandleId=10581, ComSystemTemplateSystemSignalRef=OBJ_VELOCITY_LONG_042
          OBJ_YAW_ANGLE_042_oRDR_TRACKER_OBJ_042_oPCAN_RADAR_f5695123_Tx: ComBitPosition=155, ComBitSize=12, ComSignalType=UINT16, ComHandleId=10583, ComSystemTemplateSystemSignalRef=OBJ_YAW_ANGLE_042
          OBJ_ALIVE_TIME_042_oRDR_TRACKER_OBJ_042_oPCAN_RADAR_f871749b_Tx: ComBitPosition=255, ComBitSize=16, ComSignalType=UINT16, ComHandleId=10543, ComSystemTemplateSystemSignalRef=OBJ_ALIVE_TIME_042
          OBJ_RCS_042_oRDR_TRACKER_OBJ_042_oPCAN_RADAR_7f790643_Tx: ComBitPosition=351, ComBitSize=7, ComSignalType=UINT8, ComHandleId=10572, ComSystemTemplateSystemSignalRef=OBJ_RCS_042
          OBJ_CLS_TYPE3_PROB_042_oRDR_TRACKER_OBJ_042_oPCAN_RADAR_49d5afb8_Tx: ComBitPosition=319, ComBitSize=8, ComSignalType=UINT8, ComHandleId=10549, ComSystemTemplateSystemSignalRef=OBJ_CLS_TYPE3_PROB_042
          OBJ_ACCELERATION_LAT_042_oRDR_TRACKER_OBJ_042_oPCAN_RADAR_eae066c7_Tx: ComBitPosition=177, ComBitSize=10, ComSignalType=UINT16, ComHandleId=10538, ComSystemTemplateSystemSignalRef=OBJ_ACCELERATION_LAT_042
          OBJ_MEASUREMENT_STATUS_042_oRDR_TRACKER_OBJ_042_oPCAN_RADAR_00c8f87e_Tx: ComBitPosition=14, ComBitSize=3, ComSignalType=UINT8, ComHandleId=10563, ComSystemTemplateSystemSignalRef=OBJ_MEASUREMENT_STATUS_042
          OBJ_VELOCITY_LONG_ERR_042_oRDR_TRACKER_OBJ_042_oPCAN_RADAR_c1ad5af2_Tx: ComBitPosition=143, ComBitSize=8, ComSignalType=UINT8, ComHandleId=10582, ComSystemTemplateSystemSignalRef=OBJ_VELOCITY_LONG_ERR_042
          OBJ_CLS_TYPE3_042_oRDR_TRACKER_OBJ_042_oPCAN_RADAR_afca6838_Tx: ComBitPosition=279, ComBitSize=4, ComSignalType=UINT8, ComHandleId=10548, ComSystemTemplateSystemSignalRef=OBJ_CLS_TYPE3_042
          OBJ_ACCELERATION_LAT_ERR_042_oRDR_TRACKER_OBJ_042_oPCAN_RADAR_3f145c79_Tx: ComBitPosition=223, ComBitSize=8, ComSignalType=UINT8, ComHandleId=10539, ComSystemTemplateSystemSignalRef=OBJ_ACCELERATION_LAT_ERR_042
          OBJ_CLS_TYPE2_PROB_042_oRDR_TRACKER_OBJ_042_oPCAN_RADAR_0ec65943_Tx: ComBitPosition=311, ComBitSize=8, ComSignalType=UINT8, ComHandleId=10547, ComSystemTemplateSystemSignalRef=OBJ_CLS_TYPE2_PROB_042
          OBJ_MH_CYCLE_COUNTER_042_oRDR_TRACKER_OBJ_042_oPCAN_RADAR_0d4c15a3_Tx: ComBitPosition=487, ComBitSize=8, ComSignalType=UINT8, ComHandleId=10565, ComSystemTemplateSystemSignalRef=OBJ_MH_CYCLE_COUNTER_042
          OBJ_MH_CRC16_042_oRDR_TRACKER_OBJ_042_oPCAN_RADAR_7ca84f42_Tx: ComBitPosition=495, ComBitSize=16, ComSignalType=UINT16, ComHandleId=10564, ComSystemTemplateSystemSignalRef=OBJ_MH_CRC16_042
      5 x ComIPdu, all with ComIPduDirection=SEND, ComIPduType=NORMAL, ComIPduCancellationSupport=false, ComIPduSignalProcessing=DEFERRED, ComIPduChannelRef=CN_PCAN_RADAR_458ff0f1, ComIPduGroupRef=RDR01_oPCAN_RADAR_Tx_b6bdb067 if post-build-variant-condition{matching-criterion=RDR_POS, value=0}, ComIPduMainFunctionRef=ComMainFunctionTx_Event, ComIPduGroupRef=RDR02_oPCAN_RADAR_Tx_9f750495 if post-build-variant-condition{matching-criterion=RDR_POS, value=1}, ComIPduGroupRef=RDR03_oPCAN_RADAR_Tx_311d9504 if post-build-variant-condition{matching-criterion=RDR_POS, value=2}, ComIPduGroupRef=RDR04_oPCAN_RADAR_Tx_cce46d71 if post-build-variant-condition{matching-criterion=RDR_POS, value=3}, ComIPduGroupRef=RDR05_oPCAN_RADAR_Tx_628cfce0 if post-build-variant-condition{matching-criterion=RDR_POS, value=4}, ComIPduGroupRef=RDR06_oPCAN_RADAR_Tx_4b444812 if post-build-variant-condition{matching-criterion=RDR_POS, value=5}, ComIPduGroupRef=RDR07_oPCAN_RADAR_Tx_e52cd983 if post-build-variant-condition{matching-criterion=RDR_POS, value=6}, ComIPduGroupRef=RDR08_oPCAN_RADAR_Tx_6bc6beb9 if post-build-variant-condition{matching-criterion=RDR_POS, value=7}:
        RDR_DETECTION_025_028_oPCAN_RADAR_bd4a315a_Tx: ComIPduHandleId=12, ComIPduSignalGroupRef=SG_Detections_025_028_oRDR_DETECTION_025_028_oPCAN_RADAR_9bfe01a5_Tx, ComPduIdRef=RDR_DETECTION_025_028_oPCAN_RADAR_bd4a315a_Tx
          ComTxIPdu: ComMinimumDelayTime=0, ComTxIPduUnusedAreasDefault=0
            ComTxModeTrue
              ComTxMode: ComTxModeMode=DIRECT, ComTxModeNumberOfRepetitions=0
            ComTxModeFalse
              ComTxMode: ComTxModeMode=NONE
        RDR_DETECTION_069_072_oPCAN_RADAR_9d068646_Tx: ComIPduHandleId=23, ComIPduSignalGroupRef=SG_Detections_069_072_oRDR_DETECTION_069_072_oPCAN_RADAR_686f657a_Tx, ComPduIdRef=RDR_DETECTION_069_072_oPCAN_RADAR_9d068646_Tx
          ComTxIPdu: ComMinimumDelayTime=0, ComTxIPduUnusedAreasDefault=0
            ComTxModeTrue
              ComTxMode: ComTxModeMode=DIRECT, ComTxModeNumberOfRepetitions=0
            ComTxModeFalse
              ComTxMode: ComTxModeMode=NONE
        RDR_DETECTION_345_348_oPCAN_RADAR_f9df2ab9_Tx: ComIPduHandleId=92, ComIPduSignalGroupRef=SG_Detections_345_348_oRDR_DETECTION_345_348_oPCAN_RADAR_03988697_Tx, ComPduIdRef=RDR_DETECTION_345_348_oPCAN_RADAR_f9df2ab9_Tx
          ComTxIPdu: ComMinimumDelayTime=0, ComTxIPduUnusedAreasDefault=0
            ComTxModeTrue
              ComTxMode: ComTxModeMode=DIRECT, ComTxModeNumberOfRepetitions=0
            ComTxModeFalse
              ComTxMode: ComTxModeMode=NONE
        RDR_TRACKER_OBJ_049_oPCAN_RADAR_6d28a720_Tx: ComIPduHandleId=159, ComIPduSignalGroupRef=SG_TrackerObject049_oRDR_TRACKER_OBJ_049_oPCAN_RADAR_91e8feb8_Tx, ComPduIdRef=RDR_TRACKER_OBJ_049_oPCAN_RADAR_6d28a720_Tx
          ComTxIPdu: ComMinimumDelayTime=0, ComTxIPduUnusedAreasDefault=0
            ComTxModeTrue
              ComTxMode: ComTxModeMode=DIRECT, ComTxModeNumberOfRepetitions=0
            ComTxModeFalse
              ComTxMode: ComTxModeMode=NONE
        RDR_DETECTION_077_080_oPCAN_RADAR_05b8c98c_Tx: ComIPduHandleId=25, ComIPduSignalGroupRef=SG_Detections_077_080_oRDR_DETECTION_077_080_oPCAN_RADAR_2ec83134_Tx, ComPduIdRef=RDR_DETECTION_077_080_oPCAN_RADAR_05b8c98c_Tx
          ComTxIPdu: ComMinimumDelayTime=0, ComTxIPduUnusedAreasDefault=0
            ComTxModeTrue
              ComTxMode: ComTxModeMode=DIRECT, ComTxModeNumberOfRepetitions=0
            ComTxModeFalse
              ComTxMode: ComTxModeMode=NONE
      SG_TrackerObject021_oRDR_TRACKER_OBJ_021_oPCAN_RADAR_009d93e1_Tx (ComSignalGroup):
        ComTransferProperty = TRIGGERED
        ComSignalGroupAccess = ACCESS_NEEDED_BY_SWC_OR_COM
        ComHandleId = 130
        ComSignalGroupArrayAccess = true
        ComSystemTemplateSignalGroupRef = SG_TrackerObject021
        49 x ComGroupSignal, all with ComSignalEndianness=BIG_ENDIAN, ComSignalInitValue=0, ComTransferProperty=PENDING, ComSignalAccess=ACCESS_NEEDED_BY_SWC_OR_COM:
          OBJ_CLS_TYPE1_021_oRDR_TRACKER_OBJ_021_oPCAN_RADAR_8bf33bec_Tx: ComBitPosition=271, ComBitSize=4, ComSignalType=UINT8, ComHandleId=9515, ComSystemTemplateSystemSignalRef=OBJ_CLS_TYPE1_021
          OBJ_CLS_TYPE2_021_oRDR_TRACKER_OBJ_021_oPCAN_RADAR_c61b3b8b_Tx: ComBitPosition=267, ComBitSize=4, ComSignalType=UINT8, ComHandleId=9517, ComSystemTemplateSystemSignalRef=OBJ_CLS_TYPE2_021
          OBJ_GROUP_ID_021_oRDR_TRACKER_OBJ_021_oPCAN_RADAR_686d0f95_Tx: ComBitPosition=405, ComBitSize=6, ComSignalType=UINT8, ComHandleId=9532, ComSystemTemplateSystemSignalRef=OBJ_GROUP_ID_021
          OBJ_YAW_RATE_ERR_021_oRDR_TRACKER_OBJ_021_oPCAN_RADAR_0b674de9_Tx: ComBitPosition=388, ComBitSize=5, ComSignalType=UINT8, ComHandleId=9557, ComSystemTemplateSystemSignalRef=OBJ_YAW_RATE_ERR_021
          OBJ_VELOCITY_ERR_CRR_COEF_021_oRDR_TRACKER_OBJ_021_oPCAN_RADAR_f23a3eb8_Tx: ComBitPosition=423, ComBitSize=8, ComSignalType=UINT8, ComHandleId=9549, ComSystemTemplateSystemSignalRef=OBJ_VELOCITY_ERR_CRR_COEF_021
          OBJ_DIMENSION_LENGTH_ERR_021_oRDR_TRACKER_OBJ_021_oPCAN_RADAR_f29577d2_Tx: ComBitPosition=41, ComBitSize=10, ComSignalType=UINT16, ComHandleId=9528, ComSystemTemplateSystemSignalRef=OBJ_DIMENSION_LENGTH_ERR_021
          OBJ_ACCELERATION_LAT_021_oRDR_TRACKER_OBJ_021_oPCAN_RADAR_0eb9c896_Tx: ComBitPosition=177, ComBitSize=10, ComSignalType=UINT16, ComHandleId=9509, ComSystemTemplateSystemSignalRef=OBJ_ACCELERATION_LAT_021
          OBJ_ACCELERATION_LONG_021_oRDR_TRACKER_OBJ_021_oPCAN_RADAR_7c499176_Tx: ComBitPosition=193, ComBitSize=10, ComSignalType=UINT16, ComHandleId=9511, ComSystemTemplateSystemSignalRef=OBJ_ACCELERATION_LONG_021
          OBJ_CLS_TYPE3_PROB_021_oRDR_TRACKER_OBJ_021_oPCAN_RADAR_ad8c01e9_Tx: ComBitPosition=319, ComBitSize=8, ComSignalType=UINT8, ComHandleId=9520, ComSystemTemplateSystemSignalRef=OBJ_CLS_TYPE3_PROB_021
          OBJ_ACCEL_ERR_CRR_COEF_021_oRDR_TRACKER_OBJ_021_oPCAN_RADAR_644b76e4_Tx: ComBitPosition=431, ComBitSize=8, ComSignalType=UINT8, ComHandleId=9513, ComSystemTemplateSystemSignalRef=OBJ_ACCEL_ERR_CRR_COEF_021
          OBJ_TRACK_MOTION_MODEL_021_oRDR_TRACKER_OBJ_021_oPCAN_RADAR_578fa999_Tx: ComBitPosition=9, ComBitSize=2, ComSignalType=UINT8, ComHandleId=9547, ComSystemTemplateSystemSignalRef=OBJ_TRACK_MOTION_MODEL_021
          OBJ_POS_LONG_021_oRDR_TRACKER_OBJ_021_oPCAN_RADAR_084f15da_Tx: ComBitPosition=63, ComBitSize=16, ComSignalType=UINT16, ComHandleId=9541, ComSystemTemplateSystemSignalRef=OBJ_POS_LONG_021
          OBJ_VELOCITY_LONG_021_oRDR_TRACKER_OBJ_021_oPCAN_RADAR_ad01c3f4_Tx: ComBitPosition=110, ComBitSize=15, ComSignalType=UINT16, ComHandleId=9552, ComSystemTemplateSystemSignalRef=OBJ_VELOCITY_LONG_021
          OBJ_RCS_021_oRDR_TRACKER_OBJ_021_oPCAN_RADAR_9b20a812_Tx: ComBitPosition=351, ComBitSize=7, ComSignalType=UINT8, ComHandleId=9543, ComSystemTemplateSystemSignalRef=OBJ_RCS_021
          OBJ_CLS_TYPE2_PROB_021_oRDR_TRACKER_OBJ_021_oPCAN_RADAR_ea9ff712_Tx: ComBitPosition=311, ComBitSize=8, ComSignalType=UINT8, ComHandleId=9518, ComSystemTemplateSystemSignalRef=OBJ_CLS_TYPE2_PROB_021
          OBJ_CLS_TYPE3_021_oRDR_TRACKER_OBJ_021_oPCAN_RADAR_4b93c669_Tx: ComBitPosition=279, ComBitSize=4, ComSignalType=UINT8, ComHandleId=9519, ComSystemTemplateSystemSignalRef=OBJ_CLS_TYPE3_021
          OBJ_POS_ERR_CRR_COEF_021_oRDR_TRACKER_OBJ_021_oPCAN_RADAR_5b400359_Tx: ComBitPosition=415, ComBitSize=8, ComSignalType=UINT8, ComHandleId=9538, ComSystemTemplateSystemSignalRef=OBJ_POS_ERR_CRR_COEF_021
          OBJ_TIMESTAMP_OFFSET_021_oRDR_TRACKER_OBJ_021_oPCAN_RADAR_9b8ca844_Tx: ComBitPosition=247, ComBitSize=8, ComSignalType=UINT8, ComHandleId=9546, ComSystemTemplateSystemSignalRef=OBJ_TIMESTAMP_OFFSET_021
          OBJ_DIMENSION_WIDTH_ERR_021_oRDR_TRACKER_OBJ_021_oPCAN_RADAR_0a0158ed_Tx: ComBitPosition=23, ComBitSize=6, ComSignalType=UINT8, ComHandleId=9530, ComSystemTemplateSystemSignalRef=OBJ_DIMENSION_WIDTH_ERR_021
          OBJ_MOVEMENT_STATUS_021_oRDR_TRACKER_OBJ_021_oPCAN_RADAR_cb3fc363_Tx: ComBitPosition=196, ComBitSize=3, ComSignalType=UINT8, ComHandleId=9537, ComSystemTemplateSystemSignalRef=OBJ_MOVEMENT_STATUS_021
          OBJ_DIMENSION_LENGTH_021_oRDR_TRACKER_OBJ_021_oPCAN_RADAR_c96d68a8_Tx: ComBitPosition=37, ComBitSize=12, ComSignalType=UINT16, ComHandleId=9527, ComSystemTemplateSystemSignalRef=OBJ_DIMENSION_LENGTH_021
          OBJ_CLS_TYPE5_PROB_021_oRDR_TRACKER_OBJ_021_oPCAN_RADAR_e49531b2_Tx: ComBitPosition=335, ComBitSize=8, ComSignalType=UINT8, ComHandleId=9524, ComSystemTemplateSystemSignalRef=OBJ_CLS_TYPE5_PROB_021
          OBJ_VELOCITY_LAT_021_oRDR_TRACKER_OBJ_021_oPCAN_RADAR_fd8cbb32_Tx: ComBitPosition=126, ComBitSize=15, ComSignalType=UINT16, ComHandleId=9550, ComSystemTemplateSystemSignalRef=OBJ_VELOCITY_LAT_021
          OBJ_POS_LAT_021_oRDR_TRACKER_OBJ_021_oPCAN_RADAR_b9effe15_Tx: ComBitPosition=79, ComBitSize=16, ComSignalType=UINT16, ComHandleId=9539, ComSystemTemplateSystemSignalRef=OBJ_POS_LAT_021
          OBJ_ID_021_oRDR_TRACKER_OBJ_021_oPCAN_RADAR_9b432492_Tx: ComBitPosition=7, ComBitSize=8, ComSignalType=UINT8, ComHandleId=9533, ComSystemTemplateSystemSignalRef=OBJ_ID_021
          OBJ_YAW_RATE_021_oRDR_TRACKER_OBJ_021_oPCAN_RADAR_34bfda35_Tx: ComBitPosition=399, ComBitSize=10, ComSignalType=UINT16, ComHandleId=9556, ComSystemTemplateSystemSignalRef=OBJ_YAW_RATE_021
          OBJ_ALIVE_TIME_021_oRDR_TRACKER_OBJ_021_oPCAN_RADAR_1c28daca_Tx: ComBitPosition=255, ComBitSize=16, ComSignalType=UINT16, ComHandleId=9514, ComSystemTemplateSystemSignalRef=OBJ_ALIVE_TIME_021
          OBJ_REF_PT_LAT_OFFSET_021_oRDR_TRACKER_OBJ_021_oPCAN_RADAR_6e1dc367_Tx: ComBitPosition=370, ComBitSize=14, ComSignalType=UINT16, ComHandleId=9544, ComSystemTemplateSystemSignalRef=OBJ_REF_PT_LAT_OFFSET_021
          OBJ_CLS_TYPE4_021_oRDR_TRACKER_OBJ_021_oPCAN_RADAR_5dcb3b45_Tx: ComBitPosition=275, ComBitSize=4, ComSignalType=UINT8, ComHandleId=9521, ComSystemTemplateSystemSignalRef=OBJ_CLS_TYPE4_021
          OBJ_EXISTENCE_PROB_021_oRDR_TRACKER_OBJ_021_oPCAN_RADAR_e11f1b38_Tx: ComBitPosition=229, ComBitSize=14, ComSignalType=UINT16, ComHandleId=9531, ComSystemTemplateSystemSignalRef=OBJ_EXISTENCE_PROB_021
          OBJ_POS_LONG_ERR_021_oRDR_TRACKER_OBJ_021_oPCAN_RADAR_245b50c0_Tx: ComBitPosition=95, ComBitSize=8, ComSignalType=UINT8, ComHandleId=9542, ComSystemTemplateSystemSignalRef=OBJ_POS_LONG_ERR_021
          OBJ_CLS_TYPE1_PROB_021_oRDR_TRACKER_OBJ_021_oPCAN_RADAR_23abec1f_Tx: ComBitPosition=303, ComBitSize=8, ComSignalType=UINT8, ComHandleId=9516, ComSystemTemplateSystemSignalRef=OBJ_CLS_TYPE1_PROB_021
          OBJ_CLS_TYPE6_PROB_021_oRDR_TRACKER_OBJ_021_oPCAN_RADAR_2da12abf_Tx: ComBitPosition=343, ComBitSize=8, ComSignalType=UINT8, ComHandleId=9526, ComSystemTemplateSystemSignalRef=OBJ_CLS_TYPE6_PROB_021
          OBJ_VELOCITY_LONG_ERR_021_oRDR_TRACKER_OBJ_021_oPCAN_RADAR_25f4f4a3_Tx: ComBitPosition=143, ComBitSize=8, ComSignalType=UINT8, ComHandleId=9553, ComSystemTemplateSystemSignalRef=OBJ_VELOCITY_LONG_ERR_021
          OBJ_CLS_TYPE5_021_oRDR_TRACKER_OBJ_021_oPCAN_RADAR_d043c6a7_Tx: ComBitPosition=287, ComBitSize=4, ComSignalType=UINT8, ComHandleId=9523, ComSystemTemplateSystemSignalRef=OBJ_CLS_TYPE5_021
          OBJ_VEH_TRACK_FLAG_021_oRDR_TRACKER_OBJ_021_oPCAN_RADAR_d5a55fc4_Tx: ComBitPosition=10, ComBitSize=1, ComSignalType=BOOLEAN, ComHandleId=9548, ComSystemTemplateSystemSignalRef=OBJ_VEH_TRACK_FLAG_021
          OBJ_ACCELERATION_LAT_ERR_021_oRDR_TRACKER_OBJ_021_oPCAN_RADAR_db4df228_Tx: ComBitPosition=223, ComBitSize=8, ComSignalType=UINT8, ComHandleId=9510, ComSystemTemplateSystemSignalRef=OBJ_ACCELERATION_LAT_ERR_021
          OBJ_VELOCITY_LAT_ERR_021_oRDR_TRACKER_OBJ_021_oPCAN_RADAR_c976cb63_Tx: ComBitPosition=151, ComBitSize=8, ComSignalType=UINT8, ComHandleId=9551, ComSystemTemplateSystemSignalRef=OBJ_VELOCITY_LAT_ERR_021
          OBJ_REF_PT_LONG_OFFSET_021_oRDR_TRACKER_OBJ_021_oPCAN_RADAR_214f3364_Tx: ComBitPosition=357, ComBitSize=14, ComSignalType=UINT16, ComHandleId=9545, ComSystemTemplateSystemSignalRef=OBJ_REF_PT_LONG_OFFSET_021
          OBJ_DIMENSION_WIDTH_021_oRDR_TRACKER_OBJ_021_oPCAN_RADAR_eaa39f05_Tx: ComBitPosition=17, ComBitSize=10, ComSignalType=UINT16, ComHandleId=9529, ComSystemTemplateSystemSignalRef=OBJ_DIMENSION_WIDTH_021
          OBJ_YAW_ANGLE_ERR_021_oRDR_TRACKER_OBJ_021_oPCAN_RADAR_c43df9a5_Tx: ComBitPosition=175, ComBitSize=7, ComSignalType=UINT8, ComHandleId=9555, ComSystemTemplateSystemSignalRef=OBJ_YAW_ANGLE_ERR_021
          OBJ_ACCELERATION_LONG_ERR_021_oRDR_TRACKER_OBJ_021_oPCAN_RADAR_c4e85782_Tx: ComBitPosition=215, ComBitSize=8, ComSignalType=UINT8, ComHandleId=9512, ComSystemTemplateSystemSignalRef=OBJ_ACCELERATION_LONG_ERR_021
          OBJ_YAW_ANGLE_021_oRDR_TRACKER_OBJ_021_oPCAN_RADAR_1130ff72_Tx: ComBitPosition=155, ComBitSize=12, ComSignalType=UINT16, ComHandleId=9554, ComSystemTemplateSystemSignalRef=OBJ_YAW_ANGLE_021
          OBJ_POS_LAT_ERR_021_oRDR_TRACKER_OBJ_021_oPCAN_RADAR_bda3ae22_Tx: ComBitPosition=103, ComBitSize=8, ComSignalType=UINT8, ComHandleId=9540, ComSystemTemplateSystemSignalRef=OBJ_POS_LAT_ERR_021
          OBJ_MEASUREMENT_STATUS_021_oRDR_TRACKER_OBJ_021_oPCAN_RADAR_e491562f_Tx: ComBitPosition=14, ComBitSize=3, ComSignalType=UINT8, ComHandleId=9534, ComSystemTemplateSystemSignalRef=OBJ_MEASUREMENT_STATUS_021
          OBJ_CLS_TYPE6_021_oRDR_TRACKER_OBJ_021_oPCAN_RADAR_9dabc6c0_Tx: ComBitPosition=282, ComBitSize=4, ComSignalType=UINT8, ComHandleId=9525, ComSystemTemplateSystemSignalRef=OBJ_CLS_TYPE6_021
          OBJ_CLS_TYPE4_PROB_021_oRDR_TRACKER_OBJ_021_oPCAN_RADAR_a386c749_Tx: ComBitPosition=327, ComBitSize=8, ComSignalType=UINT8, ComHandleId=9522, ComSystemTemplateSystemSignalRef=OBJ_CLS_TYPE4_PROB_021
          OBJ_MH_CYCLE_COUNTER_021_oRDR_TRACKER_OBJ_021_oPCAN_RADAR_e915bbf2_Tx: ComBitPosition=487, ComBitSize=8, ComSignalType=UINT8, ComHandleId=9536, ComSystemTemplateSystemSignalRef=OBJ_MH_CYCLE_COUNTER_021
          OBJ_MH_CRC16_021_oRDR_TRACKER_OBJ_021_oPCAN_RADAR_98f1e113_Tx: ComBitPosition=495, ComBitSize=16, ComSignalType=UINT16, ComHandleId=9535, ComSystemTemplateSystemSignalRef=OBJ_MH_CRC16_021
      RDR_DETECTION_013_016_oPCAN_RADAR_767f725b_Tx (ComIPdu):
        ComIPduDirection = SEND
        ComIPduType = NORMAL
        ComIPduCancellationSupport = false
        ComIPduHandleId = 9
        ComIPduSignalProcessing = DEFERRED
        ComIPduChannelRef = CN_PCAN_RADAR_458ff0f1
        ComIPduGroupRef = RDR01_oPCAN_RADAR_Tx_b6bdb067 if post-build-variant-condition{matching-criterion=RDR_POS, value=0}
        ComIPduSignalGroupRef = SG_Detections_013_016_oRDR_DETECTION_013_016_oPCAN_RADAR_05faeda4_Tx
        ComPduIdRef = RDR_DETECTION_013_016_oPCAN_RADAR_767f725b_Tx
        ComIPduMainFunctionRef = ComMainFunctionTx_Event
        ComIPduGroupRef = RDR02_oPCAN_RADAR_Tx_9f750495 if post-build-variant-condition{matching-criterion=RDR_POS, value=1}
        ComIPduGroupRef = RDR03_oPCAN_RADAR_Tx_311d9504 if post-build-variant-condition{matching-criterion=RDR_POS, value=2}
        ComIPduGroupRef = RDR04_oPCAN_RADAR_Tx_cce46d71 if post-build-variant-condition{matching-criterion=RDR_POS, value=3}
        ComIPduGroupRef = RDR05_oPCAN_RADAR_Tx_628cfce0 if post-build-variant-condition{matching-criterion=RDR_POS, value=4}
        ComIPduGroupRef = RDR06_oPCAN_RADAR_Tx_4b444812 if post-build-variant-condition{matching-criterion=RDR_POS, value=5}
        ComIPduGroupRef = RDR07_oPCAN_RADAR_Tx_e52cd983 if post-build-variant-condition{matching-criterion=RDR_POS, value=6}
        ComIPduGroupRef = RDR08_oPCAN_RADAR_Tx_6bc6beb9 if post-build-variant-condition{matching-criterion=RDR_POS, value=7}
        ComTxIPdu: ComMinimumDelayTime=0, ComTxIPduUnusedAreasDefault=0
          ComTxModeTrue
            ComTxMode: ComTxModeMode=DIRECT, ComTxModeNumberOfRepetitions=0
          ComTxModeFalse
            ComTxMode: ComTxModeMode=NONE
      SG_TrackerObject061_oRDR_TRACKER_OBJ_061_oPCAN_RADAR_91ab4f58_Tx (ComSignalGroup):
        ComTransferProperty = TRIGGERED
        ComSignalGroupAccess = ACCESS_NEEDED_BY_SWC_OR_COM
        ComHandleId = 170
        ComSignalGroupArrayAccess = true
        ComSystemTemplateSignalGroupRef = SG_TrackerObject061
        49 x ComGroupSignal, all with ComSignalEndianness=BIG_ENDIAN, ComSignalInitValue=0, ComTransferProperty=PENDING, ComSignalAccess=ACCESS_NEEDED_BY_SWC_OR_COM:
          OBJ_CLS_TYPE1_PROB_061_oRDR_TRACKER_OBJ_061_oPCAN_RADAR_b29d30a6_Tx: ComBitPosition=303, ComBitSize=8, ComSignalType=UINT8, ComHandleId=11476, ComSystemTemplateSystemSignalRef=OBJ_CLS_TYPE1_PROB_061
          OBJ_GROUP_ID_061_oRDR_TRACKER_OBJ_061_oPCAN_RADAR_f95bd32c_Tx: ComBitPosition=405, ComBitSize=6, ComSignalType=UINT8, ComHandleId=11492, ComSystemTemplateSystemSignalRef=OBJ_GROUP_ID_061
          OBJ_TIMESTAMP_OFFSET_061_oRDR_TRACKER_OBJ_061_oPCAN_RADAR_0aba74fd_Tx: ComBitPosition=247, ComBitSize=8, ComSignalType=UINT8, ComHandleId=11506, ComSystemTemplateSystemSignalRef=OBJ_TIMESTAMP_OFFSET_061
          OBJ_DIMENSION_LENGTH_ERR_061_oRDR_TRACKER_OBJ_061_oPCAN_RADAR_63a3ab6b_Tx: ComBitPosition=41, ComBitSize=10, ComSignalType=UINT16, ComHandleId=11488, ComSystemTemplateSystemSignalRef=OBJ_DIMENSION_LENGTH_ERR_061
          OBJ_MEASUREMENT_STATUS_061_oRDR_TRACKER_OBJ_061_oPCAN_RADAR_75a78a96_Tx: ComBitPosition=14, ComBitSize=3, ComSignalType=UINT8, ComHandleId=11494, ComSystemTemplateSystemSignalRef=OBJ_MEASUREMENT_STATUS_061
          OBJ_VELOCITY_LONG_ERR_061_oRDR_TRACKER_OBJ_061_oPCAN_RADAR_b4c2281a_Tx: ComBitPosition=143, ComBitSize=8, ComSignalType=UINT8, ComHandleId=11513, ComSystemTemplateSystemSignalRef=OBJ_VELOCITY_LONG_ERR_061
          OBJ_YAW_RATE_061_oRDR_TRACKER_OBJ_061_oPCAN_RADAR_a589068c_Tx: ComBitPosition=399, ComBitSize=10, ComSignalType=UINT16, ComHandleId=11516, ComSystemTemplateSystemSignalRef=OBJ_YAW_RATE_061
          OBJ_ACCELERATION_LONG_061_oRDR_TRACKER_OBJ_061_oPCAN_RADAR_ed7f4dcf_Tx: ComBitPosition=193, ComBitSize=10, ComSignalType=UINT16, ComHandleId=11471, ComSystemTemplateSystemSignalRef=OBJ_ACCELERATION_LONG_061
          OBJ_POS_LONG_ERR_061_oRDR_TRACKER_OBJ_061_oPCAN_RADAR_b56d8c79_Tx: ComBitPosition=95, ComBitSize=8, ComSignalType=UINT8, ComHandleId=11502, ComSystemTemplateSystemSignalRef=OBJ_POS_LONG_ERR_061
          OBJ_CLS_TYPE3_PROB_061_oRDR_TRACKER_OBJ_061_oPCAN_RADAR_3cbadd50_Tx: ComBitPosition=319, ComBitSize=8, ComSignalType=UINT8, ComHandleId=11480, ComSystemTemplateSystemSignalRef=OBJ_CLS_TYPE3_PROB_061
          OBJ_CLS_TYPE1_061_oRDR_TRACKER_OBJ_061_oPCAN_RADAR_1ac5e755_Tx: ComBitPosition=271, ComBitSize=4, ComSignalType=UINT8, ComHandleId=11475, ComSystemTemplateSystemSignalRef=OBJ_CLS_TYPE1_061
          OBJ_CLS_TYPE4_PROB_061_oRDR_TRACKER_OBJ_061_oPCAN_RADAR_32b01bf0_Tx: ComBitPosition=327, ComBitSize=8, ComSignalType=UINT8, ComHandleId=11482, ComSystemTemplateSystemSignalRef=OBJ_CLS_TYPE4_PROB_061
          OBJ_DIMENSION_LENGTH_061_oRDR_TRACKER_OBJ_061_oPCAN_RADAR_585bb411_Tx: ComBitPosition=37, ComBitSize=12, ComSignalType=UINT16, ComHandleId=11487, ComSystemTemplateSystemSignalRef=OBJ_DIMENSION_LENGTH_061
          OBJ_TRACK_MOTION_MODEL_061_oRDR_TRACKER_OBJ_061_oPCAN_RADAR_c6b97520_Tx: ComBitPosition=9, ComBitSize=2, ComSignalType=UINT8, ComHandleId=11507, ComSystemTemplateSystemSignalRef=OBJ_TRACK_MOTION_MODEL_061
          OBJ_MOVEMENT_STATUS_061_oRDR_TRACKER_OBJ_061_oPCAN_RADAR_5a091fda_Tx: ComBitPosition=196, ComBitSize=3, ComSignalType=UINT8, ComHandleId=11497, ComSystemTemplateSystemSignalRef=OBJ_MOVEMENT_STATUS_061
          OBJ_REF_PT_LAT_OFFSET_061_oRDR_TRACKER_OBJ_061_oPCAN_RADAR_ff2b1fde_Tx: ComBitPosition=370, ComBitSize=14, ComSignalType=UINT16, ComHandleId=11504, ComSystemTemplateSystemSignalRef=OBJ_REF_PT_LAT_OFFSET_061
          OBJ_POS_LAT_ERR_061_oRDR_TRACKER_OBJ_061_oPCAN_RADAR_2c95729b_Tx: ComBitPosition=103, ComBitSize=8, ComSignalType=UINT8, ComHandleId=11500, ComSystemTemplateSystemSignalRef=OBJ_POS_LAT_ERR_061
          OBJ_YAW_ANGLE_ERR_061_oRDR_TRACKER_OBJ_061_oPCAN_RADAR_550b251c_Tx: ComBitPosition=175, ComBitSize=7, ComSignalType=UINT8, ComHandleId=11515, ComSystemTemplateSystemSignalRef=OBJ_YAW_ANGLE_ERR_061
          OBJ_VELOCITY_LONG_061_oRDR_TRACKER_OBJ_061_oPCAN_RADAR_3c371f4d_Tx: ComBitPosition=110, ComBitSize=15, ComSignalType=UINT16, ComHandleId=11512, ComSystemTemplateSystemSignalRef=OBJ_VELOCITY_LONG_061
          OBJ_POS_LONG_061_oRDR_TRACKER_OBJ_061_oPCAN_RADAR_9979c963_Tx: ComBitPosition=63, ComBitSize=16, ComSignalType=UINT16, ComHandleId=11501, ComSystemTemplateSystemSignalRef=OBJ_POS_LONG_061
          OBJ_VELOCITY_ERR_CRR_COEF_061_oRDR_TRACKER_OBJ_061_oPCAN_RADAR_630ce201_Tx: ComBitPosition=423, ComBitSize=8, ComSignalType=UINT8, ComHandleId=11509, ComSystemTemplateSystemSignalRef=OBJ_VELOCITY_ERR_CRR_COEF_061
          OBJ_POS_LAT_061_oRDR_TRACKER_OBJ_061_oPCAN_RADAR_28d922ac_Tx: ComBitPosition=79, ComBitSize=16, ComSignalType=UINT16, ComHandleId=11499, ComSystemTemplateSystemSignalRef=OBJ_POS_LAT_061
          OBJ_CLS_TYPE5_PROB_061_oRDR_TRACKER_OBJ_061_oPCAN_RADAR_75a3ed0b_Tx: ComBitPosition=335, ComBitSize=8, ComSignalType=UINT8, ComHandleId=11484, ComSystemTemplateSystemSignalRef=OBJ_CLS_TYPE5_PROB_061
          OBJ_DIMENSION_WIDTH_ERR_061_oRDR_TRACKER_OBJ_061_oPCAN_RADAR_9b378454_Tx: ComBitPosition=23, ComBitSize=6, ComSignalType=UINT8, ComHandleId=11490, ComSystemTemplateSystemSignalRef=OBJ_DIMENSION_WIDTH_ERR_061
          OBJ_ID_061_oRDR_TRACKER_OBJ_061_oPCAN_RADAR_0a75f82b_Tx: ComBitPosition=7, ComBitSize=8, ComSignalType=UINT8, ComHandleId=11493, ComSystemTemplateSystemSignalRef=OBJ_ID_061
          OBJ_ACCELERATION_LAT_061_oRDR_TRACKER_OBJ_061_oPCAN_RADAR_9f8f142f_Tx: ComBitPosition=177, ComBitSize=10, ComSignalType=UINT16, ComHandleId=11469, ComSystemTemplateSystemSignalRef=OBJ_ACCELERATION_LAT_061
          OBJ_ACCELERATION_LONG_ERR_061_oRDR_TRACKER_OBJ_061_oPCAN_RADAR_55de8b3b_Tx: ComBitPosition=215, ComBitSize=8, ComSignalType=UINT8, ComHandleId=11472, ComSystemTemplateSystemSignalRef=OBJ_ACCELERATION_LONG_ERR_061
          OBJ_VELOCITY_LAT_ERR_061_oRDR_TRACKER_OBJ_061_oPCAN_RADAR_584017da_Tx: ComBitPosition=151, ComBitSize=8, ComSignalType=UINT8, ComHandleId=11511, ComSystemTemplateSystemSignalRef=OBJ_VELOCITY_LAT_ERR_061
          OBJ_DIMENSION_WIDTH_061_oRDR_TRACKER_OBJ_061_oPCAN_RADAR_7b9543bc_Tx: ComBitPosition=17, ComBitSize=10, ComSignalType=UINT16, ComHandleId=11489, ComSystemTemplateSystemSignalRef=OBJ_DIMENSION_WIDTH_061
          OBJ_REF_PT_LONG_OFFSET_061_oRDR_TRACKER_OBJ_061_oPCAN_RADAR_b079efdd_Tx: ComBitPosition=357, ComBitSize=14, ComSignalType=UINT16, ComHandleId=11505, ComSystemTemplateSystemSignalRef=OBJ_REF_PT_LONG_OFFSET_061
          OBJ_ALIVE_TIME_061_oRDR_TRACKER_OBJ_061_oPCAN_RADAR_8d1e0673_Tx: ComBitPosition=255, ComBitSize=16, ComSignalType=UINT16, ComHandleId=11474, ComSystemTemplateSystemSignalRef=OBJ_ALIVE_TIME_061
          OBJ_CLS_TYPE2_061_oRDR_TRACKER_OBJ_061_oPCAN_RADAR_572de732_Tx: ComBitPosition=267, ComBitSize=4, ComSignalType=UINT8, ComHandleId=11477, ComSystemTemplateSystemSignalRef=OBJ_CLS_TYPE2_061
          OBJ_CLS_TYPE4_061_oRDR_TRACKER_OBJ_061_oPCAN_RADAR_ccfde7fc_Tx: ComBitPosition=275, ComBitSize=4, ComSignalType=UINT8, ComHandleId=11481, ComSystemTemplateSystemSignalRef=OBJ_CLS_TYPE4_061
          OBJ_CLS_TYPE6_061_oRDR_TRACKER_OBJ_061_oPCAN_RADAR_0c9d1a79_Tx: ComBitPosition=282, ComBitSize=4, ComSignalType=UINT8, ComHandleId=11485, ComSystemTemplateSystemSignalRef=OBJ_CLS_TYPE6_061
          OBJ_POS_ERR_CRR_COEF_061_oRDR_TRACKER_OBJ_061_oPCAN_RADAR_ca76dfe0_Tx: ComBitPosition=415, ComBitSize=8, ComSignalType=UINT8, ComHandleId=11498, ComSystemTemplateSystemSignalRef=OBJ_POS_ERR_CRR_COEF_061
          OBJ_EXISTENCE_PROB_061_oRDR_TRACKER_OBJ_061_oPCAN_RADAR_7029c781_Tx: ComBitPosition=229, ComBitSize=14, ComSignalType=UINT16, ComHandleId=11491, ComSystemTemplateSystemSignalRef=OBJ_EXISTENCE_PROB_061
          OBJ_VEH_TRACK_FLAG_061_oRDR_TRACKER_OBJ_061_oPCAN_RADAR_4493837d_Tx: ComBitPosition=10, ComBitSize=1, ComSignalType=BOOLEAN, ComHandleId=11508, ComSystemTemplateSystemSignalRef=OBJ_VEH_TRACK_FLAG_061
          OBJ_CLS_TYPE5_061_oRDR_TRACKER_OBJ_061_oPCAN_RADAR_41751a1e_Tx: ComBitPosition=287, ComBitSize=4, ComSignalType=UINT8, ComHandleId=11483, ComSystemTemplateSystemSignalRef=OBJ_CLS_TYPE5_061
          OBJ_RCS_061_oRDR_TRACKER_OBJ_061_oPCAN_RADAR_0a1674ab_Tx: ComBitPosition=351, ComBitSize=7, ComSignalType=UINT8, ComHandleId=11503, ComSystemTemplateSystemSignalRef=OBJ_RCS_061
          OBJ_CLS_TYPE2_PROB_061_oRDR_TRACKER_OBJ_061_oPCAN_RADAR_7ba92bab_Tx: ComBitPosition=311, ComBitSize=8, ComSignalType=UINT8, ComHandleId=11478, ComSystemTemplateSystemSignalRef=OBJ_CLS_TYPE2_PROB_061
          OBJ_CLS_TYPE6_PROB_061_oRDR_TRACKER_OBJ_061_oPCAN_RADAR_bc97f606_Tx: ComBitPosition=343, ComBitSize=8, ComSignalType=UINT8, ComHandleId=11486, ComSystemTemplateSystemSignalRef=OBJ_CLS_TYPE6_PROB_061
          OBJ_CLS_TYPE3_061_oRDR_TRACKER_OBJ_061_oPCAN_RADAR_daa51ad0_Tx: ComBitPosition=279, ComBitSize=4, ComSignalType=UINT8, ComHandleId=11479, ComSystemTemplateSystemSignalRef=OBJ_CLS_TYPE3_061
          OBJ_ACCELERATION_LAT_ERR_061_oRDR_TRACKER_OBJ_061_oPCAN_RADAR_4a7b2e91_Tx: ComBitPosition=223, ComBitSize=8, ComSignalType=UINT8, ComHandleId=11470, ComSystemTemplateSystemSignalRef=OBJ_ACCELERATION_LAT_ERR_061
          OBJ_YAW_RATE_ERR_061_oRDR_TRACKER_OBJ_061_oPCAN_RADAR_9a519150_Tx: ComBitPosition=388, ComBitSize=5, ComSignalType=UINT8, ComHandleId=11517, ComSystemTemplateSystemSignalRef=OBJ_YAW_RATE_ERR_061
          OBJ_VELOCITY_LAT_061_oRDR_TRACKER_OBJ_061_oPCAN_RADAR_6cba678b_Tx: ComBitPosition=126, ComBitSize=15, ComSignalType=UINT16, ComHandleId=11510, ComSystemTemplateSystemSignalRef=OBJ_VELOCITY_LAT_061
          OBJ_ACCEL_ERR_CRR_COEF_061_oRDR_TRACKER_OBJ_061_oPCAN_RADAR_f57daa5d_Tx: ComBitPosition=431, ComBitSize=8, ComSignalType=UINT8, ComHandleId=11473, ComSystemTemplateSystemSignalRef=OBJ_ACCEL_ERR_CRR_COEF_061
          OBJ_YAW_ANGLE_061_oRDR_TRACKER_OBJ_061_oPCAN_RADAR_800623cb_Tx: ComBitPosition=155, ComBitSize=12, ComSignalType=UINT16, ComHandleId=11514, ComSystemTemplateSystemSignalRef=OBJ_YAW_ANGLE_061
          OBJ_MH_CYCLE_COUNTER_061_oRDR_TRACKER_OBJ_061_oPCAN_RADAR_7823674b_Tx: ComBitPosition=487, ComBitSize=8, ComSignalType=UINT8, ComHandleId=11496, ComSystemTemplateSystemSignalRef=OBJ_MH_CYCLE_COUNTER_061
          OBJ_MH_CRC16_061_oRDR_TRACKER_OBJ_061_oPCAN_RADAR_09c73daa_Tx: ComBitPosition=495, ComBitSize=16, ComSignalType=UINT16, ComHandleId=11495, ComSystemTemplateSystemSignalRef=OBJ_MH_CRC16_061
      5 x ComIPdu, all with ComIPduDirection=SEND, ComIPduType=NORMAL, ComIPduCancellationSupport=false, ComIPduSignalProcessing=DEFERRED, ComIPduChannelRef=CN_PCAN_RADAR_458ff0f1, ComIPduGroupRef=RDR01_oPCAN_RADAR_Tx_b6bdb067 if post-build-variant-condition{matching-criterion=RDR_POS, value=0}, ComIPduMainFunctionRef=ComMainFunctionTx_Event, ComIPduGroupRef=RDR02_oPCAN_RADAR_Tx_9f750495 if post-build-variant-condition{matching-criterion=RDR_POS, value=1}, ComIPduGroupRef=RDR03_oPCAN_RADAR_Tx_311d9504 if post-build-variant-condition{matching-criterion=RDR_POS, value=2}, ComIPduGroupRef=RDR04_oPCAN_RADAR_Tx_cce46d71 if post-build-variant-condition{matching-criterion=RDR_POS, value=3}, ComIPduGroupRef=RDR05_oPCAN_RADAR_Tx_628cfce0 if post-build-variant-condition{matching-criterion=RDR_POS, value=4}, ComIPduGroupRef=RDR06_oPCAN_RADAR_Tx_4b444812 if post-build-variant-condition{matching-criterion=RDR_POS, value=5}, ComIPduGroupRef=RDR07_oPCAN_RADAR_Tx_e52cd983 if post-build-variant-condition{matching-criterion=RDR_POS, value=6}, ComIPduGroupRef=RDR08_oPCAN_RADAR_Tx_6bc6beb9 if post-build-variant-condition{matching-criterion=RDR_POS, value=7}:
        RDR_TRACKER_OBJ_017_oPCAN_RADAR_136dc5fd_Tx: ComIPduHandleId=127, ComIPduSignalGroupRef=SG_TrackerObject017_oRDR_TRACKER_OBJ_017_oPCAN_RADAR_8cc7b14a_Tx, ComPduIdRef=RDR_TRACKER_OBJ_017_oPCAN_RADAR_136dc5fd_Tx
          ComTxIPdu: ComMinimumDelayTime=0, ComTxIPduUnusedAreasDefault=0
            ComTxModeTrue
              ComTxMode: ComTxModeMode=DIRECT, ComTxModeNumberOfRepetitions=0
            ComTxModeFalse
              ComTxMode: ComTxModeMode=NONE
        RDR_DETECTION_093_096_oPCAN_RADAR_5277c261_Tx: ComIPduHandleId=29, ComIPduSignalGroupRef=SG_Detections_093_096_oRDR_DETECTION_093_096_oPCAN_RADAR_d02c6cec_Tx, ComPduIdRef=RDR_DETECTION_093_096_oPCAN_RADAR_5277c261_Tx
          ComTxIPdu: ComMinimumDelayTime=0, ComTxIPduUnusedAreasDefault=0
            ComTxModeTrue
              ComTxMode: ComTxModeMode=DIRECT, ComTxModeNumberOfRepetitions=0
            ComTxModeFalse
              ComTxMode: ComTxModeMode=NONE
        RDR_STATUS_002_oPCAN_RADAR_f6a78e0b_Tx: ComIPduHandleId=110, ComIPduSignalGroupRef=SG_RadarStatus2_oRDR_STATUS_002_oPCAN_RADAR_51f7b61a_Tx, ComPduIdRef=RDR_STATUS_002_oPCAN_RADAR_f6a78e0b_Tx
          ComTxIPdu: ComMinimumDelayTime=0, ComTxIPduUnusedAreasDefault=0
            ComTxModeTrue
              ComTxMode: ComTxModeMode=DIRECT, ComTxModeTimeOffset=0, ComTxModeTimePeriod=0.05, ComTxModeNumberOfRepetitions=0
            ComTxModeFalse
              ComTxMode: ComTxModeMode=NONE, ComTxModeTimeOffset=0, ComTxModeTimePeriod=0.05
        RDR_DETECTION_113_116_oPCAN_RADAR_186629eb_Tx: ComIPduHandleId=34, ComIPduSignalGroupRef=SG_Detections_113_116_oRDR_DETECTION_113_116_oPCAN_RADAR_4752cf18_Tx, ComPduIdRef=RDR_DETECTION_113_116_oPCAN_RADAR_186629eb_Tx
          ComTxIPdu: ComMinimumDelayTime=0, ComTxIPduUnusedAreasDefault=0
            ComTxModeTrue
              ComTxMode: ComTxModeMode=DIRECT, ComTxModeNumberOfRepetitions=0
            ComTxModeFalse
              ComTxMode: ComTxModeMode=NONE
        RDR_DETECTION_257_260_oPCAN_RADAR_17c540ef_Tx: ComIPduHandleId=70, ComIPduSignalGroupRef=SG_Detections_257_260_oRDR_DETECTION_257_260_oPCAN_RADAR_06edbef2_Tx, ComPduIdRef=RDR_DETECTION_257_260_oPCAN_RADAR_17c540ef_Tx
          ComTxIPdu: ComMinimumDelayTime=0, ComTxIPduUnusedAreasDefault=0
            ComTxModeTrue
              ComTxMode: ComTxModeMode=DIRECT, ComTxModeNumberOfRepetitions=0
            ComTxModeFalse
              ComTxMode: ComTxModeMode=NONE
      RDR01_oPCAN_RADAR_Tx_b6bdb067 (ComIPduGroup): ComIPduGroupHandleId=1, variation-point=post-build-variant-condition{matching-criterion=RDR_POS, value=0}
      5 x ComIPdu, all with ComIPduDirection=SEND, ComIPduType=NORMAL, ComIPduCancellationSupport=false, ComIPduSignalProcessing=DEFERRED, ComIPduChannelRef=CN_PCAN_RADAR_458ff0f1, ComIPduGroupRef=RDR01_oPCAN_RADAR_Tx_b6bdb067 if post-build-variant-condition{matching-criterion=RDR_POS, value=0}, ComIPduMainFunctionRef=ComMainFunctionTx_Event, ComIPduGroupRef=RDR02_oPCAN_RADAR_Tx_9f750495 if post-build-variant-condition{matching-criterion=RDR_POS, value=1}, ComIPduGroupRef=RDR03_oPCAN_RADAR_Tx_311d9504 if post-build-variant-condition{matching-criterion=RDR_POS, value=2}, ComIPduGroupRef=RDR04_oPCAN_RADAR_Tx_cce46d71 if post-build-variant-condition{matching-criterion=RDR_POS, value=3}, ComIPduGroupRef=RDR05_oPCAN_RADAR_Tx_628cfce0 if post-build-variant-condition{matching-criterion=RDR_POS, value=4}, ComIPduGroupRef=RDR06_oPCAN_RADAR_Tx_4b444812 if post-build-variant-condition{matching-criterion=RDR_POS, value=5}, ComIPduGroupRef=RDR07_oPCAN_RADAR_Tx_e52cd983 if post-build-variant-condition{matching-criterion=RDR_POS, value=6}, ComIPduGroupRef=RDR08_oPCAN_RADAR_Tx_6bc6beb9 if post-build-variant-condition{matching-criterion=RDR_POS, value=7}:
        RDR_DETECTION_205_208_oPCAN_RADAR_85c22914_Tx: ComIPduHandleId=57, ComIPduSignalGroupRef=SG_Detections_205_208_oRDR_DETECTION_205_208_oPCAN_RADAR_2bdbe48f_Tx, ComPduIdRef=RDR_DETECTION_205_208_oPCAN_RADAR_85c22914_Tx
          ComTxIPdu: ComMinimumDelayTime=0, ComTxIPduUnusedAreasDefault=0
            ComTxModeTrue
              ComTxMode: ComTxModeMode=DIRECT, ComTxModeNumberOfRepetitions=0
            ComTxModeFalse
              ComTxMode: ComTxModeMode=NONE
        RDR_DETECTION_029_032_oPCAN_RADAR_8f02de5b_Tx: ComIPduHandleId=13, ComIPduSignalGroupRef=SG_Detections_029_032_oRDR_DETECTION_029_032_oPCAN_RADAR_028425de_Tx, ComPduIdRef=RDR_DETECTION_029_032_oPCAN_RADAR_8f02de5b_Tx
          ComTxIPdu: ComMinimumDelayTime=0, ComTxIPduUnusedAreasDefault=0
            ComTxModeTrue
              ComTxMode: ComTxModeMode=DIRECT, ComTxModeNumberOfRepetitions=0
            ComTxModeFalse
              ComTxMode: ComTxModeMode=NONE
        RDR_TRACKER_OBJ_009_oPCAN_RADAR_7484283b_Tx: ComIPduHandleId=119, ComIPduSignalGroupRef=SG_TrackerObject009_oRDR_TRACKER_OBJ_009_oPCAN_RADAR_00de2201_Tx, ComPduIdRef=RDR_TRACKER_OBJ_009_oPCAN_RADAR_7484283b_Tx
          ComTxIPdu: ComMinimumDelayTime=0, ComTxIPduUnusedAreasDefault=0
            ComTxModeTrue
              ComTxMode: ComTxModeMode=DIRECT, ComTxModeNumberOfRepetitions=0
            ComTxModeFalse
              ComTxMode: ComTxModeMode=NONE
        RDR_DETECTION_293_296_oPCAN_RADAR_8e457501_Tx: ComIPduHandleId=79, ComIPduSignalGroupRef=SG_Detections_293_296_oRDR_DETECTION_293_296_oPCAN_RADAR_557c2994_Tx, ComPduIdRef=RDR_DETECTION_293_296_oPCAN_RADAR_8e457501_Tx
          ComTxIPdu: ComMinimumDelayTime=0, ComTxIPduUnusedAreasDefault=0
            ComTxModeTrue
              ComTxMode: ComTxModeMode=DIRECT, ComTxModeNumberOfRepetitions=0
            ComTxModeFalse
              ComTxMode: ComTxModeMode=NONE
        RDR_TRACKER_OBJ_054_oPCAN_RADAR_b70b2628_Tx: ComIPduHandleId=164, ComIPduSignalGroupRef=SG_TrackerObject054_oRDR_TRACKER_OBJ_054_oPCAN_RADAR_cdbdf267_Tx, ComPduIdRef=RDR_TRACKER_OBJ_054_oPCAN_RADAR_b70b2628_Tx
          ComTxIPdu: ComMinimumDelayTime=0, ComTxIPduUnusedAreasDefault=0
            ComTxModeTrue
              ComTxMode: ComTxModeMode=DIRECT, ComTxModeNumberOfRepetitions=0
            ComTxModeFalse
              ComTxMode: ComTxModeMode=NONE
      SG_TrackerObject018_oRDR_TRACKER_OBJ_018_oPCAN_RADAR_ab5b5c0c_Tx (ComSignalGroup):
        ComTransferProperty = TRIGGERED
        ComSignalGroupAccess = ACCESS_NEEDED_BY_SWC_OR_COM
        ComHandleId = 127
        ComSignalGroupArrayAccess = true
        ComSystemTemplateSignalGroupRef = SG_TrackerObject018
        49 x ComGroupSignal, all with ComSignalEndianness=BIG_ENDIAN, ComSignalInitValue=0, ComTransferProperty=PENDING, ComSignalAccess=ACCESS_NEEDED_BY_SWC_OR_COM:
          OBJ_CLS_TYPE2_PROB_018_oRDR_TRACKER_OBJ_018_oPCAN_RADAR_415938ff_Tx: ComBitPosition=311, ComBitSize=8, ComSignalType=UINT8, ComHandleId=9371, ComSystemTemplateSystemSignalRef=OBJ_CLS_TYPE2_PROB_018
          OBJ_CLS_TYPE5_018_oRDR_TRACKER_OBJ_018_oPCAN_RADAR_7b85094a_Tx: ComBitPosition=287, ComBitSize=4, ComSignalType=UINT8, ComHandleId=9376, ComSystemTemplateSystemSignalRef=OBJ_CLS_TYPE5_018
          OBJ_MOVEMENT_STATUS_018_oRDR_TRACKER_OBJ_018_oPCAN_RADAR_60f90c8e_Tx: ComBitPosition=196, ComBitSize=3, ComSignalType=UINT8, ComHandleId=9390, ComSystemTemplateSystemSignalRef=OBJ_MOVEMENT_STATUS_018
          OBJ_YAW_ANGLE_ERR_018_oRDR_TRACKER_OBJ_018_oPCAN_RADAR_6ffb3648_Tx: ComBitPosition=175, ComBitSize=7, ComSignalType=UINT8, ComHandleId=9408, ComSystemTemplateSystemSignalRef=OBJ_YAW_ANGLE_ERR_018
          OBJ_RCS_018_oRDR_TRACKER_OBJ_018_oPCAN_RADAR_30e667ff_Tx: ComBitPosition=351, ComBitSize=7, ComSignalType=UINT8, ComHandleId=9396, ComSystemTemplateSystemSignalRef=OBJ_RCS_018
          OBJ_POS_LAT_018_oRDR_TRACKER_OBJ_018_oPCAN_RADAR_122931f8_Tx: ComBitPosition=79, ComBitSize=16, ComSignalType=UINT16, ComHandleId=9392, ComSystemTemplateSystemSignalRef=OBJ_POS_LAT_018
          OBJ_YAW_ANGLE_018_oRDR_TRACKER_OBJ_018_oPCAN_RADAR_baf6309f_Tx: ComBitPosition=155, ComBitSize=12, ComSignalType=UINT16, ComHandleId=9407, ComSystemTemplateSystemSignalRef=OBJ_YAW_ANGLE_018
          OBJ_VELOCITY_LONG_ERR_018_oRDR_TRACKER_OBJ_018_oPCAN_RADAR_8e323b4e_Tx: ComBitPosition=143, ComBitSize=8, ComSignalType=UINT8, ComHandleId=9406, ComSystemTemplateSystemSignalRef=OBJ_VELOCITY_LONG_ERR_018
          OBJ_ACCELERATION_LAT_ERR_018_oRDR_TRACKER_OBJ_018_oPCAN_RADAR_708b3dc5_Tx: ComBitPosition=223, ComBitSize=8, ComSignalType=UINT8, ComHandleId=9363, ComSystemTemplateSystemSignalRef=OBJ_ACCELERATION_LAT_ERR_018
          OBJ_TRACK_MOTION_MODEL_018_oRDR_TRACKER_OBJ_018_oPCAN_RADAR_fc496674_Tx: ComBitPosition=9, ComBitSize=2, ComSignalType=UINT8, ComHandleId=9400, ComSystemTemplateSystemSignalRef=OBJ_TRACK_MOTION_MODEL_018
          OBJ_CLS_TYPE4_PROB_018_oRDR_TRACKER_OBJ_018_oPCAN_RADAR_084008a4_Tx: ComBitPosition=327, ComBitSize=8, ComSignalType=UINT8, ComHandleId=9375, ComSystemTemplateSystemSignalRef=OBJ_CLS_TYPE4_PROB_018
          OBJ_CLS_TYPE3_018_oRDR_TRACKER_OBJ_018_oPCAN_RADAR_e0550984_Tx: ComBitPosition=279, ComBitSize=4, ComSignalType=UINT8, ComHandleId=9372, ComSystemTemplateSystemSignalRef=OBJ_CLS_TYPE3_018
          OBJ_POS_LONG_018_oRDR_TRACKER_OBJ_018_oPCAN_RADAR_a389da37_Tx: ComBitPosition=63, ComBitSize=16, ComSignalType=UINT16, ComHandleId=9394, ComSystemTemplateSystemSignalRef=OBJ_POS_LONG_018
          OBJ_VELOCITY_ERR_CRR_COEF_018_oRDR_TRACKER_OBJ_018_oPCAN_RADAR_59fcf155_Tx: ComBitPosition=423, ComBitSize=8, ComSignalType=UINT8, ComHandleId=9402, ComSystemTemplateSystemSignalRef=OBJ_VELOCITY_ERR_CRR_COEF_018
          OBJ_CLS_TYPE2_018_oRDR_TRACKER_OBJ_018_oPCAN_RADAR_6dddf466_Tx: ComBitPosition=267, ComBitSize=4, ComSignalType=UINT8, ComHandleId=9370, ComSystemTemplateSystemSignalRef=OBJ_CLS_TYPE2_018
          OBJ_DIMENSION_WIDTH_ERR_018_oRDR_TRACKER_OBJ_018_oPCAN_RADAR_a1c79700_Tx: ComBitPosition=23, ComBitSize=6, ComSignalType=UINT8, ComHandleId=9383, ComSystemTemplateSystemSignalRef=OBJ_DIMENSION_WIDTH_ERR_018
          OBJ_CLS_TYPE5_PROB_018_oRDR_TRACKER_OBJ_018_oPCAN_RADAR_4f53fe5f_Tx: ComBitPosition=335, ComBitSize=8, ComSignalType=UINT8, ComHandleId=9377, ComSystemTemplateSystemSignalRef=OBJ_CLS_TYPE5_PROB_018
          OBJ_YAW_RATE_ERR_018_oRDR_TRACKER_OBJ_018_oPCAN_RADAR_a0a18204_Tx: ComBitPosition=388, ComBitSize=5, ComSignalType=UINT8, ComHandleId=9410, ComSystemTemplateSystemSignalRef=OBJ_YAW_RATE_ERR_018
          OBJ_CLS_TYPE6_018_oRDR_TRACKER_OBJ_018_oPCAN_RADAR_366d092d_Tx: ComBitPosition=282, ComBitSize=4, ComSignalType=UINT8, ComHandleId=9378, ComSystemTemplateSystemSignalRef=OBJ_CLS_TYPE6_018
          OBJ_CLS_TYPE3_PROB_018_oRDR_TRACKER_OBJ_018_oPCAN_RADAR_064ace04_Tx: ComBitPosition=319, ComBitSize=8, ComSignalType=UINT8, ComHandleId=9373, ComSystemTemplateSystemSignalRef=OBJ_CLS_TYPE3_PROB_018
          OBJ_TIMESTAMP_OFFSET_018_oRDR_TRACKER_OBJ_018_oPCAN_RADAR_304a67a9_Tx: ComBitPosition=247, ComBitSize=8, ComSignalType=UINT8, ComHandleId=9399, ComSystemTemplateSystemSignalRef=OBJ_TIMESTAMP_OFFSET_018
          OBJ_GROUP_ID_018_oRDR_TRACKER_OBJ_018_oPCAN_RADAR_c3abc078_Tx: ComBitPosition=405, ComBitSize=6, ComSignalType=UINT8, ComHandleId=9385, ComSystemTemplateSystemSignalRef=OBJ_GROUP_ID_018
          OBJ_ACCELERATION_LAT_018_oRDR_TRACKER_OBJ_018_oPCAN_RADAR_a57f077b_Tx: ComBitPosition=177, ComBitSize=10, ComSignalType=UINT16, ComHandleId=9362, ComSystemTemplateSystemSignalRef=OBJ_ACCELERATION_LAT_018
          OBJ_CLS_TYPE4_018_oRDR_TRACKER_OBJ_018_oPCAN_RADAR_f60df4a8_Tx: ComBitPosition=275, ComBitSize=4, ComSignalType=UINT8, ComHandleId=9374, ComSystemTemplateSystemSignalRef=OBJ_CLS_TYPE4_018
          OBJ_ID_018_oRDR_TRACKER_OBJ_018_oPCAN_RADAR_3085eb7f_Tx: ComBitPosition=7, ComBitSize=8, ComSignalType=UINT8, ComHandleId=9386, ComSystemTemplateSystemSignalRef=OBJ_ID_018
          OBJ_ACCELERATION_LONG_ERR_018_oRDR_TRACKER_OBJ_018_oPCAN_RADAR_6f2e986f_Tx: ComBitPosition=215, ComBitSize=8, ComSignalType=UINT8, ComHandleId=9365, ComSystemTemplateSystemSignalRef=OBJ_ACCELERATION_LONG_ERR_018
          OBJ_CLS_TYPE6_PROB_018_oRDR_TRACKER_OBJ_018_oPCAN_RADAR_8667e552_Tx: ComBitPosition=343, ComBitSize=8, ComSignalType=UINT8, ComHandleId=9379, ComSystemTemplateSystemSignalRef=OBJ_CLS_TYPE6_PROB_018
          OBJ_VELOCITY_LONG_018_oRDR_TRACKER_OBJ_018_oPCAN_RADAR_06c70c19_Tx: ComBitPosition=110, ComBitSize=15, ComSignalType=UINT16, ComHandleId=9405, ComSystemTemplateSystemSignalRef=OBJ_VELOCITY_LONG_018
          OBJ_CLS_TYPE1_PROB_018_oRDR_TRACKER_OBJ_018_oPCAN_RADAR_886d23f2_Tx: ComBitPosition=303, ComBitSize=8, ComSignalType=UINT8, ComHandleId=9369, ComSystemTemplateSystemSignalRef=OBJ_CLS_TYPE1_PROB_018
          OBJ_REF_PT_LAT_OFFSET_018_oRDR_TRACKER_OBJ_018_oPCAN_RADAR_c5db0c8a_Tx: ComBitPosition=370, ComBitSize=14, ComSignalType=UINT16, ComHandleId=9397, ComSystemTemplateSystemSignalRef=OBJ_REF_PT_LAT_OFFSET_018
          OBJ_DIMENSION_WIDTH_018_oRDR_TRACKER_OBJ_018_oPCAN_RADAR_416550e8_Tx: ComBitPosition=17, ComBitSize=10, ComSignalType=UINT16, ComHandleId=9382, ComSystemTemplateSystemSignalRef=OBJ_DIMENSION_WIDTH_018
          OBJ_POS_ERR_CRR_COEF_018_oRDR_TRACKER_OBJ_018_oPCAN_RADAR_f086ccb4_Tx: ComBitPosition=415, ComBitSize=8, ComSignalType=UINT8, ComHandleId=9391, ComSystemTemplateSystemSignalRef=OBJ_POS_ERR_CRR_COEF_018
          OBJ_ACCEL_ERR_CRR_COEF_018_oRDR_TRACKER_OBJ_018_oPCAN_RADAR_cf8db909_Tx: ComBitPosition=431, ComBitSize=8, ComSignalType=UINT8, ComHandleId=9366, ComSystemTemplateSystemSignalRef=OBJ_ACCEL_ERR_CRR_COEF_018
          OBJ_POS_LONG_ERR_018_oRDR_TRACKER_OBJ_018_oPCAN_RADAR_8f9d9f2d_Tx: ComBitPosition=95, ComBitSize=8, ComSignalType=UINT8, ComHandleId=9395, ComSystemTemplateSystemSignalRef=OBJ_POS_LONG_ERR_018
          OBJ_YAW_RATE_018_oRDR_TRACKER_OBJ_018_oPCAN_RADAR_9f7915d8_Tx: ComBitPosition=399, ComBitSize=10, ComSignalType=UINT16, ComHandleId=9409, ComSystemTemplateSystemSignalRef=OBJ_YAW_RATE_018
          OBJ_ACCELERATION_LONG_018_oRDR_TRACKER_OBJ_018_oPCAN_RADAR_d78f5e9b_Tx: ComBitPosition=193, ComBitSize=10, ComSignalType=UINT16, ComHandleId=9364, ComSystemTemplateSystemSignalRef=OBJ_ACCELERATION_LONG_018
          OBJ_VELOCITY_LAT_018_oRDR_TRACKER_OBJ_018_oPCAN_RADAR_564a74df_Tx: ComBitPosition=126, ComBitSize=15, ComSignalType=UINT16, ComHandleId=9403, ComSystemTemplateSystemSignalRef=OBJ_VELOCITY_LAT_018
          OBJ_CLS_TYPE1_018_oRDR_TRACKER_OBJ_018_oPCAN_RADAR_2035f401_Tx: ComBitPosition=271, ComBitSize=4, ComSignalType=UINT8, ComHandleId=9368, ComSystemTemplateSystemSignalRef=OBJ_CLS_TYPE1_018
          OBJ_DIMENSION_LENGTH_018_oRDR_TRACKER_OBJ_018_oPCAN_RADAR_62aba745_Tx: ComBitPosition=37, ComBitSize=12, ComSignalType=UINT16, ComHandleId=9380, ComSystemTemplateSystemSignalRef=OBJ_DIMENSION_LENGTH_018
          OBJ_DIMENSION_LENGTH_ERR_018_oRDR_TRACKER_OBJ_018_oPCAN_RADAR_5953b83f_Tx: ComBitPosition=41, ComBitSize=10, ComSignalType=UINT16, ComHandleId=9381, ComSystemTemplateSystemSignalRef=OBJ_DIMENSION_LENGTH_ERR_018
          OBJ_ALIVE_TIME_018_oRDR_TRACKER_OBJ_018_oPCAN_RADAR_b7ee1527_Tx: ComBitPosition=255, ComBitSize=16, ComSignalType=UINT16, ComHandleId=9367, ComSystemTemplateSystemSignalRef=OBJ_ALIVE_TIME_018
          OBJ_POS_LAT_ERR_018_oRDR_TRACKER_OBJ_018_oPCAN_RADAR_166561cf_Tx: ComBitPosition=103, ComBitSize=8, ComSignalType=UINT8, ComHandleId=9393, ComSystemTemplateSystemSignalRef=OBJ_POS_LAT_ERR_018
          OBJ_REF_PT_LONG_OFFSET_018_oRDR_TRACKER_OBJ_018_oPCAN_RADAR_8a89fc89_Tx: ComBitPosition=357, ComBitSize=14, ComSignalType=UINT16, ComHandleId=9398, ComSystemTemplateSystemSignalRef=OBJ_REF_PT_LONG_OFFSET_018
          OBJ_VELOCITY_LAT_ERR_018_oRDR_TRACKER_OBJ_018_oPCAN_RADAR_62b0048e_Tx: ComBitPosition=151, ComBitSize=8, ComSignalType=UINT8, ComHandleId=9404, ComSystemTemplateSystemSignalRef=OBJ_VELOCITY_LAT_ERR_018
          OBJ_EXISTENCE_PROB_018_oRDR_TRACKER_OBJ_018_oPCAN_RADAR_4ad9d4d5_Tx: ComBitPosition=229, ComBitSize=14, ComSignalType=UINT16, ComHandleId=9384, ComSystemTemplateSystemSignalRef=OBJ_EXISTENCE_PROB_018
          OBJ_VEH_TRACK_FLAG_018_oRDR_TRACKER_OBJ_018_oPCAN_RADAR_7e639029_Tx: ComBitPosition=10, ComBitSize=1, ComSignalType=BOOLEAN, ComHandleId=9401, ComSystemTemplateSystemSignalRef=OBJ_VEH_TRACK_FLAG_018
          OBJ_MEASUREMENT_STATUS_018_oRDR_TRACKER_OBJ_018_oPCAN_RADAR_4f5799c2_Tx: ComBitPosition=14, ComBitSize=3, ComSignalType=UINT8, ComHandleId=9387, ComSystemTemplateSystemSignalRef=OBJ_MEASUREMENT_STATUS_018
          OBJ_MH_CRC16_018_oRDR_TRACKER_OBJ_018_oPCAN_RADAR_33372efe_Tx: ComBitPosition=495, ComBitSize=16, ComSignalType=UINT16, ComHandleId=9388, ComSystemTemplateSystemSignalRef=OBJ_MH_CRC16_018
          OBJ_MH_CYCLE_COUNTER_018_oRDR_TRACKER_OBJ_018_oPCAN_RADAR_42d3741f_Tx: ComBitPosition=487, ComBitSize=8, ComSignalType=UINT8, ComHandleId=9389, ComSystemTemplateSystemSignalRef=OBJ_MH_CYCLE_COUNTER_018
      RDR_DETECTION_225_228_oPCAN_RADAR_6178863a_Tx (ComIPdu):
        ComIPduDirection = SEND
        ComIPduType = NORMAL
        ComIPduCancellationSupport = false
        ComIPduHandleId = 62
        ComIPduSignalProcessing = DEFERRED
        ComIPduChannelRef = CN_PCAN_RADAR_458ff0f1
        ComIPduGroupRef = RDR01_oPCAN_RADAR_Tx_b6bdb067 if post-build-variant-condition{matching-criterion=RDR_POS, value=0}
        ComIPduSignalGroupRef = SG_Detections_225_228_oRDR_DETECTION_225_228_oPCAN_RADAR_1eae44dd_Tx
        ComPduIdRef = RDR_DETECTION_225_228_oPCAN_RADAR_6178863a_Tx
        ComIPduMainFunctionRef = ComMainFunctionTx_Event
        ComIPduGroupRef = RDR02_oPCAN_RADAR_Tx_9f750495 if post-build-variant-condition{matching-criterion=RDR_POS, value=1}
        ComIPduGroupRef = RDR03_oPCAN_RADAR_Tx_311d9504 if post-build-variant-condition{matching-criterion=RDR_POS, value=2}
        ComIPduGroupRef = RDR04_oPCAN_RADAR_Tx_cce46d71 if post-build-variant-condition{matching-criterion=RDR_POS, value=3}
        ComIPduGroupRef = RDR05_oPCAN_RADAR_Tx_628cfce0 if post-build-variant-condition{matching-criterion=RDR_POS, value=4}
        ComIPduGroupRef = RDR06_oPCAN_RADAR_Tx_4b444812 if post-build-variant-condition{matching-criterion=RDR_POS, value=5}
        ComIPduGroupRef = RDR07_oPCAN_RADAR_Tx_e52cd983 if post-build-variant-condition{matching-criterion=RDR_POS, value=6}
        ComIPduGroupRef = RDR08_oPCAN_RADAR_Tx_6bc6beb9 if post-build-variant-condition{matching-criterion=RDR_POS, value=7}
        ComTxIPdu: ComMinimumDelayTime=0, ComTxIPduUnusedAreasDefault=0
          ComTxModeTrue
            ComTxMode: ComTxModeMode=DIRECT, ComTxModeNumberOfRepetitions=0
          ComTxModeFalse
            ComTxMode: ComTxModeMode=NONE
      RDR_TRACKER_OBJ_003_oPCAN_RADAR_4edb4e1d_Tx (ComIPdu):
        ComIPduDirection = SEND
        ComIPduType = NORMAL
        ComIPduCancellationSupport = false
        ComIPduHandleId = 113
        ComIPduSignalProcessing = DEFERRED
        ComIPduChannelRef = CN_PCAN_RADAR_458ff0f1
        ComIPduGroupRef = RDR01_oPCAN_RADAR_Tx_b6bdb067 if post-build-variant-condition{matching-criterion=RDR_POS, value=0}
        ComIPduSignalGroupRef = SG_TrackerObject003_oRDR_TRACKER_OBJ_003_oPCAN_RADAR_8ce669ba_Tx
        ComPduIdRef = RDR_TRACKER_OBJ_003_oPCAN_RADAR_4edb4e1d_Tx
        ComIPduMainFunctionRef = ComMainFunctionTx_Event
        ComIPduGroupRef = RDR02_oPCAN_RADAR_Tx_9f750495 if post-build-variant-condition{matching-criterion=RDR_POS, value=1}
        ComIPduGroupRef = RDR03_oPCAN_RADAR_Tx_311d9504 if post-build-variant-condition{matching-criterion=RDR_POS, value=2}
        ComIPduGroupRef = RDR04_oPCAN_RADAR_Tx_cce46d71 if post-build-variant-condition{matching-criterion=RDR_POS, value=3}
        ComIPduGroupRef = RDR05_oPCAN_RADAR_Tx_628cfce0 if post-build-variant-condition{matching-criterion=RDR_POS, value=4}
        ComIPduGroupRef = RDR06_oPCAN_RADAR_Tx_4b444812 if post-build-variant-condition{matching-criterion=RDR_POS, value=5}
        ComIPduGroupRef = RDR07_oPCAN_RADAR_Tx_e52cd983 if post-build-variant-condition{matching-criterion=RDR_POS, value=6}
        ComIPduGroupRef = RDR08_oPCAN_RADAR_Tx_6bc6beb9 if post-build-variant-condition{matching-criterion=RDR_POS, value=7}
        ComTxIPdu: ComMinimumDelayTime=0, ComTxIPduUnusedAreasDefault=0
          ComTxModeTrue
            ComTxMode: ComTxModeMode=DIRECT, ComTxModeNumberOfRepetitions=0
          ComTxModeFalse
            ComTxMode: ComTxModeMode=NONE
      SG_TrackerObject001_oRDR_TRACKER_OBJ_001_oPCAN_RADAR_a5be7e9d_Tx (ComSignalGroup):
        ComTransferProperty = TRIGGERED
        ComSignalGroupAccess = ACCESS_NEEDED_BY_SWC_OR_COM
        ComHandleId = 110
        ComSignalGroupArrayAccess = true
        ComSystemTemplateSignalGroupRef = SG_TrackerObject001
        49 x ComGroupSignal, all with ComSignalEndianness=BIG_ENDIAN, ComSignalInitValue=0, ComTransferProperty=PENDING, ComSignalAccess=ACCESS_NEEDED_BY_SWC_OR_COM:
          OBJ_POS_LAT_001_oRDR_TRACKER_OBJ_001_oPCAN_RADAR_1ccc1369_Tx: ComBitPosition=79, ComBitSize=16, ComSignalType=UINT16, ComHandleId=8559, ComSystemTemplateSystemSignalRef=OBJ_POS_LAT_001
          OBJ_REF_PT_LAT_OFFSET_001_oRDR_TRACKER_OBJ_001_oPCAN_RADAR_cb3e2e1b_Tx: ComBitPosition=370, ComBitSize=14, ComSignalType=UINT16, ComHandleId=8564, ComSystemTemplateSystemSignalRef=OBJ_REF_PT_LAT_OFFSET_001
          OBJ_ACCELERATION_LAT_001_oRDR_TRACKER_OBJ_001_oPCAN_RADAR_ab9a25ea_Tx: ComBitPosition=177, ComBitSize=10, ComSignalType=UINT16, ComHandleId=8529, ComSystemTemplateSystemSignalRef=OBJ_ACCELERATION_LAT_001
          OBJ_DIMENSION_LENGTH_001_oRDR_TRACKER_OBJ_001_oPCAN_RADAR_6c4e85d4_Tx: ComBitPosition=37, ComBitSize=12, ComSignalType=UINT16, ComHandleId=8547, ComSystemTemplateSystemSignalRef=OBJ_DIMENSION_LENGTH_001
          OBJ_CLS_TYPE1_PROB_001_oRDR_TRACKER_OBJ_001_oPCAN_RADAR_86880163_Tx: ComBitPosition=303, ComBitSize=8, ComSignalType=UINT8, ComHandleId=8536, ComSystemTemplateSystemSignalRef=OBJ_CLS_TYPE1_PROB_001
          OBJ_VELOCITY_LONG_ERR_001_oRDR_TRACKER_OBJ_001_oPCAN_RADAR_80d719df_Tx: ComBitPosition=143, ComBitSize=8, ComSignalType=UINT8, ComHandleId=8573, ComSystemTemplateSystemSignalRef=OBJ_VELOCITY_LONG_ERR_001
          OBJ_CLS_TYPE3_PROB_001_oRDR_TRACKER_OBJ_001_oPCAN_RADAR_08afec95_Tx: ComBitPosition=319, ComBitSize=8, ComSignalType=UINT8, ComHandleId=8540, ComSystemTemplateSystemSignalRef=OBJ_CLS_TYPE3_PROB_001
          OBJ_CLS_TYPE4_001_oRDR_TRACKER_OBJ_001_oPCAN_RADAR_f8e8d639_Tx: ComBitPosition=275, ComBitSize=4, ComSignalType=UINT8, ComHandleId=8541, ComSystemTemplateSystemSignalRef=OBJ_CLS_TYPE4_001
          OBJ_YAW_ANGLE_ERR_001_oRDR_TRACKER_OBJ_001_oPCAN_RADAR_611e14d9_Tx: ComBitPosition=175, ComBitSize=7, ComSignalType=UINT8, ComHandleId=8575, ComSystemTemplateSystemSignalRef=OBJ_YAW_ANGLE_ERR_001
          OBJ_YAW_RATE_ERR_001_oRDR_TRACKER_OBJ_001_oPCAN_RADAR_ae44a095_Tx: ComBitPosition=388, ComBitSize=5, ComSignalType=UINT8, ComHandleId=8577, ComSystemTemplateSystemSignalRef=OBJ_YAW_RATE_ERR_001
          OBJ_CLS_TYPE2_PROB_001_oRDR_TRACKER_OBJ_001_oPCAN_RADAR_4fbc1a6e_Tx: ComBitPosition=311, ComBitSize=8, ComSignalType=UINT8, ComHandleId=8538, ComSystemTemplateSystemSignalRef=OBJ_CLS_TYPE2_PROB_001
          OBJ_YAW_RATE_001_oRDR_TRACKER_OBJ_001_oPCAN_RADAR_919c3749_Tx: ComBitPosition=399, ComBitSize=10, ComSignalType=UINT16, ComHandleId=8576, ComSystemTemplateSystemSignalRef=OBJ_YAW_RATE_001
          OBJ_DIMENSION_WIDTH_001_oRDR_TRACKER_OBJ_001_oPCAN_RADAR_4f807279_Tx: ComBitPosition=17, ComBitSize=10, ComSignalType=UINT16, ComHandleId=8549, ComSystemTemplateSystemSignalRef=OBJ_DIMENSION_WIDTH_001
          OBJ_VELOCITY_LONG_001_oRDR_TRACKER_OBJ_001_oPCAN_RADAR_08222e88_Tx: ComBitPosition=110, ComBitSize=15, ComSignalType=UINT16, ComHandleId=8572, ComSystemTemplateSystemSignalRef=OBJ_VELOCITY_LONG_001
          OBJ_ACCELERATION_LONG_001_oRDR_TRACKER_OBJ_001_oPCAN_RADAR_d96a7c0a_Tx: ComBitPosition=193, ComBitSize=10, ComSignalType=UINT16, ComHandleId=8531, ComSystemTemplateSystemSignalRef=OBJ_ACCELERATION_LONG_001
          OBJ_ALIVE_TIME_001_oRDR_TRACKER_OBJ_001_oPCAN_RADAR_b90b37b6_Tx: ComBitPosition=255, ComBitSize=16, ComSignalType=UINT16, ComHandleId=8534, ComSystemTemplateSystemSignalRef=OBJ_ALIVE_TIME_001
          OBJ_GROUP_ID_001_oRDR_TRACKER_OBJ_001_oPCAN_RADAR_cd4ee2e9_Tx: ComBitPosition=405, ComBitSize=6, ComSignalType=UINT8, ComHandleId=8552, ComSystemTemplateSystemSignalRef=OBJ_GROUP_ID_001
          OBJ_CLS_TYPE5_PROB_001_oRDR_TRACKER_OBJ_001_oPCAN_RADAR_41b6dcce_Tx: ComBitPosition=335, ComBitSize=8, ComSignalType=UINT8, ComHandleId=8544, ComSystemTemplateSystemSignalRef=OBJ_CLS_TYPE5_PROB_001
          OBJ_ID_001_oRDR_TRACKER_OBJ_001_oPCAN_RADAR_3e60c9ee_Tx: ComBitPosition=7, ComBitSize=8, ComSignalType=UINT8, ComHandleId=8553, ComSystemTemplateSystemSignalRef=OBJ_ID_001
          OBJ_MOVEMENT_STATUS_001_oRDR_TRACKER_OBJ_001_oPCAN_RADAR_6e1c2e1f_Tx: ComBitPosition=196, ComBitSize=3, ComSignalType=UINT8, ComHandleId=8557, ComSystemTemplateSystemSignalRef=OBJ_MOVEMENT_STATUS_001
          OBJ_VEH_TRACK_FLAG_001_oRDR_TRACKER_OBJ_001_oPCAN_RADAR_7086b2b8_Tx: ComBitPosition=10, ComBitSize=1, ComSignalType=BOOLEAN, ComHandleId=8568, ComSystemTemplateSystemSignalRef=OBJ_VEH_TRACK_FLAG_001
          OBJ_ACCELERATION_LONG_ERR_001_oRDR_TRACKER_OBJ_001_oPCAN_RADAR_61cbbafe_Tx: ComBitPosition=215, ComBitSize=8, ComSignalType=UINT8, ComHandleId=8532, ComSystemTemplateSystemSignalRef=OBJ_ACCELERATION_LONG_ERR_001
          OBJ_ACCELERATION_LAT_ERR_001_oRDR_TRACKER_OBJ_001_oPCAN_RADAR_7e6e1f54_Tx: ComBitPosition=223, ComBitSize=8, ComSignalType=UINT8, ComHandleId=8530, ComSystemTemplateSystemSignalRef=OBJ_ACCELERATION_LAT_ERR_001
          OBJ_EXISTENCE_PROB_001_oRDR_TRACKER_OBJ_001_oPCAN_RADAR_443cf644_Tx: ComBitPosition=229, ComBitSize=14, ComSignalType=UINT16, ComHandleId=8551, ComSystemTemplateSystemSignalRef=OBJ_EXISTENCE_PROB_001
          OBJ_POS_LONG_001_oRDR_TRACKER_OBJ_001_oPCAN_RADAR_ad6cf8a6_Tx: ComBitPosition=63, ComBitSize=16, ComSignalType=UINT16, ComHandleId=8561, ComSystemTemplateSystemSignalRef=OBJ_POS_LONG_001
          OBJ_RCS_001_oRDR_TRACKER_OBJ_001_oPCAN_RADAR_3e03456e_Tx: ComBitPosition=351, ComBitSize=7, ComSignalType=UINT8, ComHandleId=8563, ComSystemTemplateSystemSignalRef=OBJ_RCS_001
          OBJ_VELOCITY_LAT_ERR_001_oRDR_TRACKER_OBJ_001_oPCAN_RADAR_6c55261f_Tx: ComBitPosition=151, ComBitSize=8, ComSignalType=UINT8, ComHandleId=8571, ComSystemTemplateSystemSignalRef=OBJ_VELOCITY_LAT_ERR_001
          OBJ_DIMENSION_WIDTH_ERR_001_oRDR_TRACKER_OBJ_001_oPCAN_RADAR_af22b591_Tx: ComBitPosition=23, ComBitSize=6, ComSignalType=UINT8, ComHandleId=8550, ComSystemTemplateSystemSignalRef=OBJ_DIMENSION_WIDTH_ERR_001
          OBJ_CLS_TYPE4_PROB_001_oRDR_TRACKER_OBJ_001_oPCAN_RADAR_06a52a35_Tx: ComBitPosition=327, ComBitSize=8, ComSignalType=UINT8, ComHandleId=8542, ComSystemTemplateSystemSignalRef=OBJ_CLS_TYPE4_PROB_001
          OBJ_CLS_TYPE6_PROB_001_oRDR_TRACKER_OBJ_001_oPCAN_RADAR_8882c7c3_Tx: ComBitPosition=343, ComBitSize=8, ComSignalType=UINT8, ComHandleId=8546, ComSystemTemplateSystemSignalRef=OBJ_CLS_TYPE6_PROB_001
          OBJ_ACCEL_ERR_CRR_COEF_001_oRDR_TRACKER_OBJ_001_oPCAN_RADAR_c1689b98_Tx: ComBitPosition=431, ComBitSize=8, ComSignalType=UINT8, ComHandleId=8533, ComSystemTemplateSystemSignalRef=OBJ_ACCEL_ERR_CRR_COEF_001
          OBJ_VELOCITY_ERR_CRR_COEF_001_oRDR_TRACKER_OBJ_001_oPCAN_RADAR_5719d3c4_Tx: ComBitPosition=423, ComBitSize=8, ComSignalType=UINT8, ComHandleId=8569, ComSystemTemplateSystemSignalRef=OBJ_VELOCITY_ERR_CRR_COEF_001
          OBJ_CLS_TYPE3_001_oRDR_TRACKER_OBJ_001_oPCAN_RADAR_eeb02b15_Tx: ComBitPosition=279, ComBitSize=4, ComSignalType=UINT8, ComHandleId=8539, ComSystemTemplateSystemSignalRef=OBJ_CLS_TYPE3_001
          OBJ_MEASUREMENT_STATUS_001_oRDR_TRACKER_OBJ_001_oPCAN_RADAR_41b2bb53_Tx: ComBitPosition=14, ComBitSize=3, ComSignalType=UINT8, ComHandleId=8554, ComSystemTemplateSystemSignalRef=OBJ_MEASUREMENT_STATUS_001
          OBJ_POS_LAT_ERR_001_oRDR_TRACKER_OBJ_001_oPCAN_RADAR_1880435e_Tx: ComBitPosition=103, ComBitSize=8, ComSignalType=UINT8, ComHandleId=8560, ComSystemTemplateSystemSignalRef=OBJ_POS_LAT_ERR_001
          OBJ_CLS_TYPE1_001_oRDR_TRACKER_OBJ_001_oPCAN_RADAR_2ed0d690_Tx: ComBitPosition=271, ComBitSize=4, ComSignalType=UINT8, ComHandleId=8535, ComSystemTemplateSystemSignalRef=OBJ_CLS_TYPE1_001
          OBJ_TRACK_MOTION_MODEL_001_oRDR_TRACKER_OBJ_001_oPCAN_RADAR_f2ac44e5_Tx: ComBitPosition=9, ComBitSize=2, ComSignalType=UINT8, ComHandleId=8567, ComSystemTemplateSystemSignalRef=OBJ_TRACK_MOTION_MODEL_001
          OBJ_VELOCITY_LAT_001_oRDR_TRACKER_OBJ_001_oPCAN_RADAR_58af564e_Tx: ComBitPosition=126, ComBitSize=15, ComSignalType=UINT16, ComHandleId=8570, ComSystemTemplateSystemSignalRef=OBJ_VELOCITY_LAT_001
          OBJ_CLS_TYPE5_001_oRDR_TRACKER_OBJ_001_oPCAN_RADAR_75602bdb_Tx: ComBitPosition=287, ComBitSize=4, ComSignalType=UINT8, ComHandleId=8543, ComSystemTemplateSystemSignalRef=OBJ_CLS_TYPE5_001
          OBJ_POS_ERR_CRR_COEF_001_oRDR_TRACKER_OBJ_001_oPCAN_RADAR_fe63ee25_Tx: ComBitPosition=415, ComBitSize=8, ComSignalType=UINT8, ComHandleId=8558, ComSystemTemplateSystemSignalRef=OBJ_POS_ERR_CRR_COEF_001
          OBJ_CLS_TYPE2_001_oRDR_TRACKER_OBJ_001_oPCAN_RADAR_6338d6f7_Tx: ComBitPosition=267, ComBitSize=4, ComSignalType=UINT8, ComHandleId=8537, ComSystemTemplateSystemSignalRef=OBJ_CLS_TYPE2_001
          OBJ_REF_PT_LONG_OFFSET_001_oRDR_TRACKER_OBJ_001_oPCAN_RADAR_846cde18_Tx: ComBitPosition=357, ComBitSize=14, ComSignalType=UINT16, ComHandleId=8565, ComSystemTemplateSystemSignalRef=OBJ_REF_PT_LONG_OFFSET_001
          OBJ_CLS_TYPE6_001_oRDR_TRACKER_OBJ_001_oPCAN_RADAR_38882bbc_Tx: ComBitPosition=282, ComBitSize=4, ComSignalType=UINT8, ComHandleId=8545, ComSystemTemplateSystemSignalRef=OBJ_CLS_TYPE6_001
          OBJ_DIMENSION_LENGTH_ERR_001_oRDR_TRACKER_OBJ_001_oPCAN_RADAR_57b69aae_Tx: ComBitPosition=41, ComBitSize=10, ComSignalType=UINT16, ComHandleId=8548, ComSystemTemplateSystemSignalRef=OBJ_DIMENSION_LENGTH_ERR_001
          OBJ_POS_LONG_ERR_001_oRDR_TRACKER_OBJ_001_oPCAN_RADAR_8178bdbc_Tx: ComBitPosition=95, ComBitSize=8, ComSignalType=UINT8, ComHandleId=8562, ComSystemTemplateSystemSignalRef=OBJ_POS_LONG_ERR_001
          OBJ_TIMESTAMP_OFFSET_001_oRDR_TRACKER_OBJ_001_oPCAN_RADAR_3eaf4538_Tx: ComBitPosition=247, ComBitSize=8, ComSignalType=UINT8, ComHandleId=8566, ComSystemTemplateSystemSignalRef=OBJ_TIMESTAMP_OFFSET_001
          OBJ_YAW_ANGLE_001_oRDR_TRACKER_OBJ_001_oPCAN_RADAR_b413120e_Tx: ComBitPosition=155, ComBitSize=12, ComSignalType=UINT16, ComHandleId=8574, ComSystemTemplateSystemSignalRef=OBJ_YAW_ANGLE_001
          OBJ_MH_CYCLE_COUNTER_001_oRDR_TRACKER_OBJ_001_oPCAN_RADAR_4c36568e_Tx: ComBitPosition=487, ComBitSize=8, ComSignalType=UINT8, ComHandleId=8556, ComSystemTemplateSystemSignalRef=OBJ_MH_CYCLE_COUNTER_001
          OBJ_MH_CRC16_001_oRDR_TRACKER_OBJ_001_oPCAN_RADAR_3dd20c6f_Tx: ComBitPosition=495, ComBitSize=16, ComSignalType=UINT16, ComHandleId=8555, ComSystemTemplateSystemSignalRef=OBJ_MH_CRC16_001
      RDR_DETECTION_109_112_oPCAN_RADAR_05a12ac5_Tx (ComIPdu):
        ComIPduDirection = SEND
        ComIPduType = NORMAL
        ComIPduCancellationSupport = false
        ComIPduHandleId = 33
        ComIPduSignalProcessing = DEFERRED
        ComIPduChannelRef = CN_PCAN_RADAR_458ff0f1
        ComIPduGroupRef = RDR01_oPCAN_RADAR_Tx_b6bdb067 if post-build-variant-condition{matching-criterion=RDR_POS, value=0}
        ComIPduSignalGroupRef = SG_Detections_109_112_oRDR_DETECTION_109_112_oPCAN_RADAR_7559a730_Tx
        ComPduIdRef = RDR_DETECTION_109_112_oPCAN_RADAR_05a12ac5_Tx
        ComIPduMainFunctionRef = ComMainFunctionTx_Event
        ComIPduGroupRef = RDR02_oPCAN_RADAR_Tx_9f750495 if post-build-variant-condition{matching-criterion=RDR_POS, value=1}
        ComIPduGroupRef = RDR03_oPCAN_RADAR_Tx_311d9504 if post-build-variant-condition{matching-criterion=RDR_POS, value=2}
        ComIPduGroupRef = RDR04_oPCAN_RADAR_Tx_cce46d71 if post-build-variant-condition{matching-criterion=RDR_POS, value=3}
        ComIPduGroupRef = RDR05_oPCAN_RADAR_Tx_628cfce0 if post-build-variant-condition{matching-criterion=RDR_POS, value=4}
        ComIPduGroupRef = RDR06_oPCAN_RADAR_Tx_4b444812 if post-build-variant-condition{matching-criterion=RDR_POS, value=5}
        ComIPduGroupRef = RDR07_oPCAN_RADAR_Tx_e52cd983 if post-build-variant-condition{matching-criterion=RDR_POS, value=6}
        ComIPduGroupRef = RDR08_oPCAN_RADAR_Tx_6bc6beb9 if post-build-variant-condition{matching-criterion=RDR_POS, value=7}
        ComTxIPdu: ComMinimumDelayTime=0, ComTxIPduUnusedAreasDefault=0
          ComTxModeTrue
            ComTxMode: ComTxModeMode=DIRECT, ComTxModeNumberOfRepetitions=0
          ComTxModeFalse
            ComTxMode: ComTxModeMode=NONE
      SG_TrackerObject051_oRDR_TRACKER_OBJ_051_oPCAN_RADAR_6619549a_Tx (ComSignalGroup):
        ComTransferProperty = TRIGGERED
        ComSignalGroupAccess = ACCESS_NEEDED_BY_SWC_OR_COM
        ComHandleId = 160
        ComSignalGroupArrayAccess = true
        ComSystemTemplateSignalGroupRef = SG_TrackerObject051
        49 x ComGroupSignal, all with ComSignalEndianness=BIG_ENDIAN, ComSignalInitValue=0, ComTransferProperty=PENDING, ComSignalAccess=ACCESS_NEEDED_BY_SWC_OR_COM:
          OBJ_POS_LONG_ERR_051_oRDR_TRACKER_OBJ_051_oPCAN_RADAR_42df97bb_Tx: ComBitPosition=95, ComBitSize=8, ComSignalType=UINT8, ComHandleId=11012, ComSystemTemplateSystemSignalRef=OBJ_POS_LONG_ERR_051
          OBJ_VELOCITY_LAT_051_oRDR_TRACKER_OBJ_051_oPCAN_RADAR_9b087c49_Tx: ComBitPosition=126, ComBitSize=15, ComSignalType=UINT16, ComHandleId=11020, ComSystemTemplateSystemSignalRef=OBJ_VELOCITY_LAT_051
          OBJ_MOVEMENT_STATUS_051_oRDR_TRACKER_OBJ_051_oPCAN_RADAR_adbb0418_Tx: ComBitPosition=196, ComBitSize=3, ComSignalType=UINT8, ComHandleId=11007, ComSystemTemplateSystemSignalRef=OBJ_MOVEMENT_STATUS_051
          OBJ_CLS_TYPE4_051_oRDR_TRACKER_OBJ_051_oPCAN_RADAR_3b4ffc3e_Tx: ComBitPosition=275, ComBitSize=4, ComSignalType=UINT8, ComHandleId=10991, ComSystemTemplateSystemSignalRef=OBJ_CLS_TYPE4_051
          OBJ_CLS_TYPE1_PROB_051_oRDR_TRACKER_OBJ_051_oPCAN_RADAR_452f2b64_Tx: ComBitPosition=303, ComBitSize=8, ComSignalType=UINT8, ComHandleId=10986, ComSystemTemplateSystemSignalRef=OBJ_CLS_TYPE1_PROB_051
          OBJ_CLS_TYPE6_PROB_051_oRDR_TRACKER_OBJ_051_oPCAN_RADAR_4b25edc4_Tx: ComBitPosition=343, ComBitSize=8, ComSignalType=UINT8, ComHandleId=10996, ComSystemTemplateSystemSignalRef=OBJ_CLS_TYPE6_PROB_051
          OBJ_ACCELERATION_LONG_ERR_051_oRDR_TRACKER_OBJ_051_oPCAN_RADAR_a26c90f9_Tx: ComBitPosition=215, ComBitSize=8, ComSignalType=UINT8, ComHandleId=10982, ComSystemTemplateSystemSignalRef=OBJ_ACCELERATION_LONG_ERR_051
          OBJ_CLS_TYPE3_PROB_051_oRDR_TRACKER_OBJ_051_oPCAN_RADAR_cb08c692_Tx: ComBitPosition=319, ComBitSize=8, ComSignalType=UINT8, ComHandleId=10990, ComSystemTemplateSystemSignalRef=OBJ_CLS_TYPE3_PROB_051
          OBJ_VELOCITY_LAT_ERR_051_oRDR_TRACKER_OBJ_051_oPCAN_RADAR_aff20c18_Tx: ComBitPosition=151, ComBitSize=8, ComSignalType=UINT8, ComHandleId=11021, ComSystemTemplateSystemSignalRef=OBJ_VELOCITY_LAT_ERR_051
          OBJ_ACCELERATION_LAT_051_oRDR_TRACKER_OBJ_051_oPCAN_RADAR_683d0fed_Tx: ComBitPosition=177, ComBitSize=10, ComSignalType=UINT16, ComHandleId=10979, ComSystemTemplateSystemSignalRef=OBJ_ACCELERATION_LAT_051
          OBJ_CLS_TYPE2_051_oRDR_TRACKER_OBJ_051_oPCAN_RADAR_a09ffcf0_Tx: ComBitPosition=267, ComBitSize=4, ComSignalType=UINT8, ComHandleId=10987, ComSystemTemplateSystemSignalRef=OBJ_CLS_TYPE2_051
          OBJ_CLS_TYPE6_051_oRDR_TRACKER_OBJ_051_oPCAN_RADAR_fb2f01bb_Tx: ComBitPosition=282, ComBitSize=4, ComSignalType=UINT8, ComHandleId=10995, ComSystemTemplateSystemSignalRef=OBJ_CLS_TYPE6_051
          OBJ_GROUP_ID_051_oRDR_TRACKER_OBJ_051_oPCAN_RADAR_0ee9c8ee_Tx: ComBitPosition=405, ComBitSize=6, ComSignalType=UINT8, ComHandleId=11002, ComSystemTemplateSystemSignalRef=OBJ_GROUP_ID_051
          OBJ_POS_LAT_051_oRDR_TRACKER_OBJ_051_oPCAN_RADAR_df6b396e_Tx: ComBitPosition=79, ComBitSize=16, ComSignalType=UINT16, ComHandleId=11009, ComSystemTemplateSystemSignalRef=OBJ_POS_LAT_051
          OBJ_VELOCITY_LONG_ERR_051_oRDR_TRACKER_OBJ_051_oPCAN_RADAR_437033d8_Tx: ComBitPosition=143, ComBitSize=8, ComSignalType=UINT8, ComHandleId=11023, ComSystemTemplateSystemSignalRef=OBJ_VELOCITY_LONG_ERR_051
          OBJ_DIMENSION_LENGTH_ERR_051_oRDR_TRACKER_OBJ_051_oPCAN_RADAR_9411b0a9_Tx: ComBitPosition=41, ComBitSize=10, ComSignalType=UINT16, ComHandleId=10998, ComSystemTemplateSystemSignalRef=OBJ_DIMENSION_LENGTH_ERR_051
          OBJ_ACCELERATION_LONG_051_oRDR_TRACKER_OBJ_051_oPCAN_RADAR_1acd560d_Tx: ComBitPosition=193, ComBitSize=10, ComSignalType=UINT16, ComHandleId=10981, ComSystemTemplateSystemSignalRef=OBJ_ACCELERATION_LONG_051
          OBJ_YAW_RATE_ERR_051_oRDR_TRACKER_OBJ_051_oPCAN_RADAR_6de38a92_Tx: ComBitPosition=388, ComBitSize=5, ComSignalType=UINT8, ComHandleId=11027, ComSystemTemplateSystemSignalRef=OBJ_YAW_RATE_ERR_051
          OBJ_DIMENSION_WIDTH_051_oRDR_TRACKER_OBJ_051_oPCAN_RADAR_8c27587e_Tx: ComBitPosition=17, ComBitSize=10, ComSignalType=UINT16, ComHandleId=10999, ComSystemTemplateSystemSignalRef=OBJ_DIMENSION_WIDTH_051
          OBJ_VELOCITY_LONG_051_oRDR_TRACKER_OBJ_051_oPCAN_RADAR_cb85048f_Tx: ComBitPosition=110, ComBitSize=15, ComSignalType=UINT16, ComHandleId=11022, ComSystemTemplateSystemSignalRef=OBJ_VELOCITY_LONG_051
          OBJ_ACCELERATION_LAT_ERR_051_oRDR_TRACKER_OBJ_051_oPCAN_RADAR_bdc93553_Tx: ComBitPosition=223, ComBitSize=8, ComSignalType=UINT8, ComHandleId=10980, ComSystemTemplateSystemSignalRef=OBJ_ACCELERATION_LAT_ERR_051
          OBJ_CLS_TYPE2_PROB_051_oRDR_TRACKER_OBJ_051_oPCAN_RADAR_8c1b3069_Tx: ComBitPosition=311, ComBitSize=8, ComSignalType=UINT8, ComHandleId=10988, ComSystemTemplateSystemSignalRef=OBJ_CLS_TYPE2_PROB_051
          OBJ_ID_051_oRDR_TRACKER_OBJ_051_oPCAN_RADAR_fdc7e3e9_Tx: ComBitPosition=7, ComBitSize=8, ComSignalType=UINT8, ComHandleId=11003, ComSystemTemplateSystemSignalRef=OBJ_ID_051
          OBJ_RCS_051_oRDR_TRACKER_OBJ_051_oPCAN_RADAR_fda46f69_Tx: ComBitPosition=351, ComBitSize=7, ComSignalType=UINT8, ComHandleId=11013, ComSystemTemplateSystemSignalRef=OBJ_RCS_051
          OBJ_POS_LAT_ERR_051_oRDR_TRACKER_OBJ_051_oPCAN_RADAR_db276959_Tx: ComBitPosition=103, ComBitSize=8, ComSignalType=UINT8, ComHandleId=11010, ComSystemTemplateSystemSignalRef=OBJ_POS_LAT_ERR_051
          OBJ_MEASUREMENT_STATUS_051_oRDR_TRACKER_OBJ_051_oPCAN_RADAR_82159154_Tx: ComBitPosition=14, ComBitSize=3, ComSignalType=UINT8, ComHandleId=11004, ComSystemTemplateSystemSignalRef=OBJ_MEASUREMENT_STATUS_051
          OBJ_YAW_ANGLE_051_oRDR_TRACKER_OBJ_051_oPCAN_RADAR_77b43809_Tx: ComBitPosition=155, ComBitSize=12, ComSignalType=UINT16, ComHandleId=11024, ComSystemTemplateSystemSignalRef=OBJ_YAW_ANGLE_051
          OBJ_CLS_TYPE5_PROB_051_oRDR_TRACKER_OBJ_051_oPCAN_RADAR_8211f6c9_Tx: ComBitPosition=335, ComBitSize=8, ComSignalType=UINT8, ComHandleId=10994, ComSystemTemplateSystemSignalRef=OBJ_CLS_TYPE5_PROB_051
          OBJ_REF_PT_LONG_OFFSET_051_oRDR_TRACKER_OBJ_051_oPCAN_RADAR_47cbf41f_Tx: ComBitPosition=357, ComBitSize=14, ComSignalType=UINT16, ComHandleId=11015, ComSystemTemplateSystemSignalRef=OBJ_REF_PT_LONG_OFFSET_051
          OBJ_ALIVE_TIME_051_oRDR_TRACKER_OBJ_051_oPCAN_RADAR_7aac1db1_Tx: ComBitPosition=255, ComBitSize=16, ComSignalType=UINT16, ComHandleId=10984, ComSystemTemplateSystemSignalRef=OBJ_ALIVE_TIME_051
          OBJ_CLS_TYPE1_051_oRDR_TRACKER_OBJ_051_oPCAN_RADAR_ed77fc97_Tx: ComBitPosition=271, ComBitSize=4, ComSignalType=UINT8, ComHandleId=10985, ComSystemTemplateSystemSignalRef=OBJ_CLS_TYPE1_051
          OBJ_VEH_TRACK_FLAG_051_oRDR_TRACKER_OBJ_051_oPCAN_RADAR_b32198bf_Tx: ComBitPosition=10, ComBitSize=1, ComSignalType=BOOLEAN, ComHandleId=11018, ComSystemTemplateSystemSignalRef=OBJ_VEH_TRACK_FLAG_051
          OBJ_VELOCITY_ERR_CRR_COEF_051_oRDR_TRACKER_OBJ_051_oPCAN_RADAR_94bef9c3_Tx: ComBitPosition=423, ComBitSize=8, ComSignalType=UINT8, ComHandleId=11019, ComSystemTemplateSystemSignalRef=OBJ_VELOCITY_ERR_CRR_COEF_051
          OBJ_YAW_ANGLE_ERR_051_oRDR_TRACKER_OBJ_051_oPCAN_RADAR_a2b93ede_Tx: ComBitPosition=175, ComBitSize=7, ComSignalType=UINT8, ComHandleId=11025, ComSystemTemplateSystemSignalRef=OBJ_YAW_ANGLE_ERR_051
          OBJ_YAW_RATE_051_oRDR_TRACKER_OBJ_051_oPCAN_RADAR_523b1d4e_Tx: ComBitPosition=399, ComBitSize=10, ComSignalType=UINT16, ComHandleId=11026, ComSystemTemplateSystemSignalRef=OBJ_YAW_RATE_051
          OBJ_POS_ERR_CRR_COEF_051_oRDR_TRACKER_OBJ_051_oPCAN_RADAR_3dc4c422_Tx: ComBitPosition=415, ComBitSize=8, ComSignalType=UINT8, ComHandleId=11008, ComSystemTemplateSystemSignalRef=OBJ_POS_ERR_CRR_COEF_051
          OBJ_CLS_TYPE4_PROB_051_oRDR_TRACKER_OBJ_051_oPCAN_RADAR_c5020032_Tx: ComBitPosition=327, ComBitSize=8, ComSignalType=UINT8, ComHandleId=10992, ComSystemTemplateSystemSignalRef=OBJ_CLS_TYPE4_PROB_051
          OBJ_DIMENSION_LENGTH_051_oRDR_TRACKER_OBJ_051_oPCAN_RADAR_afe9afd3_Tx: ComBitPosition=37, ComBitSize=12, ComSignalType=UINT16, ComHandleId=10997, ComSystemTemplateSystemSignalRef=OBJ_DIMENSION_LENGTH_051
          OBJ_EXISTENCE_PROB_051_oRDR_TRACKER_OBJ_051_oPCAN_RADAR_879bdc43_Tx: ComBitPosition=229, ComBitSize=14, ComSignalType=UINT16, ComHandleId=11001, ComSystemTemplateSystemSignalRef=OBJ_EXISTENCE_PROB_051
          OBJ_ACCEL_ERR_CRR_COEF_051_oRDR_TRACKER_OBJ_051_oPCAN_RADAR_02cfb19f_Tx: ComBitPosition=431, ComBitSize=8, ComSignalType=UINT8, ComHandleId=10983, ComSystemTemplateSystemSignalRef=OBJ_ACCEL_ERR_CRR_COEF_051
          OBJ_TIMESTAMP_OFFSET_051_oRDR_TRACKER_OBJ_051_oPCAN_RADAR_fd086f3f_Tx: ComBitPosition=247, ComBitSize=8, ComSignalType=UINT8, ComHandleId=11016, ComSystemTemplateSystemSignalRef=OBJ_TIMESTAMP_OFFSET_051
          OBJ_TRACK_MOTION_MODEL_051_oRDR_TRACKER_OBJ_051_oPCAN_RADAR_310b6ee2_Tx: ComBitPosition=9, ComBitSize=2, ComSignalType=UINT8, ComHandleId=11017, ComSystemTemplateSystemSignalRef=OBJ_TRACK_MOTION_MODEL_051
          OBJ_CLS_TYPE3_051_oRDR_TRACKER_OBJ_051_oPCAN_RADAR_2d170112_Tx: ComBitPosition=279, ComBitSize=4, ComSignalType=UINT8, ComHandleId=10989, ComSystemTemplateSystemSignalRef=OBJ_CLS_TYPE3_051
          OBJ_POS_LONG_051_oRDR_TRACKER_OBJ_051_oPCAN_RADAR_6ecbd2a1_Tx: ComBitPosition=63, ComBitSize=16, ComSignalType=UINT16, ComHandleId=11011, ComSystemTemplateSystemSignalRef=OBJ_POS_LONG_051
          OBJ_DIMENSION_WIDTH_ERR_051_oRDR_TRACKER_OBJ_051_oPCAN_RADAR_6c859f96_Tx: ComBitPosition=23, ComBitSize=6, ComSignalType=UINT8, ComHandleId=11000, ComSystemTemplateSystemSignalRef=OBJ_DIMENSION_WIDTH_ERR_051
          OBJ_CLS_TYPE5_051_oRDR_TRACKER_OBJ_051_oPCAN_RADAR_b6c701dc_Tx: ComBitPosition=287, ComBitSize=4, ComSignalType=UINT8, ComHandleId=10993, ComSystemTemplateSystemSignalRef=OBJ_CLS_TYPE5_051
          OBJ_REF_PT_LAT_OFFSET_051_oRDR_TRACKER_OBJ_051_oPCAN_RADAR_0899041c_Tx: ComBitPosition=370, ComBitSize=14, ComSignalType=UINT16, ComHandleId=11014, ComSystemTemplateSystemSignalRef=OBJ_REF_PT_LAT_OFFSET_051
          OBJ_MH_CYCLE_COUNTER_051_oRDR_TRACKER_OBJ_051_oPCAN_RADAR_8f917c89_Tx: ComBitPosition=487, ComBitSize=8, ComSignalType=UINT8, ComHandleId=11006, ComSystemTemplateSystemSignalRef=OBJ_MH_CYCLE_COUNTER_051
          OBJ_MH_CRC16_051_oRDR_TRACKER_OBJ_051_oPCAN_RADAR_fe752668_Tx: ComBitPosition=495, ComBitSize=16, ComSignalType=UINT16, ComHandleId=11005, ComSystemTemplateSystemSignalRef=OBJ_MH_CRC16_051
      11 x ComIPdu, all with ComIPduDirection=SEND, ComIPduType=NORMAL, ComIPduCancellationSupport=false, ComIPduSignalProcessing=DEFERRED, ComIPduChannelRef=CN_PCAN_RADAR_458ff0f1, ComIPduGroupRef=RDR01_oPCAN_RADAR_Tx_b6bdb067 if post-build-variant-condition{matching-criterion=RDR_POS, value=0}, ComIPduMainFunctionRef=ComMainFunctionTx_Event, ComIPduGroupRef=RDR02_oPCAN_RADAR_Tx_9f750495 if post-build-variant-condition{matching-criterion=RDR_POS, value=1}, ComIPduGroupRef=RDR03_oPCAN_RADAR_Tx_311d9504 if post-build-variant-condition{matching-criterion=RDR_POS, value=2}, ComIPduGroupRef=RDR04_oPCAN_RADAR_Tx_cce46d71 if post-build-variant-condition{matching-criterion=RDR_POS, value=3}, ComIPduGroupRef=RDR05_oPCAN_RADAR_Tx_628cfce0 if post-build-variant-condition{matching-criterion=RDR_POS, value=4}, ComIPduGroupRef=RDR06_oPCAN_RADAR_Tx_4b444812 if post-build-variant-condition{matching-criterion=RDR_POS, value=5}, ComIPduGroupRef=RDR07_oPCAN_RADAR_Tx_e52cd983 if post-build-variant-condition{matching-criterion=RDR_POS, value=6}, ComIPduGroupRef=RDR08_oPCAN_RADAR_Tx_6bc6beb9 if post-build-variant-condition{matching-criterion=RDR_POS, value=7}:
        RDR_DETECTION_145_148_oPCAN_RADAR_25ed9dd9_Tx: ComIPduHandleId=42, ComIPduSignalGroupRef=SG_Detections_145_148_oRDR_DETECTION_145_148_oPCAN_RADAR_86c8c3ef_Tx, ComPduIdRef=RDR_DETECTION_145_148_oPCAN_RADAR_25ed9dd9_Tx
          ComTxIPdu: ComMinimumDelayTime=0, ComTxIPduUnusedAreasDefault=0
            ComTxModeTrue
              ComTxMode: ComTxModeMode=DIRECT, ComTxModeNumberOfRepetitions=0
            ComTxModeFalse
              ComTxMode: ComTxModeMode=NONE
        RDR_TRACKER_OBJ_048_oPCAN_RADAR_b0be7ea5_Tx: ComIPduHandleId=158, ComIPduSignalGroupRef=SG_TrackerObject048_oRDR_TRACKER_OBJ_048_oPCAN_RADAR_68fc760b_Tx, ComPduIdRef=RDR_TRACKER_OBJ_048_oPCAN_RADAR_b0be7ea5_Tx
          ComTxIPdu: ComMinimumDelayTime=0, ComTxIPduUnusedAreasDefault=0
            ComTxModeTrue
              ComTxMode: ComTxModeMode=DIRECT, ComTxModeNumberOfRepetitions=0
            ComTxModeFalse
              ComTxMode: ComTxModeMode=NONE
        RDR_DETECTION_065_068_oPCAN_RADAR_af4e6947_Tx: ComIPduHandleId=22, ComIPduSignalGroupRef=SG_Detections_065_068_oRDR_DETECTION_065_068_oPCAN_RADAR_f1154101_Tx, ComPduIdRef=RDR_DETECTION_065_068_oPCAN_RADAR_af4e6947_Tx
          ComTxIPdu: ComMinimumDelayTime=0, ComTxIPduUnusedAreasDefault=0
            ComTxModeTrue
              ComTxMode: ComTxModeMode=DIRECT, ComTxModeNumberOfRepetitions=0
            ComTxModeFalse
              ComTxMode: ComTxModeMode=NONE
        RDR_DETECTION_241_244_oPCAN_RADAR_7e74ef3d_Tx: ComIPduHandleId=66, ComIPduSignalGroupRef=SG_Detections_241_244_oRDR_DETECTION_241_244_oPCAN_RADAR_30f39079_Tx, ComPduIdRef=RDR_DETECTION_241_244_oPCAN_RADAR_7e74ef3d_Tx
          ComTxIPdu: ComMinimumDelayTime=0, ComTxIPduUnusedAreasDefault=0
            ComTxModeTrue
              ComTxMode: ComTxModeMode=DIRECT, ComTxModeNumberOfRepetitions=0
            ComTxModeFalse
              ComTxMode: ComTxModeMode=NONE
        RDR_DETECTION_189_192_oPCAN_RADAR_21a99aff_Tx: ComIPduHandleId=53, ComIPduSignalGroupRef=SG_Detections_189_192_oRDR_DETECTION_189_192_oPCAN_RADAR_a08f2678_Tx, ComPduIdRef=RDR_DETECTION_189_192_oPCAN_RADAR_21a99aff_Tx
          ComTxIPdu: ComMinimumDelayTime=0, ComTxIPduUnusedAreasDefault=0
            ComTxModeTrue
              ComTxMode: ComTxModeMode=DIRECT, ComTxModeNumberOfRepetitions=0
            ComTxModeFalse
              ComTxMode: ComTxModeMode=NONE
        RDR_DETECTION_265_268_oPCAN_RADAR_737cde27_Tx: ComIPduHandleId=72, ComIPduSignalGroupRef=SG_Detections_265_268_oRDR_DETECTION_265_268_oPCAN_RADAR_74450479_Tx, ComPduIdRef=RDR_DETECTION_265_268_oPCAN_RADAR_737cde27_Tx
          ComTxIPdu: ComMinimumDelayTime=0, ComTxIPduUnusedAreasDefault=0
            ComTxModeTrue
              ComTxMode: ComTxModeMode=DIRECT, ComTxModeNumberOfRepetitions=0
            ComTxModeFalse
              ComTxMode: ComTxModeMode=NONE
        RDR_TRACKER_OBJ_064_oPCAN_RADAR_cb6a03f3_Tx: ComIPduHandleId=174, ComIPduSignalGroupRef=SG_TrackerObject064_oRDR_TRACKER_OBJ_064_oPCAN_RADAR_3a0fe9a5_Tx, ComPduIdRef=RDR_TRACKER_OBJ_064_oPCAN_RADAR_cb6a03f3_Tx
          ComTxIPdu: ComMinimumDelayTime=0, ComTxIPduUnusedAreasDefault=0
            ComTxModeTrue
              ComTxMode: ComTxModeMode=DIRECT, ComTxModeNumberOfRepetitions=0
            ComTxModeFalse
              ComTxMode: ComTxModeMode=NONE
        RDR_DETECTION_173_176_oPCAN_RADAR_eed8ded8_Tx: ComIPduHandleId=49, ComIPduSignalGroupRef=SG_Detections_173_176_oRDR_DETECTION_173_176_oPCAN_RADAR_18cc2fee_Tx, ComPduIdRef=RDR_DETECTION_173_176_oPCAN_RADAR_eed8ded8_Tx
          ComTxIPdu: ComMinimumDelayTime=0, ComTxIPduUnusedAreasDefault=0
            ComTxModeTrue
              ComTxMode: ComTxModeMode=DIRECT, ComTxModeNumberOfRepetitions=0
            ComTxModeFalse
              ComTxMode: ComTxModeMode=NONE
        RDR_HEADER_001_oPCAN_RADAR_0cd81ee7_Tx: ComIPduHandleId=106, ComIPduSignalGroupRef=SG_RadarHeader_oRDR_HEADER_001_oPCAN_RADAR_48334d97_Tx, ComPduIdRef=RDR_HEADER_001_oPCAN_RADAR_0cd81ee7_Tx
          ComTxIPdu: ComMinimumDelayTime=0, ComTxIPduUnusedAreasDefault=0
            ComTxModeTrue
              ComTxMode: ComTxModeMode=DIRECT, ComTxModeNumberOfRepetitions=0
            ComTxModeFalse
              ComTxMode: ComTxModeMode=NONE
        RDR_TRACKER_OBJ_036_oPCAN_RADAR_2f95d8d5_Tx: ComIPduHandleId=146, ComIPduSignalGroupRef=SG_TrackerObject036_oRDR_TRACKER_OBJ_036_oPCAN_RADAR_d0f0d485_Tx, ComPduIdRef=RDR_TRACKER_OBJ_036_oPCAN_RADAR_2f95d8d5_Tx
          ComTxIPdu: ComMinimumDelayTime=0, ComTxIPduUnusedAreasDefault=0
            ComTxModeTrue
              ComTxMode: ComTxModeMode=DIRECT, ComTxModeNumberOfRepetitions=0
            ComTxModeFalse
              ComTxMode: ComTxModeMode=NONE
        RDR_DETECTION_229_232_oPCAN_RADAR_5330693b_Tx: ComIPduHandleId=63, ComIPduSignalGroupRef=SG_Detections_229_232_oRDR_DETECTION_229_232_oPCAN_RADAR_87d460a6_Tx, ComPduIdRef=RDR_DETECTION_229_232_oPCAN_RADAR_5330693b_Tx
          ComTxIPdu: ComMinimumDelayTime=0, ComTxIPduUnusedAreasDefault=0
            ComTxModeTrue
              ComTxMode: ComTxModeMode=DIRECT, ComTxModeNumberOfRepetitions=0
            ComTxModeFalse
              ComTxMode: ComTxModeMode=NONE
      SG_TrackerObject041_oRDR_TRACKER_OBJ_041_oPCAN_RADAR_3488a224_Tx (ComSignalGroup):
        ComTransferProperty = TRIGGERED
        ComSignalGroupAccess = ACCESS_NEEDED_BY_SWC_OR_COM
        ComHandleId = 150
        ComSignalGroupArrayAccess = true
        ComSystemTemplateSignalGroupRef = SG_TrackerObject041
        49 x ComGroupSignal, all with ComSignalEndianness=BIG_ENDIAN, ComSignalInitValue=0, ComTransferProperty=PENDING, ComSignalAccess=ACCESS_NEEDED_BY_SWC_OR_COM:
          OBJ_ACCEL_ERR_CRR_COEF_041_oRDR_TRACKER_OBJ_041_oPCAN_RADAR_505e4721_Tx: ComBitPosition=431, ComBitSize=8, ComSignalType=UINT8, ComHandleId=10493, ComSystemTemplateSystemSignalRef=OBJ_ACCEL_ERR_CRR_COEF_041
          OBJ_TRACK_MOTION_MODEL_041_oRDR_TRACKER_OBJ_041_oPCAN_RADAR_639a985c_Tx: ComBitPosition=9, ComBitSize=2, ComSignalType=UINT8, ComHandleId=10527, ComSystemTemplateSystemSignalRef=OBJ_TRACK_MOTION_MODEL_041
          OBJ_CLS_TYPE1_PROB_041_oRDR_TRACKER_OBJ_041_oPCAN_RADAR_17beddda_Tx: ComBitPosition=303, ComBitSize=8, ComSignalType=UINT8, ComHandleId=10496, ComSystemTemplateSystemSignalRef=OBJ_CLS_TYPE1_PROB_041
          OBJ_DIMENSION_WIDTH_041_oRDR_TRACKER_OBJ_041_oPCAN_RADAR_deb6aec0_Tx: ComBitPosition=17, ComBitSize=10, ComSignalType=UINT16, ComHandleId=10509, ComSystemTemplateSystemSignalRef=OBJ_DIMENSION_WIDTH_041
          OBJ_CLS_TYPE4_PROB_041_oRDR_TRACKER_OBJ_041_oPCAN_RADAR_9793f68c_Tx: ComBitPosition=327, ComBitSize=8, ComSignalType=UINT8, ComHandleId=10502, ComSystemTemplateSystemSignalRef=OBJ_CLS_TYPE4_PROB_041
          OBJ_GROUP_ID_041_oRDR_TRACKER_OBJ_041_oPCAN_RADAR_5c783e50_Tx: ComBitPosition=405, ComBitSize=6, ComSignalType=UINT8, ComHandleId=10512, ComSystemTemplateSystemSignalRef=OBJ_GROUP_ID_041
          OBJ_POS_LONG_ERR_041_oRDR_TRACKER_OBJ_041_oPCAN_RADAR_104e6105_Tx: ComBitPosition=95, ComBitSize=8, ComSignalType=UINT8, ComHandleId=10522, ComSystemTemplateSystemSignalRef=OBJ_POS_LONG_ERR_041
          OBJ_RCS_041_oRDR_TRACKER_OBJ_041_oPCAN_RADAR_af3599d7_Tx: ComBitPosition=351, ComBitSize=7, ComSignalType=UINT8, ComHandleId=10523, ComSystemTemplateSystemSignalRef=OBJ_RCS_041
          OBJ_YAW_ANGLE_ERR_041_oRDR_TRACKER_OBJ_041_oPCAN_RADAR_f028c860_Tx: ComBitPosition=175, ComBitSize=7, ComSignalType=UINT8, ComHandleId=10535, ComSystemTemplateSystemSignalRef=OBJ_YAW_ANGLE_ERR_041
          OBJ_CLS_TYPE5_041_oRDR_TRACKER_OBJ_041_oPCAN_RADAR_e456f762_Tx: ComBitPosition=287, ComBitSize=4, ComSignalType=UINT8, ComHandleId=10503, ComSystemTemplateSystemSignalRef=OBJ_CLS_TYPE5_041
          OBJ_VELOCITY_LAT_041_oRDR_TRACKER_OBJ_041_oPCAN_RADAR_c9998af7_Tx: ComBitPosition=126, ComBitSize=15, ComSignalType=UINT16, ComHandleId=10530, ComSystemTemplateSystemSignalRef=OBJ_VELOCITY_LAT_041
          OBJ_ACCELERATION_LAT_041_oRDR_TRACKER_OBJ_041_oPCAN_RADAR_3aacf953_Tx: ComBitPosition=177, ComBitSize=10, ComSignalType=UINT16, ComHandleId=10489, ComSystemTemplateSystemSignalRef=OBJ_ACCELERATION_LAT_041
          OBJ_CLS_TYPE3_PROB_041_oRDR_TRACKER_OBJ_041_oPCAN_RADAR_9999302c_Tx: ComBitPosition=319, ComBitSize=8, ComSignalType=UINT8, ComHandleId=10500, ComSystemTemplateSystemSignalRef=OBJ_CLS_TYPE3_PROB_041
          OBJ_YAW_RATE_041_oRDR_TRACKER_OBJ_041_oPCAN_RADAR_00aaebf0_Tx: ComBitPosition=399, ComBitSize=10, ComSignalType=UINT16, ComHandleId=10536, ComSystemTemplateSystemSignalRef=OBJ_YAW_RATE_041
          OBJ_CLS_TYPE1_041_oRDR_TRACKER_OBJ_041_oPCAN_RADAR_bfe60a29_Tx: ComBitPosition=271, ComBitSize=4, ComSignalType=UINT8, ComHandleId=10495, ComSystemTemplateSystemSignalRef=OBJ_CLS_TYPE1_041
          OBJ_VELOCITY_LAT_ERR_041_oRDR_TRACKER_OBJ_041_oPCAN_RADAR_fd63faa6_Tx: ComBitPosition=151, ComBitSize=8, ComSignalType=UINT8, ComHandleId=10531, ComSystemTemplateSystemSignalRef=OBJ_VELOCITY_LAT_ERR_041
          OBJ_YAW_RATE_ERR_041_oRDR_TRACKER_OBJ_041_oPCAN_RADAR_3f727c2c_Tx: ComBitPosition=388, ComBitSize=5, ComSignalType=UINT8, ComHandleId=10537, ComSystemTemplateSystemSignalRef=OBJ_YAW_RATE_ERR_041
          OBJ_TIMESTAMP_OFFSET_041_oRDR_TRACKER_OBJ_041_oPCAN_RADAR_af999981_Tx: ComBitPosition=247, ComBitSize=8, ComSignalType=UINT8, ComHandleId=10526, ComSystemTemplateSystemSignalRef=OBJ_TIMESTAMP_OFFSET_041
          OBJ_DIMENSION_WIDTH_ERR_041_oRDR_TRACKER_OBJ_041_oPCAN_RADAR_3e146928_Tx: ComBitPosition=23, ComBitSize=6, ComSignalType=UINT8, ComHandleId=10510, ComSystemTemplateSystemSignalRef=OBJ_DIMENSION_WIDTH_ERR_041
          OBJ_VEH_TRACK_FLAG_041_oRDR_TRACKER_OBJ_041_oPCAN_RADAR_e1b06e01_Tx: ComBitPosition=10, ComBitSize=1, ComSignalType=BOOLEAN, ComHandleId=10528, ComSystemTemplateSystemSignalRef=OBJ_VEH_TRACK_FLAG_041
          OBJ_ACCELERATION_LONG_041_oRDR_TRACKER_OBJ_041_oPCAN_RADAR_485ca0b3_Tx: ComBitPosition=193, ComBitSize=10, ComSignalType=UINT16, ComHandleId=10491, ComSystemTemplateSystemSignalRef=OBJ_ACCELERATION_LONG_041
          OBJ_EXISTENCE_PROB_041_oRDR_TRACKER_OBJ_041_oPCAN_RADAR_d50a2afd_Tx: ComBitPosition=229, ComBitSize=14, ComSignalType=UINT16, ComHandleId=10511, ComSystemTemplateSystemSignalRef=OBJ_EXISTENCE_PROB_041
          OBJ_CLS_TYPE2_PROB_041_oRDR_TRACKER_OBJ_041_oPCAN_RADAR_de8ac6d7_Tx: ComBitPosition=311, ComBitSize=8, ComSignalType=UINT8, ComHandleId=10498, ComSystemTemplateSystemSignalRef=OBJ_CLS_TYPE2_PROB_041
          OBJ_POS_LAT_041_oRDR_TRACKER_OBJ_041_oPCAN_RADAR_8dfacfd0_Tx: ComBitPosition=79, ComBitSize=16, ComSignalType=UINT16, ComHandleId=10519, ComSystemTemplateSystemSignalRef=OBJ_POS_LAT_041
          OBJ_MOVEMENT_STATUS_041_oRDR_TRACKER_OBJ_041_oPCAN_RADAR_ff2af2a6_Tx: ComBitPosition=196, ComBitSize=3, ComSignalType=UINT8, ComHandleId=10517, ComSystemTemplateSystemSignalRef=OBJ_MOVEMENT_STATUS_041
          OBJ_ID_041_oRDR_TRACKER_OBJ_041_oPCAN_RADAR_af561557_Tx: ComBitPosition=7, ComBitSize=8, ComSignalType=UINT8, ComHandleId=10513, ComSystemTemplateSystemSignalRef=OBJ_ID_041
          OBJ_CLS_TYPE3_041_oRDR_TRACKER_OBJ_041_oPCAN_RADAR_7f86f7ac_Tx: ComBitPosition=279, ComBitSize=4, ComSignalType=UINT8, ComHandleId=10499, ComSystemTemplateSystemSignalRef=OBJ_CLS_TYPE3_041
          OBJ_CLS_TYPE6_PROB_041_oRDR_TRACKER_OBJ_041_oPCAN_RADAR_19b41b7a_Tx: ComBitPosition=343, ComBitSize=8, ComSignalType=UINT8, ComHandleId=10506, ComSystemTemplateSystemSignalRef=OBJ_CLS_TYPE6_PROB_041
          OBJ_DIMENSION_LENGTH_ERR_041_oRDR_TRACKER_OBJ_041_oPCAN_RADAR_c6804617_Tx: ComBitPosition=41, ComBitSize=10, ComSignalType=UINT16, ComHandleId=10508, ComSystemTemplateSystemSignalRef=OBJ_DIMENSION_LENGTH_ERR_041
          OBJ_YAW_ANGLE_041_oRDR_TRACKER_OBJ_041_oPCAN_RADAR_2525ceb7_Tx: ComBitPosition=155, ComBitSize=12, ComSignalType=UINT16, ComHandleId=10534, ComSystemTemplateSystemSignalRef=OBJ_YAW_ANGLE_041
          OBJ_VELOCITY_ERR_CRR_COEF_041_oRDR_TRACKER_OBJ_041_oPCAN_RADAR_c62f0f7d_Tx: ComBitPosition=423, ComBitSize=8, ComSignalType=UINT8, ComHandleId=10529, ComSystemTemplateSystemSignalRef=OBJ_VELOCITY_ERR_CRR_COEF_041
          OBJ_CLS_TYPE4_041_oRDR_TRACKER_OBJ_041_oPCAN_RADAR_69de0a80_Tx: ComBitPosition=275, ComBitSize=4, ComSignalType=UINT8, ComHandleId=10501, ComSystemTemplateSystemSignalRef=OBJ_CLS_TYPE4_041
          OBJ_ACCELERATION_LONG_ERR_041_oRDR_TRACKER_OBJ_041_oPCAN_RADAR_f0fd6647_Tx: ComBitPosition=215, ComBitSize=8, ComSignalType=UINT8, ComHandleId=10492, ComSystemTemplateSystemSignalRef=OBJ_ACCELERATION_LONG_ERR_041
          OBJ_POS_ERR_CRR_COEF_041_oRDR_TRACKER_OBJ_041_oPCAN_RADAR_6f55329c_Tx: ComBitPosition=415, ComBitSize=8, ComSignalType=UINT8, ComHandleId=10518, ComSystemTemplateSystemSignalRef=OBJ_POS_ERR_CRR_COEF_041
          OBJ_VELOCITY_LONG_041_oRDR_TRACKER_OBJ_041_oPCAN_RADAR_9914f231_Tx: ComBitPosition=110, ComBitSize=15, ComSignalType=UINT16, ComHandleId=10532, ComSystemTemplateSystemSignalRef=OBJ_VELOCITY_LONG_041
          OBJ_CLS_TYPE6_041_oRDR_TRACKER_OBJ_041_oPCAN_RADAR_a9bef705_Tx: ComBitPosition=282, ComBitSize=4, ComSignalType=UINT8, ComHandleId=10505, ComSystemTemplateSystemSignalRef=OBJ_CLS_TYPE6_041
          OBJ_CLS_TYPE5_PROB_041_oRDR_TRACKER_OBJ_041_oPCAN_RADAR_d0800077_Tx: ComBitPosition=335, ComBitSize=8, ComSignalType=UINT8, ComHandleId=10504, ComSystemTemplateSystemSignalRef=OBJ_CLS_TYPE5_PROB_041
          OBJ_REF_PT_LONG_OFFSET_041_oRDR_TRACKER_OBJ_041_oPCAN_RADAR_155a02a1_Tx: ComBitPosition=357, ComBitSize=14, ComSignalType=UINT16, ComHandleId=10525, ComSystemTemplateSystemSignalRef=OBJ_REF_PT_LONG_OFFSET_041
          OBJ_VELOCITY_LONG_ERR_041_oRDR_TRACKER_OBJ_041_oPCAN_RADAR_11e1c566_Tx: ComBitPosition=143, ComBitSize=8, ComSignalType=UINT8, ComHandleId=10533, ComSystemTemplateSystemSignalRef=OBJ_VELOCITY_LONG_ERR_041
          OBJ_ALIVE_TIME_041_oRDR_TRACKER_OBJ_041_oPCAN_RADAR_283deb0f_Tx: ComBitPosition=255, ComBitSize=16, ComSignalType=UINT16, ComHandleId=10494, ComSystemTemplateSystemSignalRef=OBJ_ALIVE_TIME_041
          OBJ_DIMENSION_LENGTH_041_oRDR_TRACKER_OBJ_041_oPCAN_RADAR_fd78596d_Tx: ComBitPosition=37, ComBitSize=12, ComSignalType=UINT16, ComHandleId=10507, ComSystemTemplateSystemSignalRef=OBJ_DIMENSION_LENGTH_041
          OBJ_POS_LONG_041_oRDR_TRACKER_OBJ_041_oPCAN_RADAR_3c5a241f_Tx: ComBitPosition=63, ComBitSize=16, ComSignalType=UINT16, ComHandleId=10521, ComSystemTemplateSystemSignalRef=OBJ_POS_LONG_041
          OBJ_CLS_TYPE2_041_oRDR_TRACKER_OBJ_041_oPCAN_RADAR_f20e0a4e_Tx: ComBitPosition=267, ComBitSize=4, ComSignalType=UINT8, ComHandleId=10497, ComSystemTemplateSystemSignalRef=OBJ_CLS_TYPE2_041
          OBJ_MEASUREMENT_STATUS_041_oRDR_TRACKER_OBJ_041_oPCAN_RADAR_d08467ea_Tx: ComBitPosition=14, ComBitSize=3, ComSignalType=UINT8, ComHandleId=10514, ComSystemTemplateSystemSignalRef=OBJ_MEASUREMENT_STATUS_041
          OBJ_POS_LAT_ERR_041_oRDR_TRACKER_OBJ_041_oPCAN_RADAR_89b69fe7_Tx: ComBitPosition=103, ComBitSize=8, ComSignalType=UINT8, ComHandleId=10520, ComSystemTemplateSystemSignalRef=OBJ_POS_LAT_ERR_041
          OBJ_ACCELERATION_LAT_ERR_041_oRDR_TRACKER_OBJ_041_oPCAN_RADAR_ef58c3ed_Tx: ComBitPosition=223, ComBitSize=8, ComSignalType=UINT8, ComHandleId=10490, ComSystemTemplateSystemSignalRef=OBJ_ACCELERATION_LAT_ERR_041
          OBJ_REF_PT_LAT_OFFSET_041_oRDR_TRACKER_OBJ_041_oPCAN_RADAR_5a08f2a2_Tx: ComBitPosition=370, ComBitSize=14, ComSignalType=UINT16, ComHandleId=10524, ComSystemTemplateSystemSignalRef=OBJ_REF_PT_LAT_OFFSET_041
          OBJ_MH_CRC16_041_oRDR_TRACKER_OBJ_041_oPCAN_RADAR_ace4d0d6_Tx: ComBitPosition=495, ComBitSize=16, ComSignalType=UINT16, ComHandleId=10515, ComSystemTemplateSystemSignalRef=OBJ_MH_CRC16_041
          OBJ_MH_CYCLE_COUNTER_041_oRDR_TRACKER_OBJ_041_oPCAN_RADAR_dd008a37_Tx: ComBitPosition=487, ComBitSize=8, ComSignalType=UINT8, ComHandleId=10516, ComSystemTemplateSystemSignalRef=OBJ_MH_CYCLE_COUNTER_041
      4 x ComIPdu, all with ComIPduDirection=SEND, ComIPduType=NORMAL, ComIPduCancellationSupport=false, ComIPduSignalProcessing=DEFERRED, ComIPduChannelRef=CN_PCAN_RADAR_458ff0f1, ComIPduGroupRef=RDR01_oPCAN_RADAR_Tx_b6bdb067 if post-build-variant-condition{matching-criterion=RDR_POS, value=0}, ComIPduMainFunctionRef=ComMainFunctionTx_Event, ComIPduGroupRef=RDR02_oPCAN_RADAR_Tx_9f750495 if post-build-variant-condition{matching-criterion=RDR_POS, value=1}, ComIPduGroupRef=RDR03_oPCAN_RADAR_Tx_311d9504 if post-build-variant-condition{matching-criterion=RDR_POS, value=2}, ComIPduGroupRef=RDR04_oPCAN_RADAR_Tx_cce46d71 if post-build-variant-condition{matching-criterion=RDR_POS, value=3}, ComIPduGroupRef=RDR05_oPCAN_RADAR_Tx_628cfce0 if post-build-variant-condition{matching-criterion=RDR_POS, value=4}, ComIPduGroupRef=RDR06_oPCAN_RADAR_Tx_4b444812 if post-build-variant-condition{matching-criterion=RDR_POS, value=5}, ComIPduGroupRef=RDR07_oPCAN_RADAR_Tx_e52cd983 if post-build-variant-condition{matching-criterion=RDR_POS, value=6}, ComIPduGroupRef=RDR08_oPCAN_RADAR_Tx_6bc6beb9 if post-build-variant-condition{matching-criterion=RDR_POS, value=7}:
        RDR_TRACKER_OBJ_043_oPCAN_RADAR_5777c106_Tx: ComIPduHandleId=153, ComIPduSignalGroupRef=SG_TrackerObject043_oRDR_TRACKER_OBJ_043_oPCAN_RADAR_1dd0b503_Tx, ComPduIdRef=RDR_TRACKER_OBJ_043_oPCAN_RADAR_5777c106_Tx
          ComTxIPdu: ComMinimumDelayTime=0, ComTxIPduUnusedAreasDefault=0
            ComTxModeTrue
              ComTxMode: ComTxModeMode=DIRECT, ComTxModeNumberOfRepetitions=0
            ComTxModeFalse
              ComTxMode: ComTxModeMode=NONE
        RDR_TRACKER_OBJ_027_oPCAN_RADAR_6f0ce026_Tx: ComIPduHandleId=137, ComIPduSignalGroupRef=SG_TrackerObject027_oRDR_TRACKER_OBJ_027_oPCAN_RADAR_7b75aa88_Tx, ComPduIdRef=RDR_TRACKER_OBJ_027_oPCAN_RADAR_6f0ce026_Tx
          ComTxIPdu: ComMinimumDelayTime=0, ComTxIPduUnusedAreasDefault=0
            ComTxModeTrue
              ComTxMode: ComTxModeMode=DIRECT, ComTxModeNumberOfRepetitions=0
            ComTxModeFalse
              ComTxMode: ComTxModeMode=NONE
        RDR_DETECTION_301_304_oPCAN_RADAR_0269ec90_Tx: ComIPduHandleId=81, ComIPduSignalGroupRef=SG_Detections_301_304_oRDR_DETECTION_301_304_oPCAN_RADAR_18b0f261_Tx, ComPduIdRef=RDR_DETECTION_301_304_oPCAN_RADAR_0269ec90_Tx
          ComTxIPdu: ComMinimumDelayTime=0, ComTxIPduUnusedAreasDefault=0
            ComTxModeTrue
              ComTxMode: ComTxModeMode=DIRECT, ComTxModeNumberOfRepetitions=0
            ComTxModeFalse
              ComTxMode: ComTxModeMode=NONE
        RDR_TRACKER_OBJ_056_oPCAN_RADAR_d7579363_Tx: ComIPduHandleId=166, ComIPduSignalGroupRef=SG_TrackerObject056_oRDR_TRACKER_OBJ_056_oPCAN_RADAR_e4e5e540_Tx, ComPduIdRef=RDR_TRACKER_OBJ_056_oPCAN_RADAR_d7579363_Tx
          ComTxIPdu: ComMinimumDelayTime=0, ComTxIPduUnusedAreasDefault=0
            ComTxModeTrue
              ComTxMode: ComTxModeMode=DIRECT, ComTxModeNumberOfRepetitions=0
            ComTxModeFalse
              ComTxMode: ComTxModeMode=NONE
      109 x ComSignalGroup, all with ComSignalGroupAccess=ACCESS_NEEDED_BY_SWC_OR_COM, ComSignalGroupArrayAccess=true:
        SG_Detections_349_352_oRDR_DETECTION_349_352_oPCAN_RADAR_9ae2a2ec_Tx: ComTransferProperty=TRIGGERED, ComHandleId=89, ComSystemTemplateSignalGroupRef=SG_Detections_349_352
          83 x ComGroupSignal, all with ComSignalEndianness=LITTLE_ENDIAN, ComTransferProperty=PENDING, ComSignalAccess=ACCESS_NEEDED_BY_SWC_OR_COM:
            DET_RCS_350_oRDR_DETECTION_349_352_oPCAN_RADAR_6bce1329_Tx: ComBitPosition=240, ComBitSize=8, ComSignalInitValue=128, ComSignalType=UINT8, ComHandleId=7354, ComSystemTemplateSystemSignalRef=DET_RCS_350
            DET_AZIMUTH_ERR_350_oRDR_DETECTION_349_352_oPCAN_RADAR_2dc60018_Tx: ComBitPosition=217, ComBitSize=7, ComSignalInitValue=0, ComSignalType=UINT8, ComHandleId=7287, ComSystemTemplateSystemSignalRef=DET_AZIMUTH_ERR_350
            DET_HVC_FLAG_350_oRDR_DETECTION_349_352_oPCAN_RADAR_ec12e48b_Tx: ComBitPosition=198, ComBitSize=1, ComSignalInitValue=0, ComSignalType=BOOLEAN, ComHandleId=7319, ComSystemTemplateSystemSignalRef=DET_HVC_FLAG_350
            DET_SUPER_RES_TARGET_351_oRDR_DETECTION_349_352_oPCAN_RADAR_1289bbdb_Tx: ComBitPosition=311, ComBitSize=1, ComSignalInitValue=0, ComSignalType=BOOLEAN, ComHandleId=7363, ComSystemTemplateSystemSignalRef=DET_SUPER_RES_TARGET_351
            DET_HVC_FLAG_349_oRDR_DETECTION_349_352_oPCAN_RADAR_8932962f_Tx: ComBitPosition=86, ComBitSize=1, ComSignalInitValue=0, ComSignalType=BOOLEAN, ComHandleId=7318, ComSystemTemplateSystemSignalRef=DET_HVC_FLAG_349
            DET_EXISTENCE_PROB_351_oRDR_DETECTION_349_352_oPCAN_RADAR_98167361_Tx: ComBitPosition=336, ComBitSize=6, ComSignalInitValue=0, ComSignalType=UINT8, ComHandleId=7316, ComSystemTemplateSystemSignalRef=DET_EXISTENCE_PROB_351
            DET_RANGE_ERR_349_oRDR_DETECTION_349_352_oPCAN_RADAR_5b202e9b_Tx: ComBitPosition=40, ComBitSize=7, ComSignalInitValue=0, ComSignalType=UINT8, ComHandleId=7341, ComSystemTemplateSystemSignalRef=DET_RANGE_ERR_349
            DET_ELEVATION_352_oRDR_DETECTION_349_352_oPCAN_RADAR_a950e58a_Tx: ComBitPosition=408, ComBitSize=8, ComSignalInitValue=0, ComSignalType=UINT8, ComHandleId=7309, ComSystemTemplateSystemSignalRef=DET_ELEVATION_352
            DET_BI_STATIC_FLAG_350_oRDR_DETECTION_349_352_oPCAN_RADAR_df5fd568_Tx: ComBitPosition=216, ComBitSize=1, ComSignalInitValue=0, ComSignalType=BOOLEAN, ComHandleId=7295, ComSystemTemplateSystemSignalRef=DET_BI_STATIC_FLAG_350
            DET_MH_CYCLE_COUNTER_349_352_oRDR_DETECTION_349_352_oPCAN_RADAR_9a1fd1d0_Tx: ComBitPosition=16, ComBitSize=8, ComSignalInitValue=0, ComSignalType=UINT8, ComHandleId=7327, ComSystemTemplateSystemSignalRef=DET_MH_CYCLE_COUNTER_349_352
            DET_AZIMUTH_351_oRDR_DETECTION_349_352_oPCAN_RADAR_1c034178_Tx: ComBitPosition=312, ComBitSize=13, ComSignalInitValue=0, ComSignalType=UINT16, ComHandleId=7284, ComSystemTemplateSystemSignalRef=DET_AZIMUTH_351
            DET_AZIMUTH_ERR_349_oRDR_DETECTION_349_352_oPCAN_RADAR_48e672bc_Tx: ComBitPosition=105, ComBitSize=7, ComSignalInitValue=0, ComSignalType=UINT8, ComHandleId=7286, ComSystemTemplateSystemSignalRef=DET_AZIMUTH_ERR_349
            DET_RANGE_352_oRDR_DETECTION_349_352_oPCAN_RADAR_6878493d_Tx: ComBitPosition=360, ComBitSize=15, ComSignalInitValue=0, ComSignalType=UINT16, ComHandleId=7340, ComSystemTemplateSystemSignalRef=DET_RANGE_352
            DET_RANGE_ERR_352_oRDR_DETECTION_349_352_oPCAN_RADAR_cf90f354_Tx: ComBitPosition=376, ComBitSize=7, ComSignalInitValue=0, ComSignalType=UINT8, ComHandleId=7344, ComSystemTemplateSystemSignalRef=DET_RANGE_ERR_352
            DET_AZIMUTH_350_oRDR_DETECTION_349_352_oPCAN_RADAR_897395ed_Tx: ComBitPosition=200, ComBitSize=13, ComSignalInitValue=0, ComSignalType=UINT16, ComHandleId=7283, ComSystemTemplateSystemSignalRef=DET_AZIMUTH_350
            DET_MH_SCAN_INDEX_4LSB_349_352_oRDR_DETECTION_349_352_oPCAN_RADAR_5635f45c_Tx: ComBitPosition=476, ComBitSize=4, ComSignalInitValue=0, ComSignalType=UINT8, ComHandleId=7328, ComSystemTemplateSystemSignalRef=DET_MH_SCAN_INDEX_4LSB_349_352
            DET_RANGE_ERR_351_oRDR_DETECTION_349_352_oPCAN_RADAR_ab7088aa_Tx: ComBitPosition=264, ComBitSize=7, ComSignalInitValue=0, ComSignalType=UINT8, ComHandleId=7343, ComSystemTemplateSystemSignalRef=DET_RANGE_ERR_351
            DET_CONFD_ELEVATION_351_oRDR_DETECTION_349_352_oPCAN_RADAR_1c704a48_Tx: ComBitPosition=325, ComBitSize=2, ComSignalInitValue=0, ComSignalType=UINT8, ComHandleId=7304, ComSystemTemplateSystemSignalRef=DET_CONFD_ELEVATION_351
            DET_AZIMUTH_ERR_352_oRDR_DETECTION_349_352_oPCAN_RADAR_dc56af73_Tx: ComBitPosition=441, ComBitSize=7, ComSignalInitValue=0, ComSignalType=UINT8, ComHandleId=7289, ComSystemTemplateSystemSignalRef=DET_AZIMUTH_ERR_352
            DET_BI_STATIC_FLAG_352_oRDR_DETECTION_349_352_oPCAN_RADAR_2ecf7a03_Tx: ComBitPosition=440, ComBitSize=1, ComSignalInitValue=0, ComSignalType=BOOLEAN, ComHandleId=7297, ComSystemTemplateSystemSignalRef=DET_BI_STATIC_FLAG_352
            DET_RANGE_VELOCITY_ERR_352_oRDR_DETECTION_349_352_oPCAN_RADAR_126570aa_Tx: ComBitPosition=400, ComBitSize=8, ComSignalInitValue=0, ComSignalType=UINT8, ComHandleId=7352, ComSystemTemplateSystemSignalRef=DET_RANGE_VELOCITY_ERR_352
            DET_SUPER_RES_TARGET_349_oRDR_DETECTION_349_352_oPCAN_RADAR_e2d91dea_Tx: ComBitPosition=87, ComBitSize=1, ComSignalInitValue=0, ComSignalType=BOOLEAN, ComHandleId=7361, ComSystemTemplateSystemSignalRef=DET_SUPER_RES_TARGET_349
            DET_CONFD_AZIMUTH_352_oRDR_DETECTION_349_352_oPCAN_RADAR_7a05304c_Tx: ComBitPosition=454, ComBitSize=2, ComSignalInitValue=0, ComSignalType=UINT8, ComHandleId=7301, ComSystemTemplateSystemSignalRef=DET_CONFD_AZIMUTH_352
            DET_RANGE_ERR_350_oRDR_DETECTION_349_352_oPCAN_RADAR_3e005c3f_Tx: ComBitPosition=152, ComBitSize=7, ComSignalInitValue=0, ComSignalType=UINT8, ComHandleId=7342, ComSystemTemplateSystemSignalRef=DET_RANGE_ERR_350
            DET_RANGE_VELOCITY_352_oRDR_DETECTION_349_352_oPCAN_RADAR_1dde8b18_Tx: ComBitPosition=384, ComBitSize=15, ComSignalInitValue=16384, ComSignalType=UINT16, ComHandleId=7348, ComSystemTemplateSystemSignalRef=DET_RANGE_VELOCITY_352
            DET_ELEVATION_ERR_351_oRDR_DETECTION_349_352_oPCAN_RADAR_4a890601_Tx: ComBitPosition=304, ComBitSize=6, ComSignalInitValue=0, ComSignalType=UINT8, ComHandleId=7312, ComSystemTemplateSystemSignalRef=DET_ELEVATION_ERR_351
            DET_CONFD_AZIMUTH_349_oRDR_DETECTION_349_352_oPCAN_RADAR_eeb5ed83_Tx: ComBitPosition=118, ComBitSize=2, ComSignalInitValue=0, ComSignalType=UINT8, ComHandleId=7298, ComSystemTemplateSystemSignalRef=DET_CONFD_AZIMUTH_349
            DET_RANGE_VELOCITY_ERR_350_oRDR_DETECTION_349_352_oPCAN_RADAR_e3f5dfc1_Tx: ComBitPosition=176, ComBitSize=8, ComSignalInitValue=0, ComSignalType=UINT8, ComHandleId=7350, ComSystemTemplateSystemSignalRef=DET_RANGE_VELOCITY_ERR_350
            DET_RCS_349_oRDR_DETECTION_349_352_oPCAN_RADAR_0eee618d_Tx: ComBitPosition=128, ComBitSize=8, ComSignalInitValue=128, ComSignalType=UINT8, ComHandleId=7353, ComSystemTemplateSystemSignalRef=DET_RCS_349
            DET_BI_STATIC_FLAG_351_oRDR_DETECTION_349_352_oPCAN_RADAR_4a2f01fd_Tx: ComBitPosition=328, ComBitSize=1, ComSignalInitValue=0, ComSignalType=BOOLEAN, ComHandleId=7296, ComSystemTemplateSystemSignalRef=DET_BI_STATIC_FLAG_351
            DET_HVC_FLAG_352_oRDR_DETECTION_349_352_oPCAN_RADAR_1d824be0_Tx: ComBitPosition=422, ComBitSize=1, ComSignalInitValue=0, ComSignalType=BOOLEAN, ComHandleId=7321, ComSystemTemplateSystemSignalRef=DET_HVC_FLAG_352
            DET_ELEVATION_ERR_352_oRDR_DETECTION_349_352_oPCAN_RADAR_2e697dff_Tx: ComBitPosition=416, ComBitSize=6, ComSignalInitValue=0, ComSignalType=UINT8, ComHandleId=7313, ComSystemTemplateSystemSignalRef=DET_ELEVATION_ERR_352
            DET_RANGE_350_oRDR_DETECTION_349_352_oPCAN_RADAR_99e8e656_Tx: ComBitPosition=136, ComBitSize=15, ComSignalInitValue=0, ComSignalType=UINT16, ComHandleId=7338, ComSystemTemplateSystemSignalRef=DET_RANGE_350
            DET_EXISTENCE_PROB_352_oRDR_DETECTION_349_352_oPCAN_RADAR_fcf6089f_Tx: ComBitPosition=448, ComBitSize=6, ComSignalInitValue=0, ComSignalType=UINT8, ComHandleId=7317, ComSystemTemplateSystemSignalRef=DET_EXISTENCE_PROB_352
            DET_AZIMUTH_352_oRDR_DETECTION_349_352_oPCAN_RADAR_78e33a86_Tx: ComBitPosition=424, ComBitSize=13, ComSignalInitValue=0, ComSignalType=UINT16, ComHandleId=7285, ComSystemTemplateSystemSignalRef=DET_AZIMUTH_352
            DET_ELEVATION_ERR_349_oRDR_DETECTION_349_352_oPCAN_RADAR_bad9a030_Tx: ComBitPosition=80, ComBitSize=6, ComSignalInitValue=0, ComSignalType=UINT8, ComHandleId=7310, ComSystemTemplateSystemSignalRef=DET_ELEVATION_ERR_349
            DET_HVC_FLAG_351_oRDR_DETECTION_349_352_oPCAN_RADAR_7962301e_Tx: ComBitPosition=310, ComBitSize=1, ComSignalInitValue=0, ComSignalType=BOOLEAN, ComHandleId=7320, ComSystemTemplateSystemSignalRef=DET_HVC_FLAG_351
            DET_EXISTENCE_PROB_349_oRDR_DETECTION_349_352_oPCAN_RADAR_6846d550_Tx: ComBitPosition=112, ComBitSize=6, ComSignalInitValue=0, ComSignalType=UINT8, ComHandleId=7314, ComSystemTemplateSystemSignalRef=DET_EXISTENCE_PROB_349
            DET_MH_CRC16_349_352_oRDR_DETECTION_349_352_oPCAN_RADAR_1e6a70e7_Tx: ComBitPosition=0, ComBitSize=16, ComSignalInitValue=0, ComSignalType=UINT16, ComHandleId=7326, ComSystemTemplateSystemSignalRef=DET_MH_CRC16_349_352
            DET_SNR_352_oRDR_DETECTION_349_352_oPCAN_RADAR_47f0e840_Tx: ComBitPosition=456, ComBitSize=8, ComSignalInitValue=0, ComSignalType=UINT8, ComHandleId=7360, ComSystemTemplateSystemSignalRef=DET_SNR_352
            DET_ELEVATION_349_oRDR_DETECTION_349_352_oPCAN_RADAR_3de03845_Tx: ComBitPosition=72, ComBitSize=8, ComSignalInitValue=0, ComSignalType=UINT8, ComHandleId=7306, ComSystemTemplateSystemSignalRef=DET_ELEVATION_349
            DET_SNR_349_oRDR_DETECTION_349_352_oPCAN_RADAR_d340358f_Tx: ComBitPosition=120, ComBitSize=8, ComSignalInitValue=0, ComSignalType=UINT8, ComHandleId=7357, ComSystemTemplateSystemSignalRef=DET_SNR_349
            DET_SNR_350_oRDR_DETECTION_349_352_oPCAN_RADAR_b660472b_Tx: ComBitPosition=232, ComBitSize=8, ComSignalInitValue=0, ComSignalType=UINT8, ComHandleId=7358, ComSystemTemplateSystemSignalRef=DET_SNR_350
            DET_SUPER_RES_TARGET_352_oRDR_DETECTION_349_352_oPCAN_RADAR_7669c025_Tx: ComBitPosition=423, ComBitSize=1, ComSignalInitValue=0, ComSignalType=BOOLEAN, ComHandleId=7364, ComSystemTemplateSystemSignalRef=DET_SUPER_RES_TARGET_352
            DET_RANGE_VELOCITY_350_oRDR_DETECTION_349_352_oPCAN_RADAR_ec4e2473_Tx: ComBitPosition=160, ComBitSize=15, ComSignalInitValue=16384, ComSignalType=UINT16, ComHandleId=7346, ComSystemTemplateSystemSignalRef=DET_RANGE_VELOCITY_350
            DET_CONFD_ELEVATION_349_oRDR_DETECTION_349_352_oPCAN_RADAR_ec20ec79_Tx: ComBitPosition=101, ComBitSize=2, ComSignalInitValue=0, ComSignalType=UINT8, ComHandleId=7302, ComSystemTemplateSystemSignalRef=DET_CONFD_ELEVATION_349
            DET_RANGE_349_oRDR_DETECTION_349_352_oPCAN_RADAR_fcc894f2_Tx: ComBitPosition=24, ComBitSize=15, ComSignalInitValue=0, ComSignalType=UINT16, ComHandleId=7337, ComSystemTemplateSystemSignalRef=DET_RANGE_349
            DET_RANGE_VELOCITY_351_oRDR_DETECTION_349_352_oPCAN_RADAR_793ef0e6_Tx: ComBitPosition=272, ComBitSize=15, ComSignalInitValue=16384, ComSignalType=UINT16, ComHandleId=7347, ComSystemTemplateSystemSignalRef=DET_RANGE_VELOCITY_351
            DET_CONFD_AZIMUTH_351_oRDR_DETECTION_349_352_oPCAN_RADAR_1ee54bb2_Tx: ComBitPosition=342, ComBitSize=2, ComSignalInitValue=0, ComSignalType=UINT8, ComHandleId=7300, ComSystemTemplateSystemSignalRef=DET_CONFD_AZIMUTH_351
            DET_RANGE_VELOCITY_349_oRDR_DETECTION_349_352_oPCAN_RADAR_896e56d7_Tx: ComBitPosition=48, ComBitSize=15, ComSignalInitValue=16384, ComSignalType=UINT16, ComHandleId=7345, ComSystemTemplateSystemSignalRef=DET_RANGE_VELOCITY_349
            DET_RCS_352_oRDR_DETECTION_349_352_oPCAN_RADAR_9a5ebc42_Tx: ComBitPosition=464, ComBitSize=8, ComSignalInitValue=128, ComSignalType=UINT8, ComHandleId=7356, ComSystemTemplateSystemSignalRef=DET_RCS_352
            DET_ELEVATION_ERR_350_oRDR_DETECTION_349_352_oPCAN_RADAR_dff9d294_Tx: ComBitPosition=192, ComBitSize=6, ComSignalInitValue=0, ComSignalType=UINT8, ComHandleId=7311, ComSystemTemplateSystemSignalRef=DET_ELEVATION_ERR_350
            DET_SUPER_RES_TARGET_350_oRDR_DETECTION_349_352_oPCAN_RADAR_87f96f4e_Tx: ComBitPosition=199, ComBitSize=1, ComSignalInitValue=0, ComSignalType=BOOLEAN, ComHandleId=7362, ComSystemTemplateSystemSignalRef=DET_SUPER_RES_TARGET_350
            DET_RANGE_VELOCITY_ERR_351_oRDR_DETECTION_349_352_oPCAN_RADAR_76850b54_Tx: ComBitPosition=288, ComBitSize=8, ComSignalInitValue=0, ComSignalType=UINT8, ComHandleId=7351, ComSystemTemplateSystemSignalRef=DET_RANGE_VELOCITY_ERR_351
            DET_CONFD_AZIMUTH_350_oRDR_DETECTION_349_352_oPCAN_RADAR_8b959f27_Tx: ComBitPosition=230, ComBitSize=2, ComSignalInitValue=0, ComSignalType=UINT8, ComHandleId=7299, ComSystemTemplateSystemSignalRef=DET_CONFD_AZIMUTH_350
            DET_ELEVATION_351_oRDR_DETECTION_349_352_oPCAN_RADAR_cdb09e74_Tx: ComBitPosition=296, ComBitSize=8, ComSignalInitValue=0, ComSignalType=UINT8, ComHandleId=7308, ComSystemTemplateSystemSignalRef=DET_ELEVATION_351
            DET_RCS_351_oRDR_DETECTION_349_352_oPCAN_RADAR_febec7bc_Tx: ComBitPosition=352, ComBitSize=8, ComSignalInitValue=128, ComSignalType=UINT8, ComHandleId=7355, ComSystemTemplateSystemSignalRef=DET_RCS_351
            DET_BI_STATIC_FLAG_349_oRDR_DETECTION_349_352_oPCAN_RADAR_ba7fa7cc_Tx: ComBitPosition=104, ComBitSize=1, ComSignalInitValue=0, ComSignalType=BOOLEAN, ComHandleId=7294, ComSystemTemplateSystemSignalRef=DET_BI_STATIC_FLAG_349
            DET_SNR_351_oRDR_DETECTION_349_352_oPCAN_RADAR_231093be_Tx: ComBitPosition=344, ComBitSize=8, ComSignalInitValue=0, ComSignalType=UINT8, ComHandleId=7359, ComSystemTemplateSystemSignalRef=DET_SNR_351
            DET_EXISTENCE_PROB_350_oRDR_DETECTION_349_352_oPCAN_RADAR_0d66a7f4_Tx: ComBitPosition=224, ComBitSize=6, ComSignalInitValue=0, ComSignalType=UINT8, ComHandleId=7315, ComSystemTemplateSystemSignalRef=DET_EXISTENCE_PROB_350
            DET_AZIMUTH_ERR_351_oRDR_DETECTION_349_352_oPCAN_RADAR_b8b6d48d_Tx: ComBitPosition=329, ComBitSize=7, ComSignalInitValue=0, ComSignalType=UINT8, ComHandleId=7288, ComSystemTemplateSystemSignalRef=DET_AZIMUTH_ERR_351
            DET_ELEVATION_350_oRDR_DETECTION_349_352_oPCAN_RADAR_58c04ae1_Tx: ComBitPosition=184, ComBitSize=8, ComSignalInitValue=0, ComSignalType=UINT8, ComHandleId=7307, ComSystemTemplateSystemSignalRef=DET_ELEVATION_350
            DET_AZIMUTH_349_oRDR_DETECTION_349_352_oPCAN_RADAR_ec53e749_Tx: ComBitPosition=88, ComBitSize=13, ComSignalInitValue=0, ComSignalType=UINT16, ComHandleId=7282, ComSystemTemplateSystemSignalRef=DET_AZIMUTH_349
            DET_CONFD_ELEVATION_352_oRDR_DETECTION_349_352_oPCAN_RADAR_789031b6_Tx: ComBitPosition=437, ComBitSize=2, ComSignalInitValue=0, ComSignalType=UINT8, ComHandleId=7305, ComSystemTemplateSystemSignalRef=DET_CONFD_ELEVATION_352
            DET_RANGE_VELOCITY_ERR_349_oRDR_DETECTION_349_352_oPCAN_RADAR_86d5ad65_Tx: ComBitPosition=64, ComBitSize=8, ComSignalInitValue=0, ComSignalType=UINT8, ComHandleId=7349, ComSystemTemplateSystemSignalRef=DET_RANGE_VELOCITY_ERR_349
            DET_RANGE_351_oRDR_DETECTION_349_352_oPCAN_RADAR_0c9832c3_Tx: ComBitPosition=248, ComBitSize=15, ComSignalInitValue=0, ComSignalType=UINT16, ComHandleId=7339, ComSystemTemplateSystemSignalRef=DET_RANGE_351
            DET_CONFD_ELEVATION_350_oRDR_DETECTION_349_352_oPCAN_RADAR_89009edd_Tx: ComBitPosition=213, ComBitSize=2, ComSignalInitValue=0, ComSignalType=UINT8, ComHandleId=7303, ComSystemTemplateSystemSignalRef=DET_CONFD_ELEVATION_350
            DET_MTD_352_oRDR_DETECTION_349_352_oPCAN_RADAR_f0634286_Tx: ComBitPosition=383, ComBitSize=1, ComSignalInitValue=0, ComSignalType=UINT8, ComHandleId=7332, ComSystemTemplateSystemSignalRef=DET_MTD_352
            DET_IDM_350_oRDR_DETECTION_349_352_oPCAN_RADAR_6740df36_Tx: ComBitPosition=175, ComBitSize=1, ComSignalInitValue=0, ComSignalType=UINT8, ComHandleId=7323, ComSystemTemplateSystemSignalRef=DET_IDM_350
            DET_BELOW_RAIN_THOLD_352_oRDR_DETECTION_349_352_oPCAN_RADAR_ade2a946_Tx: ComBitPosition=375, ComBitSize=1, ComSignalInitValue=0, ComSignalType=UINT8, ComHandleId=7293, ComSystemTemplateSystemSignalRef=DET_BELOW_RAIN_THOLD_352
            DET_IDM_351_oRDR_DETECTION_349_352_oPCAN_RADAR_f2300ba3_Tx: ComBitPosition=287, ComBitSize=1, ComSignalInitValue=0, ComSignalType=UINT8, ComHandleId=7324, ComSystemTemplateSystemSignalRef=DET_IDM_351
            DET_MTD_351_oRDR_DETECTION_349_352_oPCAN_RADAR_94833978_Tx: ComBitPosition=271, ComBitSize=1, ComSignalInitValue=0, ComSignalType=UINT8, ComHandleId=7331, ComSystemTemplateSystemSignalRef=DET_MTD_351
            DET_IDM_352_oRDR_DETECTION_349_352_oPCAN_RADAR_96d0705d_Tx: ComBitPosition=399, ComBitSize=1, ComSignalInitValue=0, ComSignalType=UINT8, ComHandleId=7325, ComSystemTemplateSystemSignalRef=DET_IDM_352
            DET_PROB_1STAZHYPO_349_oRDR_DETECTION_349_352_oPCAN_RADAR_f7677784_Tx: ComBitPosition=103, ComBitSize=1, ComSignalInitValue=0, ComSignalType=BOOLEAN, ComHandleId=7333, ComSystemTemplateSystemSignalRef=DET_PROB_1STAZHYPO_349
            DET_BELOW_RAIN_THOLD_350_oRDR_DETECTION_349_352_oPCAN_RADAR_5c72062d_Tx: ComBitPosition=151, ComBitSize=1, ComSignalInitValue=0, ComSignalType=UINT8, ComHandleId=7291, ComSystemTemplateSystemSignalRef=DET_BELOW_RAIN_THOLD_350
            DET_IDM_349_oRDR_DETECTION_349_352_oPCAN_RADAR_0260ad92_Tx: ComBitPosition=63, ComBitSize=1, ComSignalInitValue=0, ComSignalType=UINT8, ComHandleId=7322, ComSystemTemplateSystemSignalRef=DET_IDM_349
            DET_BELOW_RAIN_THOLD_351_oRDR_DETECTION_349_352_oPCAN_RADAR_c902d2b8_Tx: ComBitPosition=263, ComBitSize=1, ComSignalInitValue=0, ComSignalType=UINT8, ComHandleId=7292, ComSystemTemplateSystemSignalRef=DET_BELOW_RAIN_THOLD_351
            DET_BELOW_RAIN_THOLD_349_oRDR_DETECTION_349_352_oPCAN_RADAR_39527489_Tx: ComBitPosition=39, ComBitSize=1, ComSignalInitValue=0, ComSignalType=UINT8, ComHandleId=7290, ComSystemTemplateSystemSignalRef=DET_BELOW_RAIN_THOLD_349
            DET_MTD_349_oRDR_DETECTION_349_352_oPCAN_RADAR_64d39f49_Tx: ComBitPosition=47, ComBitSize=1, ComSignalInitValue=0, ComSignalType=UINT8, ComHandleId=7329, ComSystemTemplateSystemSignalRef=DET_MTD_349
            DET_MTD_350_oRDR_DETECTION_349_352_oPCAN_RADAR_01f3eded_Tx: ComBitPosition=159, ComBitSize=1, ComSignalInitValue=0, ComSignalType=UINT8, ComHandleId=7330, ComSystemTemplateSystemSignalRef=DET_MTD_350
            DET_PROB_1STAZHYPO_350_oRDR_DETECTION_349_352_oPCAN_RADAR_92470520_Tx: ComBitPosition=215, ComBitSize=1, ComSignalInitValue=0, ComSignalType=BOOLEAN, ComHandleId=7334, ComSystemTemplateSystemSignalRef=DET_PROB_1STAZHYPO_350
            DET_PROB_1STAZHYPO_352_oRDR_DETECTION_349_352_oPCAN_RADAR_63d7aa4b_Tx: ComBitPosition=439, ComBitSize=1, ComSignalInitValue=0, ComSignalType=BOOLEAN, ComHandleId=7336, ComSystemTemplateSystemSignalRef=DET_PROB_1STAZHYPO_352
            DET_PROB_1STAZHYPO_351_oRDR_DETECTION_349_352_oPCAN_RADAR_0737d1b5_Tx: ComBitPosition=327, ComBitSize=1, ComSignalInitValue=0, ComSignalType=BOOLEAN, ComHandleId=7335, ComSystemTemplateSystemSignalRef=DET_PROB_1STAZHYPO_351
        SG_Detections_061_064_oRDR_DETECTION_061_064_oPCAN_RADAR_80d67553_Tx: ComTransferProperty=TRIGGERED, ComHandleId=17, ComSystemTemplateSignalGroupRef=SG_Detections_061_064
          83 x ComGroupSignal, all with ComSignalEndianness=LITTLE_ENDIAN, ComTransferProperty=PENDING, ComSignalAccess=ACCESS_NEEDED_BY_SWC_OR_COM:
            DET_ELEVATION_064_oRDR_DETECTION_061_064_oPCAN_RADAR_fa721fba_Tx: ComBitPosition=408, ComBitSize=8, ComSignalInitValue=0, ComSignalType=UINT8, ComHandleId=1333, ComSystemTemplateSystemSignalRef=DET_ELEVATION_064
            DET_AZIMUTH_ERR_062_oRDR_DETECTION_061_064_oPCAN_RADAR_46b4a2bf_Tx: ComBitPosition=217, ComBitSize=7, ComSignalInitValue=0, ComSignalType=UINT8, ComHandleId=1311, ComSystemTemplateSystemSignalRef=DET_AZIMUTH_ERR_062
            DET_RANGE_ERR_062_oRDR_DETECTION_061_064_oPCAN_RADAR_5572fe98_Tx: ComBitPosition=152, ComBitSize=7, ComSignalInitValue=0, ComSignalType=UINT8, ComHandleId=1366, ComSystemTemplateSystemSignalRef=DET_RANGE_ERR_062
            DET_RANGE_VELOCITY_ERR_064_oRDR_DETECTION_061_064_oPCAN_RADAR_41478a9a_Tx: ComBitPosition=400, ComBitSize=8, ComSignalInitValue=0, ComSignalType=UINT8, ComHandleId=1376, ComSystemTemplateSystemSignalRef=DET_RANGE_VELOCITY_ERR_064
            DET_ELEVATION_ERR_063_oRDR_DETECTION_061_064_oPCAN_RADAR_21fba4a6_Tx: ComBitPosition=304, ComBitSize=6, ComSignalInitValue=0, ComSignalType=UINT8, ComHandleId=1336, ComSystemTemplateSystemSignalRef=DET_ELEVATION_ERR_063
            DET_SNR_062_oRDR_DETECTION_061_064_oPCAN_RADAR_dd12e58c_Tx: ComBitPosition=232, ComBitSize=8, ComSignalInitValue=0, ComSignalType=UINT8, ComHandleId=1382, ComSystemTemplateSystemSignalRef=DET_SNR_062
            DET_SUPER_RES_TARGET_063_oRDR_DETECTION_061_064_oPCAN_RADAR_79fb197c_Tx: ComBitPosition=311, ComBitSize=1, ComSignalInitValue=0, ComSignalType=BOOLEAN, ComHandleId=1387, ComSystemTemplateSystemSignalRef=DET_SUPER_RES_TARGET_063
            DET_CONFD_AZIMUTH_064_oRDR_DETECTION_061_064_oPCAN_RADAR_2927ca7c_Tx: ComBitPosition=454, ComBitSize=2, ComSignalInitValue=0, ComSignalType=UINT8, ComHandleId=1325, ComSystemTemplateSystemSignalRef=DET_CONFD_AZIMUTH_064
            DET_MH_SCAN_INDEX_4LSB_061_064_oRDR_DETECTION_061_064_oPCAN_RADAR_4c0123e3_Tx: ComBitPosition=476, ComBitSize=4, ComSignalInitValue=0, ComSignalType=UINT8, ComHandleId=1352, ComSystemTemplateSystemSignalRef=DET_MH_SCAN_INDEX_4LSB_061_064
            DET_ELEVATION_063_oRDR_DETECTION_061_064_oPCAN_RADAR_a6c23cd3_Tx: ComBitPosition=296, ComBitSize=8, ComSignalInitValue=0, ComSignalType=UINT8, ComHandleId=1332, ComSystemTemplateSystemSignalRef=DET_ELEVATION_063
            DET_RANGE_ERR_061_oRDR_DETECTION_061_064_oPCAN_RADAR_31928566_Tx: ComBitPosition=40, ComBitSize=7, ComSignalInitValue=0, ComSignalType=UINT8, ComHandleId=1365, ComSystemTemplateSystemSignalRef=DET_RANGE_ERR_061
            DET_CONFD_ELEVATION_062_oRDR_DETECTION_061_064_oPCAN_RADAR_e2723c7a_Tx: ComBitPosition=213, ComBitSize=2, ComSignalInitValue=0, ComSignalType=UINT8, ComHandleId=1327, ComSystemTemplateSystemSignalRef=DET_CONFD_ELEVATION_062
            DET_RANGE_062_oRDR_DETECTION_061_064_oPCAN_RADAR_f29a44f1_Tx: ComBitPosition=136, ComBitSize=15, ComSignalInitValue=0, ComSignalType=UINT16, ComHandleId=1362, ComSystemTemplateSystemSignalRef=DET_RANGE_062
            DET_MH_CYCLE_COUNTER_061_064_oRDR_DETECTION_061_064_oPCAN_RADAR_802b066f_Tx: ComBitPosition=16, ComBitSize=8, ComSignalInitValue=0, ComSignalType=UINT8, ComHandleId=1351, ComSystemTemplateSystemSignalRef=DET_MH_CYCLE_COUNTER_061_064
            DET_RCS_061_oRDR_DETECTION_061_064_oPCAN_RADAR_645cca70_Tx: ComBitPosition=128, ComBitSize=8, ComSignalInitValue=128, ComSignalType=UINT8, ComHandleId=1377, ComSystemTemplateSystemSignalRef=DET_RCS_061
            DET_HVC_FLAG_061_oRDR_DETECTION_061_064_oPCAN_RADAR_e3803dd2_Tx: ComBitPosition=86, ComBitSize=1, ComSignalInitValue=0, ComSignalType=BOOLEAN, ComHandleId=1342, ComSystemTemplateSystemSignalRef=DET_HVC_FLAG_061
            DET_RANGE_ERR_063_oRDR_DETECTION_061_064_oPCAN_RADAR_c0022a0d_Tx: ComBitPosition=264, ComBitSize=7, ComSignalInitValue=0, ComSignalType=UINT8, ComHandleId=1367, ComSystemTemplateSystemSignalRef=DET_RANGE_ERR_063
            DET_BI_STATIC_FLAG_062_oRDR_DETECTION_061_064_oPCAN_RADAR_b42d77cf_Tx: ComBitPosition=216, ComBitSize=1, ComSignalInitValue=0, ComSignalType=BOOLEAN, ComHandleId=1319, ComSystemTemplateSystemSignalRef=DET_BI_STATIC_FLAG_062
            DET_ELEVATION_062_oRDR_DETECTION_061_064_oPCAN_RADAR_33b2e846_Tx: ComBitPosition=184, ComBitSize=8, ComSignalInitValue=0, ComSignalType=UINT8, ComHandleId=1331, ComSystemTemplateSystemSignalRef=DET_ELEVATION_062
            DET_RANGE_VELOCITY_062_oRDR_DETECTION_061_064_oPCAN_RADAR_873c86d4_Tx: ComBitPosition=160, ComBitSize=15, ComSignalInitValue=16384, ComSignalType=UINT16, ComHandleId=1370, ComSystemTemplateSystemSignalRef=DET_RANGE_VELOCITY_062
            DET_HVC_FLAG_062_oRDR_DETECTION_061_064_oPCAN_RADAR_8760462c_Tx: ComBitPosition=198, ComBitSize=1, ComSignalInitValue=0, ComSignalType=BOOLEAN, ComHandleId=1343, ComSystemTemplateSystemSignalRef=DET_HVC_FLAG_062
            DET_RANGE_063_oRDR_DETECTION_061_064_oPCAN_RADAR_67ea9064_Tx: ComBitPosition=248, ComBitSize=15, ComSignalInitValue=0, ComSignalType=UINT16, ComHandleId=1363, ComSystemTemplateSystemSignalRef=DET_RANGE_063
            DET_BI_STATIC_FLAG_061_oRDR_DETECTION_061_064_oPCAN_RADAR_d0cd0c31_Tx: ComBitPosition=104, ComBitSize=1, ComSignalInitValue=0, ComSignalType=BOOLEAN, ComHandleId=1318, ComSystemTemplateSystemSignalRef=DET_BI_STATIC_FLAG_061
            DET_ELEVATION_061_oRDR_DETECTION_061_064_oPCAN_RADAR_575293b8_Tx: ComBitPosition=72, ComBitSize=8, ComSignalInitValue=0, ComSignalType=UINT8, ComHandleId=1330, ComSystemTemplateSystemSignalRef=DET_ELEVATION_061
            DET_SNR_061_oRDR_DETECTION_061_064_oPCAN_RADAR_b9f29e72_Tx: ComBitPosition=120, ComBitSize=8, ComSignalInitValue=0, ComSignalType=UINT8, ComHandleId=1381, ComSystemTemplateSystemSignalRef=DET_SNR_061
            DET_RANGE_VELOCITY_ERR_063_oRDR_DETECTION_061_064_oPCAN_RADAR_1df7a9f3_Tx: ComBitPosition=288, ComBitSize=8, ComSignalInitValue=0, ComSignalType=UINT8, ComHandleId=1375, ComSystemTemplateSystemSignalRef=DET_RANGE_VELOCITY_ERR_063
            DET_SUPER_RES_TARGET_062_oRDR_DETECTION_061_064_oPCAN_RADAR_ec8bcde9_Tx: ComBitPosition=199, ComBitSize=1, ComSignalInitValue=0, ComSignalType=BOOLEAN, ComHandleId=1386, ComSystemTemplateSystemSignalRef=DET_SUPER_RES_TARGET_062
            DET_RANGE_VELOCITY_064_oRDR_DETECTION_061_064_oPCAN_RADAR_4efc7128_Tx: ComBitPosition=384, ComBitSize=15, ComSignalInitValue=16384, ComSignalType=UINT16, ComHandleId=1372, ComSystemTemplateSystemSignalRef=DET_RANGE_VELOCITY_064
            DET_CONFD_ELEVATION_064_oRDR_DETECTION_061_064_oPCAN_RADAR_2bb2cb86_Tx: ComBitPosition=437, ComBitSize=2, ComSignalInitValue=0, ComSignalType=UINT8, ComHandleId=1329, ComSystemTemplateSystemSignalRef=DET_CONFD_ELEVATION_064
            DET_ELEVATION_ERR_064_oRDR_DETECTION_061_064_oPCAN_RADAR_7d4b87cf_Tx: ComBitPosition=416, ComBitSize=6, ComSignalInitValue=0, ComSignalType=UINT8, ComHandleId=1337, ComSystemTemplateSystemSignalRef=DET_ELEVATION_ERR_064
            DET_RANGE_VELOCITY_061_oRDR_DETECTION_061_064_oPCAN_RADAR_e3dcfd2a_Tx: ComBitPosition=48, ComBitSize=15, ComSignalInitValue=16384, ComSignalType=UINT16, ComHandleId=1369, ComSystemTemplateSystemSignalRef=DET_RANGE_VELOCITY_061
            DET_AZIMUTH_062_oRDR_DETECTION_061_064_oPCAN_RADAR_e201374a_Tx: ComBitPosition=200, ComBitSize=13, ComSignalInitValue=0, ComSignalType=UINT16, ComHandleId=1307, ComSystemTemplateSystemSignalRef=DET_AZIMUTH_062
            DET_RCS_062_oRDR_DETECTION_061_064_oPCAN_RADAR_00bcb18e_Tx: ComBitPosition=240, ComBitSize=8, ComSignalInitValue=128, ComSignalType=UINT8, ComHandleId=1378, ComSystemTemplateSystemSignalRef=DET_RCS_062
            DET_CONFD_ELEVATION_063_oRDR_DETECTION_061_064_oPCAN_RADAR_7702e8ef_Tx: ComBitPosition=325, ComBitSize=2, ComSignalInitValue=0, ComSignalType=UINT8, ComHandleId=1328, ComSystemTemplateSystemSignalRef=DET_CONFD_ELEVATION_063
            DET_RANGE_VELOCITY_063_oRDR_DETECTION_061_064_oPCAN_RADAR_124c5241_Tx: ComBitPosition=272, ComBitSize=15, ComSignalInitValue=16384, ComSignalType=UINT16, ComHandleId=1371, ComSystemTemplateSystemSignalRef=DET_RANGE_VELOCITY_063
            DET_BI_STATIC_FLAG_064_oRDR_DETECTION_061_064_oPCAN_RADAR_7ded8033_Tx: ComBitPosition=440, ComBitSize=1, ComSignalInitValue=0, ComSignalType=BOOLEAN, ComHandleId=1321, ComSystemTemplateSystemSignalRef=DET_BI_STATIC_FLAG_064
            DET_CONFD_AZIMUTH_061_oRDR_DETECTION_061_064_oPCAN_RADAR_8407467e_Tx: ComBitPosition=118, ComBitSize=2, ComSignalInitValue=0, ComSignalType=UINT8, ComHandleId=1322, ComSystemTemplateSystemSignalRef=DET_CONFD_AZIMUTH_061
            DET_HVC_FLAG_063_oRDR_DETECTION_061_064_oPCAN_RADAR_121092b9_Tx: ComBitPosition=310, ComBitSize=1, ComSignalInitValue=0, ComSignalType=BOOLEAN, ComHandleId=1344, ComSystemTemplateSystemSignalRef=DET_HVC_FLAG_063
            DET_ELEVATION_ERR_061_oRDR_DETECTION_061_064_oPCAN_RADAR_d06b0bcd_Tx: ComBitPosition=80, ComBitSize=6, ComSignalInitValue=0, ComSignalType=UINT8, ComHandleId=1334, ComSystemTemplateSystemSignalRef=DET_ELEVATION_ERR_061
            DET_AZIMUTH_063_oRDR_DETECTION_061_064_oPCAN_RADAR_7771e3df_Tx: ComBitPosition=312, ComBitSize=13, ComSignalInitValue=0, ComSignalType=UINT16, ComHandleId=1308, ComSystemTemplateSystemSignalRef=DET_AZIMUTH_063
            DET_RANGE_061_oRDR_DETECTION_061_064_oPCAN_RADAR_967a3f0f_Tx: ComBitPosition=24, ComBitSize=15, ComSignalInitValue=0, ComSignalType=UINT16, ComHandleId=1361, ComSystemTemplateSystemSignalRef=DET_RANGE_061
            DET_BI_STATIC_FLAG_063_oRDR_DETECTION_061_064_oPCAN_RADAR_215da35a_Tx: ComBitPosition=328, ComBitSize=1, ComSignalInitValue=0, ComSignalType=BOOLEAN, ComHandleId=1320, ComSystemTemplateSystemSignalRef=DET_BI_STATIC_FLAG_063
            DET_SUPER_RES_TARGET_061_oRDR_DETECTION_061_064_oPCAN_RADAR_886bb617_Tx: ComBitPosition=87, ComBitSize=1, ComSignalInitValue=0, ComSignalType=BOOLEAN, ComHandleId=1385, ComSystemTemplateSystemSignalRef=DET_SUPER_RES_TARGET_061
            DET_MH_CRC16_061_064_oRDR_DETECTION_061_064_oPCAN_RADAR_045ea758_Tx: ComBitPosition=0, ComBitSize=16, ComSignalInitValue=0, ComSignalType=UINT16, ComHandleId=1350, ComSystemTemplateSystemSignalRef=DET_MH_CRC16_061_064
            DET_AZIMUTH_064_oRDR_DETECTION_061_064_oPCAN_RADAR_2bc1c0b6_Tx: ComBitPosition=424, ComBitSize=13, ComSignalInitValue=0, ComSignalType=UINT16, ComHandleId=1309, ComSystemTemplateSystemSignalRef=DET_AZIMUTH_064
            DET_SUPER_RES_TARGET_064_oRDR_DETECTION_061_064_oPCAN_RADAR_254b3a15_Tx: ComBitPosition=423, ComBitSize=1, ComSignalInitValue=0, ComSignalType=BOOLEAN, ComHandleId=1388, ComSystemTemplateSystemSignalRef=DET_SUPER_RES_TARGET_064
            DET_SNR_063_oRDR_DETECTION_061_064_oPCAN_RADAR_48623119_Tx: ComBitPosition=344, ComBitSize=8, ComSignalInitValue=0, ComSignalType=UINT8, ComHandleId=1383, ComSystemTemplateSystemSignalRef=DET_SNR_063
            DET_RANGE_VELOCITY_ERR_061_oRDR_DETECTION_061_064_oPCAN_RADAR_ec670698_Tx: ComBitPosition=64, ComBitSize=8, ComSignalInitValue=0, ComSignalType=UINT8, ComHandleId=1373, ComSystemTemplateSystemSignalRef=DET_RANGE_VELOCITY_ERR_061
            DET_HVC_FLAG_064_oRDR_DETECTION_061_064_oPCAN_RADAR_4ea0b1d0_Tx: ComBitPosition=422, ComBitSize=1, ComSignalInitValue=0, ComSignalType=BOOLEAN, ComHandleId=1345, ComSystemTemplateSystemSignalRef=DET_HVC_FLAG_064
            DET_SNR_064_oRDR_DETECTION_061_064_oPCAN_RADAR_14d21270_Tx: ComBitPosition=456, ComBitSize=8, ComSignalInitValue=0, ComSignalType=UINT8, ComHandleId=1384, ComSystemTemplateSystemSignalRef=DET_SNR_064
            DET_EXISTENCE_PROB_061_oRDR_DETECTION_061_064_oPCAN_RADAR_02f47ead_Tx: ComBitPosition=112, ComBitSize=6, ComSignalInitValue=0, ComSignalType=UINT8, ComHandleId=1338, ComSystemTemplateSystemSignalRef=DET_EXISTENCE_PROB_061
            DET_RANGE_VELOCITY_ERR_062_oRDR_DETECTION_061_064_oPCAN_RADAR_88877d66_Tx: ComBitPosition=176, ComBitSize=8, ComSignalInitValue=0, ComSignalType=UINT8, ComHandleId=1374, ComSystemTemplateSystemSignalRef=DET_RANGE_VELOCITY_ERR_062
            DET_EXISTENCE_PROB_063_oRDR_DETECTION_061_064_oPCAN_RADAR_f364d1c6_Tx: ComBitPosition=336, ComBitSize=6, ComSignalInitValue=0, ComSignalType=UINT8, ComHandleId=1340, ComSystemTemplateSystemSignalRef=DET_EXISTENCE_PROB_063
            DET_AZIMUTH_ERR_064_oRDR_DETECTION_061_064_oPCAN_RADAR_8f745543_Tx: ComBitPosition=441, ComBitSize=7, ComSignalInitValue=0, ComSignalType=UINT8, ComHandleId=1313, ComSystemTemplateSystemSignalRef=DET_AZIMUTH_ERR_064
            DET_CONFD_ELEVATION_061_oRDR_DETECTION_061_064_oPCAN_RADAR_86924784_Tx: ComBitPosition=101, ComBitSize=2, ComSignalInitValue=0, ComSignalType=UINT8, ComHandleId=1326, ComSystemTemplateSystemSignalRef=DET_CONFD_ELEVATION_061
            DET_RCS_064_oRDR_DETECTION_061_064_oPCAN_RADAR_c97c4672_Tx: ComBitPosition=464, ComBitSize=8, ComSignalInitValue=128, ComSignalType=UINT8, ComHandleId=1380, ComSystemTemplateSystemSignalRef=DET_RCS_064
            DET_RANGE_064_oRDR_DETECTION_061_064_oPCAN_RADAR_3b5ab30d_Tx: ComBitPosition=360, ComBitSize=15, ComSignalInitValue=0, ComSignalType=UINT16, ComHandleId=1364, ComSystemTemplateSystemSignalRef=DET_RANGE_064
            DET_RCS_063_oRDR_DETECTION_061_064_oPCAN_RADAR_95cc651b_Tx: ComBitPosition=352, ComBitSize=8, ComSignalInitValue=128, ComSignalType=UINT8, ComHandleId=1379, ComSystemTemplateSystemSignalRef=DET_RCS_063
            DET_AZIMUTH_061_oRDR_DETECTION_061_064_oPCAN_RADAR_86e14cb4_Tx: ComBitPosition=88, ComBitSize=13, ComSignalInitValue=0, ComSignalType=UINT16, ComHandleId=1306, ComSystemTemplateSystemSignalRef=DET_AZIMUTH_061
            DET_AZIMUTH_ERR_061_oRDR_DETECTION_061_064_oPCAN_RADAR_2254d941_Tx: ComBitPosition=105, ComBitSize=7, ComSignalInitValue=0, ComSignalType=UINT8, ComHandleId=1310, ComSystemTemplateSystemSignalRef=DET_AZIMUTH_ERR_061
            DET_ELEVATION_ERR_062_oRDR_DETECTION_061_064_oPCAN_RADAR_b48b7033_Tx: ComBitPosition=192, ComBitSize=6, ComSignalInitValue=0, ComSignalType=UINT8, ComHandleId=1335, ComSystemTemplateSystemSignalRef=DET_ELEVATION_ERR_062
            DET_RANGE_ERR_064_oRDR_DETECTION_061_064_oPCAN_RADAR_9cb20964_Tx: ComBitPosition=376, ComBitSize=7, ComSignalInitValue=0, ComSignalType=UINT8, ComHandleId=1368, ComSystemTemplateSystemSignalRef=DET_RANGE_ERR_064
            DET_CONFD_AZIMUTH_063_oRDR_DETECTION_061_064_oPCAN_RADAR_7597e915_Tx: ComBitPosition=342, ComBitSize=2, ComSignalInitValue=0, ComSignalType=UINT8, ComHandleId=1324, ComSystemTemplateSystemSignalRef=DET_CONFD_AZIMUTH_063
            DET_EXISTENCE_PROB_062_oRDR_DETECTION_061_064_oPCAN_RADAR_66140553_Tx: ComBitPosition=224, ComBitSize=6, ComSignalInitValue=0, ComSignalType=UINT8, ComHandleId=1339, ComSystemTemplateSystemSignalRef=DET_EXISTENCE_PROB_062
            DET_CONFD_AZIMUTH_062_oRDR_DETECTION_061_064_oPCAN_RADAR_e0e73d80_Tx: ComBitPosition=230, ComBitSize=2, ComSignalInitValue=0, ComSignalType=UINT8, ComHandleId=1323, ComSystemTemplateSystemSignalRef=DET_CONFD_AZIMUTH_062
            DET_AZIMUTH_ERR_063_oRDR_DETECTION_061_064_oPCAN_RADAR_d3c4762a_Tx: ComBitPosition=329, ComBitSize=7, ComSignalInitValue=0, ComSignalType=UINT8, ComHandleId=1312, ComSystemTemplateSystemSignalRef=DET_AZIMUTH_ERR_063
            DET_EXISTENCE_PROB_064_oRDR_DETECTION_061_064_oPCAN_RADAR_afd4f2af_Tx: ComBitPosition=448, ComBitSize=6, ComSignalInitValue=0, ComSignalType=UINT8, ComHandleId=1341, ComSystemTemplateSystemSignalRef=DET_EXISTENCE_PROB_064
            DET_IDM_061_oRDR_DETECTION_061_064_oPCAN_RADAR_68d2066f_Tx: ComBitPosition=63, ComBitSize=1, ComSignalInitValue=0, ComSignalType=UINT8, ComHandleId=1346, ComSystemTemplateSystemSignalRef=DET_IDM_061
            DET_BELOW_RAIN_THOLD_062_oRDR_DETECTION_061_064_oPCAN_RADAR_3700a48a_Tx: ComBitPosition=151, ComBitSize=1, ComSignalInitValue=0, ComSignalType=UINT8, ComHandleId=1315, ComSystemTemplateSystemSignalRef=DET_BELOW_RAIN_THOLD_062
            DET_IDM_062_oRDR_DETECTION_061_064_oPCAN_RADAR_0c327d91_Tx: ComBitPosition=175, ComBitSize=1, ComSignalInitValue=0, ComSignalType=UINT8, ComHandleId=1347, ComSystemTemplateSystemSignalRef=DET_IDM_062
            DET_BELOW_RAIN_THOLD_064_oRDR_DETECTION_061_064_oPCAN_RADAR_fec05376_Tx: ComBitPosition=375, ComBitSize=1, ComSignalInitValue=0, ComSignalType=UINT8, ComHandleId=1317, ComSystemTemplateSystemSignalRef=DET_BELOW_RAIN_THOLD_064
            DET_PROB_1STAZHYPO_062_oRDR_DETECTION_061_064_oPCAN_RADAR_f935a787_Tx: ComBitPosition=215, ComBitSize=1, ComSignalInitValue=0, ComSignalType=BOOLEAN, ComHandleId=1358, ComSystemTemplateSystemSignalRef=DET_PROB_1STAZHYPO_062
            DET_MTD_063_oRDR_DETECTION_061_064_oPCAN_RADAR_fff19bdf_Tx: ComBitPosition=271, ComBitSize=1, ComSignalInitValue=0, ComSignalType=UINT8, ComHandleId=1355, ComSystemTemplateSystemSignalRef=DET_MTD_063
            DET_IDM_063_oRDR_DETECTION_061_064_oPCAN_RADAR_9942a904_Tx: ComBitPosition=287, ComBitSize=1, ComSignalInitValue=0, ComSignalType=UINT8, ComHandleId=1348, ComSystemTemplateSystemSignalRef=DET_IDM_063
            DET_MTD_064_oRDR_DETECTION_061_064_oPCAN_RADAR_a341b8b6_Tx: ComBitPosition=383, ComBitSize=1, ComSignalInitValue=0, ComSignalType=UINT8, ComHandleId=1356, ComSystemTemplateSystemSignalRef=DET_MTD_064
            DET_PROB_1STAZHYPO_061_oRDR_DETECTION_061_064_oPCAN_RADAR_9dd5dc79_Tx: ComBitPosition=103, ComBitSize=1, ComSignalInitValue=0, ComSignalType=BOOLEAN, ComHandleId=1357, ComSystemTemplateSystemSignalRef=DET_PROB_1STAZHYPO_061
            DET_MTD_061_oRDR_DETECTION_061_064_oPCAN_RADAR_0e6134b4_Tx: ComBitPosition=47, ComBitSize=1, ComSignalInitValue=0, ComSignalType=UINT8, ComHandleId=1353, ComSystemTemplateSystemSignalRef=DET_MTD_061
            DET_BELOW_RAIN_THOLD_063_oRDR_DETECTION_061_064_oPCAN_RADAR_a270701f_Tx: ComBitPosition=263, ComBitSize=1, ComSignalInitValue=0, ComSignalType=UINT8, ComHandleId=1316, ComSystemTemplateSystemSignalRef=DET_BELOW_RAIN_THOLD_063
            DET_MTD_062_oRDR_DETECTION_061_064_oPCAN_RADAR_6a814f4a_Tx: ComBitPosition=159, ComBitSize=1, ComSignalInitValue=0, ComSignalType=UINT8, ComHandleId=1354, ComSystemTemplateSystemSignalRef=DET_MTD_062
            DET_PROB_1STAZHYPO_063_oRDR_DETECTION_061_064_oPCAN_RADAR_6c457312_Tx: ComBitPosition=327, ComBitSize=1, ComSignalInitValue=0, ComSignalType=BOOLEAN, ComHandleId=1359, ComSystemTemplateSystemSignalRef=DET_PROB_1STAZHYPO_063
            DET_IDM_064_oRDR_DETECTION_061_064_oPCAN_RADAR_c5f28a6d_Tx: ComBitPosition=399, ComBitSize=1, ComSignalInitValue=0, ComSignalType=UINT8, ComHandleId=1349, ComSystemTemplateSystemSignalRef=DET_IDM_064
            DET_PROB_1STAZHYPO_064_oRDR_DETECTION_061_064_oPCAN_RADAR_30f5507b_Tx: ComBitPosition=439, ComBitSize=1, ComSignalInitValue=0, ComSignalType=BOOLEAN, ComHandleId=1360, ComSystemTemplateSystemSignalRef=DET_PROB_1STAZHYPO_064
            DET_BELOW_RAIN_THOLD_061_oRDR_DETECTION_061_064_oPCAN_RADAR_53e0df74_Tx: ComBitPosition=39, ComBitSize=1, ComSignalInitValue=0, ComSignalType=UINT8, ComHandleId=1314, ComSystemTemplateSystemSignalRef=DET_BELOW_RAIN_THOLD_061
        SG_Detections_341_344_oRDR_DETECTION_341_344_oPCAN_RADAR_725bb2c5_Tx: ComTransferProperty=TRIGGERED, ComHandleId=87, ComSystemTemplateSignalGroupRef=SG_Detections_341_344
          83 x ComGroupSignal, all with ComSignalEndianness=LITTLE_ENDIAN, ComTransferProperty=PENDING, ComSignalAccess=ACCESS_NEEDED_BY_SWC_OR_COM:
            DET_RANGE_VELOCITY_341_oRDR_DETECTION_341_344_oPCAN_RADAR_223496cc_Tx: ComBitPosition=48, ComBitSize=15, ComSignalInitValue=16384, ComSignalType=UINT16, ComHandleId=7179, ComSystemTemplateSystemSignalRef=DET_RANGE_VELOCITY_341
            DET_RANGE_ERR_344_oRDR_DETECTION_341_344_oPCAN_RADAR_5d5a6282_Tx: ComBitPosition=376, ComBitSize=7, ComSignalInitValue=0, ComSignalType=UINT8, ComHandleId=7178, ComSystemTemplateSystemSignalRef=DET_RANGE_ERR_344
            DET_RCS_342_oRDR_DETECTION_341_344_oPCAN_RADAR_c154da68_Tx: ComBitPosition=240, ComBitSize=8, ComSignalInitValue=128, ComSignalType=UINT8, ComHandleId=7188, ComSystemTemplateSystemSignalRef=DET_RCS_342
            DET_RANGE_VELOCITY_344_oRDR_DETECTION_341_344_oPCAN_RADAR_8f141ace_Tx: ComBitPosition=384, ComBitSize=15, ComSignalInitValue=16384, ComSignalType=UINT16, ComHandleId=7182, ComSystemTemplateSystemSignalRef=DET_RANGE_VELOCITY_344
            DET_ELEVATION_ERR_342_oRDR_DETECTION_341_344_oPCAN_RADAR_75631bd5_Tx: ComBitPosition=192, ComBitSize=6, ComSignalInitValue=0, ComSignalType=UINT8, ComHandleId=7145, ComSystemTemplateSystemSignalRef=DET_ELEVATION_ERR_342
            DET_RANGE_341_oRDR_DETECTION_341_344_oPCAN_RADAR_579254e9_Tx: ComBitPosition=24, ComBitSize=15, ComSignalInitValue=0, ComSignalType=UINT16, ComHandleId=7171, ComSystemTemplateSystemSignalRef=DET_RANGE_341
            DET_SNR_344_oRDR_DETECTION_341_344_oPCAN_RADAR_d53a7996_Tx: ComBitPosition=456, ComBitSize=8, ComSignalInitValue=0, ComSignalType=UINT8, ComHandleId=7194, ComSystemTemplateSystemSignalRef=DET_SNR_344
            DET_AZIMUTH_344_oRDR_DETECTION_341_344_oPCAN_RADAR_ea29ab50_Tx: ComBitPosition=424, ComBitSize=13, ComSignalInitValue=0, ComSignalType=UINT16, ComHandleId=7119, ComSystemTemplateSystemSignalRef=DET_AZIMUTH_344
            DET_CONFD_ELEVATION_343_oRDR_DETECTION_341_344_oPCAN_RADAR_b6ea8309_Tx: ComBitPosition=325, ComBitSize=2, ComSignalInitValue=0, ComSignalType=UINT8, ComHandleId=7138, ComSystemTemplateSystemSignalRef=DET_CONFD_ELEVATION_343
            DET_AZIMUTH_ERR_341_oRDR_DETECTION_341_344_oPCAN_RADAR_e3bcb2a7_Tx: ComBitPosition=105, ComBitSize=7, ComSignalInitValue=0, ComSignalType=UINT8, ComHandleId=7120, ComSystemTemplateSystemSignalRef=DET_AZIMUTH_ERR_341
            DET_MH_CRC16_341_344_oRDR_DETECTION_341_344_oPCAN_RADAR_f6d360ce_Tx: ComBitPosition=0, ComBitSize=16, ComSignalInitValue=0, ComSignalType=UINT16, ComHandleId=7160, ComSystemTemplateSystemSignalRef=DET_MH_CRC16_341_344
            DET_CONFD_AZIMUTH_342_oRDR_DETECTION_341_344_oPCAN_RADAR_210f5666_Tx: ComBitPosition=230, ComBitSize=2, ComSignalInitValue=0, ComSignalType=UINT8, ComHandleId=7133, ComSystemTemplateSystemSignalRef=DET_CONFD_AZIMUTH_342
            DET_EXISTENCE_PROB_344_oRDR_DETECTION_341_344_oPCAN_RADAR_6e3c9949_Tx: ComBitPosition=448, ComBitSize=6, ComSignalInitValue=0, ComSignalType=UINT8, ComHandleId=7151, ComSystemTemplateSystemSignalRef=DET_EXISTENCE_PROB_344
            DET_ELEVATION_ERR_341_oRDR_DETECTION_341_344_oPCAN_RADAR_1183602b_Tx: ComBitPosition=80, ComBitSize=6, ComSignalInitValue=0, ComSignalType=UINT8, ComHandleId=7144, ComSystemTemplateSystemSignalRef=DET_ELEVATION_ERR_341
            DET_BI_STATIC_FLAG_343_oRDR_DETECTION_341_344_oPCAN_RADAR_e0b5c8bc_Tx: ComBitPosition=328, ComBitSize=1, ComSignalInitValue=0, ComSignalType=BOOLEAN, ComHandleId=7130, ComSystemTemplateSystemSignalRef=DET_BI_STATIC_FLAG_343
            DET_RANGE_344_oRDR_DETECTION_341_344_oPCAN_RADAR_fab2d8eb_Tx: ComBitPosition=360, ComBitSize=15, ComSignalInitValue=0, ComSignalType=UINT16, ComHandleId=7174, ComSystemTemplateSystemSignalRef=DET_RANGE_344
            DET_AZIMUTH_ERR_342_oRDR_DETECTION_341_344_oPCAN_RADAR_875cc959_Tx: ComBitPosition=217, ComBitSize=7, ComSignalInitValue=0, ComSignalType=UINT8, ComHandleId=7121, ComSystemTemplateSystemSignalRef=DET_AZIMUTH_ERR_342
            DET_AZIMUTH_341_oRDR_DETECTION_341_344_oPCAN_RADAR_47092752_Tx: ComBitPosition=88, ComBitSize=13, ComSignalInitValue=0, ComSignalType=UINT16, ComHandleId=7116, ComSystemTemplateSystemSignalRef=DET_AZIMUTH_341
            DET_ELEVATION_342_oRDR_DETECTION_341_344_oPCAN_RADAR_f25a83a0_Tx: ComBitPosition=184, ComBitSize=8, ComSignalInitValue=0, ComSignalType=UINT8, ComHandleId=7141, ComSystemTemplateSystemSignalRef=DET_ELEVATION_342
            DET_SNR_341_oRDR_DETECTION_341_344_oPCAN_RADAR_781af594_Tx: ComBitPosition=120, ComBitSize=8, ComSignalInitValue=0, ComSignalType=UINT8, ComHandleId=7191, ComSystemTemplateSystemSignalRef=DET_SNR_341
            DET_RANGE_VELOCITY_ERR_343_oRDR_DETECTION_341_344_oPCAN_RADAR_dc1fc215_Tx: ComBitPosition=288, ComBitSize=8, ComSignalInitValue=0, ComSignalType=UINT8, ComHandleId=7185, ComSystemTemplateSystemSignalRef=DET_RANGE_VELOCITY_ERR_343
            DET_CONFD_ELEVATION_341_oRDR_DETECTION_341_344_oPCAN_RADAR_477a2c62_Tx: ComBitPosition=101, ComBitSize=2, ComSignalInitValue=0, ComSignalType=UINT8, ComHandleId=7136, ComSystemTemplateSystemSignalRef=DET_CONFD_ELEVATION_341
            DET_RANGE_VELOCITY_ERR_341_oRDR_DETECTION_341_344_oPCAN_RADAR_2d8f6d7e_Tx: ComBitPosition=64, ComBitSize=8, ComSignalInitValue=0, ComSignalType=UINT8, ComHandleId=7183, ComSystemTemplateSystemSignalRef=DET_RANGE_VELOCITY_ERR_341
            DET_RANGE_VELOCITY_ERR_344_oRDR_DETECTION_341_344_oPCAN_RADAR_80afe17c_Tx: ComBitPosition=400, ComBitSize=8, ComSignalInitValue=0, ComSignalType=UINT8, ComHandleId=7186, ComSystemTemplateSystemSignalRef=DET_RANGE_VELOCITY_ERR_344
            DET_AZIMUTH_ERR_343_oRDR_DETECTION_341_344_oPCAN_RADAR_122c1dcc_Tx: ComBitPosition=329, ComBitSize=7, ComSignalInitValue=0, ComSignalType=UINT8, ComHandleId=7122, ComSystemTemplateSystemSignalRef=DET_AZIMUTH_ERR_343
            DET_ELEVATION_344_oRDR_DETECTION_341_344_oPCAN_RADAR_3b9a745c_Tx: ComBitPosition=408, ComBitSize=8, ComSignalInitValue=0, ComSignalType=UINT8, ComHandleId=7143, ComSystemTemplateSystemSignalRef=DET_ELEVATION_344
            DET_BI_STATIC_FLAG_341_oRDR_DETECTION_341_344_oPCAN_RADAR_112567d7_Tx: ComBitPosition=104, ComBitSize=1, ComSignalInitValue=0, ComSignalType=BOOLEAN, ComHandleId=7128, ComSystemTemplateSystemSignalRef=DET_BI_STATIC_FLAG_341
            DET_MH_CYCLE_COUNTER_341_344_oRDR_DETECTION_341_344_oPCAN_RADAR_72a6c1f9_Tx: ComBitPosition=16, ComBitSize=8, ComSignalInitValue=0, ComSignalType=UINT8, ComHandleId=7161, ComSystemTemplateSystemSignalRef=DET_MH_CYCLE_COUNTER_341_344
            DET_HVC_FLAG_342_oRDR_DETECTION_341_344_oPCAN_RADAR_46882dca_Tx: ComBitPosition=198, ComBitSize=1, ComSignalInitValue=0, ComSignalType=BOOLEAN, ComHandleId=7153, ComSystemTemplateSystemSignalRef=DET_HVC_FLAG_342
            DET_CONFD_AZIMUTH_341_oRDR_DETECTION_341_344_oPCAN_RADAR_45ef2d98_Tx: ComBitPosition=118, ComBitSize=2, ComSignalInitValue=0, ComSignalType=UINT8, ComHandleId=7132, ComSystemTemplateSystemSignalRef=DET_CONFD_AZIMUTH_341
            DET_SUPER_RES_TARGET_344_oRDR_DETECTION_341_344_oPCAN_RADAR_e4a351f3_Tx: ComBitPosition=423, ComBitSize=1, ComSignalInitValue=0, ComSignalType=BOOLEAN, ComHandleId=7198, ComSystemTemplateSystemSignalRef=DET_SUPER_RES_TARGET_344
            DET_ELEVATION_ERR_344_oRDR_DETECTION_341_344_oPCAN_RADAR_bca3ec29_Tx: ComBitPosition=416, ComBitSize=6, ComSignalInitValue=0, ComSignalType=UINT8, ComHandleId=7147, ComSystemTemplateSystemSignalRef=DET_ELEVATION_ERR_344
            DET_SNR_343_oRDR_DETECTION_341_344_oPCAN_RADAR_898a5aff_Tx: ComBitPosition=344, ComBitSize=8, ComSignalInitValue=0, ComSignalType=UINT8, ComHandleId=7193, ComSystemTemplateSystemSignalRef=DET_SNR_343
            DET_CONFD_ELEVATION_344_oRDR_DETECTION_341_344_oPCAN_RADAR_ea5aa060_Tx: ComBitPosition=437, ComBitSize=2, ComSignalInitValue=0, ComSignalType=UINT8, ComHandleId=7139, ComSystemTemplateSystemSignalRef=DET_CONFD_ELEVATION_344
            DET_RANGE_342_oRDR_DETECTION_341_344_oPCAN_RADAR_33722f17_Tx: ComBitPosition=136, ComBitSize=15, ComSignalInitValue=0, ComSignalType=UINT16, ComHandleId=7172, ComSystemTemplateSystemSignalRef=DET_RANGE_342
            DET_SNR_342_oRDR_DETECTION_341_344_oPCAN_RADAR_1cfa8e6a_Tx: ComBitPosition=232, ComBitSize=8, ComSignalInitValue=0, ComSignalType=UINT8, ComHandleId=7192, ComSystemTemplateSystemSignalRef=DET_SNR_342
            DET_HVC_FLAG_343_oRDR_DETECTION_341_344_oPCAN_RADAR_d3f8f95f_Tx: ComBitPosition=310, ComBitSize=1, ComSignalInitValue=0, ComSignalType=BOOLEAN, ComHandleId=7154, ComSystemTemplateSystemSignalRef=DET_HVC_FLAG_343
            DET_RANGE_VELOCITY_342_oRDR_DETECTION_341_344_oPCAN_RADAR_46d4ed32_Tx: ComBitPosition=160, ComBitSize=15, ComSignalInitValue=16384, ComSignalType=UINT16, ComHandleId=7180, ComSystemTemplateSystemSignalRef=DET_RANGE_VELOCITY_342
            DET_RANGE_343_oRDR_DETECTION_341_344_oPCAN_RADAR_a602fb82_Tx: ComBitPosition=248, ComBitSize=15, ComSignalInitValue=0, ComSignalType=UINT16, ComHandleId=7173, ComSystemTemplateSystemSignalRef=DET_RANGE_343
            DET_RANGE_ERR_343_oRDR_DETECTION_341_344_oPCAN_RADAR_01ea41eb_Tx: ComBitPosition=264, ComBitSize=7, ComSignalInitValue=0, ComSignalType=UINT8, ComHandleId=7177, ComSystemTemplateSystemSignalRef=DET_RANGE_ERR_343
            DET_ELEVATION_341_oRDR_DETECTION_341_344_oPCAN_RADAR_96baf85e_Tx: ComBitPosition=72, ComBitSize=8, ComSignalInitValue=0, ComSignalType=UINT8, ComHandleId=7140, ComSystemTemplateSystemSignalRef=DET_ELEVATION_341
            DET_RCS_343_oRDR_DETECTION_341_344_oPCAN_RADAR_54240efd_Tx: ComBitPosition=352, ComBitSize=8, ComSignalInitValue=128, ComSignalType=UINT8, ComHandleId=7189, ComSystemTemplateSystemSignalRef=DET_RCS_343
            DET_BI_STATIC_FLAG_342_oRDR_DETECTION_341_344_oPCAN_RADAR_75c51c29_Tx: ComBitPosition=216, ComBitSize=1, ComSignalInitValue=0, ComSignalType=BOOLEAN, ComHandleId=7129, ComSystemTemplateSystemSignalRef=DET_BI_STATIC_FLAG_342
            DET_CONFD_AZIMUTH_343_oRDR_DETECTION_341_344_oPCAN_RADAR_b47f82f3_Tx: ComBitPosition=342, ComBitSize=2, ComSignalInitValue=0, ComSignalType=UINT8, ComHandleId=7134, ComSystemTemplateSystemSignalRef=DET_CONFD_AZIMUTH_343
            DET_SUPER_RES_TARGET_341_oRDR_DETECTION_341_344_oPCAN_RADAR_4983ddf1_Tx: ComBitPosition=87, ComBitSize=1, ComSignalInitValue=0, ComSignalType=BOOLEAN, ComHandleId=7195, ComSystemTemplateSystemSignalRef=DET_SUPER_RES_TARGET_341
            DET_MH_SCAN_INDEX_4LSB_341_344_oRDR_DETECTION_341_344_oPCAN_RADAR_be8ce475_Tx: ComBitPosition=476, ComBitSize=4, ComSignalInitValue=0, ComSignalType=UINT8, ComHandleId=7162, ComSystemTemplateSystemSignalRef=DET_MH_SCAN_INDEX_4LSB_341_344
            DET_RCS_341_oRDR_DETECTION_341_344_oPCAN_RADAR_a5b4a196_Tx: ComBitPosition=128, ComBitSize=8, ComSignalInitValue=128, ComSignalType=UINT8, ComHandleId=7187, ComSystemTemplateSystemSignalRef=DET_RCS_341
            DET_EXISTENCE_PROB_342_oRDR_DETECTION_341_344_oPCAN_RADAR_a7fc6eb5_Tx: ComBitPosition=224, ComBitSize=6, ComSignalInitValue=0, ComSignalType=UINT8, ComHandleId=7149, ComSystemTemplateSystemSignalRef=DET_EXISTENCE_PROB_342
            DET_ELEVATION_ERR_343_oRDR_DETECTION_341_344_oPCAN_RADAR_e013cf40_Tx: ComBitPosition=304, ComBitSize=6, ComSignalInitValue=0, ComSignalType=UINT8, ComHandleId=7146, ComSystemTemplateSystemSignalRef=DET_ELEVATION_ERR_343
            DET_BI_STATIC_FLAG_344_oRDR_DETECTION_341_344_oPCAN_RADAR_bc05ebd5_Tx: ComBitPosition=440, ComBitSize=1, ComSignalInitValue=0, ComSignalType=BOOLEAN, ComHandleId=7131, ComSystemTemplateSystemSignalRef=DET_BI_STATIC_FLAG_344
            DET_SUPER_RES_TARGET_343_oRDR_DETECTION_341_344_oPCAN_RADAR_b813729a_Tx: ComBitPosition=311, ComBitSize=1, ComSignalInitValue=0, ComSignalType=BOOLEAN, ComHandleId=7197, ComSystemTemplateSystemSignalRef=DET_SUPER_RES_TARGET_343
            DET_RANGE_VELOCITY_343_oRDR_DETECTION_341_344_oPCAN_RADAR_d3a439a7_Tx: ComBitPosition=272, ComBitSize=15, ComSignalInitValue=16384, ComSignalType=UINT16, ComHandleId=7181, ComSystemTemplateSystemSignalRef=DET_RANGE_VELOCITY_343
            DET_EXISTENCE_PROB_341_oRDR_DETECTION_341_344_oPCAN_RADAR_c31c154b_Tx: ComBitPosition=112, ComBitSize=6, ComSignalInitValue=0, ComSignalType=UINT8, ComHandleId=7148, ComSystemTemplateSystemSignalRef=DET_EXISTENCE_PROB_341
            DET_RANGE_ERR_342_oRDR_DETECTION_341_344_oPCAN_RADAR_949a957e_Tx: ComBitPosition=152, ComBitSize=7, ComSignalInitValue=0, ComSignalType=UINT8, ComHandleId=7176, ComSystemTemplateSystemSignalRef=DET_RANGE_ERR_342
            DET_SUPER_RES_TARGET_342_oRDR_DETECTION_341_344_oPCAN_RADAR_2d63a60f_Tx: ComBitPosition=199, ComBitSize=1, ComSignalInitValue=0, ComSignalType=BOOLEAN, ComHandleId=7196, ComSystemTemplateSystemSignalRef=DET_SUPER_RES_TARGET_342
            DET_AZIMUTH_343_oRDR_DETECTION_341_344_oPCAN_RADAR_b6998839_Tx: ComBitPosition=312, ComBitSize=13, ComSignalInitValue=0, ComSignalType=UINT16, ComHandleId=7118, ComSystemTemplateSystemSignalRef=DET_AZIMUTH_343
            DET_RANGE_ERR_341_oRDR_DETECTION_341_344_oPCAN_RADAR_f07aee80_Tx: ComBitPosition=40, ComBitSize=7, ComSignalInitValue=0, ComSignalType=UINT8, ComHandleId=7175, ComSystemTemplateSystemSignalRef=DET_RANGE_ERR_341
            DET_AZIMUTH_342_oRDR_DETECTION_341_344_oPCAN_RADAR_23e95cac_Tx: ComBitPosition=200, ComBitSize=13, ComSignalInitValue=0, ComSignalType=UINT16, ComHandleId=7117, ComSystemTemplateSystemSignalRef=DET_AZIMUTH_342
            DET_HVC_FLAG_341_oRDR_DETECTION_341_344_oPCAN_RADAR_22685634_Tx: ComBitPosition=86, ComBitSize=1, ComSignalInitValue=0, ComSignalType=BOOLEAN, ComHandleId=7152, ComSystemTemplateSystemSignalRef=DET_HVC_FLAG_341
            DET_CONFD_AZIMUTH_344_oRDR_DETECTION_341_344_oPCAN_RADAR_e8cfa19a_Tx: ComBitPosition=454, ComBitSize=2, ComSignalInitValue=0, ComSignalType=UINT8, ComHandleId=7135, ComSystemTemplateSystemSignalRef=DET_CONFD_AZIMUTH_344
            DET_EXISTENCE_PROB_343_oRDR_DETECTION_341_344_oPCAN_RADAR_328cba20_Tx: ComBitPosition=336, ComBitSize=6, ComSignalInitValue=0, ComSignalType=UINT8, ComHandleId=7150, ComSystemTemplateSystemSignalRef=DET_EXISTENCE_PROB_343
            DET_HVC_FLAG_344_oRDR_DETECTION_341_344_oPCAN_RADAR_8f48da36_Tx: ComBitPosition=422, ComBitSize=1, ComSignalInitValue=0, ComSignalType=BOOLEAN, ComHandleId=7155, ComSystemTemplateSystemSignalRef=DET_HVC_FLAG_344
            DET_CONFD_ELEVATION_342_oRDR_DETECTION_341_344_oPCAN_RADAR_239a579c_Tx: ComBitPosition=213, ComBitSize=2, ComSignalInitValue=0, ComSignalType=UINT8, ComHandleId=7137, ComSystemTemplateSystemSignalRef=DET_CONFD_ELEVATION_342
            DET_ELEVATION_343_oRDR_DETECTION_341_344_oPCAN_RADAR_672a5735_Tx: ComBitPosition=296, ComBitSize=8, ComSignalInitValue=0, ComSignalType=UINT8, ComHandleId=7142, ComSystemTemplateSystemSignalRef=DET_ELEVATION_343
            DET_RCS_344_oRDR_DETECTION_341_344_oPCAN_RADAR_08942d94_Tx: ComBitPosition=464, ComBitSize=8, ComSignalInitValue=128, ComSignalType=UINT8, ComHandleId=7190, ComSystemTemplateSystemSignalRef=DET_RCS_344
            DET_AZIMUTH_ERR_344_oRDR_DETECTION_341_344_oPCAN_RADAR_4e9c3ea5_Tx: ComBitPosition=441, ComBitSize=7, ComSignalInitValue=0, ComSignalType=UINT8, ComHandleId=7123, ComSystemTemplateSystemSignalRef=DET_AZIMUTH_ERR_344
            DET_RANGE_VELOCITY_ERR_342_oRDR_DETECTION_341_344_oPCAN_RADAR_496f1680_Tx: ComBitPosition=176, ComBitSize=8, ComSignalInitValue=0, ComSignalType=UINT8, ComHandleId=7184, ComSystemTemplateSystemSignalRef=DET_RANGE_VELOCITY_ERR_342
            DET_PROB_1STAZHYPO_341_oRDR_DETECTION_341_344_oPCAN_RADAR_5c3db79f_Tx: ComBitPosition=103, ComBitSize=1, ComSignalInitValue=0, ComSignalType=BOOLEAN, ComHandleId=7167, ComSystemTemplateSystemSignalRef=DET_PROB_1STAZHYPO_341
            DET_PROB_1STAZHYPO_343_oRDR_DETECTION_341_344_oPCAN_RADAR_adad18f4_Tx: ComBitPosition=327, ComBitSize=1, ComSignalInitValue=0, ComSignalType=BOOLEAN, ComHandleId=7169, ComSystemTemplateSystemSignalRef=DET_PROB_1STAZHYPO_343
            DET_BELOW_RAIN_THOLD_342_oRDR_DETECTION_341_344_oPCAN_RADAR_f6e8cf6c_Tx: ComBitPosition=151, ComBitSize=1, ComSignalInitValue=0, ComSignalType=UINT8, ComHandleId=7125, ComSystemTemplateSystemSignalRef=DET_BELOW_RAIN_THOLD_342
            DET_MTD_342_oRDR_DETECTION_341_344_oPCAN_RADAR_ab6924ac_Tx: ComBitPosition=159, ComBitSize=1, ComSignalInitValue=0, ComSignalType=UINT8, ComHandleId=7164, ComSystemTemplateSystemSignalRef=DET_MTD_342
            DET_PROB_1STAZHYPO_344_oRDR_DETECTION_341_344_oPCAN_RADAR_f11d3b9d_Tx: ComBitPosition=439, ComBitSize=1, ComSignalInitValue=0, ComSignalType=BOOLEAN, ComHandleId=7170, ComSystemTemplateSystemSignalRef=DET_PROB_1STAZHYPO_344
            DET_IDM_342_oRDR_DETECTION_341_344_oPCAN_RADAR_cdda1677_Tx: ComBitPosition=175, ComBitSize=1, ComSignalInitValue=0, ComSignalType=UINT8, ComHandleId=7157, ComSystemTemplateSystemSignalRef=DET_IDM_342
            DET_IDM_344_oRDR_DETECTION_341_344_oPCAN_RADAR_041ae18b_Tx: ComBitPosition=399, ComBitSize=1, ComSignalInitValue=0, ComSignalType=UINT8, ComHandleId=7159, ComSystemTemplateSystemSignalRef=DET_IDM_344
            DET_MTD_343_oRDR_DETECTION_341_344_oPCAN_RADAR_3e19f039_Tx: ComBitPosition=271, ComBitSize=1, ComSignalInitValue=0, ComSignalType=UINT8, ComHandleId=7165, ComSystemTemplateSystemSignalRef=DET_MTD_343
            DET_MTD_341_oRDR_DETECTION_341_344_oPCAN_RADAR_cf895f52_Tx: ComBitPosition=47, ComBitSize=1, ComSignalInitValue=0, ComSignalType=UINT8, ComHandleId=7163, ComSystemTemplateSystemSignalRef=DET_MTD_341
            DET_PROB_1STAZHYPO_342_oRDR_DETECTION_341_344_oPCAN_RADAR_38ddcc61_Tx: ComBitPosition=215, ComBitSize=1, ComSignalInitValue=0, ComSignalType=BOOLEAN, ComHandleId=7168, ComSystemTemplateSystemSignalRef=DET_PROB_1STAZHYPO_342
            DET_BELOW_RAIN_THOLD_344_oRDR_DETECTION_341_344_oPCAN_RADAR_3f283890_Tx: ComBitPosition=375, ComBitSize=1, ComSignalInitValue=0, ComSignalType=UINT8, ComHandleId=7127, ComSystemTemplateSystemSignalRef=DET_BELOW_RAIN_THOLD_344
            DET_BELOW_RAIN_THOLD_341_oRDR_DETECTION_341_344_oPCAN_RADAR_9208b492_Tx: ComBitPosition=39, ComBitSize=1, ComSignalInitValue=0, ComSignalType=UINT8, ComHandleId=7124, ComSystemTemplateSystemSignalRef=DET_BELOW_RAIN_THOLD_341
            DET_BELOW_RAIN_THOLD_343_oRDR_DETECTION_341_344_oPCAN_RADAR_63981bf9_Tx: ComBitPosition=263, ComBitSize=1, ComSignalInitValue=0, ComSignalType=UINT8, ComHandleId=7126, ComSystemTemplateSystemSignalRef=DET_BELOW_RAIN_THOLD_343
            DET_MTD_344_oRDR_DETECTION_341_344_oPCAN_RADAR_62a9d350_Tx: ComBitPosition=383, ComBitSize=1, ComSignalInitValue=0, ComSignalType=UINT8, ComHandleId=7166, ComSystemTemplateSystemSignalRef=DET_MTD_344
            DET_IDM_343_oRDR_DETECTION_341_344_oPCAN_RADAR_58aac2e2_Tx: ComBitPosition=287, ComBitSize=1, ComSignalInitValue=0, ComSignalType=UINT8, ComHandleId=7158, ComSystemTemplateSystemSignalRef=DET_IDM_343
            DET_IDM_341_oRDR_DETECTION_341_344_oPCAN_RADAR_a93a6d89_Tx: ComBitPosition=63, ComBitSize=1, ComSignalInitValue=0, ComSignalType=UINT8, ComHandleId=7156, ComSystemTemplateSystemSignalRef=DET_IDM_341
