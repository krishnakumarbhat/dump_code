[part 10 of 20: package /ActiveEcuC]
AUTOSAR XML (schema 00053)
package /ActiveEcuC  (continued)
  module config Com: implementation-config-variant=VARIANT-PRE-COMPILE, module-description=Com_Impl  (continued)
    ComConfig: ComConfigurationId=0, ComRxImmediateNotificationCacheSize=0, ComRxDeferredNotificationCacheSize=1  (continued)
      109 x ComSignalGroup, all with ComSignalGroupAccess=ACCESS_NEEDED_BY_SWC_OR_COM, ComSignalGroupArrayAccess=true:  (continued)
        SG_Detections_145_148_oRDR_DETECTION_145_148_oPCAN_RADAR_86c8c3ef_Tx: ComTransferProperty=TRIGGERED, ComHandleId=38, ComSystemTemplateSignalGroupRef=SG_Detections_145_148
          83 x ComGroupSignal, all with ComSignalEndianness=LITTLE_ENDIAN, ComTransferProperty=PENDING, ComSignalAccess=ACCESS_NEEDED_BY_SWC_OR_COM:
            DET_AZIMUTH_145_oRDR_DETECTION_145_148_oPCAN_RADAR_8ab9ab14_Tx: ComBitPosition=88, ComBitSize=13, ComSignalInitValue=0, ComSignalType=UINT16, ComHandleId=3049, ComSystemTemplateSystemSignalRef=DET_AZIMUTH_145
            DET_AZIMUTH_ERR_145_oRDR_DETECTION_145_148_oPCAN_RADAR_2e0c3ee1_Tx: ComBitPosition=105, ComBitSize=7, ComSignalInitValue=0, ComSignalType=UINT8, ComHandleId=3053, ComSystemTemplateSystemSignalRef=DET_AZIMUTH_ERR_145
            DET_SNR_148_oRDR_DETECTION_145_148_oPCAN_RADAR_682a44fe_Tx: ComBitPosition=456, ComBitSize=8, ComSignalInitValue=0, ComSignalType=UINT8, ComHandleId=3127, ComSystemTemplateSystemSignalRef=DET_SNR_148
            DET_MH_SCAN_INDEX_4LSB_145_148_oRDR_DETECTION_145_148_oPCAN_RADAR_4a1f955f_Tx: ComBitPosition=476, ComBitSize=4, ComSignalInitValue=0, ComSignalType=UINT8, ComHandleId=3095, ComSystemTemplateSystemSignalRef=DET_MH_SCAN_INDEX_4LSB_145_148
            DET_CONFD_AZIMUTH_147_oRDR_DETECTION_145_148_oPCAN_RADAR_79cf0eb5_Tx: ComBitPosition=342, ComBitSize=2, ComSignalInitValue=0, ComSignalType=UINT8, ComHandleId=3067, ComSystemTemplateSystemSignalRef=DET_CONFD_AZIMUTH_147
            DET_HVC_FLAG_146_oRDR_DETECTION_145_148_oPCAN_RADAR_8b38a18c_Tx: ComBitPosition=198, ComBitSize=1, ComSignalInitValue=0, ComSignalType=BOOLEAN, ComHandleId=3086, ComSystemTemplateSystemSignalRef=DET_HVC_FLAG_146
            DET_AZIMUTH_147_oRDR_DETECTION_145_148_oPCAN_RADAR_7b29047f_Tx: ComBitPosition=312, ComBitSize=13, ComSignalInitValue=0, ComSignalType=UINT16, ComHandleId=3051, ComSystemTemplateSystemSignalRef=DET_AZIMUTH_147
            DET_CONFD_ELEVATION_147_oRDR_DETECTION_145_148_oPCAN_RADAR_7b5a0f4f_Tx: ComBitPosition=325, ComBitSize=2, ComSignalInitValue=0, ComSignalType=UINT8, ComHandleId=3071, ComSystemTemplateSystemSignalRef=DET_CONFD_ELEVATION_147
            DET_HVC_FLAG_145_oRDR_DETECTION_145_148_oPCAN_RADAR_efd8da72_Tx: ComBitPosition=86, ComBitSize=1, ComSignalInitValue=0, ComSignalType=BOOLEAN, ComHandleId=3085, ComSystemTemplateSystemSignalRef=DET_HVC_FLAG_145
            DET_AZIMUTH_148_oRDR_DETECTION_145_148_oPCAN_RADAR_57399638_Tx: ComBitPosition=424, ComBitSize=13, ComSignalInitValue=0, ComSignalType=UINT16, ComHandleId=3052, ComSystemTemplateSystemSignalRef=DET_AZIMUTH_148
            DET_RCS_145_oRDR_DETECTION_145_148_oPCAN_RADAR_68042dd0_Tx: ComBitPosition=128, ComBitSize=8, ComSignalInitValue=128, ComSignalType=UINT8, ComHandleId=3120, ComSystemTemplateSystemSignalRef=DET_RCS_145
            DET_BI_STATIC_FLAG_148_oRDR_DETECTION_145_148_oPCAN_RADAR_0115d6bd_Tx: ComBitPosition=440, ComBitSize=1, ComSignalInitValue=0, ComSignalType=BOOLEAN, ComHandleId=3064, ComSystemTemplateSystemSignalRef=DET_BI_STATIC_FLAG_148
            DET_RANGE_146_oRDR_DETECTION_145_148_oPCAN_RADAR_fec2a351_Tx: ComBitPosition=136, ComBitSize=15, ComSignalInitValue=0, ComSignalType=UINT16, ComHandleId=3105, ComSystemTemplateSystemSignalRef=DET_RANGE_146
            DET_EXISTENCE_PROB_145_oRDR_DETECTION_145_148_oPCAN_RADAR_0eac990d_Tx: ComBitPosition=112, ComBitSize=6, ComSignalInitValue=0, ComSignalType=UINT8, ComHandleId=3081, ComSystemTemplateSystemSignalRef=DET_EXISTENCE_PROB_145
            DET_SUPER_RES_TARGET_147_oRDR_DETECTION_145_148_oPCAN_RADAR_75a3fedc_Tx: ComBitPosition=311, ComBitSize=1, ComSignalInitValue=0, ComSignalType=BOOLEAN, ComHandleId=3130, ComSystemTemplateSystemSignalRef=DET_SUPER_RES_TARGET_147
            DET_MH_CRC16_145_148_oRDR_DETECTION_145_148_oPCAN_RADAR_024011e4_Tx: ComBitPosition=0, ComBitSize=16, ComSignalInitValue=0, ComSignalType=UINT16, ComHandleId=3093, ComSystemTemplateSystemSignalRef=DET_MH_CRC16_145_148
            DET_RANGE_VELOCITY_146_oRDR_DETECTION_145_148_oPCAN_RADAR_8b646174_Tx: ComBitPosition=160, ComBitSize=15, ComSignalInitValue=16384, ComSignalType=UINT16, ComHandleId=3113, ComSystemTemplateSystemSignalRef=DET_RANGE_VELOCITY_146
            DET_RCS_147_oRDR_DETECTION_145_148_oPCAN_RADAR_999482bb_Tx: ComBitPosition=352, ComBitSize=8, ComSignalInitValue=128, ComSignalType=UINT8, ComHandleId=3122, ComSystemTemplateSystemSignalRef=DET_RCS_147
            DET_EXISTENCE_PROB_148_oRDR_DETECTION_145_148_oPCAN_RADAR_d32ca421_Tx: ComBitPosition=448, ComBitSize=6, ComSignalInitValue=0, ComSignalType=UINT8, ComHandleId=3084, ComSystemTemplateSystemSignalRef=DET_EXISTENCE_PROB_148
            DET_RANGE_ERR_145_oRDR_DETECTION_145_148_oPCAN_RADAR_3dca62c6_Tx: ComBitPosition=40, ComBitSize=7, ComSignalInitValue=0, ComSignalType=UINT8, ComHandleId=3108, ComSystemTemplateSystemSignalRef=DET_RANGE_ERR_145
            DET_EXISTENCE_PROB_146_oRDR_DETECTION_145_148_oPCAN_RADAR_6a4ce2f3_Tx: ComBitPosition=224, ComBitSize=6, ComSignalInitValue=0, ComSignalType=UINT8, ComHandleId=3082, ComSystemTemplateSystemSignalRef=DET_EXISTENCE_PROB_146
            DET_ELEVATION_147_oRDR_DETECTION_145_148_oPCAN_RADAR_aa9adb73_Tx: ComBitPosition=296, ComBitSize=8, ComSignalInitValue=0, ComSignalType=UINT8, ComHandleId=3075, ComSystemTemplateSystemSignalRef=DET_ELEVATION_147
            DET_RANGE_VELOCITY_ERR_146_oRDR_DETECTION_145_148_oPCAN_RADAR_84df9ac6_Tx: ComBitPosition=176, ComBitSize=8, ComSignalInitValue=0, ComSignalType=UINT8, ComHandleId=3117, ComSystemTemplateSystemSignalRef=DET_RANGE_VELOCITY_ERR_146
            DET_BI_STATIC_FLAG_145_oRDR_DETECTION_145_148_oPCAN_RADAR_dc95eb91_Tx: ComBitPosition=104, ComBitSize=1, ComSignalInitValue=0, ComSignalType=BOOLEAN, ComHandleId=3061, ComSystemTemplateSystemSignalRef=DET_BI_STATIC_FLAG_145
            DET_RANGE_VELOCITY_ERR_145_oRDR_DETECTION_145_148_oPCAN_RADAR_e03fe138_Tx: ComBitPosition=64, ComBitSize=8, ComSignalInitValue=0, ComSignalType=UINT8, ComHandleId=3116, ComSystemTemplateSystemSignalRef=DET_RANGE_VELOCITY_ERR_145
            DET_HVC_FLAG_147_oRDR_DETECTION_145_148_oPCAN_RADAR_1e487519_Tx: ComBitPosition=310, ComBitSize=1, ComSignalInitValue=0, ComSignalType=BOOLEAN, ComHandleId=3087, ComSystemTemplateSystemSignalRef=DET_HVC_FLAG_147
            DET_SNR_146_oRDR_DETECTION_145_148_oPCAN_RADAR_d14a022c_Tx: ComBitPosition=232, ComBitSize=8, ComSignalInitValue=0, ComSignalType=UINT8, ComHandleId=3125, ComSystemTemplateSystemSignalRef=DET_SNR_146
            DET_RANGE_148_oRDR_DETECTION_145_148_oPCAN_RADAR_47a2e583_Tx: ComBitPosition=360, ComBitSize=15, ComSignalInitValue=0, ComSignalType=UINT16, ComHandleId=3107, ComSystemTemplateSystemSignalRef=DET_RANGE_148
            DET_SUPER_RES_TARGET_145_oRDR_DETECTION_145_148_oPCAN_RADAR_843351b7_Tx: ComBitPosition=87, ComBitSize=1, ComSignalInitValue=0, ComSignalType=BOOLEAN, ComHandleId=3128, ComSystemTemplateSystemSignalRef=DET_SUPER_RES_TARGET_145
            DET_SUPER_RES_TARGET_146_oRDR_DETECTION_145_148_oPCAN_RADAR_e0d32a49_Tx: ComBitPosition=199, ComBitSize=1, ComSignalInitValue=0, ComSignalType=BOOLEAN, ComHandleId=3129, ComSystemTemplateSystemSignalRef=DET_SUPER_RES_TARGET_146
            DET_SUPER_RES_TARGET_148_oRDR_DETECTION_145_148_oPCAN_RADAR_59b36c9b_Tx: ComBitPosition=423, ComBitSize=1, ComSignalInitValue=0, ComSignalType=BOOLEAN, ComHandleId=3131, ComSystemTemplateSystemSignalRef=DET_SUPER_RES_TARGET_148
            DET_EXISTENCE_PROB_147_oRDR_DETECTION_145_148_oPCAN_RADAR_ff3c3666_Tx: ComBitPosition=336, ComBitSize=6, ComSignalInitValue=0, ComSignalType=UINT8, ComHandleId=3083, ComSystemTemplateSystemSignalRef=DET_EXISTENCE_PROB_147
            DET_AZIMUTH_146_oRDR_DETECTION_145_148_oPCAN_RADAR_ee59d0ea_Tx: ComBitPosition=200, ComBitSize=13, ComSignalInitValue=0, ComSignalType=UINT16, ComHandleId=3050, ComSystemTemplateSystemSignalRef=DET_AZIMUTH_146
            DET_CONFD_ELEVATION_146_oRDR_DETECTION_145_148_oPCAN_RADAR_ee2adbda_Tx: ComBitPosition=213, ComBitSize=2, ComSignalInitValue=0, ComSignalType=UINT8, ComHandleId=3070, ComSystemTemplateSystemSignalRef=DET_CONFD_ELEVATION_146
            DET_ELEVATION_148_oRDR_DETECTION_145_148_oPCAN_RADAR_868a4934_Tx: ComBitPosition=408, ComBitSize=8, ComSignalInitValue=0, ComSignalType=UINT8, ComHandleId=3076, ComSystemTemplateSystemSignalRef=DET_ELEVATION_148
            DET_RANGE_VELOCITY_147_oRDR_DETECTION_145_148_oPCAN_RADAR_1e14b5e1_Tx: ComBitPosition=272, ComBitSize=15, ComSignalInitValue=16384, ComSignalType=UINT16, ComHandleId=3114, ComSystemTemplateSystemSignalRef=DET_RANGE_VELOCITY_147
            DET_RANGE_ERR_146_oRDR_DETECTION_145_148_oPCAN_RADAR_592a1938_Tx: ComBitPosition=152, ComBitSize=7, ComSignalInitValue=0, ComSignalType=UINT8, ComHandleId=3109, ComSystemTemplateSystemSignalRef=DET_RANGE_ERR_146
            DET_RANGE_VELOCITY_ERR_147_oRDR_DETECTION_145_148_oPCAN_RADAR_11af4e53_Tx: ComBitPosition=288, ComBitSize=8, ComSignalInitValue=0, ComSignalType=UINT8, ComHandleId=3118, ComSystemTemplateSystemSignalRef=DET_RANGE_VELOCITY_ERR_147
            DET_AZIMUTH_ERR_147_oRDR_DETECTION_145_148_oPCAN_RADAR_df9c918a_Tx: ComBitPosition=329, ComBitSize=7, ComSignalInitValue=0, ComSignalType=UINT8, ComHandleId=3055, ComSystemTemplateSystemSignalRef=DET_AZIMUTH_ERR_147
            DET_ELEVATION_ERR_146_oRDR_DETECTION_145_148_oPCAN_RADAR_b8d39793_Tx: ComBitPosition=192, ComBitSize=6, ComSignalInitValue=0, ComSignalType=UINT8, ComHandleId=3078, ComSystemTemplateSystemSignalRef=DET_ELEVATION_ERR_146
            DET_RANGE_ERR_148_oRDR_DETECTION_145_148_oPCAN_RADAR_e04a5fea_Tx: ComBitPosition=376, ComBitSize=7, ComSignalInitValue=0, ComSignalType=UINT8, ComHandleId=3111, ComSystemTemplateSystemSignalRef=DET_RANGE_ERR_148
            DET_BI_STATIC_FLAG_147_oRDR_DETECTION_145_148_oPCAN_RADAR_2d0544fa_Tx: ComBitPosition=328, ComBitSize=1, ComSignalInitValue=0, ComSignalType=BOOLEAN, ComHandleId=3063, ComSystemTemplateSystemSignalRef=DET_BI_STATIC_FLAG_147
            DET_RANGE_VELOCITY_148_oRDR_DETECTION_145_148_oPCAN_RADAR_320427a6_Tx: ComBitPosition=384, ComBitSize=15, ComSignalInitValue=16384, ComSignalType=UINT16, ComHandleId=3115, ComSystemTemplateSystemSignalRef=DET_RANGE_VELOCITY_148
            DET_RANGE_VELOCITY_145_oRDR_DETECTION_145_148_oPCAN_RADAR_ef841a8a_Tx: ComBitPosition=48, ComBitSize=15, ComSignalInitValue=16384, ComSignalType=UINT16, ComHandleId=3112, ComSystemTemplateSystemSignalRef=DET_RANGE_VELOCITY_145
            DET_AZIMUTH_ERR_148_oRDR_DETECTION_145_148_oPCAN_RADAR_f38c03cd_Tx: ComBitPosition=441, ComBitSize=7, ComSignalInitValue=0, ComSignalType=UINT8, ComHandleId=3056, ComSystemTemplateSystemSignalRef=DET_AZIMUTH_ERR_148
            DET_CONFD_ELEVATION_145_oRDR_DETECTION_145_148_oPCAN_RADAR_8acaa024_Tx: ComBitPosition=101, ComBitSize=2, ComSignalInitValue=0, ComSignalType=UINT8, ComHandleId=3069, ComSystemTemplateSystemSignalRef=DET_CONFD_ELEVATION_145
            DET_ELEVATION_ERR_147_oRDR_DETECTION_145_148_oPCAN_RADAR_2da34306_Tx: ComBitPosition=304, ComBitSize=6, ComSignalInitValue=0, ComSignalType=UINT8, ComHandleId=3079, ComSystemTemplateSystemSignalRef=DET_ELEVATION_ERR_147
            DET_CONFD_ELEVATION_148_oRDR_DETECTION_145_148_oPCAN_RADAR_574a9d08_Tx: ComBitPosition=437, ComBitSize=2, ComSignalInitValue=0, ComSignalType=UINT8, ComHandleId=3072, ComSystemTemplateSystemSignalRef=DET_CONFD_ELEVATION_148
            DET_RANGE_ERR_147_oRDR_DETECTION_145_148_oPCAN_RADAR_cc5acdad_Tx: ComBitPosition=264, ComBitSize=7, ComSignalInitValue=0, ComSignalType=UINT8, ComHandleId=3110, ComSystemTemplateSystemSignalRef=DET_RANGE_ERR_147
            DET_SNR_145_oRDR_DETECTION_145_148_oPCAN_RADAR_b5aa79d2_Tx: ComBitPosition=120, ComBitSize=8, ComSignalInitValue=0, ComSignalType=UINT8, ComHandleId=3124, ComSystemTemplateSystemSignalRef=DET_SNR_145
            DET_RANGE_VELOCITY_ERR_148_oRDR_DETECTION_145_148_oPCAN_RADAR_3dbfdc14_Tx: ComBitPosition=400, ComBitSize=8, ComSignalInitValue=0, ComSignalType=UINT8, ComHandleId=3119, ComSystemTemplateSystemSignalRef=DET_RANGE_VELOCITY_ERR_148
            DET_CONFD_AZIMUTH_148_oRDR_DETECTION_145_148_oPCAN_RADAR_55df9cf2_Tx: ComBitPosition=454, ComBitSize=2, ComSignalInitValue=0, ComSignalType=UINT8, ComHandleId=3068, ComSystemTemplateSystemSignalRef=DET_CONFD_AZIMUTH_148
            DET_AZIMUTH_ERR_146_oRDR_DETECTION_145_148_oPCAN_RADAR_4aec451f_Tx: ComBitPosition=217, ComBitSize=7, ComSignalInitValue=0, ComSignalType=UINT8, ComHandleId=3054, ComSystemTemplateSystemSignalRef=DET_AZIMUTH_ERR_146
            DET_ELEVATION_146_oRDR_DETECTION_145_148_oPCAN_RADAR_3fea0fe6_Tx: ComBitPosition=184, ComBitSize=8, ComSignalInitValue=0, ComSignalType=UINT8, ComHandleId=3074, ComSystemTemplateSystemSignalRef=DET_ELEVATION_146
            DET_HVC_FLAG_148_oRDR_DETECTION_145_148_oPCAN_RADAR_3258e75e_Tx: ComBitPosition=422, ComBitSize=1, ComSignalInitValue=0, ComSignalType=BOOLEAN, ComHandleId=3088, ComSystemTemplateSystemSignalRef=DET_HVC_FLAG_148
            DET_RANGE_147_oRDR_DETECTION_145_148_oPCAN_RADAR_6bb277c4_Tx: ComBitPosition=248, ComBitSize=15, ComSignalInitValue=0, ComSignalType=UINT16, ComHandleId=3106, ComSystemTemplateSystemSignalRef=DET_RANGE_147
            DET_CONFD_AZIMUTH_145_oRDR_DETECTION_145_148_oPCAN_RADAR_885fa1de_Tx: ComBitPosition=118, ComBitSize=2, ComSignalInitValue=0, ComSignalType=UINT8, ComHandleId=3065, ComSystemTemplateSystemSignalRef=DET_CONFD_AZIMUTH_145
            DET_SNR_147_oRDR_DETECTION_145_148_oPCAN_RADAR_443ad6b9_Tx: ComBitPosition=344, ComBitSize=8, ComSignalInitValue=0, ComSignalType=UINT8, ComHandleId=3126, ComSystemTemplateSystemSignalRef=DET_SNR_147
            DET_CONFD_AZIMUTH_146_oRDR_DETECTION_145_148_oPCAN_RADAR_ecbfda20_Tx: ComBitPosition=230, ComBitSize=2, ComSignalInitValue=0, ComSignalType=UINT8, ComHandleId=3066, ComSystemTemplateSystemSignalRef=DET_CONFD_AZIMUTH_146
            DET_ELEVATION_145_oRDR_DETECTION_145_148_oPCAN_RADAR_5b0a7418_Tx: ComBitPosition=72, ComBitSize=8, ComSignalInitValue=0, ComSignalType=UINT8, ComHandleId=3073, ComSystemTemplateSystemSignalRef=DET_ELEVATION_145
            DET_ELEVATION_ERR_145_oRDR_DETECTION_145_148_oPCAN_RADAR_dc33ec6d_Tx: ComBitPosition=80, ComBitSize=6, ComSignalInitValue=0, ComSignalType=UINT8, ComHandleId=3077, ComSystemTemplateSystemSignalRef=DET_ELEVATION_ERR_145
            DET_RCS_146_oRDR_DETECTION_145_148_oPCAN_RADAR_0ce4562e_Tx: ComBitPosition=240, ComBitSize=8, ComSignalInitValue=128, ComSignalType=UINT8, ComHandleId=3121, ComSystemTemplateSystemSignalRef=DET_RCS_146
            DET_RANGE_145_oRDR_DETECTION_145_148_oPCAN_RADAR_9a22d8af_Tx: ComBitPosition=24, ComBitSize=15, ComSignalInitValue=0, ComSignalType=UINT16, ComHandleId=3104, ComSystemTemplateSystemSignalRef=DET_RANGE_145
            DET_RCS_148_oRDR_DETECTION_145_148_oPCAN_RADAR_b58410fc_Tx: ComBitPosition=464, ComBitSize=8, ComSignalInitValue=128, ComSignalType=UINT8, ComHandleId=3123, ComSystemTemplateSystemSignalRef=DET_RCS_148
            DET_BI_STATIC_FLAG_146_oRDR_DETECTION_145_148_oPCAN_RADAR_b875906f_Tx: ComBitPosition=216, ComBitSize=1, ComSignalInitValue=0, ComSignalType=BOOLEAN, ComHandleId=3062, ComSystemTemplateSystemSignalRef=DET_BI_STATIC_FLAG_146
            DET_MH_CYCLE_COUNTER_145_148_oRDR_DETECTION_145_148_oPCAN_RADAR_8635b0d3_Tx: ComBitPosition=16, ComBitSize=8, ComSignalInitValue=0, ComSignalType=UINT8, ComHandleId=3094, ComSystemTemplateSystemSignalRef=DET_MH_CYCLE_COUNTER_145_148
            DET_ELEVATION_ERR_148_oRDR_DETECTION_145_148_oPCAN_RADAR_01b3d141_Tx: ComBitPosition=416, ComBitSize=6, ComSignalInitValue=0, ComSignalType=UINT8, ComHandleId=3080, ComSystemTemplateSystemSignalRef=DET_ELEVATION_ERR_148
            DET_PROB_1STAZHYPO_148_oRDR_DETECTION_145_148_oPCAN_RADAR_4c0d06f5_Tx: ComBitPosition=439, ComBitSize=1, ComSignalInitValue=0, ComSignalType=BOOLEAN, ComHandleId=3103, ComSystemTemplateSystemSignalRef=DET_PROB_1STAZHYPO_148
            DET_BELOW_RAIN_THOLD_147_oRDR_DETECTION_145_148_oPCAN_RADAR_ae2897bf_Tx: ComBitPosition=263, ComBitSize=1, ComSignalInitValue=0, ComSignalType=UINT8, ComHandleId=3059, ComSystemTemplateSystemSignalRef=DET_BELOW_RAIN_THOLD_147
            DET_PROB_1STAZHYPO_145_oRDR_DETECTION_145_148_oPCAN_RADAR_918d3bd9_Tx: ComBitPosition=103, ComBitSize=1, ComSignalInitValue=0, ComSignalType=BOOLEAN, ComHandleId=3100, ComSystemTemplateSystemSignalRef=DET_PROB_1STAZHYPO_145
            DET_MTD_148_oRDR_DETECTION_145_148_oPCAN_RADAR_dfb9ee38_Tx: ComBitPosition=383, ComBitSize=1, ComSignalInitValue=0, ComSignalType=UINT8, ComHandleId=3099, ComSystemTemplateSystemSignalRef=DET_MTD_148
            DET_BELOW_RAIN_THOLD_148_oRDR_DETECTION_145_148_oPCAN_RADAR_823805f8_Tx: ComBitPosition=375, ComBitSize=1, ComSignalInitValue=0, ComSignalType=UINT8, ComHandleId=3060, ComSystemTemplateSystemSignalRef=DET_BELOW_RAIN_THOLD_148
            DET_IDM_147_oRDR_DETECTION_145_148_oPCAN_RADAR_951a4ea4_Tx: ComBitPosition=287, ComBitSize=1, ComSignalInitValue=0, ComSignalType=UINT8, ComHandleId=3091, ComSystemTemplateSystemSignalRef=DET_IDM_147
            DET_PROB_1STAZHYPO_146_oRDR_DETECTION_145_148_oPCAN_RADAR_f56d4027_Tx: ComBitPosition=215, ComBitSize=1, ComSignalInitValue=0, ComSignalType=BOOLEAN, ComHandleId=3101, ComSystemTemplateSystemSignalRef=DET_PROB_1STAZHYPO_146
            DET_PROB_1STAZHYPO_147_oRDR_DETECTION_145_148_oPCAN_RADAR_601d94b2_Tx: ComBitPosition=327, ComBitSize=1, ComSignalInitValue=0, ComSignalType=BOOLEAN, ComHandleId=3102, ComSystemTemplateSystemSignalRef=DET_PROB_1STAZHYPO_147
            DET_IDM_148_oRDR_DETECTION_145_148_oPCAN_RADAR_b90adce3_Tx: ComBitPosition=399, ComBitSize=1, ComSignalInitValue=0, ComSignalType=UINT8, ComHandleId=3092, ComSystemTemplateSystemSignalRef=DET_IDM_148
            DET_BELOW_RAIN_THOLD_145_oRDR_DETECTION_145_148_oPCAN_RADAR_5fb838d4_Tx: ComBitPosition=39, ComBitSize=1, ComSignalInitValue=0, ComSignalType=UINT8, ComHandleId=3057, ComSystemTemplateSystemSignalRef=DET_BELOW_RAIN_THOLD_145
            DET_MTD_145_oRDR_DETECTION_145_148_oPCAN_RADAR_0239d314_Tx: ComBitPosition=47, ComBitSize=1, ComSignalInitValue=0, ComSignalType=UINT8, ComHandleId=3096, ComSystemTemplateSystemSignalRef=DET_MTD_145
            DET_BELOW_RAIN_THOLD_146_oRDR_DETECTION_145_148_oPCAN_RADAR_3b58432a_Tx: ComBitPosition=151, ComBitSize=1, ComSignalInitValue=0, ComSignalType=UINT8, ComHandleId=3058, ComSystemTemplateSystemSignalRef=DET_BELOW_RAIN_THOLD_146
            DET_IDM_146_oRDR_DETECTION_145_148_oPCAN_RADAR_006a9a31_Tx: ComBitPosition=175, ComBitSize=1, ComSignalInitValue=0, ComSignalType=UINT8, ComHandleId=3090, ComSystemTemplateSystemSignalRef=DET_IDM_146
            DET_MTD_146_oRDR_DETECTION_145_148_oPCAN_RADAR_66d9a8ea_Tx: ComBitPosition=159, ComBitSize=1, ComSignalInitValue=0, ComSignalType=UINT8, ComHandleId=3097, ComSystemTemplateSystemSignalRef=DET_MTD_146
            DET_IDM_145_oRDR_DETECTION_145_148_oPCAN_RADAR_648ae1cf_Tx: ComBitPosition=63, ComBitSize=1, ComSignalInitValue=0, ComSignalType=UINT8, ComHandleId=3089, ComSystemTemplateSystemSignalRef=DET_IDM_145
            DET_MTD_147_oRDR_DETECTION_145_148_oPCAN_RADAR_f3a97c7f_Tx: ComBitPosition=271, ComBitSize=1, ComSignalInitValue=0, ComSignalType=UINT8, ComHandleId=3098, ComSystemTemplateSystemSignalRef=DET_MTD_147
        SG_Detections_353_356_oRDR_DETECTION_353_356_oPCAN_RADAR_a8e9cac4_Tx: ComTransferProperty=TRIGGERED, ComHandleId=90, ComSystemTemplateSignalGroupRef=SG_Detections_353_356
          83 x ComGroupSignal, all with ComSignalEndianness=LITTLE_ENDIAN, ComTransferProperty=PENDING, ComSignalAccess=ACCESS_NEEDED_BY_SWC_OR_COM:
            DET_BI_STATIC_FLAG_354_oRDR_DETECTION_353_356_oPCAN_RADAR_fac88ed1_Tx: ComBitPosition=216, ComBitSize=1, ComSignalInitValue=0, ComSignalType=BOOLEAN, ComHandleId=7378, ComSystemTemplateSystemSignalRef=DET_BI_STATIC_FLAG_354
            DET_RANGE_VELOCITY_ERR_354_oRDR_DETECTION_353_356_oPCAN_RADAR_c6628478_Tx: ComBitPosition=176, ComBitSize=8, ComSignalInitValue=0, ComSignalType=UINT8, ComHandleId=7433, ComSystemTemplateSystemSignalRef=DET_RANGE_VELOCITY_ERR_354
            DET_SUPER_RES_TARGET_353_oRDR_DETECTION_353_356_oPCAN_RADAR_fede179e_Tx: ComBitPosition=87, ComBitSize=1, ComSignalInitValue=0, ComSignalType=BOOLEAN, ComHandleId=7444, ComSystemTemplateSystemSignalRef=DET_SUPER_RES_TARGET_353
            DET_AZIMUTH_353_oRDR_DETECTION_353_356_oPCAN_RADAR_f054ed3d_Tx: ComBitPosition=88, ComBitSize=13, ComSignalInitValue=0, ComSignalType=UINT16, ComHandleId=7365, ComSystemTemplateSystemSignalRef=DET_AZIMUTH_353
            DET_ELEVATION_ERR_354_oRDR_DETECTION_353_356_oPCAN_RADAR_fa6e892d_Tx: ComBitPosition=192, ComBitSize=6, ComSignalInitValue=0, ComSignalType=UINT8, ComHandleId=7394, ComSystemTemplateSystemSignalRef=DET_ELEVATION_ERR_354
            DET_RANGE_VELOCITY_ERR_355_oRDR_DETECTION_353_356_oPCAN_RADAR_531250ed_Tx: ComBitPosition=288, ComBitSize=8, ComSignalInitValue=0, ComSignalType=UINT8, ComHandleId=7434, ComSystemTemplateSystemSignalRef=DET_RANGE_VELOCITY_ERR_355
            DET_AZIMUTH_354_oRDR_DETECTION_353_356_oPCAN_RADAR_ace4ce54_Tx: ComBitPosition=200, ComBitSize=13, ComSignalInitValue=0, ComSignalType=UINT16, ComHandleId=7366, ComSystemTemplateSystemSignalRef=DET_AZIMUTH_354
            DET_SUPER_RES_TARGET_354_oRDR_DETECTION_353_356_oPCAN_RADAR_a26e34f7_Tx: ComBitPosition=199, ComBitSize=1, ComSignalInitValue=0, ComSignalType=BOOLEAN, ComHandleId=7445, ComSystemTemplateSystemSignalRef=DET_SUPER_RES_TARGET_354
            DET_RANGE_VELOCITY_356_oRDR_DETECTION_353_356_oPCAN_RADAR_3849d0a1_Tx: ComBitPosition=384, ComBitSize=15, ComSignalInitValue=16384, ComSignalType=UINT16, ComHandleId=7431, ComSystemTemplateSystemSignalRef=DET_RANGE_VELOCITY_356
            DET_HVC_FLAG_353_oRDR_DETECTION_353_356_oPCAN_RADAR_95359c5b_Tx: ComBitPosition=86, ComBitSize=1, ComSignalInitValue=0, ComSignalType=BOOLEAN, ComHandleId=7401, ComSystemTemplateSystemSignalRef=DET_HVC_FLAG_353
            DET_CONFD_ELEVATION_353_oRDR_DETECTION_353_356_oPCAN_RADAR_f027e60d_Tx: ComBitPosition=101, ComBitSize=2, ComSignalInitValue=0, ComSignalType=UINT8, ComHandleId=7385, ComSystemTemplateSystemSignalRef=DET_CONFD_ELEVATION_353
            DET_RANGE_VELOCITY_354_oRDR_DETECTION_353_356_oPCAN_RADAR_c9d97fca_Tx: ComBitPosition=160, ComBitSize=15, ComSignalInitValue=16384, ComSignalType=UINT16, ComHandleId=7429, ComSystemTemplateSystemSignalRef=DET_RANGE_VELOCITY_354
            DET_SNR_356_oRDR_DETECTION_353_356_oPCAN_RADAR_6267b3f9_Tx: ComBitPosition=456, ComBitSize=8, ComSignalInitValue=0, ComSignalType=UINT8, ComHandleId=7443, ComSystemTemplateSystemSignalRef=DET_SNR_356
            DET_CONFD_ELEVATION_356_oRDR_DETECTION_353_356_oPCAN_RADAR_5d076a0f_Tx: ComBitPosition=437, ComBitSize=2, ComSignalInitValue=0, ComSignalType=UINT8, ComHandleId=7388, ComSystemTemplateSystemSignalRef=DET_CONFD_ELEVATION_356
            DET_MH_CRC16_353_356_oRDR_DETECTION_353_356_oPCAN_RADAR_2c6118cf_Tx: ComBitPosition=0, ComBitSize=16, ComSignalInitValue=0, ComSignalType=UINT16, ComHandleId=7409, ComSystemTemplateSystemSignalRef=DET_MH_CRC16_353_356
            DET_SNR_355_oRDR_DETECTION_353_356_oPCAN_RADAR_0687c807_Tx: ComBitPosition=344, ComBitSize=8, ComSignalInitValue=0, ComSignalType=UINT8, ComHandleId=7442, ComSystemTemplateSystemSignalRef=DET_SNR_355
            DET_AZIMUTH_ERR_355_oRDR_DETECTION_353_356_oPCAN_RADAR_9d218f34_Tx: ComBitPosition=329, ComBitSize=7, ComSignalInitValue=0, ComSignalType=UINT8, ComHandleId=7371, ComSystemTemplateSystemSignalRef=DET_AZIMUTH_ERR_355
            DET_RANGE_355_oRDR_DETECTION_353_356_oPCAN_RADAR_290f697a_Tx: ComBitPosition=248, ComBitSize=15, ComSignalInitValue=0, ComSignalType=UINT16, ComHandleId=7422, ComSystemTemplateSystemSignalRef=DET_RANGE_355
            DET_RANGE_VELOCITY_ERR_353_oRDR_DETECTION_353_356_oPCAN_RADAR_9ad2a711_Tx: ComBitPosition=64, ComBitSize=8, ComSignalInitValue=0, ComSignalType=UINT8, ComHandleId=7432, ComSystemTemplateSystemSignalRef=DET_RANGE_VELOCITY_ERR_353
            DET_MH_SCAN_INDEX_4LSB_353_356_oRDR_DETECTION_353_356_oPCAN_RADAR_643e9c74_Tx: ComBitPosition=476, ComBitSize=4, ComSignalInitValue=0, ComSignalType=UINT8, ComHandleId=7411, ComSystemTemplateSystemSignalRef=DET_MH_SCAN_INDEX_4LSB_353_356
            DET_MH_CYCLE_COUNTER_353_356_oRDR_DETECTION_353_356_oPCAN_RADAR_a814b9f8_Tx: ComBitPosition=16, ComBitSize=8, ComSignalInitValue=0, ComSignalType=UINT8, ComHandleId=7410, ComSystemTemplateSystemSignalRef=DET_MH_CYCLE_COUNTER_353_356
            DET_ELEVATION_ERR_353_oRDR_DETECTION_353_356_oPCAN_RADAR_a6deaa44_Tx: ComBitPosition=80, ComBitSize=6, ComSignalInitValue=0, ComSignalType=UINT8, ComHandleId=7393, ComSystemTemplateSystemSignalRef=DET_ELEVATION_ERR_353
            DET_RCS_354_oRDR_DETECTION_353_356_oPCAN_RADAR_4e594890_Tx: ComBitPosition=240, ComBitSize=8, ComSignalInitValue=128, ComSignalType=UINT8, ComHandleId=7437, ComSystemTemplateSystemSignalRef=DET_RCS_354
            DET_CONFD_ELEVATION_354_oRDR_DETECTION_353_356_oPCAN_RADAR_ac97c564_Tx: ComBitPosition=213, ComBitSize=2, ComSignalInitValue=0, ComSignalType=UINT8, ComHandleId=7386, ComSystemTemplateSystemSignalRef=DET_CONFD_ELEVATION_354
            DET_AZIMUTH_ERR_353_oRDR_DETECTION_353_356_oPCAN_RADAR_54e178c8_Tx: ComBitPosition=105, ComBitSize=7, ComSignalInitValue=0, ComSignalType=UINT8, ComHandleId=7369, ComSystemTemplateSystemSignalRef=DET_AZIMUTH_ERR_353
            DET_RCS_355_oRDR_DETECTION_353_356_oPCAN_RADAR_db299c05_Tx: ComBitPosition=352, ComBitSize=8, ComSignalInitValue=128, ComSignalType=UINT8, ComHandleId=7438, ComSystemTemplateSystemSignalRef=DET_RCS_355
            DET_AZIMUTH_ERR_356_oRDR_DETECTION_353_356_oPCAN_RADAR_f9c1f4ca_Tx: ComBitPosition=441, ComBitSize=7, ComSignalInitValue=0, ComSignalType=UINT8, ComHandleId=7372, ComSystemTemplateSystemSignalRef=DET_AZIMUTH_ERR_356
            DET_RANGE_ERR_353_oRDR_DETECTION_353_356_oPCAN_RADAR_472724ef_Tx: ComBitPosition=40, ComBitSize=7, ComSignalInitValue=0, ComSignalType=UINT8, ComHandleId=7424, ComSystemTemplateSystemSignalRef=DET_RANGE_ERR_353
            DET_RANGE_VELOCITY_ERR_356_oRDR_DETECTION_353_356_oPCAN_RADAR_37f22b13_Tx: ComBitPosition=400, ComBitSize=8, ComSignalInitValue=0, ComSignalType=UINT8, ComHandleId=7435, ComSystemTemplateSystemSignalRef=DET_RANGE_VELOCITY_ERR_356
            DET_RANGE_354_oRDR_DETECTION_353_356_oPCAN_RADAR_bc7fbdef_Tx: ComBitPosition=136, ComBitSize=15, ComSignalInitValue=0, ComSignalType=UINT16, ComHandleId=7421, ComSystemTemplateSystemSignalRef=DET_RANGE_354
            DET_BI_STATIC_FLAG_356_oRDR_DETECTION_353_356_oPCAN_RADAR_0b5821ba_Tx: ComBitPosition=440, ComBitSize=1, ComSignalInitValue=0, ComSignalType=BOOLEAN, ComHandleId=7380, ComSystemTemplateSystemSignalRef=DET_BI_STATIC_FLAG_356
            DET_BI_STATIC_FLAG_353_oRDR_DETECTION_353_356_oPCAN_RADAR_a678adb8_Tx: ComBitPosition=104, ComBitSize=1, ComSignalInitValue=0, ComSignalType=BOOLEAN, ComHandleId=7377, ComSystemTemplateSystemSignalRef=DET_BI_STATIC_FLAG_353
            DET_RCS_356_oRDR_DETECTION_353_356_oPCAN_RADAR_bfc9e7fb_Tx: ComBitPosition=464, ComBitSize=8, ComSignalInitValue=128, ComSignalType=UINT8, ComHandleId=7439, ComSystemTemplateSystemSignalRef=DET_RCS_356
            DET_CONFD_ELEVATION_355_oRDR_DETECTION_353_356_oPCAN_RADAR_39e711f1_Tx: ComBitPosition=325, ComBitSize=2, ComSignalInitValue=0, ComSignalType=UINT8, ComHandleId=7387, ComSystemTemplateSystemSignalRef=DET_CONFD_ELEVATION_355
            DET_RANGE_ERR_356_oRDR_DETECTION_353_356_oPCAN_RADAR_ea07a8ed_Tx: ComBitPosition=376, ComBitSize=7, ComSignalInitValue=0, ComSignalType=UINT8, ComHandleId=7427, ComSystemTemplateSystemSignalRef=DET_RANGE_ERR_356
            DET_ELEVATION_354_oRDR_DETECTION_353_356_oPCAN_RADAR_7d571158_Tx: ComBitPosition=184, ComBitSize=8, ComSignalInitValue=0, ComSignalType=UINT8, ComHandleId=7390, ComSystemTemplateSystemSignalRef=DET_ELEVATION_354
            DET_ELEVATION_ERR_355_oRDR_DETECTION_353_356_oPCAN_RADAR_6f1e5db8_Tx: ComBitPosition=304, ComBitSize=6, ComSignalInitValue=0, ComSignalType=UINT8, ComHandleId=7395, ComSystemTemplateSystemSignalRef=DET_ELEVATION_ERR_355
            DET_SUPER_RES_TARGET_355_oRDR_DETECTION_353_356_oPCAN_RADAR_371ee062_Tx: ComBitPosition=311, ComBitSize=1, ComSignalInitValue=0, ComSignalType=BOOLEAN, ComHandleId=7446, ComSystemTemplateSystemSignalRef=DET_SUPER_RES_TARGET_355
            DET_SUPER_RES_TARGET_356_oRDR_DETECTION_353_356_oPCAN_RADAR_53fe9b9c_Tx: ComBitPosition=423, ComBitSize=1, ComSignalInitValue=0, ComSignalType=BOOLEAN, ComHandleId=7447, ComSystemTemplateSystemSignalRef=DET_SUPER_RES_TARGET_356
            DET_CONFD_AZIMUTH_354_oRDR_DETECTION_353_356_oPCAN_RADAR_ae02c49e_Tx: ComBitPosition=230, ComBitSize=2, ComSignalInitValue=0, ComSignalType=UINT8, ComHandleId=7382, ComSystemTemplateSystemSignalRef=DET_CONFD_AZIMUTH_354
            DET_AZIMUTH_356_oRDR_DETECTION_353_356_oPCAN_RADAR_5d74613f_Tx: ComBitPosition=424, ComBitSize=13, ComSignalInitValue=0, ComSignalType=UINT16, ComHandleId=7368, ComSystemTemplateSystemSignalRef=DET_AZIMUTH_356
            DET_ELEVATION_355_oRDR_DETECTION_353_356_oPCAN_RADAR_e827c5cd_Tx: ComBitPosition=296, ComBitSize=8, ComSignalInitValue=0, ComSignalType=UINT8, ComHandleId=7391, ComSystemTemplateSystemSignalRef=DET_ELEVATION_355
            DET_SNR_354_oRDR_DETECTION_353_356_oPCAN_RADAR_93f71c92_Tx: ComBitPosition=232, ComBitSize=8, ComSignalInitValue=0, ComSignalType=UINT8, ComHandleId=7441, ComSystemTemplateSystemSignalRef=DET_SNR_354
            DET_CONFD_AZIMUTH_355_oRDR_DETECTION_353_356_oPCAN_RADAR_3b72100b_Tx: ComBitPosition=342, ComBitSize=2, ComSignalInitValue=0, ComSignalType=UINT8, ComHandleId=7383, ComSystemTemplateSystemSignalRef=DET_CONFD_AZIMUTH_355
            DET_ELEVATION_353_oRDR_DETECTION_353_356_oPCAN_RADAR_21e73231_Tx: ComBitPosition=72, ComBitSize=8, ComSignalInitValue=0, ComSignalType=UINT8, ComHandleId=7389, ComSystemTemplateSystemSignalRef=DET_ELEVATION_353
            DET_RANGE_VELOCITY_353_oRDR_DETECTION_353_356_oPCAN_RADAR_95695ca3_Tx: ComBitPosition=48, ComBitSize=15, ComSignalInitValue=16384, ComSignalType=UINT16, ComHandleId=7428, ComSystemTemplateSystemSignalRef=DET_RANGE_VELOCITY_353
            DET_RANGE_VELOCITY_355_oRDR_DETECTION_353_356_oPCAN_RADAR_5ca9ab5f_Tx: ComBitPosition=272, ComBitSize=15, ComSignalInitValue=16384, ComSignalType=UINT16, ComHandleId=7430, ComSystemTemplateSystemSignalRef=DET_RANGE_VELOCITY_355
            DET_RANGE_353_oRDR_DETECTION_353_356_oPCAN_RADAR_e0cf9e86_Tx: ComBitPosition=24, ComBitSize=15, ComSignalInitValue=0, ComSignalType=UINT16, ComHandleId=7420, ComSystemTemplateSystemSignalRef=DET_RANGE_353
            DET_ELEVATION_ERR_356_oRDR_DETECTION_353_356_oPCAN_RADAR_0bfe2646_Tx: ComBitPosition=416, ComBitSize=6, ComSignalInitValue=0, ComSignalType=UINT8, ComHandleId=7396, ComSystemTemplateSystemSignalRef=DET_ELEVATION_ERR_356
            DET_RANGE_ERR_355_oRDR_DETECTION_353_356_oPCAN_RADAR_8ee7d313_Tx: ComBitPosition=264, ComBitSize=7, ComSignalInitValue=0, ComSignalType=UINT8, ComHandleId=7426, ComSystemTemplateSystemSignalRef=DET_RANGE_ERR_355
            DET_EXISTENCE_PROB_355_oRDR_DETECTION_353_356_oPCAN_RADAR_bd8128d8_Tx: ComBitPosition=336, ComBitSize=6, ComSignalInitValue=0, ComSignalType=UINT8, ComHandleId=7399, ComSystemTemplateSystemSignalRef=DET_EXISTENCE_PROB_355
            DET_EXISTENCE_PROB_356_oRDR_DETECTION_353_356_oPCAN_RADAR_d9615326_Tx: ComBitPosition=448, ComBitSize=6, ComSignalInitValue=0, ComSignalType=UINT8, ComHandleId=7400, ComSystemTemplateSystemSignalRef=DET_EXISTENCE_PROB_356
            DET_CONFD_AZIMUTH_356_oRDR_DETECTION_353_356_oPCAN_RADAR_5f926bf5_Tx: ComBitPosition=454, ComBitSize=2, ComSignalInitValue=0, ComSignalType=UINT8, ComHandleId=7384, ComSystemTemplateSystemSignalRef=DET_CONFD_AZIMUTH_356
            DET_EXISTENCE_PROB_353_oRDR_DETECTION_353_356_oPCAN_RADAR_7441df24_Tx: ComBitPosition=112, ComBitSize=6, ComSignalInitValue=0, ComSignalType=UINT8, ComHandleId=7397, ComSystemTemplateSystemSignalRef=DET_EXISTENCE_PROB_353
            DET_AZIMUTH_ERR_354_oRDR_DETECTION_353_356_oPCAN_RADAR_08515ba1_Tx: ComBitPosition=217, ComBitSize=7, ComSignalInitValue=0, ComSignalType=UINT8, ComHandleId=7370, ComSystemTemplateSystemSignalRef=DET_AZIMUTH_ERR_354
            DET_CONFD_AZIMUTH_353_oRDR_DETECTION_353_356_oPCAN_RADAR_f2b2e7f7_Tx: ComBitPosition=118, ComBitSize=2, ComSignalInitValue=0, ComSignalType=UINT8, ComHandleId=7381, ComSystemTemplateSystemSignalRef=DET_CONFD_AZIMUTH_353
            DET_RANGE_ERR_354_oRDR_DETECTION_353_356_oPCAN_RADAR_1b970786_Tx: ComBitPosition=152, ComBitSize=7, ComSignalInitValue=0, ComSignalType=UINT8, ComHandleId=7425, ComSystemTemplateSystemSignalRef=DET_RANGE_ERR_354
            DET_HVC_FLAG_356_oRDR_DETECTION_353_356_oPCAN_RADAR_38151059_Tx: ComBitPosition=422, ComBitSize=1, ComSignalInitValue=0, ComSignalType=BOOLEAN, ComHandleId=7404, ComSystemTemplateSystemSignalRef=DET_HVC_FLAG_356
            DET_BI_STATIC_FLAG_355_oRDR_DETECTION_353_356_oPCAN_RADAR_6fb85a44_Tx: ComBitPosition=328, ComBitSize=1, ComSignalInitValue=0, ComSignalType=BOOLEAN, ComHandleId=7379, ComSystemTemplateSystemSignalRef=DET_BI_STATIC_FLAG_355
            DET_ELEVATION_356_oRDR_DETECTION_353_356_oPCAN_RADAR_8cc7be33_Tx: ComBitPosition=408, ComBitSize=8, ComSignalInitValue=0, ComSignalType=UINT8, ComHandleId=7392, ComSystemTemplateSystemSignalRef=DET_ELEVATION_356
            DET_SNR_353_oRDR_DETECTION_353_356_oPCAN_RADAR_cf473ffb_Tx: ComBitPosition=120, ComBitSize=8, ComSignalInitValue=0, ComSignalType=UINT8, ComHandleId=7440, ComSystemTemplateSystemSignalRef=DET_SNR_353
            DET_HVC_FLAG_354_oRDR_DETECTION_353_356_oPCAN_RADAR_c985bf32_Tx: ComBitPosition=198, ComBitSize=1, ComSignalInitValue=0, ComSignalType=BOOLEAN, ComHandleId=7402, ComSystemTemplateSystemSignalRef=DET_HVC_FLAG_354
            DET_AZIMUTH_355_oRDR_DETECTION_353_356_oPCAN_RADAR_39941ac1_Tx: ComBitPosition=312, ComBitSize=13, ComSignalInitValue=0, ComSignalType=UINT16, ComHandleId=7367, ComSystemTemplateSystemSignalRef=DET_AZIMUTH_355
            DET_EXISTENCE_PROB_354_oRDR_DETECTION_353_356_oPCAN_RADAR_28f1fc4d_Tx: ComBitPosition=224, ComBitSize=6, ComSignalInitValue=0, ComSignalType=UINT8, ComHandleId=7398, ComSystemTemplateSystemSignalRef=DET_EXISTENCE_PROB_354
            DET_RANGE_356_oRDR_DETECTION_353_356_oPCAN_RADAR_4def1284_Tx: ComBitPosition=360, ComBitSize=15, ComSignalInitValue=0, ComSignalType=UINT16, ComHandleId=7423, ComSystemTemplateSystemSignalRef=DET_RANGE_356
            DET_HVC_FLAG_355_oRDR_DETECTION_353_356_oPCAN_RADAR_5cf56ba7_Tx: ComBitPosition=310, ComBitSize=1, ComSignalInitValue=0, ComSignalType=BOOLEAN, ComHandleId=7403, ComSystemTemplateSystemSignalRef=DET_HVC_FLAG_355
            DET_RCS_353_oRDR_DETECTION_353_356_oPCAN_RADAR_12e96bf9_Tx: ComBitPosition=128, ComBitSize=8, ComSignalInitValue=128, ComSignalType=UINT8, ComHandleId=7436, ComSystemTemplateSystemSignalRef=DET_RCS_353
            DET_IDM_355_oRDR_DETECTION_353_356_oPCAN_RADAR_d7a7501a_Tx: ComBitPosition=287, ComBitSize=1, ComSignalInitValue=0, ComSignalType=UINT8, ComHandleId=7407, ComSystemTemplateSystemSignalRef=DET_IDM_355
            DET_BELOW_RAIN_THOLD_353_oRDR_DETECTION_353_356_oPCAN_RADAR_25557efd_Tx: ComBitPosition=39, ComBitSize=1, ComSignalInitValue=0, ComSignalType=UINT8, ComHandleId=7373, ComSystemTemplateSystemSignalRef=DET_BELOW_RAIN_THOLD_353
            DET_MTD_353_oRDR_DETECTION_353_356_oPCAN_RADAR_78d4953d_Tx: ComBitPosition=47, ComBitSize=1, ComSignalInitValue=0, ComSignalType=UINT8, ComHandleId=7412, ComSystemTemplateSystemSignalRef=DET_MTD_353
            DET_MTD_356_oRDR_DETECTION_353_356_oPCAN_RADAR_d5f4193f_Tx: ComBitPosition=383, ComBitSize=1, ComSignalInitValue=0, ComSignalType=UINT8, ComHandleId=7415, ComSystemTemplateSystemSignalRef=DET_MTD_356
            DET_MTD_354_oRDR_DETECTION_353_356_oPCAN_RADAR_2464b654_Tx: ComBitPosition=159, ComBitSize=1, ComSignalInitValue=0, ComSignalType=UINT8, ComHandleId=7413, ComSystemTemplateSystemSignalRef=DET_MTD_354
            DET_IDM_353_oRDR_DETECTION_353_356_oPCAN_RADAR_1e67a7e6_Tx: ComBitPosition=63, ComBitSize=1, ComSignalInitValue=0, ComSignalType=UINT8, ComHandleId=7405, ComSystemTemplateSystemSignalRef=DET_IDM_353
            DET_PROB_1STAZHYPO_353_oRDR_DETECTION_353_356_oPCAN_RADAR_eb607df0_Tx: ComBitPosition=103, ComBitSize=1, ComSignalInitValue=0, ComSignalType=BOOLEAN, ComHandleId=7416, ComSystemTemplateSystemSignalRef=DET_PROB_1STAZHYPO_353
            DET_BELOW_RAIN_THOLD_355_oRDR_DETECTION_353_356_oPCAN_RADAR_ec958901_Tx: ComBitPosition=263, ComBitSize=1, ComSignalInitValue=0, ComSignalType=UINT8, ComHandleId=7375, ComSystemTemplateSystemSignalRef=DET_BELOW_RAIN_THOLD_355
            DET_IDM_356_oRDR_DETECTION_353_356_oPCAN_RADAR_b3472be4_Tx: ComBitPosition=399, ComBitSize=1, ComSignalInitValue=0, ComSignalType=UINT8, ComHandleId=7408, ComSystemTemplateSystemSignalRef=DET_IDM_356
            DET_PROB_1STAZHYPO_356_oRDR_DETECTION_353_356_oPCAN_RADAR_4640f1f2_Tx: ComBitPosition=439, ComBitSize=1, ComSignalInitValue=0, ComSignalType=BOOLEAN, ComHandleId=7419, ComSystemTemplateSystemSignalRef=DET_PROB_1STAZHYPO_356
            DET_MTD_355_oRDR_DETECTION_353_356_oPCAN_RADAR_b11462c1_Tx: ComBitPosition=271, ComBitSize=1, ComSignalInitValue=0, ComSignalType=UINT8, ComHandleId=7414, ComSystemTemplateSystemSignalRef=DET_MTD_355
            DET_IDM_354_oRDR_DETECTION_353_356_oPCAN_RADAR_42d7848f_Tx: ComBitPosition=175, ComBitSize=1, ComSignalInitValue=0, ComSignalType=UINT8, ComHandleId=7406, ComSystemTemplateSystemSignalRef=DET_IDM_354
            DET_BELOW_RAIN_THOLD_354_oRDR_DETECTION_353_356_oPCAN_RADAR_79e55d94_Tx: ComBitPosition=151, ComBitSize=1, ComSignalInitValue=0, ComSignalType=UINT8, ComHandleId=7374, ComSystemTemplateSystemSignalRef=DET_BELOW_RAIN_THOLD_354
            DET_PROB_1STAZHYPO_354_oRDR_DETECTION_353_356_oPCAN_RADAR_b7d05e99_Tx: ComBitPosition=215, ComBitSize=1, ComSignalInitValue=0, ComSignalType=BOOLEAN, ComHandleId=7417, ComSystemTemplateSystemSignalRef=DET_PROB_1STAZHYPO_354
            DET_PROB_1STAZHYPO_355_oRDR_DETECTION_353_356_oPCAN_RADAR_22a08a0c_Tx: ComBitPosition=327, ComBitSize=1, ComSignalInitValue=0, ComSignalType=BOOLEAN, ComHandleId=7418, ComSystemTemplateSystemSignalRef=DET_PROB_1STAZHYPO_355
            DET_BELOW_RAIN_THOLD_356_oRDR_DETECTION_353_356_oPCAN_RADAR_8875f2ff_Tx: ComBitPosition=375, ComBitSize=1, ComSignalInitValue=0, ComSignalType=UINT8, ComHandleId=7376, ComSystemTemplateSystemSignalRef=DET_BELOW_RAIN_THOLD_356
        SG_Detections_077_080_oRDR_DETECTION_077_080_oPCAN_RADAR_2ec83134_Tx: ComTransferProperty=TRIGGERED, ComHandleId=21, ComSystemTemplateSignalGroupRef=SG_Detections_077_080
          83 x ComGroupSignal, all with ComSignalEndianness=LITTLE_ENDIAN, ComTransferProperty=PENDING, ComSignalAccess=ACCESS_NEEDED_BY_SWC_OR_COM:
            DET_HVC_FLAG_078_oRDR_DETECTION_077_080_oPCAN_RADAR_c5e47189_Tx: ComBitPosition=198, ComBitSize=1, ComSignalInitValue=0, ComSignalType=BOOLEAN, ComHandleId=1675, ComSystemTemplateSystemSignalRef=DET_HVC_FLAG_078
            DET_CONFD_AZIMUTH_080_oRDR_DETECTION_077_080_oPCAN_RADAR_3a577faa_Tx: ComBitPosition=454, ComBitSize=2, ComSignalInitValue=0, ComSignalType=UINT8, ComHandleId=1657, ComSystemTemplateSystemSignalRef=DET_CONFD_AZIMUTH_080
            DET_BI_STATIC_FLAG_078_oRDR_DETECTION_077_080_oPCAN_RADAR_f6a9406a_Tx: ComBitPosition=216, ComBitSize=1, ComSignalInitValue=0, ComSignalType=BOOLEAN, ComHandleId=1651, ComSystemTemplateSystemSignalRef=DET_BI_STATIC_FLAG_078
            DET_SUPER_RES_TARGET_077_oRDR_DETECTION_077_080_oPCAN_RADAR_821f680b_Tx: ComBitPosition=87, ComBitSize=1, ComSignalInitValue=0, ComSignalType=BOOLEAN, ComHandleId=1717, ComSystemTemplateSystemSignalRef=DET_SUPER_RES_TARGET_077
            DET_RANGE_ERR_080_oRDR_DETECTION_077_080_oPCAN_RADAR_8fc2bcb2_Tx: ComBitPosition=376, ComBitSize=7, ComSignalInitValue=0, ComSignalType=UINT8, ComHandleId=1700, ComSystemTemplateSystemSignalRef=DET_RANGE_ERR_080
            DET_BI_STATIC_FLAG_077_oRDR_DETECTION_077_080_oPCAN_RADAR_dab9d22d_Tx: ComBitPosition=104, ComBitSize=1, ComSignalInitValue=0, ComSignalType=BOOLEAN, ComHandleId=1650, ComSystemTemplateSystemSignalRef=DET_BI_STATIC_FLAG_077
            DET_RCS_080_oRDR_DETECTION_077_080_oPCAN_RADAR_da0cf3a4_Tx: ComBitPosition=464, ComBitSize=8, ComSignalInitValue=128, ComSignalType=UINT8, ComHandleId=1712, ComSystemTemplateSystemSignalRef=DET_RCS_080
            DET_AZIMUTH_077_oRDR_DETECTION_077_080_oPCAN_RADAR_8c9592a8_Tx: ComBitPosition=88, ComBitSize=13, ComSignalInitValue=0, ComSignalType=UINT16, ComHandleId=1638, ComSystemTemplateSystemSignalRef=DET_AZIMUTH_077
            DET_CONFD_AZIMUTH_078_oRDR_DETECTION_077_080_oPCAN_RADAR_a2630a25_Tx: ComBitPosition=230, ComBitSize=2, ComSignalInitValue=0, ComSignalType=UINT8, ComHandleId=1655, ComSystemTemplateSystemSignalRef=DET_CONFD_AZIMUTH_078
            DET_SNR_080_oRDR_DETECTION_077_080_oPCAN_RADAR_07a2a7a6_Tx: ComBitPosition=456, ComBitSize=8, ComSignalInitValue=0, ComSignalType=UINT8, ComHandleId=1716, ComSystemTemplateSystemSignalRef=DET_SNR_080
            DET_EXISTENCE_PROB_078_oRDR_DETECTION_077_080_oPCAN_RADAR_249032f6_Tx: ComBitPosition=224, ComBitSize=6, ComSignalInitValue=0, ComSignalType=UINT8, ComHandleId=1671, ComSystemTemplateSystemSignalRef=DET_EXISTENCE_PROB_078
            DET_AZIMUTH_ERR_079_oRDR_DETECTION_077_080_oPCAN_RADAR_9140418f_Tx: ComBitPosition=329, ComBitSize=7, ComSignalInitValue=0, ComSignalType=UINT8, ComHandleId=1644, ComSystemTemplateSystemSignalRef=DET_AZIMUTH_ERR_079
            DET_AZIMUTH_078_oRDR_DETECTION_077_080_oPCAN_RADAR_a08500ef_Tx: ComBitPosition=200, ComBitSize=13, ComSignalInitValue=0, ComSignalType=UINT16, ComHandleId=1639, ComSystemTemplateSystemSignalRef=DET_AZIMUTH_078
            DET_MH_CYCLE_COUNTER_077_080_oRDR_DETECTION_077_080_oPCAN_RADAR_2e354208_Tx: ComBitPosition=16, ComBitSize=8, ComSignalInitValue=0, ComSignalType=UINT8, ComHandleId=1683, ComSystemTemplateSystemSignalRef=DET_MH_CYCLE_COUNTER_077_080
            DET_RANGE_VELOCITY_080_oRDR_DETECTION_077_080_oPCAN_RADAR_5d8cc4fe_Tx: ComBitPosition=384, ComBitSize=15, ComSignalInitValue=16384, ComSignalType=UINT16, ComHandleId=1704, ComSystemTemplateSystemSignalRef=DET_RANGE_VELOCITY_080
            DET_ELEVATION_079_oRDR_DETECTION_077_080_oPCAN_RADAR_e4460b76_Tx: ComBitPosition=296, ComBitSize=8, ComSignalInitValue=0, ComSignalType=UINT8, ComHandleId=1664, ComSystemTemplateSystemSignalRef=DET_ELEVATION_079
            DET_RANGE_VELOCITY_ERR_079_oRDR_DETECTION_077_080_oPCAN_RADAR_5f739e56_Tx: ComBitPosition=288, ComBitSize=8, ComSignalInitValue=0, ComSignalType=UINT8, ComHandleId=1707, ComSystemTemplateSystemSignalRef=DET_RANGE_VELOCITY_ERR_079
            DET_ELEVATION_ERR_077_oRDR_DETECTION_077_080_oPCAN_RADAR_da1fd5d1_Tx: ComBitPosition=80, ComBitSize=6, ComSignalInitValue=0, ComSignalType=UINT8, ComHandleId=1666, ComSystemTemplateSystemSignalRef=DET_ELEVATION_ERR_077
            DET_RCS_078_oRDR_DETECTION_077_080_oPCAN_RADAR_4238862b_Tx: ComBitPosition=240, ComBitSize=8, ComSignalInitValue=128, ComSignalType=UINT8, ComHandleId=1710, ComSystemTemplateSystemSignalRef=DET_RCS_078
            DET_CONFD_AZIMUTH_079_oRDR_DETECTION_077_080_oPCAN_RADAR_3713deb0_Tx: ComBitPosition=342, ComBitSize=2, ComSignalInitValue=0, ComSignalType=UINT8, ComHandleId=1656, ComSystemTemplateSystemSignalRef=DET_CONFD_AZIMUTH_079
            DET_HVC_FLAG_080_oRDR_DETECTION_077_080_oPCAN_RADAR_5dd00406_Tx: ComBitPosition=422, ComBitSize=1, ComSignalInitValue=0, ComSignalType=BOOLEAN, ComHandleId=1677, ComSystemTemplateSystemSignalRef=DET_HVC_FLAG_080
            DET_HVC_FLAG_077_oRDR_DETECTION_077_080_oPCAN_RADAR_e9f4e3ce_Tx: ComBitPosition=86, ComBitSize=1, ComSignalInitValue=0, ComSignalType=BOOLEAN, ComHandleId=1674, ComSystemTemplateSystemSignalRef=DET_HVC_FLAG_077
            DET_RANGE_078_oRDR_DETECTION_077_080_oPCAN_RADAR_b01e7354_Tx: ComBitPosition=136, ComBitSize=15, ComSignalInitValue=0, ComSignalType=UINT16, ComHandleId=1694, ComSystemTemplateSystemSignalRef=DET_RANGE_078
            DET_RANGE_080_oRDR_DETECTION_077_080_oPCAN_RADAR_282a06db_Tx: ComBitPosition=360, ComBitSize=15, ComSignalInitValue=0, ComSignalType=UINT16, ComHandleId=1696, ComSystemTemplateSystemSignalRef=DET_RANGE_080
            DET_ELEVATION_080_oRDR_DETECTION_077_080_oPCAN_RADAR_e902aa6c_Tx: ComBitPosition=408, ComBitSize=8, ComSignalInitValue=0, ComSignalType=UINT8, ComHandleId=1665, ComSystemTemplateSystemSignalRef=DET_ELEVATION_080
            DET_ELEVATION_078_oRDR_DETECTION_077_080_oPCAN_RADAR_7136dfe3_Tx: ComBitPosition=184, ComBitSize=8, ComSignalInitValue=0, ComSignalType=UINT8, ComHandleId=1663, ComSystemTemplateSystemSignalRef=DET_ELEVATION_078
            DET_RCS_077_oRDR_DETECTION_077_080_oPCAN_RADAR_6e28146c_Tx: ComBitPosition=128, ComBitSize=8, ComSignalInitValue=128, ComSignalType=UINT8, ComHandleId=1709, ComSystemTemplateSystemSignalRef=DET_RCS_077
            DET_AZIMUTH_ERR_080_oRDR_DETECTION_077_080_oPCAN_RADAR_9c04e095_Tx: ComBitPosition=441, ComBitSize=7, ComSignalInitValue=0, ComSignalType=UINT8, ComHandleId=1645, ComSystemTemplateSystemSignalRef=DET_AZIMUTH_ERR_080
            DET_ELEVATION_ERR_080_oRDR_DETECTION_077_080_oPCAN_RADAR_6e3b3219_Tx: ComBitPosition=416, ComBitSize=6, ComSignalInitValue=0, ComSignalType=UINT8, ComHandleId=1669, ComSystemTemplateSystemSignalRef=DET_ELEVATION_ERR_080
            DET_RANGE_079_oRDR_DETECTION_077_080_oPCAN_RADAR_256ea7c1_Tx: ComBitPosition=248, ComBitSize=15, ComSignalInitValue=0, ComSignalType=UINT16, ComHandleId=1695, ComSystemTemplateSystemSignalRef=DET_RANGE_079
            DET_CONFD_ELEVATION_080_oRDR_DETECTION_077_080_oPCAN_RADAR_38c27e50_Tx: ComBitPosition=437, ComBitSize=2, ComSignalInitValue=0, ComSignalType=UINT8, ComHandleId=1661, ComSystemTemplateSystemSignalRef=DET_CONFD_ELEVATION_080
            DET_SUPER_RES_TARGET_080_oRDR_DETECTION_077_080_oPCAN_RADAR_363b8fc3_Tx: ComBitPosition=423, ComBitSize=1, ComSignalInitValue=0, ComSignalType=BOOLEAN, ComHandleId=1720, ComSystemTemplateSystemSignalRef=DET_SUPER_RES_TARGET_080
            DET_MH_SCAN_INDEX_4LSB_077_080_oRDR_DETECTION_077_080_oPCAN_RADAR_e21f6784_Tx: ComBitPosition=476, ComBitSize=4, ComSignalInitValue=0, ComSignalType=UINT8, ComHandleId=1684, ComSystemTemplateSystemSignalRef=DET_MH_SCAN_INDEX_4LSB_077_080
            DET_BI_STATIC_FLAG_079_oRDR_DETECTION_077_080_oPCAN_RADAR_63d994ff_Tx: ComBitPosition=328, ComBitSize=1, ComSignalInitValue=0, ComSignalType=BOOLEAN, ComHandleId=1652, ComSystemTemplateSystemSignalRef=DET_BI_STATIC_FLAG_079
            DET_EXISTENCE_PROB_077_oRDR_DETECTION_077_080_oPCAN_RADAR_0880a0b1_Tx: ComBitPosition=112, ComBitSize=6, ComSignalInitValue=0, ComSignalType=UINT8, ComHandleId=1670, ComSystemTemplateSystemSignalRef=DET_EXISTENCE_PROB_077
            DET_AZIMUTH_080_oRDR_DETECTION_077_080_oPCAN_RADAR_38b17560_Tx: ComBitPosition=424, ComBitSize=13, ComSignalInitValue=0, ComSignalType=UINT16, ComHandleId=1641, ComSystemTemplateSystemSignalRef=DET_AZIMUTH_080
            DET_RANGE_VELOCITY_ERR_080_oRDR_DETECTION_077_080_oPCAN_RADAR_52373f4c_Tx: ComBitPosition=400, ComBitSize=8, ComSignalInitValue=0, ComSignalType=UINT8, ComHandleId=1708, ComSystemTemplateSystemSignalRef=DET_RANGE_VELOCITY_ERR_080
            DET_RANGE_VELOCITY_ERR_077_oRDR_DETECTION_077_080_oPCAN_RADAR_e613d884_Tx: ComBitPosition=64, ComBitSize=8, ComSignalInitValue=0, ComSignalType=UINT8, ComHandleId=1705, ComSystemTemplateSystemSignalRef=DET_RANGE_VELOCITY_ERR_077
            DET_RANGE_077_oRDR_DETECTION_077_080_oPCAN_RADAR_9c0ee113_Tx: ComBitPosition=24, ComBitSize=15, ComSignalInitValue=0, ComSignalType=UINT16, ComHandleId=1693, ComSystemTemplateSystemSignalRef=DET_RANGE_077
            DET_CONFD_AZIMUTH_077_oRDR_DETECTION_077_080_oPCAN_RADAR_8e739862_Tx: ComBitPosition=118, ComBitSize=2, ComSignalInitValue=0, ComSignalType=UINT8, ComHandleId=1654, ComSystemTemplateSystemSignalRef=DET_CONFD_AZIMUTH_077
            DET_CONFD_ELEVATION_077_oRDR_DETECTION_077_080_oPCAN_RADAR_8ce69998_Tx: ComBitPosition=101, ComBitSize=2, ComSignalInitValue=0, ComSignalType=UINT8, ComHandleId=1658, ComSystemTemplateSystemSignalRef=DET_CONFD_ELEVATION_077
            DET_AZIMUTH_ERR_078_oRDR_DETECTION_077_080_oPCAN_RADAR_0430951a_Tx: ComBitPosition=217, ComBitSize=7, ComSignalInitValue=0, ComSignalType=UINT8, ComHandleId=1643, ComSystemTemplateSystemSignalRef=DET_AZIMUTH_ERR_078
            DET_EXISTENCE_PROB_080_oRDR_DETECTION_077_080_oPCAN_RADAR_bca44779_Tx: ComBitPosition=448, ComBitSize=6, ComSignalInitValue=0, ComSignalType=UINT8, ComHandleId=1673, ComSystemTemplateSystemSignalRef=DET_EXISTENCE_PROB_080
            DET_AZIMUTH_ERR_077_oRDR_DETECTION_077_080_oPCAN_RADAR_2820075d_Tx: ComBitPosition=105, ComBitSize=7, ComSignalInitValue=0, ComSignalType=UINT8, ComHandleId=1642, ComSystemTemplateSystemSignalRef=DET_AZIMUTH_ERR_077
            DET_ELEVATION_077_oRDR_DETECTION_077_080_oPCAN_RADAR_5d264da4_Tx: ComBitPosition=72, ComBitSize=8, ComSignalInitValue=0, ComSignalType=UINT8, ComHandleId=1662, ComSystemTemplateSystemSignalRef=DET_ELEVATION_077
            DET_EXISTENCE_PROB_079_oRDR_DETECTION_077_080_oPCAN_RADAR_b1e0e663_Tx: ComBitPosition=336, ComBitSize=6, ComSignalInitValue=0, ComSignalType=UINT8, ComHandleId=1672, ComSystemTemplateSystemSignalRef=DET_EXISTENCE_PROB_079
            DET_RANGE_ERR_078_oRDR_DETECTION_077_080_oPCAN_RADAR_17f6c93d_Tx: ComBitPosition=152, ComBitSize=7, ComSignalInitValue=0, ComSignalType=UINT8, ComHandleId=1698, ComSystemTemplateSystemSignalRef=DET_RANGE_ERR_078
            DET_RANGE_VELOCITY_077_oRDR_DETECTION_077_080_oPCAN_RADAR_e9a82336_Tx: ComBitPosition=48, ComBitSize=15, ComSignalInitValue=16384, ComSignalType=UINT16, ComHandleId=1701, ComSystemTemplateSystemSignalRef=DET_RANGE_VELOCITY_077
            DET_HVC_FLAG_079_oRDR_DETECTION_077_080_oPCAN_RADAR_5094a51c_Tx: ComBitPosition=310, ComBitSize=1, ComSignalInitValue=0, ComSignalType=BOOLEAN, ComHandleId=1676, ComSystemTemplateSystemSignalRef=DET_HVC_FLAG_079
            DET_RCS_079_oRDR_DETECTION_077_080_oPCAN_RADAR_d74852be_Tx: ComBitPosition=352, ComBitSize=8, ComSignalInitValue=128, ComSignalType=UINT8, ComHandleId=1711, ComSystemTemplateSystemSignalRef=DET_RCS_079
            DET_SNR_077_oRDR_DETECTION_077_080_oPCAN_RADAR_b386406e_Tx: ComBitPosition=120, ComBitSize=8, ComSignalInitValue=0, ComSignalType=UINT8, ComHandleId=1713, ComSystemTemplateSystemSignalRef=DET_SNR_077
            DET_SNR_079_oRDR_DETECTION_077_080_oPCAN_RADAR_0ae606bc_Tx: ComBitPosition=344, ComBitSize=8, ComSignalInitValue=0, ComSignalType=UINT8, ComHandleId=1715, ComSystemTemplateSystemSignalRef=DET_SNR_079
            DET_SUPER_RES_TARGET_078_oRDR_DETECTION_077_080_oPCAN_RADAR_ae0ffa4c_Tx: ComBitPosition=199, ComBitSize=1, ComSignalInitValue=0, ComSignalType=BOOLEAN, ComHandleId=1718, ComSystemTemplateSystemSignalRef=DET_SUPER_RES_TARGET_078
            DET_ELEVATION_ERR_078_oRDR_DETECTION_077_080_oPCAN_RADAR_f60f4796_Tx: ComBitPosition=192, ComBitSize=6, ComSignalInitValue=0, ComSignalType=UINT8, ComHandleId=1667, ComSystemTemplateSystemSignalRef=DET_ELEVATION_ERR_078
            DET_BI_STATIC_FLAG_080_oRDR_DETECTION_077_080_oPCAN_RADAR_6e9d35e5_Tx: ComBitPosition=440, ComBitSize=1, ComSignalInitValue=0, ComSignalType=BOOLEAN, ComHandleId=1653, ComSystemTemplateSystemSignalRef=DET_BI_STATIC_FLAG_080
            DET_CONFD_ELEVATION_078_oRDR_DETECTION_077_080_oPCAN_RADAR_a0f60bdf_Tx: ComBitPosition=213, ComBitSize=2, ComSignalInitValue=0, ComSignalType=UINT8, ComHandleId=1659, ComSystemTemplateSystemSignalRef=DET_CONFD_ELEVATION_078
            DET_RANGE_VELOCITY_078_oRDR_DETECTION_077_080_oPCAN_RADAR_c5b8b171_Tx: ComBitPosition=160, ComBitSize=15, ComSignalInitValue=16384, ComSignalType=UINT16, ComHandleId=1702, ComSystemTemplateSystemSignalRef=DET_RANGE_VELOCITY_078
            DET_CONFD_ELEVATION_079_oRDR_DETECTION_077_080_oPCAN_RADAR_3586df4a_Tx: ComBitPosition=325, ComBitSize=2, ComSignalInitValue=0, ComSignalType=UINT8, ComHandleId=1660, ComSystemTemplateSystemSignalRef=DET_CONFD_ELEVATION_079
            DET_RANGE_ERR_079_oRDR_DETECTION_077_080_oPCAN_RADAR_82861da8_Tx: ComBitPosition=264, ComBitSize=7, ComSignalInitValue=0, ComSignalType=UINT8, ComHandleId=1699, ComSystemTemplateSystemSignalRef=DET_RANGE_ERR_079
            DET_ELEVATION_ERR_079_oRDR_DETECTION_077_080_oPCAN_RADAR_637f9303_Tx: ComBitPosition=304, ComBitSize=6, ComSignalInitValue=0, ComSignalType=UINT8, ComHandleId=1668, ComSystemTemplateSystemSignalRef=DET_ELEVATION_ERR_079
            DET_RANGE_VELOCITY_079_oRDR_DETECTION_077_080_oPCAN_RADAR_50c865e4_Tx: ComBitPosition=272, ComBitSize=15, ComSignalInitValue=16384, ComSignalType=UINT16, ComHandleId=1703, ComSystemTemplateSystemSignalRef=DET_RANGE_VELOCITY_079
            DET_RANGE_VELOCITY_ERR_078_oRDR_DETECTION_077_080_oPCAN_RADAR_ca034ac3_Tx: ComBitPosition=176, ComBitSize=8, ComSignalInitValue=0, ComSignalType=UINT8, ComHandleId=1706, ComSystemTemplateSystemSignalRef=DET_RANGE_VELOCITY_ERR_078
            DET_RANGE_ERR_077_oRDR_DETECTION_077_080_oPCAN_RADAR_3be65b7a_Tx: ComBitPosition=40, ComBitSize=7, ComSignalInitValue=0, ComSignalType=UINT8, ComHandleId=1697, ComSystemTemplateSystemSignalRef=DET_RANGE_ERR_077
            DET_AZIMUTH_079_oRDR_DETECTION_077_080_oPCAN_RADAR_35f5d47a_Tx: ComBitPosition=312, ComBitSize=13, ComSignalInitValue=0, ComSignalType=UINT16, ComHandleId=1640, ComSystemTemplateSystemSignalRef=DET_AZIMUTH_079
            DET_MH_CRC16_077_080_oRDR_DETECTION_077_080_oPCAN_RADAR_aa40e33f_Tx: ComBitPosition=0, ComBitSize=16, ComSignalInitValue=0, ComSignalType=UINT16, ComHandleId=1682, ComSystemTemplateSystemSignalRef=DET_MH_CRC16_077_080
            DET_SNR_078_oRDR_DETECTION_077_080_oPCAN_RADAR_9f96d229_Tx: ComBitPosition=232, ComBitSize=8, ComSignalInitValue=0, ComSignalType=UINT8, ComHandleId=1714, ComSystemTemplateSystemSignalRef=DET_SNR_078
            DET_SUPER_RES_TARGET_079_oRDR_DETECTION_077_080_oPCAN_RADAR_3b7f2ed9_Tx: ComBitPosition=311, ComBitSize=1, ComSignalInitValue=0, ComSignalType=BOOLEAN, ComHandleId=1719, ComSystemTemplateSystemSignalRef=DET_SUPER_RES_TARGET_079
            DET_IDM_080_oRDR_DETECTION_077_080_oPCAN_RADAR_d6823fbb_Tx: ComBitPosition=399, ComBitSize=1, ComSignalInitValue=0, ComSignalType=UINT8, ComHandleId=1681, ComSystemTemplateSystemSignalRef=DET_IDM_080
            DET_BELOW_RAIN_THOLD_078_oRDR_DETECTION_077_080_oPCAN_RADAR_7584932f_Tx: ComBitPosition=151, ComBitSize=1, ComSignalInitValue=0, ComSignalType=UINT8, ComHandleId=1647, ComSystemTemplateSystemSignalRef=DET_BELOW_RAIN_THOLD_078
            DET_IDM_077_oRDR_DETECTION_077_080_oPCAN_RADAR_62a6d873_Tx: ComBitPosition=63, ComBitSize=1, ComSignalInitValue=0, ComSignalType=UINT8, ComHandleId=1678, ComSystemTemplateSystemSignalRef=DET_IDM_077
            DET_BELOW_RAIN_THOLD_079_oRDR_DETECTION_077_080_oPCAN_RADAR_e0f447ba_Tx: ComBitPosition=263, ComBitSize=1, ComSignalInitValue=0, ComSignalType=UINT8, ComHandleId=1648, ComSystemTemplateSystemSignalRef=DET_BELOW_RAIN_THOLD_079
            DET_BELOW_RAIN_THOLD_080_oRDR_DETECTION_077_080_oPCAN_RADAR_edb0e6a0_Tx: ComBitPosition=375, ComBitSize=1, ComSignalInitValue=0, ComSignalType=UINT8, ComHandleId=1649, ComSystemTemplateSystemSignalRef=DET_BELOW_RAIN_THOLD_080
            DET_PROB_1STAZHYPO_079_oRDR_DETECTION_077_080_oPCAN_RADAR_2ec144b7_Tx: ComBitPosition=327, ComBitSize=1, ComSignalInitValue=0, ComSignalType=BOOLEAN, ComHandleId=1691, ComSystemTemplateSystemSignalRef=DET_PROB_1STAZHYPO_079
            DET_MTD_077_oRDR_DETECTION_077_080_oPCAN_RADAR_0415eaa8_Tx: ComBitPosition=47, ComBitSize=1, ComSignalInitValue=0, ComSignalType=UINT8, ComHandleId=1685, ComSystemTemplateSystemSignalRef=DET_MTD_077
            DET_PROB_1STAZHYPO_078_oRDR_DETECTION_077_080_oPCAN_RADAR_bbb19022_Tx: ComBitPosition=215, ComBitSize=1, ComSignalInitValue=0, ComSignalType=BOOLEAN, ComHandleId=1690, ComSystemTemplateSystemSignalRef=DET_PROB_1STAZHYPO_078
            DET_IDM_079_oRDR_DETECTION_077_080_oPCAN_RADAR_dbc69ea1_Tx: ComBitPosition=287, ComBitSize=1, ComSignalInitValue=0, ComSignalType=UINT8, ComHandleId=1680, ComSystemTemplateSystemSignalRef=DET_IDM_079
            DET_PROB_1STAZHYPO_080_oRDR_DETECTION_077_080_oPCAN_RADAR_2385e5ad_Tx: ComBitPosition=439, ComBitSize=1, ComSignalInitValue=0, ComSignalType=BOOLEAN, ComHandleId=1692, ComSystemTemplateSystemSignalRef=DET_PROB_1STAZHYPO_080
            DET_MTD_078_oRDR_DETECTION_077_080_oPCAN_RADAR_280578ef_Tx: ComBitPosition=159, ComBitSize=1, ComSignalInitValue=0, ComSignalType=UINT8, ComHandleId=1686, ComSystemTemplateSystemSignalRef=DET_MTD_078
            DET_MTD_080_oRDR_DETECTION_077_080_oPCAN_RADAR_b0310d60_Tx: ComBitPosition=383, ComBitSize=1, ComSignalInitValue=0, ComSignalType=UINT8, ComHandleId=1688, ComSystemTemplateSystemSignalRef=DET_MTD_080
            DET_MTD_079_oRDR_DETECTION_077_080_oPCAN_RADAR_bd75ac7a_Tx: ComBitPosition=271, ComBitSize=1, ComSignalInitValue=0, ComSignalType=UINT8, ComHandleId=1687, ComSystemTemplateSystemSignalRef=DET_MTD_079
            DET_PROB_1STAZHYPO_077_oRDR_DETECTION_077_080_oPCAN_RADAR_97a10265_Tx: ComBitPosition=103, ComBitSize=1, ComSignalInitValue=0, ComSignalType=BOOLEAN, ComHandleId=1689, ComSystemTemplateSystemSignalRef=DET_PROB_1STAZHYPO_077
            DET_BELOW_RAIN_THOLD_077_oRDR_DETECTION_077_080_oPCAN_RADAR_59940168_Tx: ComBitPosition=39, ComBitSize=1, ComSignalInitValue=0, ComSignalType=UINT8, ComHandleId=1646, ComSystemTemplateSystemSignalRef=DET_BELOW_RAIN_THOLD_077
            DET_IDM_078_oRDR_DETECTION_077_080_oPCAN_RADAR_4eb64a34_Tx: ComBitPosition=175, ComBitSize=1, ComSignalInitValue=0, ComSignalType=UINT8, ComHandleId=1679, ComSystemTemplateSystemSignalRef=DET_IDM_078
        SG_Detections_253_256_oRDR_DETECTION_253_256_oPCAN_RADAR_ea41e878_Tx: ComTransferProperty=TRIGGERED, ComHandleId=65, ComSystemTemplateSignalGroupRef=SG_Detections_253_256
          83 x ComGroupSignal, all with ComSignalEndianness=LITTLE_ENDIAN, ComTransferProperty=PENDING, ComSignalAccess=ACCESS_NEEDED_BY_SWC_OR_COM:
            DET_CONFD_AZIMUTH_253_oRDR_DETECTION_253_256_oPCAN_RADAR_112341a5_Tx: ComBitPosition=118, ComBitSize=2, ComSignalInitValue=0, ComSignalType=UINT8, ComHandleId=5306, ComSystemTemplateSystemSignalRef=DET_CONFD_AZIMUTH_253
            DET_MH_CRC16_253_256_oRDR_DETECTION_253_256_oPCAN_RADAR_6ec93a73_Tx: ComBitPosition=0, ComBitSize=16, ComSignalInitValue=0, ComSignalType=UINT16, ComHandleId=5334, ComSystemTemplateSystemSignalRef=DET_MH_CRC16_253_256
            DET_SNR_253_oRDR_DETECTION_253_256_oPCAN_RADAR_2cd699a9_Tx: ComBitPosition=120, ComBitSize=8, ComSignalInitValue=0, ComSignalType=UINT8, ComHandleId=5365, ComSystemTemplateSystemSignalRef=DET_SNR_253
            DET_EXISTENCE_PROB_255_oRDR_DETECTION_253_256_oPCAN_RADAR_5e108e8a_Tx: ComBitPosition=336, ComBitSize=6, ComSignalInitValue=0, ComSignalType=UINT8, ComHandleId=5324, ComSystemTemplateSystemSignalRef=DET_EXISTENCE_PROB_255
            DET_BI_STATIC_FLAG_253_oRDR_DETECTION_253_256_oPCAN_RADAR_45e90bea_Tx: ComBitPosition=104, ComBitSize=1, ComSignalInitValue=0, ComSignalType=BOOLEAN, ComHandleId=5302, ComSystemTemplateSystemSignalRef=DET_BI_STATIC_FLAG_253
            DET_HVC_FLAG_255_oRDR_DETECTION_253_256_oPCAN_RADAR_bf64cdf5_Tx: ComBitPosition=310, ComBitSize=1, ComSignalInitValue=0, ComSignalType=BOOLEAN, ComHandleId=5328, ComSystemTemplateSystemSignalRef=DET_HVC_FLAG_255
            DET_RANGE_VELOCITY_ERR_254_oRDR_DETECTION_253_256_oPCAN_RADAR_25f3222a_Tx: ComBitPosition=176, ComBitSize=8, ComSignalInitValue=0, ComSignalType=UINT8, ComHandleId=5358, ComSystemTemplateSystemSignalRef=DET_RANGE_VELOCITY_ERR_254
            DET_HVC_FLAG_253_oRDR_DETECTION_253_256_oPCAN_RADAR_76a43a09_Tx: ComBitPosition=86, ComBitSize=1, ComSignalInitValue=0, ComSignalType=BOOLEAN, ComHandleId=5326, ComSystemTemplateSystemSignalRef=DET_HVC_FLAG_253
            DET_ELEVATION_ERR_255_oRDR_DETECTION_253_256_oPCAN_RADAR_8c8ffbea_Tx: ComBitPosition=304, ComBitSize=6, ComSignalInitValue=0, ComSignalType=UINT8, ComHandleId=5320, ComSystemTemplateSystemSignalRef=DET_ELEVATION_ERR_255
            DET_RANGE_VELOCITY_ERR_253_oRDR_DETECTION_253_256_oPCAN_RADAR_79430143_Tx: ComBitPosition=64, ComBitSize=8, ComSignalInitValue=0, ComSignalType=UINT8, ComHandleId=5357, ComSystemTemplateSystemSignalRef=DET_RANGE_VELOCITY_ERR_253
            DET_AZIMUTH_ERR_254_oRDR_DETECTION_253_256_oPCAN_RADAR_ebc0fdf3_Tx: ComBitPosition=217, ComBitSize=7, ComSignalInitValue=0, ComSignalType=UINT8, ComHandleId=5295, ComSystemTemplateSystemSignalRef=DET_AZIMUTH_ERR_254
            DET_EXISTENCE_PROB_256_oRDR_DETECTION_253_256_oPCAN_RADAR_3af0f574_Tx: ComBitPosition=448, ComBitSize=6, ComSignalInitValue=0, ComSignalType=UINT8, ComHandleId=5325, ComSystemTemplateSystemSignalRef=DET_EXISTENCE_PROB_256
            DET_HVC_FLAG_256_oRDR_DETECTION_253_256_oPCAN_RADAR_db84b60b_Tx: ComBitPosition=422, ComBitSize=1, ComSignalInitValue=0, ComSignalType=BOOLEAN, ComHandleId=5329, ComSystemTemplateSystemSignalRef=DET_HVC_FLAG_256
            DET_RANGE_ERR_254_oRDR_DETECTION_253_256_oPCAN_RADAR_f806a1d4_Tx: ComBitPosition=152, ComBitSize=7, ComSignalInitValue=0, ComSignalType=UINT8, ComHandleId=5350, ComSystemTemplateSystemSignalRef=DET_RANGE_ERR_254
            DET_CONFD_AZIMUTH_255_oRDR_DETECTION_253_256_oPCAN_RADAR_d8e3b659_Tx: ComBitPosition=342, ComBitSize=2, ComSignalInitValue=0, ComSignalType=UINT8, ComHandleId=5308, ComSystemTemplateSystemSignalRef=DET_CONFD_AZIMUTH_255
            DET_RANGE_VELOCITY_253_oRDR_DETECTION_253_256_oPCAN_RADAR_76f8faf1_Tx: ComBitPosition=48, ComBitSize=15, ComSignalInitValue=16384, ComSignalType=UINT16, ComHandleId=5353, ComSystemTemplateSystemSignalRef=DET_RANGE_VELOCITY_253
            DET_ELEVATION_ERR_256_oRDR_DETECTION_253_256_oPCAN_RADAR_e86f8014_Tx: ComBitPosition=416, ComBitSize=6, ComSignalInitValue=0, ComSignalType=UINT8, ComHandleId=5321, ComSystemTemplateSystemSignalRef=DET_ELEVATION_ERR_256
            DET_SUPER_RES_TARGET_254_oRDR_DETECTION_253_256_oPCAN_RADAR_41ff92a5_Tx: ComBitPosition=199, ComBitSize=1, ComSignalInitValue=0, ComSignalType=BOOLEAN, ComHandleId=5370, ComSystemTemplateSystemSignalRef=DET_SUPER_RES_TARGET_254
            DET_RANGE_VELOCITY_256_oRDR_DETECTION_253_256_oPCAN_RADAR_dbd876f3_Tx: ComBitPosition=384, ComBitSize=15, ComSignalInitValue=16384, ComSignalType=UINT16, ComHandleId=5356, ComSystemTemplateSystemSignalRef=DET_RANGE_VELOCITY_256
            DET_ELEVATION_ERR_253_oRDR_DETECTION_253_256_oPCAN_RADAR_454f0c16_Tx: ComBitPosition=80, ComBitSize=6, ComSignalInitValue=0, ComSignalType=UINT8, ComHandleId=5318, ComSystemTemplateSystemSignalRef=DET_ELEVATION_ERR_253
            DET_RCS_256_oRDR_DETECTION_253_256_oPCAN_RADAR_5c5841a9_Tx: ComBitPosition=464, ComBitSize=8, ComSignalInitValue=128, ComSignalType=UINT8, ComHandleId=5364, ComSystemTemplateSystemSignalRef=DET_RCS_256
            DET_AZIMUTH_ERR_253_oRDR_DETECTION_253_256_oPCAN_RADAR_b770de9a_Tx: ComBitPosition=105, ComBitSize=7, ComSignalInitValue=0, ComSignalType=UINT8, ComHandleId=5294, ComSystemTemplateSystemSignalRef=DET_AZIMUTH_ERR_253
            DET_CONFD_AZIMUTH_254_oRDR_DETECTION_253_256_oPCAN_RADAR_4d9362cc_Tx: ComBitPosition=230, ComBitSize=2, ComSignalInitValue=0, ComSignalType=UINT8, ComHandleId=5307, ComSystemTemplateSystemSignalRef=DET_CONFD_AZIMUTH_254
            DET_BI_STATIC_FLAG_254_oRDR_DETECTION_253_256_oPCAN_RADAR_19592883_Tx: ComBitPosition=216, ComBitSize=1, ComSignalInitValue=0, ComSignalType=BOOLEAN, ComHandleId=5303, ComSystemTemplateSystemSignalRef=DET_BI_STATIC_FLAG_254
            DET_RANGE_256_oRDR_DETECTION_253_256_oPCAN_RADAR_ae7eb4d6_Tx: ComBitPosition=360, ComBitSize=15, ComSignalInitValue=0, ComSignalType=UINT16, ComHandleId=5348, ComSystemTemplateSystemSignalRef=DET_RANGE_256
            DET_SNR_254_oRDR_DETECTION_253_256_oPCAN_RADAR_7066bac0_Tx: ComBitPosition=232, ComBitSize=8, ComSignalInitValue=0, ComSignalType=UINT8, ComHandleId=5366, ComSystemTemplateSystemSignalRef=DET_SNR_254
            DET_RANGE_ERR_256_oRDR_DETECTION_253_256_oPCAN_RADAR_09960ebf_Tx: ComBitPosition=376, ComBitSize=7, ComSignalInitValue=0, ComSignalType=UINT8, ComHandleId=5352, ComSystemTemplateSystemSignalRef=DET_RANGE_ERR_256
            DET_CONFD_ELEVATION_254_oRDR_DETECTION_253_256_oPCAN_RADAR_4f066336_Tx: ComBitPosition=213, ComBitSize=2, ComSignalInitValue=0, ComSignalType=UINT8, ComHandleId=5311, ComSystemTemplateSystemSignalRef=DET_CONFD_ELEVATION_254
            DET_MH_SCAN_INDEX_4LSB_253_256_oRDR_DETECTION_253_256_oPCAN_RADAR_2696bec8_Tx: ComBitPosition=476, ComBitSize=4, ComSignalInitValue=0, ComSignalType=UINT8, ComHandleId=5336, ComSystemTemplateSystemSignalRef=DET_MH_SCAN_INDEX_4LSB_253_256
            DET_AZIMUTH_254_oRDR_DETECTION_253_256_oPCAN_RADAR_4f756806_Tx: ComBitPosition=200, ComBitSize=13, ComSignalInitValue=0, ComSignalType=UINT16, ComHandleId=5291, ComSystemTemplateSystemSignalRef=DET_AZIMUTH_254
            DET_EXISTENCE_PROB_253_oRDR_DETECTION_253_256_oPCAN_RADAR_97d07976_Tx: ComBitPosition=112, ComBitSize=6, ComSignalInitValue=0, ComSignalType=UINT8, ComHandleId=5322, ComSystemTemplateSystemSignalRef=DET_EXISTENCE_PROB_253
            DET_RANGE_ERR_255_oRDR_DETECTION_253_256_oPCAN_RADAR_6d767541_Tx: ComBitPosition=264, ComBitSize=7, ComSignalInitValue=0, ComSignalType=UINT8, ComHandleId=5351, ComSystemTemplateSystemSignalRef=DET_RANGE_ERR_255
            DET_SUPER_RES_TARGET_256_oRDR_DETECTION_253_256_oPCAN_RADAR_b06f3dce_Tx: ComBitPosition=423, ComBitSize=1, ComSignalInitValue=0, ComSignalType=BOOLEAN, ComHandleId=5372, ComSystemTemplateSystemSignalRef=DET_SUPER_RES_TARGET_256
            DET_CONFD_ELEVATION_256_oRDR_DETECTION_253_256_oPCAN_RADAR_be96cc5d_Tx: ComBitPosition=437, ComBitSize=2, ComSignalInitValue=0, ComSignalType=UINT8, ComHandleId=5313, ComSystemTemplateSystemSignalRef=DET_CONFD_ELEVATION_256
            DET_AZIMUTH_255_oRDR_DETECTION_253_256_oPCAN_RADAR_da05bc93_Tx: ComBitPosition=312, ComBitSize=13, ComSignalInitValue=0, ComSignalType=UINT16, ComHandleId=5292, ComSystemTemplateSystemSignalRef=DET_AZIMUTH_255
            DET_CONFD_AZIMUTH_256_oRDR_DETECTION_253_256_oPCAN_RADAR_bc03cda7_Tx: ComBitPosition=454, ComBitSize=2, ComSignalInitValue=0, ComSignalType=UINT8, ComHandleId=5309, ComSystemTemplateSystemSignalRef=DET_CONFD_AZIMUTH_256
            DET_MH_CYCLE_COUNTER_253_256_oRDR_DETECTION_253_256_oPCAN_RADAR_eabc9b44_Tx: ComBitPosition=16, ComBitSize=8, ComSignalInitValue=0, ComSignalType=UINT8, ComHandleId=5335, ComSystemTemplateSystemSignalRef=DET_MH_CYCLE_COUNTER_253_256
            DET_RANGE_ERR_253_oRDR_DETECTION_253_256_oPCAN_RADAR_a4b682bd_Tx: ComBitPosition=40, ComBitSize=7, ComSignalInitValue=0, ComSignalType=UINT8, ComHandleId=5349, ComSystemTemplateSystemSignalRef=DET_RANGE_ERR_253
            DET_ELEVATION_254_oRDR_DETECTION_253_256_oPCAN_RADAR_9ec6b70a_Tx: ComBitPosition=184, ComBitSize=8, ComSignalInitValue=0, ComSignalType=UINT8, ComHandleId=5315, ComSystemTemplateSystemSignalRef=DET_ELEVATION_254
            DET_RANGE_255_oRDR_DETECTION_253_256_oPCAN_RADAR_ca9ecf28_Tx: ComBitPosition=248, ComBitSize=15, ComSignalInitValue=0, ComSignalType=UINT16, ComHandleId=5347, ComSystemTemplateSystemSignalRef=DET_RANGE_255
            DET_RCS_254_oRDR_DETECTION_253_256_oPCAN_RADAR_adc8eec2_Tx: ComBitPosition=240, ComBitSize=8, ComSignalInitValue=128, ComSignalType=UINT8, ComHandleId=5362, ComSystemTemplateSystemSignalRef=DET_RCS_254
            DET_CONFD_ELEVATION_253_oRDR_DETECTION_253_256_oPCAN_RADAR_13b6405f_Tx: ComBitPosition=101, ComBitSize=2, ComSignalInitValue=0, ComSignalType=UINT8, ComHandleId=5310, ComSystemTemplateSystemSignalRef=DET_CONFD_ELEVATION_253
            DET_BI_STATIC_FLAG_255_oRDR_DETECTION_253_256_oPCAN_RADAR_8c29fc16_Tx: ComBitPosition=328, ComBitSize=1, ComSignalInitValue=0, ComSignalType=BOOLEAN, ComHandleId=5304, ComSystemTemplateSystemSignalRef=DET_BI_STATIC_FLAG_255
            DET_RCS_253_oRDR_DETECTION_253_256_oPCAN_RADAR_f178cdab_Tx: ComBitPosition=128, ComBitSize=8, ComSignalInitValue=128, ComSignalType=UINT8, ComHandleId=5361, ComSystemTemplateSystemSignalRef=DET_RCS_253
            DET_SNR_256_oRDR_DETECTION_253_256_oPCAN_RADAR_81f615ab_Tx: ComBitPosition=456, ComBitSize=8, ComSignalInitValue=0, ComSignalType=UINT8, ComHandleId=5368, ComSystemTemplateSystemSignalRef=DET_SNR_256
            DET_SUPER_RES_TARGET_255_oRDR_DETECTION_253_256_oPCAN_RADAR_d48f4630_Tx: ComBitPosition=311, ComBitSize=1, ComSignalInitValue=0, ComSignalType=BOOLEAN, ComHandleId=5371, ComSystemTemplateSystemSignalRef=DET_SUPER_RES_TARGET_255
            DET_RANGE_VELOCITY_255_oRDR_DETECTION_253_256_oPCAN_RADAR_bf380d0d_Tx: ComBitPosition=272, ComBitSize=15, ComSignalInitValue=16384, ComSignalType=UINT16, ComHandleId=5355, ComSystemTemplateSystemSignalRef=DET_RANGE_VELOCITY_255
            DET_ELEVATION_256_oRDR_DETECTION_253_256_oPCAN_RADAR_6f561861_Tx: ComBitPosition=408, ComBitSize=8, ComSignalInitValue=0, ComSignalType=UINT8, ComHandleId=5317, ComSystemTemplateSystemSignalRef=DET_ELEVATION_256
            DET_AZIMUTH_ERR_255_oRDR_DETECTION_253_256_oPCAN_RADAR_7eb02966_Tx: ComBitPosition=329, ComBitSize=7, ComSignalInitValue=0, ComSignalType=UINT8, ComHandleId=5296, ComSystemTemplateSystemSignalRef=DET_AZIMUTH_ERR_255
            DET_RCS_255_oRDR_DETECTION_253_256_oPCAN_RADAR_38b83a57_Tx: ComBitPosition=352, ComBitSize=8, ComSignalInitValue=128, ComSignalType=UINT8, ComHandleId=5363, ComSystemTemplateSystemSignalRef=DET_RCS_255
            DET_RANGE_VELOCITY_254_oRDR_DETECTION_253_256_oPCAN_RADAR_2a48d998_Tx: ComBitPosition=160, ComBitSize=15, ComSignalInitValue=16384, ComSignalType=UINT16, ComHandleId=5354, ComSystemTemplateSystemSignalRef=DET_RANGE_VELOCITY_254
            DET_RANGE_VELOCITY_ERR_255_oRDR_DETECTION_253_256_oPCAN_RADAR_b083f6bf_Tx: ComBitPosition=288, ComBitSize=8, ComSignalInitValue=0, ComSignalType=UINT8, ComHandleId=5359, ComSystemTemplateSystemSignalRef=DET_RANGE_VELOCITY_ERR_255
            DET_HVC_FLAG_254_oRDR_DETECTION_253_256_oPCAN_RADAR_2a141960_Tx: ComBitPosition=198, ComBitSize=1, ComSignalInitValue=0, ComSignalType=BOOLEAN, ComHandleId=5327, ComSystemTemplateSystemSignalRef=DET_HVC_FLAG_254
            DET_CONFD_ELEVATION_255_oRDR_DETECTION_253_256_oPCAN_RADAR_da76b7a3_Tx: ComBitPosition=325, ComBitSize=2, ComSignalInitValue=0, ComSignalType=UINT8, ComHandleId=5312, ComSystemTemplateSystemSignalRef=DET_CONFD_ELEVATION_255
            DET_RANGE_254_oRDR_DETECTION_253_256_oPCAN_RADAR_5fee1bbd_Tx: ComBitPosition=136, ComBitSize=15, ComSignalInitValue=0, ComSignalType=UINT16, ComHandleId=5346, ComSystemTemplateSystemSignalRef=DET_RANGE_254
            DET_ELEVATION_ERR_254_oRDR_DETECTION_253_256_oPCAN_RADAR_19ff2f7f_Tx: ComBitPosition=192, ComBitSize=6, ComSignalInitValue=0, ComSignalType=UINT8, ComHandleId=5319, ComSystemTemplateSystemSignalRef=DET_ELEVATION_ERR_254
            DET_AZIMUTH_253_oRDR_DETECTION_253_256_oPCAN_RADAR_13c54b6f_Tx: ComBitPosition=88, ComBitSize=13, ComSignalInitValue=0, ComSignalType=UINT16, ComHandleId=5290, ComSystemTemplateSystemSignalRef=DET_AZIMUTH_253
            DET_BI_STATIC_FLAG_256_oRDR_DETECTION_253_256_oPCAN_RADAR_e8c987e8_Tx: ComBitPosition=440, ComBitSize=1, ComSignalInitValue=0, ComSignalType=BOOLEAN, ComHandleId=5305, ComSystemTemplateSystemSignalRef=DET_BI_STATIC_FLAG_256
            DET_AZIMUTH_256_oRDR_DETECTION_253_256_oPCAN_RADAR_bee5c76d_Tx: ComBitPosition=424, ComBitSize=13, ComSignalInitValue=0, ComSignalType=UINT16, ComHandleId=5293, ComSystemTemplateSystemSignalRef=DET_AZIMUTH_256
            DET_SNR_255_oRDR_DETECTION_253_256_oPCAN_RADAR_e5166e55_Tx: ComBitPosition=344, ComBitSize=8, ComSignalInitValue=0, ComSignalType=UINT8, ComHandleId=5367, ComSystemTemplateSystemSignalRef=DET_SNR_255
            DET_EXISTENCE_PROB_254_oRDR_DETECTION_253_256_oPCAN_RADAR_cb605a1f_Tx: ComBitPosition=224, ComBitSize=6, ComSignalInitValue=0, ComSignalType=UINT8, ComHandleId=5323, ComSystemTemplateSystemSignalRef=DET_EXISTENCE_PROB_254
            DET_RANGE_VELOCITY_ERR_256_oRDR_DETECTION_253_256_oPCAN_RADAR_d4638d41_Tx: ComBitPosition=400, ComBitSize=8, ComSignalInitValue=0, ComSignalType=UINT8, ComHandleId=5360, ComSystemTemplateSystemSignalRef=DET_RANGE_VELOCITY_ERR_256
            DET_ELEVATION_255_oRDR_DETECTION_253_256_oPCAN_RADAR_0bb6639f_Tx: ComBitPosition=296, ComBitSize=8, ComSignalInitValue=0, ComSignalType=UINT8, ComHandleId=5316, ComSystemTemplateSystemSignalRef=DET_ELEVATION_255
            DET_AZIMUTH_ERR_256_oRDR_DETECTION_253_256_oPCAN_RADAR_1a505298_Tx: ComBitPosition=441, ComBitSize=7, ComSignalInitValue=0, ComSignalType=UINT8, ComHandleId=5297, ComSystemTemplateSystemSignalRef=DET_AZIMUTH_ERR_256
            DET_ELEVATION_253_oRDR_DETECTION_253_256_oPCAN_RADAR_c2769463_Tx: ComBitPosition=72, ComBitSize=8, ComSignalInitValue=0, ComSignalType=UINT8, ComHandleId=5314, ComSystemTemplateSystemSignalRef=DET_ELEVATION_253
            DET_RANGE_253_oRDR_DETECTION_253_256_oPCAN_RADAR_035e38d4_Tx: ComBitPosition=24, ComBitSize=15, ComSignalInitValue=0, ComSignalType=UINT16, ComHandleId=5345, ComSystemTemplateSystemSignalRef=DET_RANGE_253
            DET_SUPER_RES_TARGET_253_oRDR_DETECTION_253_256_oPCAN_RADAR_1d4fb1cc_Tx: ComBitPosition=87, ComBitSize=1, ComSignalInitValue=0, ComSignalType=BOOLEAN, ComHandleId=5369, ComSystemTemplateSystemSignalRef=DET_SUPER_RES_TARGET_253
            DET_BELOW_RAIN_THOLD_254_oRDR_DETECTION_253_256_oPCAN_RADAR_9a74fbc6_Tx: ComBitPosition=151, ComBitSize=1, ComSignalInitValue=0, ComSignalType=UINT8, ComHandleId=5299, ComSystemTemplateSystemSignalRef=DET_BELOW_RAIN_THOLD_254
            DET_PROB_1STAZHYPO_254_oRDR_DETECTION_253_256_oPCAN_RADAR_5441f8cb_Tx: ComBitPosition=215, ComBitSize=1, ComSignalInitValue=0, ComSignalType=BOOLEAN, ComHandleId=5342, ComSystemTemplateSystemSignalRef=DET_PROB_1STAZHYPO_254
            DET_BELOW_RAIN_THOLD_256_oRDR_DETECTION_253_256_oPCAN_RADAR_6be454ad_Tx: ComBitPosition=375, ComBitSize=1, ComSignalInitValue=0, ComSignalType=UINT8, ComHandleId=5301, ComSystemTemplateSystemSignalRef=DET_BELOW_RAIN_THOLD_256
            DET_IDM_256_oRDR_DETECTION_253_256_oPCAN_RADAR_50d68db6_Tx: ComBitPosition=399, ComBitSize=1, ComSignalInitValue=0, ComSignalType=UINT8, ComHandleId=5333, ComSystemTemplateSystemSignalRef=DET_IDM_256
            DET_MTD_255_oRDR_DETECTION_253_256_oPCAN_RADAR_5285c493_Tx: ComBitPosition=271, ComBitSize=1, ComSignalInitValue=0, ComSignalType=UINT8, ComHandleId=5339, ComSystemTemplateSystemSignalRef=DET_MTD_255
            DET_IDM_254_oRDR_DETECTION_253_256_oPCAN_RADAR_a14622dd_Tx: ComBitPosition=175, ComBitSize=1, ComSignalInitValue=0, ComSignalType=UINT8, ComHandleId=5331, ComSystemTemplateSystemSignalRef=DET_IDM_254
            DET_MTD_253_oRDR_DETECTION_253_256_oPCAN_RADAR_9b45336f_Tx: ComBitPosition=47, ComBitSize=1, ComSignalInitValue=0, ComSignalType=UINT8, ComHandleId=5337, ComSystemTemplateSystemSignalRef=DET_MTD_253
            DET_PROB_1STAZHYPO_255_oRDR_DETECTION_253_256_oPCAN_RADAR_c1312c5e_Tx: ComBitPosition=327, ComBitSize=1, ComSignalInitValue=0, ComSignalType=BOOLEAN, ComHandleId=5343, ComSystemTemplateSystemSignalRef=DET_PROB_1STAZHYPO_255
            DET_PROB_1STAZHYPO_253_oRDR_DETECTION_253_256_oPCAN_RADAR_08f1dba2_Tx: ComBitPosition=103, ComBitSize=1, ComSignalInitValue=0, ComSignalType=BOOLEAN, ComHandleId=5341, ComSystemTemplateSystemSignalRef=DET_PROB_1STAZHYPO_253
            DET_IDM_255_oRDR_DETECTION_253_256_oPCAN_RADAR_3436f648_Tx: ComBitPosition=287, ComBitSize=1, ComSignalInitValue=0, ComSignalType=UINT8, ComHandleId=5332, ComSystemTemplateSystemSignalRef=DET_IDM_255
            DET_BELOW_RAIN_THOLD_255_oRDR_DETECTION_253_256_oPCAN_RADAR_0f042f53_Tx: ComBitPosition=263, ComBitSize=1, ComSignalInitValue=0, ComSignalType=UINT8, ComHandleId=5300, ComSystemTemplateSystemSignalRef=DET_BELOW_RAIN_THOLD_255
            DET_BELOW_RAIN_THOLD_253_oRDR_DETECTION_253_256_oPCAN_RADAR_c6c4d8af_Tx: ComBitPosition=39, ComBitSize=1, ComSignalInitValue=0, ComSignalType=UINT8, ComHandleId=5298, ComSystemTemplateSystemSignalRef=DET_BELOW_RAIN_THOLD_253
            DET_MTD_254_oRDR_DETECTION_253_256_oPCAN_RADAR_c7f51006_Tx: ComBitPosition=159, ComBitSize=1, ComSignalInitValue=0, ComSignalType=UINT8, ComHandleId=5338, ComSystemTemplateSystemSignalRef=DET_MTD_254
            DET_MTD_256_oRDR_DETECTION_253_256_oPCAN_RADAR_3665bf6d_Tx: ComBitPosition=383, ComBitSize=1, ComSignalInitValue=0, ComSignalType=UINT8, ComHandleId=5340, ComSystemTemplateSystemSignalRef=DET_MTD_256
            DET_PROB_1STAZHYPO_256_oRDR_DETECTION_253_256_oPCAN_RADAR_a5d157a0_Tx: ComBitPosition=439, ComBitSize=1, ComSignalInitValue=0, ComSignalType=BOOLEAN, ComHandleId=5344, ComSystemTemplateSystemSignalRef=DET_PROB_1STAZHYPO_256
            DET_IDM_253_oRDR_DETECTION_253_256_oPCAN_RADAR_fdf601b4_Tx: ComBitPosition=63, ComBitSize=1, ComSignalInitValue=0, ComSignalType=UINT8, ComHandleId=5330, ComSystemTemplateSystemSignalRef=DET_IDM_253
        SG_Detections_269_272_oRDR_DETECTION_269_272_oPCAN_RADAR_ed3f2002_Tx: ComTransferProperty=TRIGGERED, ComHandleId=69, ComSystemTemplateSignalGroupRef=SG_Detections_269_272
          83 x ComGroupSignal, all with ComSignalEndianness=LITTLE_ENDIAN, ComTransferProperty=PENDING, ComSignalAccess=ACCESS_NEEDED_BY_SWC_OR_COM:
            DET_HVC_FLAG_271_oRDR_DETECTION_269_272_oPCAN_RADAR_a4d8111d_Tx: ComBitPosition=310, ComBitSize=1, ComSignalInitValue=0, ComSignalType=BOOLEAN, ComHandleId=5660, ComSystemTemplateSystemSignalRef=DET_HVC_FLAG_271
            DET_AZIMUTH_ERR_271_oRDR_DETECTION_269_272_oPCAN_RADAR_650cf58e_Tx: ComBitPosition=329, ComBitSize=7, ComSignalInitValue=0, ComSignalType=UINT8, ComHandleId=5628, ComSystemTemplateSystemSignalRef=DET_AZIMUTH_ERR_271
            DET_RANGE_VELOCITY_ERR_269_oRDR_DETECTION_269_272_oPCAN_RADAR_5b6f8c66_Tx: ComBitPosition=64, ComBitSize=8, ComSignalInitValue=0, ComSignalType=UINT8, ComHandleId=5689, ComSystemTemplateSystemSignalRef=DET_RANGE_VELOCITY_ERR_269
            DET_RANGE_ERR_269_oRDR_DETECTION_269_272_oPCAN_RADAR_869a0f98_Tx: ComBitPosition=40, ComBitSize=7, ComSignalInitValue=0, ComSignalType=UINT8, ComHandleId=5681, ComSystemTemplateSystemSignalRef=DET_RANGE_ERR_269
            DET_CONFD_AZIMUTH_269_oRDR_DETECTION_269_272_oPCAN_RADAR_330fcc80_Tx: ComBitPosition=118, ComBitSize=2, ComSignalInitValue=0, ComSignalType=UINT8, ComHandleId=5638, ComSystemTemplateSystemSignalRef=DET_CONFD_AZIMUTH_269
            DET_SNR_271_oRDR_DETECTION_269_272_oPCAN_RADAR_feaab2bd_Tx: ComBitPosition=344, ComBitSize=8, ComSignalInitValue=0, ComSignalType=UINT8, ComHandleId=5699, ComSystemTemplateSystemSignalRef=DET_SNR_271
            DET_SUPER_RES_TARGET_271_oRDR_DETECTION_269_272_oPCAN_RADAR_cf339ad8_Tx: ComBitPosition=311, ComBitSize=1, ComSignalInitValue=0, ComSignalType=BOOLEAN, ComHandleId=5703, ComSystemTemplateSystemSignalRef=DET_SUPER_RES_TARGET_271
            DET_MH_CYCLE_COUNTER_269_272_oRDR_DETECTION_269_272_oPCAN_RADAR_edc2533e_Tx: ComBitPosition=16, ComBitSize=8, ComSignalInitValue=0, ComSignalType=UINT8, ComHandleId=5667, ComSystemTemplateSystemSignalRef=DET_MH_CYCLE_COUNTER_269_272
            DET_AZIMUTH_271_oRDR_DETECTION_269_272_oPCAN_RADAR_c1b9607b_Tx: ComBitPosition=312, ComBitSize=13, ComSignalInitValue=0, ComSignalType=UINT16, ComHandleId=5624, ComSystemTemplateSystemSignalRef=DET_AZIMUTH_271
            DET_ELEVATION_ERR_271_oRDR_DETECTION_269_272_oPCAN_RADAR_97332702_Tx: ComBitPosition=304, ComBitSize=6, ComSignalInitValue=0, ComSignalType=UINT8, ComHandleId=5652, ComSystemTemplateSystemSignalRef=DET_ELEVATION_ERR_271
            DET_AZIMUTH_ERR_269_oRDR_DETECTION_269_272_oPCAN_RADAR_955c53bf_Tx: ComBitPosition=105, ComBitSize=7, ComSignalInitValue=0, ComSignalType=UINT8, ComHandleId=5626, ComSystemTemplateSystemSignalRef=DET_AZIMUTH_ERR_269
            DET_MH_SCAN_INDEX_4LSB_269_272_oRDR_DETECTION_269_272_oPCAN_RADAR_21e876b2_Tx: ComBitPosition=476, ComBitSize=4, ComSignalInitValue=0, ComSignalType=UINT8, ComHandleId=5668, ComSystemTemplateSystemSignalRef=DET_MH_SCAN_INDEX_4LSB_269_272
            DET_RANGE_VELOCITY_270_oRDR_DETECTION_269_272_oPCAN_RADAR_31f40570_Tx: ComBitPosition=160, ComBitSize=15, ComSignalInitValue=16384, ComSignalType=UINT16, ComHandleId=5686, ComSystemTemplateSystemSignalRef=DET_RANGE_VELOCITY_270
            DET_BI_STATIC_FLAG_270_oRDR_DETECTION_269_272_oPCAN_RADAR_02e5f46b_Tx: ComBitPosition=216, ComBitSize=1, ComSignalInitValue=0, ComSignalType=BOOLEAN, ComHandleId=5635, ComSystemTemplateSystemSignalRef=DET_BI_STATIC_FLAG_270
            DET_RANGE_271_oRDR_DETECTION_269_272_oPCAN_RADAR_d12213c0_Tx: ComBitPosition=248, ComBitSize=15, ComSignalInitValue=0, ComSignalType=UINT16, ComHandleId=5679, ComSystemTemplateSystemSignalRef=DET_RANGE_271
            DET_EXISTENCE_PROB_271_oRDR_DETECTION_269_272_oPCAN_RADAR_45ac5262_Tx: ComBitPosition=336, ComBitSize=6, ComSignalInitValue=0, ComSignalType=UINT8, ComHandleId=5656, ComSystemTemplateSystemSignalRef=DET_EXISTENCE_PROB_271
            DET_SUPER_RES_TARGET_270_oRDR_DETECTION_269_272_oPCAN_RADAR_5a434e4d_Tx: ComBitPosition=199, ComBitSize=1, ComSignalInitValue=0, ComSignalType=BOOLEAN, ComHandleId=5702, ComSystemTemplateSystemSignalRef=DET_SUPER_RES_TARGET_270
            DET_SUPER_RES_TARGET_269_oRDR_DETECTION_269_272_oPCAN_RADAR_3f633ce9_Tx: ComBitPosition=87, ComBitSize=1, ComSignalInitValue=0, ComSignalType=BOOLEAN, ComHandleId=5701, ComSystemTemplateSystemSignalRef=DET_SUPER_RES_TARGET_269
            DET_AZIMUTH_269_oRDR_DETECTION_269_272_oPCAN_RADAR_31e9c64a_Tx: ComBitPosition=88, ComBitSize=13, ComSignalInitValue=0, ComSignalType=UINT16, ComHandleId=5622, ComSystemTemplateSystemSignalRef=DET_AZIMUTH_269
            DET_ELEVATION_ERR_272_oRDR_DETECTION_269_272_oPCAN_RADAR_f3d35cfc_Tx: ComBitPosition=416, ComBitSize=6, ComSignalInitValue=0, ComSignalType=UINT8, ComHandleId=5653, ComSystemTemplateSystemSignalRef=DET_ELEVATION_ERR_272
            DET_RCS_270_oRDR_DETECTION_269_272_oPCAN_RADAR_b674322a_Tx: ComBitPosition=240, ComBitSize=8, ComSignalInitValue=128, ComSignalType=UINT8, ComHandleId=5694, ComSystemTemplateSystemSignalRef=DET_RCS_270
            DET_SNR_272_oRDR_DETECTION_269_272_oPCAN_RADAR_9a4ac943_Tx: ComBitPosition=456, ComBitSize=8, ComSignalInitValue=0, ComSignalType=UINT8, ComHandleId=5700, ComSystemTemplateSystemSignalRef=DET_SNR_272
            DET_BI_STATIC_FLAG_269_oRDR_DETECTION_269_272_oPCAN_RADAR_67c586cf_Tx: ComBitPosition=104, ComBitSize=1, ComSignalInitValue=0, ComSignalType=BOOLEAN, ComHandleId=5634, ComSystemTemplateSystemSignalRef=DET_BI_STATIC_FLAG_269
            DET_ELEVATION_272_oRDR_DETECTION_269_272_oPCAN_RADAR_74eac489_Tx: ComBitPosition=408, ComBitSize=8, ComSignalInitValue=0, ComSignalType=UINT8, ComHandleId=5649, ComSystemTemplateSystemSignalRef=DET_ELEVATION_272
            DET_MH_CRC16_269_272_oRDR_DETECTION_269_272_oPCAN_RADAR_69b7f209_Tx: ComBitPosition=0, ComBitSize=16, ComSignalInitValue=0, ComSignalType=UINT16, ComHandleId=5666, ComSystemTemplateSystemSignalRef=DET_MH_CRC16_269_272
            DET_RANGE_VELOCITY_ERR_271_oRDR_DETECTION_269_272_oPCAN_RADAR_ab3f2a57_Tx: ComBitPosition=288, ComBitSize=8, ComSignalInitValue=0, ComSignalType=UINT8, ComHandleId=5691, ComSystemTemplateSystemSignalRef=DET_RANGE_VELOCITY_ERR_271
            DET_CONFD_AZIMUTH_272_oRDR_DETECTION_269_272_oPCAN_RADAR_a7bf114f_Tx: ComBitPosition=454, ComBitSize=2, ComSignalInitValue=0, ComSignalType=UINT8, ComHandleId=5641, ComSystemTemplateSystemSignalRef=DET_CONFD_AZIMUTH_272
            DET_RANGE_ERR_272_oRDR_DETECTION_269_272_oPCAN_RADAR_122ad257_Tx: ComBitPosition=376, ComBitSize=7, ComSignalInitValue=0, ComSignalType=UINT8, ComHandleId=5684, ComSystemTemplateSystemSignalRef=DET_RANGE_ERR_272
            DET_RANGE_270_oRDR_DETECTION_269_272_oPCAN_RADAR_4452c755_Tx: ComBitPosition=136, ComBitSize=15, ComSignalInitValue=0, ComSignalType=UINT16, ComHandleId=5678, ComSystemTemplateSystemSignalRef=DET_RANGE_270
            DET_RANGE_VELOCITY_ERR_272_oRDR_DETECTION_269_272_oPCAN_RADAR_cfdf51a9_Tx: ComBitPosition=400, ComBitSize=8, ComSignalInitValue=0, ComSignalType=UINT8, ComHandleId=5692, ComSystemTemplateSystemSignalRef=DET_RANGE_VELOCITY_ERR_272
            DET_ELEVATION_ERR_269_oRDR_DETECTION_269_272_oPCAN_RADAR_67638133_Tx: ComBitPosition=80, ComBitSize=6, ComSignalInitValue=0, ComSignalType=UINT8, ComHandleId=5650, ComSystemTemplateSystemSignalRef=DET_ELEVATION_ERR_269
            DET_AZIMUTH_270_oRDR_DETECTION_269_272_oPCAN_RADAR_54c9b4ee_Tx: ComBitPosition=200, ComBitSize=13, ComSignalInitValue=0, ComSignalType=UINT16, ComHandleId=5623, ComSystemTemplateSystemSignalRef=DET_AZIMUTH_270
            DET_EXISTENCE_PROB_270_oRDR_DETECTION_269_272_oPCAN_RADAR_d0dc86f7_Tx: ComBitPosition=224, ComBitSize=6, ComSignalInitValue=0, ComSignalType=UINT8, ComHandleId=5655, ComSystemTemplateSystemSignalRef=DET_EXISTENCE_PROB_270
            DET_HVC_FLAG_272_oRDR_DETECTION_269_272_oPCAN_RADAR_c0386ae3_Tx: ComBitPosition=422, ComBitSize=1, ComSignalInitValue=0, ComSignalType=BOOLEAN, ComHandleId=5661, ComSystemTemplateSystemSignalRef=DET_HVC_FLAG_272
            DET_SNR_270_oRDR_DETECTION_269_272_oPCAN_RADAR_6bda6628_Tx: ComBitPosition=232, ComBitSize=8, ComSignalInitValue=0, ComSignalType=UINT8, ComHandleId=5698, ComSystemTemplateSystemSignalRef=DET_SNR_270
            DET_RANGE_ERR_270_oRDR_DETECTION_269_272_oPCAN_RADAR_e3ba7d3c_Tx: ComBitPosition=152, ComBitSize=7, ComSignalInitValue=0, ComSignalType=UINT8, ComHandleId=5682, ComSystemTemplateSystemSignalRef=DET_RANGE_ERR_270
            DET_CONFD_ELEVATION_272_oRDR_DETECTION_269_272_oPCAN_RADAR_a52a10b5_Tx: ComBitPosition=437, ComBitSize=2, ComSignalInitValue=0, ComSignalType=UINT8, ComHandleId=5645, ComSystemTemplateSystemSignalRef=DET_CONFD_ELEVATION_272
            DET_ELEVATION_269_oRDR_DETECTION_269_272_oPCAN_RADAR_e05a1946_Tx: ComBitPosition=72, ComBitSize=8, ComSignalInitValue=0, ComSignalType=UINT8, ComHandleId=5646, ComSystemTemplateSystemSignalRef=DET_ELEVATION_269
            DET_RANGE_269_oRDR_DETECTION_269_272_oPCAN_RADAR_2172b5f1_Tx: ComBitPosition=24, ComBitSize=15, ComSignalInitValue=0, ComSignalType=UINT16, ComHandleId=5677, ComSystemTemplateSystemSignalRef=DET_RANGE_269
            DET_RANGE_VELOCITY_272_oRDR_DETECTION_269_272_oPCAN_RADAR_c064aa1b_Tx: ComBitPosition=384, ComBitSize=15, ComSignalInitValue=16384, ComSignalType=UINT16, ComHandleId=5688, ComSystemTemplateSystemSignalRef=DET_RANGE_VELOCITY_272
            DET_RCS_271_oRDR_DETECTION_269_272_oPCAN_RADAR_2304e6bf_Tx: ComBitPosition=352, ComBitSize=8, ComSignalInitValue=128, ComSignalType=UINT8, ComHandleId=5695, ComSystemTemplateSystemSignalRef=DET_RCS_271
            DET_CONFD_AZIMUTH_271_oRDR_DETECTION_269_272_oPCAN_RADAR_c35f6ab1_Tx: ComBitPosition=342, ComBitSize=2, ComSignalInitValue=0, ComSignalType=UINT8, ComHandleId=5640, ComSystemTemplateSystemSignalRef=DET_CONFD_AZIMUTH_271
            DET_EXISTENCE_PROB_272_oRDR_DETECTION_269_272_oPCAN_RADAR_214c299c_Tx: ComBitPosition=448, ComBitSize=6, ComSignalInitValue=0, ComSignalType=UINT8, ComHandleId=5657, ComSystemTemplateSystemSignalRef=DET_EXISTENCE_PROB_272
            DET_CONFD_ELEVATION_269_oRDR_DETECTION_269_272_oPCAN_RADAR_319acd7a_Tx: ComBitPosition=101, ComBitSize=2, ComSignalInitValue=0, ComSignalType=UINT8, ComHandleId=5642, ComSystemTemplateSystemSignalRef=DET_CONFD_ELEVATION_269
            DET_RCS_272_oRDR_DETECTION_269_272_oPCAN_RADAR_47e49d41_Tx: ComBitPosition=464, ComBitSize=8, ComSignalInitValue=128, ComSignalType=UINT8, ComHandleId=5696, ComSystemTemplateSystemSignalRef=DET_RCS_272
            DET_CONFD_AZIMUTH_270_oRDR_DETECTION_269_272_oPCAN_RADAR_562fbe24_Tx: ComBitPosition=230, ComBitSize=2, ComSignalInitValue=0, ComSignalType=UINT8, ComHandleId=5639, ComSystemTemplateSystemSignalRef=DET_CONFD_AZIMUTH_270
            DET_BI_STATIC_FLAG_271_oRDR_DETECTION_269_272_oPCAN_RADAR_979520fe_Tx: ComBitPosition=328, ComBitSize=1, ComSignalInitValue=0, ComSignalType=BOOLEAN, ComHandleId=5636, ComSystemTemplateSystemSignalRef=DET_BI_STATIC_FLAG_271
            DET_ELEVATION_270_oRDR_DETECTION_269_272_oPCAN_RADAR_857a6be2_Tx: ComBitPosition=184, ComBitSize=8, ComSignalInitValue=0, ComSignalType=UINT8, ComHandleId=5647, ComSystemTemplateSystemSignalRef=DET_ELEVATION_270
            DET_ELEVATION_ERR_270_oRDR_DETECTION_269_272_oPCAN_RADAR_0243f397_Tx: ComBitPosition=192, ComBitSize=6, ComSignalInitValue=0, ComSignalType=UINT8, ComHandleId=5651, ComSystemTemplateSystemSignalRef=DET_ELEVATION_ERR_270
            DET_CONFD_ELEVATION_271_oRDR_DETECTION_269_272_oPCAN_RADAR_c1ca6b4b_Tx: ComBitPosition=325, ComBitSize=2, ComSignalInitValue=0, ComSignalType=UINT8, ComHandleId=5644, ComSystemTemplateSystemSignalRef=DET_CONFD_ELEVATION_271
            DET_AZIMUTH_ERR_270_oRDR_DETECTION_269_272_oPCAN_RADAR_f07c211b_Tx: ComBitPosition=217, ComBitSize=7, ComSignalInitValue=0, ComSignalType=UINT8, ComHandleId=5627, ComSystemTemplateSystemSignalRef=DET_AZIMUTH_ERR_270
            DET_BI_STATIC_FLAG_272_oRDR_DETECTION_269_272_oPCAN_RADAR_f3755b00_Tx: ComBitPosition=440, ComBitSize=1, ComSignalInitValue=0, ComSignalType=BOOLEAN, ComHandleId=5637, ComSystemTemplateSystemSignalRef=DET_BI_STATIC_FLAG_272
            DET_HVC_FLAG_269_oRDR_DETECTION_269_272_oPCAN_RADAR_5488b72c_Tx: ComBitPosition=86, ComBitSize=1, ComSignalInitValue=0, ComSignalType=BOOLEAN, ComHandleId=5658, ComSystemTemplateSystemSignalRef=DET_HVC_FLAG_269
            DET_HVC_FLAG_270_oRDR_DETECTION_269_272_oPCAN_RADAR_31a8c588_Tx: ComBitPosition=198, ComBitSize=1, ComSignalInitValue=0, ComSignalType=BOOLEAN, ComHandleId=5659, ComSystemTemplateSystemSignalRef=DET_HVC_FLAG_270
            DET_RANGE_ERR_271_oRDR_DETECTION_269_272_oPCAN_RADAR_76caa9a9_Tx: ComBitPosition=264, ComBitSize=7, ComSignalInitValue=0, ComSignalType=UINT8, ComHandleId=5683, ComSystemTemplateSystemSignalRef=DET_RANGE_ERR_271
            DET_ELEVATION_271_oRDR_DETECTION_269_272_oPCAN_RADAR_100abf77_Tx: ComBitPosition=296, ComBitSize=8, ComSignalInitValue=0, ComSignalType=UINT8, ComHandleId=5648, ComSystemTemplateSystemSignalRef=DET_ELEVATION_271
            DET_RANGE_VELOCITY_271_oRDR_DETECTION_269_272_oPCAN_RADAR_a484d1e5_Tx: ComBitPosition=272, ComBitSize=15, ComSignalInitValue=16384, ComSignalType=UINT16, ComHandleId=5687, ComSystemTemplateSystemSignalRef=DET_RANGE_VELOCITY_271
            DET_RANGE_VELOCITY_269_oRDR_DETECTION_269_272_oPCAN_RADAR_54d477d4_Tx: ComBitPosition=48, ComBitSize=15, ComSignalInitValue=16384, ComSignalType=UINT16, ComHandleId=5685, ComSystemTemplateSystemSignalRef=DET_RANGE_VELOCITY_269
            DET_CONFD_ELEVATION_270_oRDR_DETECTION_269_272_oPCAN_RADAR_54babfde_Tx: ComBitPosition=213, ComBitSize=2, ComSignalInitValue=0, ComSignalType=UINT8, ComHandleId=5643, ComSystemTemplateSystemSignalRef=DET_CONFD_ELEVATION_270
            DET_SUPER_RES_TARGET_272_oRDR_DETECTION_269_272_oPCAN_RADAR_abd3e126_Tx: ComBitPosition=423, ComBitSize=1, ComSignalInitValue=0, ComSignalType=BOOLEAN, ComHandleId=5704, ComSystemTemplateSystemSignalRef=DET_SUPER_RES_TARGET_272
            DET_AZIMUTH_ERR_272_oRDR_DETECTION_269_272_oPCAN_RADAR_01ec8e70_Tx: ComBitPosition=441, ComBitSize=7, ComSignalInitValue=0, ComSignalType=UINT8, ComHandleId=5629, ComSystemTemplateSystemSignalRef=DET_AZIMUTH_ERR_272
            DET_RANGE_272_oRDR_DETECTION_269_272_oPCAN_RADAR_b5c2683e_Tx: ComBitPosition=360, ComBitSize=15, ComSignalInitValue=0, ComSignalType=UINT16, ComHandleId=5680, ComSystemTemplateSystemSignalRef=DET_RANGE_272
            DET_AZIMUTH_272_oRDR_DETECTION_269_272_oPCAN_RADAR_a5591b85_Tx: ComBitPosition=424, ComBitSize=13, ComSignalInitValue=0, ComSignalType=UINT16, ComHandleId=5625, ComSystemTemplateSystemSignalRef=DET_AZIMUTH_272
            DET_RCS_269_oRDR_DETECTION_269_272_oPCAN_RADAR_d354408e_Tx: ComBitPosition=128, ComBitSize=8, ComSignalInitValue=128, ComSignalType=UINT8, ComHandleId=5693, ComSystemTemplateSystemSignalRef=DET_RCS_269
            DET_EXISTENCE_PROB_269_oRDR_DETECTION_269_272_oPCAN_RADAR_b5fcf453_Tx: ComBitPosition=112, ComBitSize=6, ComSignalInitValue=0, ComSignalType=UINT8, ComHandleId=5654, ComSystemTemplateSystemSignalRef=DET_EXISTENCE_PROB_269
            DET_RANGE_VELOCITY_ERR_270_oRDR_DETECTION_269_272_oPCAN_RADAR_3e4ffec2_Tx: ComBitPosition=176, ComBitSize=8, ComSignalInitValue=0, ComSignalType=UINT8, ComHandleId=5690, ComSystemTemplateSystemSignalRef=DET_RANGE_VELOCITY_ERR_270
            DET_SNR_269_oRDR_DETECTION_269_272_oPCAN_RADAR_0efa148c_Tx: ComBitPosition=120, ComBitSize=8, ComSignalInitValue=0, ComSignalType=UINT8, ComHandleId=5697, ComSystemTemplateSystemSignalRef=DET_SNR_269
            DET_BELOW_RAIN_THOLD_269_oRDR_DETECTION_269_272_oPCAN_RADAR_e4e8558a_Tx: ComBitPosition=39, ComBitSize=1, ComSignalInitValue=0, ComSignalType=UINT8, ComHandleId=5630, ComSystemTemplateSystemSignalRef=DET_BELOW_RAIN_THOLD_269
            DET_PROB_1STAZHYPO_271_oRDR_DETECTION_269_272_oPCAN_RADAR_da8df0b6_Tx: ComBitPosition=327, ComBitSize=1, ComSignalInitValue=0, ComSignalType=BOOLEAN, ComHandleId=5675, ComSystemTemplateSystemSignalRef=DET_PROB_1STAZHYPO_271
            DET_MTD_271_oRDR_DETECTION_269_272_oPCAN_RADAR_4939187b_Tx: ComBitPosition=271, ComBitSize=1, ComSignalInitValue=0, ComSignalType=UINT8, ComHandleId=5671, ComSystemTemplateSystemSignalRef=DET_MTD_271
            DET_BELOW_RAIN_THOLD_272_oRDR_DETECTION_269_272_oPCAN_RADAR_70588845_Tx: ComBitPosition=375, ComBitSize=1, ComSignalInitValue=0, ComSignalType=UINT8, ComHandleId=5633, ComSystemTemplateSystemSignalRef=DET_BELOW_RAIN_THOLD_272
            DET_IDM_269_oRDR_DETECTION_269_272_oPCAN_RADAR_dfda8c91_Tx: ComBitPosition=63, ComBitSize=1, ComSignalInitValue=0, ComSignalType=UINT8, ComHandleId=5662, ComSystemTemplateSystemSignalRef=DET_IDM_269
            DET_IDM_270_oRDR_DETECTION_269_272_oPCAN_RADAR_bafafe35_Tx: ComBitPosition=175, ComBitSize=1, ComSignalInitValue=0, ComSignalType=UINT8, ComHandleId=5663, ComSystemTemplateSystemSignalRef=DET_IDM_270
            DET_PROB_1STAZHYPO_272_oRDR_DETECTION_269_272_oPCAN_RADAR_be6d8b48_Tx: ComBitPosition=439, ComBitSize=1, ComSignalInitValue=0, ComSignalType=BOOLEAN, ComHandleId=5676, ComSystemTemplateSystemSignalRef=DET_PROB_1STAZHYPO_272
            DET_MTD_270_oRDR_DETECTION_269_272_oPCAN_RADAR_dc49ccee_Tx: ComBitPosition=159, ComBitSize=1, ComSignalInitValue=0, ComSignalType=UINT8, ComHandleId=5670, ComSystemTemplateSystemSignalRef=DET_MTD_270
            DET_IDM_272_oRDR_DETECTION_269_272_oPCAN_RADAR_4b6a515e_Tx: ComBitPosition=399, ComBitSize=1, ComSignalInitValue=0, ComSignalType=UINT8, ComHandleId=5665, ComSystemTemplateSystemSignalRef=DET_IDM_272
            DET_MTD_269_oRDR_DETECTION_269_272_oPCAN_RADAR_b969be4a_Tx: ComBitPosition=47, ComBitSize=1, ComSignalInitValue=0, ComSignalType=UINT8, ComHandleId=5669, ComSystemTemplateSystemSignalRef=DET_MTD_269
            DET_PROB_1STAZHYPO_270_oRDR_DETECTION_269_272_oPCAN_RADAR_4ffd2423_Tx: ComBitPosition=215, ComBitSize=1, ComSignalInitValue=0, ComSignalType=BOOLEAN, ComHandleId=5674, ComSystemTemplateSystemSignalRef=DET_PROB_1STAZHYPO_270
            DET_BELOW_RAIN_THOLD_271_oRDR_DETECTION_269_272_oPCAN_RADAR_14b8f3bb_Tx: ComBitPosition=263, ComBitSize=1, ComSignalInitValue=0, ComSignalType=UINT8, ComHandleId=5632, ComSystemTemplateSystemSignalRef=DET_BELOW_RAIN_THOLD_271
            DET_PROB_1STAZHYPO_269_oRDR_DETECTION_269_272_oPCAN_RADAR_2add5687_Tx: ComBitPosition=103, ComBitSize=1, ComSignalInitValue=0, ComSignalType=BOOLEAN, ComHandleId=5673, ComSystemTemplateSystemSignalRef=DET_PROB_1STAZHYPO_269
            DET_IDM_271_oRDR_DETECTION_269_272_oPCAN_RADAR_2f8a2aa0_Tx: ComBitPosition=287, ComBitSize=1, ComSignalInitValue=0, ComSignalType=UINT8, ComHandleId=5664, ComSystemTemplateSystemSignalRef=DET_IDM_271
            DET_BELOW_RAIN_THOLD_270_oRDR_DETECTION_269_272_oPCAN_RADAR_81c8272e_Tx: ComBitPosition=151, ComBitSize=1, ComSignalInitValue=0, ComSignalType=UINT8, ComHandleId=5631, ComSystemTemplateSystemSignalRef=DET_BELOW_RAIN_THOLD_270
            DET_MTD_272_oRDR_DETECTION_269_272_oPCAN_RADAR_2dd96385_Tx: ComBitPosition=383, ComBitSize=1, ComSignalInitValue=0, ComSignalType=UINT8, ComHandleId=5672, ComSystemTemplateSystemSignalRef=DET_MTD_272
        SG_Detections_097_100_oRDR_DETECTION_097_100_oPCAN_RADAR_dcf343f6_Tx: ComTransferProperty=TRIGGERED, ComHandleId=26, ComSystemTemplateSignalGroupRef=SG_Detections_097_100
          83 x ComGroupSignal, all with ComSignalEndianness=LITTLE_ENDIAN, ComTransferProperty=PENDING, ComSignalAccess=ACCESS_NEEDED_BY_SWC_OR_COM:
            DET_BI_STATIC_FLAG_100_oRDR_DETECTION_097_100_oPCAN_RADAR_ac3cb22e_Tx: ComBitPosition=440, ComBitSize=1, ComSignalInitValue=0, ComSignalType=BOOLEAN, ComHandleId=2068, ComSystemTemplateSystemSignalRef=DET_BI_STATIC_FLAG_100
            DET_ELEVATION_099_oRDR_DETECTION_097_100_oPCAN_RADAR_1fad0f9f_Tx: ComBitPosition=296, ComBitSize=8, ComSignalInitValue=0, ComSignalType=UINT8, ComHandleId=2079, ComSystemTemplateSystemSignalRef=DET_ELEVATION_099
            DET_RANGE_VELOCITY_100_oRDR_DETECTION_097_100_oPCAN_RADAR_9f2d4335_Tx: ComBitPosition=384, ComBitSize=15, ComSignalInitValue=16384, ComSignalType=UINT16, ComHandleId=2119, ComSystemTemplateSystemSignalRef=DET_RANGE_VELOCITY_100
            DET_SNR_100_oRDR_DETECTION_097_100_oPCAN_RADAR_c503206d_Tx: ComBitPosition=456, ComBitSize=8, ComSignalInitValue=0, ComSignalType=UINT8, ComHandleId=2131, ComSystemTemplateSystemSignalRef=DET_SNR_100
            DET_RANGE_VELOCITY_ERR_100_oRDR_DETECTION_097_100_oPCAN_RADAR_9096b887_Tx: ComBitPosition=400, ComBitSize=8, ComSignalInitValue=0, ComSignalType=UINT8, ComHandleId=2123, ComSystemTemplateSystemSignalRef=DET_RANGE_VELOCITY_ERR_100
            DET_AZIMUTH_ERR_097_oRDR_DETECTION_097_100_oPCAN_RADAR_d3cb03b4_Tx: ComBitPosition=105, ComBitSize=7, ComSignalInitValue=0, ComSignalType=UINT8, ComHandleId=2057, ComSystemTemplateSystemSignalRef=DET_AZIMUTH_ERR_097
            DET_RANGE_ERR_099_oRDR_DETECTION_097_100_oPCAN_RADAR_796d1941_Tx: ComBitPosition=264, ComBitSize=7, ComSignalInitValue=0, ComSignalType=UINT8, ComHandleId=2114, ComSystemTemplateSystemSignalRef=DET_RANGE_ERR_099
            DET_SNR_097_oRDR_DETECTION_097_100_oPCAN_RADAR_486d4487_Tx: ComBitPosition=120, ComBitSize=8, ComSignalInitValue=0, ComSignalType=UINT8, ComHandleId=2128, ComSystemTemplateSystemSignalRef=DET_SNR_097
            DET_BI_STATIC_FLAG_098_oRDR_DETECTION_097_100_oPCAN_RADAR_0d424483_Tx: ComBitPosition=216, ComBitSize=1, ComSignalInitValue=0, ComSignalType=BOOLEAN, ComHandleId=2066, ComSystemTemplateSystemSignalRef=DET_BI_STATIC_FLAG_098
            DET_AZIMUTH_097_oRDR_DETECTION_097_100_oPCAN_RADAR_777e9641_Tx: ComBitPosition=88, ComBitSize=13, ComSignalInitValue=0, ComSignalType=UINT16, ComHandleId=2053, ComSystemTemplateSystemSignalRef=DET_AZIMUTH_097
            DET_CONFD_AZIMUTH_098_oRDR_DETECTION_097_100_oPCAN_RADAR_59880ecc_Tx: ComBitPosition=230, ComBitSize=2, ComSignalInitValue=0, ComSignalType=UINT8, ComHandleId=2070, ComSystemTemplateSystemSignalRef=DET_CONFD_AZIMUTH_098
            DET_HVC_FLAG_100_oRDR_DETECTION_097_100_oPCAN_RADAR_9f7183cd_Tx: ComBitPosition=422, ComBitSize=1, ComSignalInitValue=0, ComSignalType=BOOLEAN, ComHandleId=2092, ComSystemTemplateSystemSignalRef=DET_HVC_FLAG_100
            DET_RANGE_VELOCITY_098_oRDR_DETECTION_097_100_oPCAN_RADAR_3e53b598_Tx: ComBitPosition=160, ComBitSize=15, ComSignalInitValue=16384, ComSignalType=UINT16, ComHandleId=2117, ComSystemTemplateSystemSignalRef=DET_RANGE_VELOCITY_098
            DET_RANGE_ERR_098_oRDR_DETECTION_097_100_oPCAN_RADAR_ec1dcdd4_Tx: ComBitPosition=152, ComBitSize=7, ComSignalInitValue=0, ComSignalType=UINT8, ComHandleId=2113, ComSystemTemplateSystemSignalRef=DET_RANGE_ERR_098
            DET_BI_STATIC_FLAG_099_oRDR_DETECTION_097_100_oPCAN_RADAR_98329016_Tx: ComBitPosition=328, ComBitSize=1, ComSignalInitValue=0, ComSignalType=BOOLEAN, ComHandleId=2067, ComSystemTemplateSystemSignalRef=DET_BI_STATIC_FLAG_099
            DET_RANGE_097_oRDR_DETECTION_097_100_oPCAN_RADAR_67e5e5fa_Tx: ComBitPosition=24, ComBitSize=15, ComSignalInitValue=0, ComSignalType=UINT16, ComHandleId=2108, ComSystemTemplateSystemSignalRef=DET_RANGE_097
            DET_SUPER_RES_TARGET_097_oRDR_DETECTION_097_100_oPCAN_RADAR_79f46ce2_Tx: ComBitPosition=87, ComBitSize=1, ComSignalInitValue=0, ComSignalType=BOOLEAN, ComHandleId=2132, ComSystemTemplateSystemSignalRef=DET_SUPER_RES_TARGET_097
            DET_CONFD_ELEVATION_099_oRDR_DETECTION_097_100_oPCAN_RADAR_ce6ddba3_Tx: ComBitPosition=325, ComBitSize=2, ComSignalInitValue=0, ComSignalType=UINT8, ComHandleId=2075, ComSystemTemplateSystemSignalRef=DET_CONFD_ELEVATION_099
            DET_HVC_FLAG_097_oRDR_DETECTION_097_100_oPCAN_RADAR_121fe727_Tx: ComBitPosition=86, ComBitSize=1, ComSignalInitValue=0, ComSignalType=BOOLEAN, ComHandleId=2089, ComSystemTemplateSystemSignalRef=DET_HVC_FLAG_097
            DET_RANGE_100_oRDR_DETECTION_097_100_oPCAN_RADAR_ea8b8110_Tx: ComBitPosition=360, ComBitSize=15, ComSignalInitValue=0, ComSignalType=UINT16, ComHandleId=2111, ComSystemTemplateSystemSignalRef=DET_RANGE_100
            DET_AZIMUTH_ERR_100_oRDR_DETECTION_097_100_oPCAN_RADAR_5ea5675e_Tx: ComBitPosition=441, ComBitSize=7, ComSignalInitValue=0, ComSignalType=UINT8, ComHandleId=2060, ComSystemTemplateSystemSignalRef=DET_AZIMUTH_ERR_100
            DET_ELEVATION_ERR_100_oRDR_DETECTION_097_100_oPCAN_RADAR_ac9ab5d2_Tx: ComBitPosition=416, ComBitSize=6, ComSignalInitValue=0, ComSignalType=UINT8, ComHandleId=2084, ComSystemTemplateSystemSignalRef=DET_ELEVATION_ERR_100
            DET_RANGE_VELOCITY_ERR_097_oRDR_DETECTION_097_100_oPCAN_RADAR_1df8dc6d_Tx: ComBitPosition=64, ComBitSize=8, ComSignalInitValue=0, ComSignalType=UINT8, ComHandleId=2120, ComSystemTemplateSystemSignalRef=DET_RANGE_VELOCITY_ERR_097
            DET_MH_CRC16_097_100_oRDR_DETECTION_097_100_oPCAN_RADAR_587b91fd_Tx: ComBitPosition=0, ComBitSize=16, ComSignalInitValue=0, ComSignalType=UINT16, ComHandleId=2097, ComSystemTemplateSystemSignalRef=DET_MH_CRC16_097_100
            DET_AZIMUTH_ERR_098_oRDR_DETECTION_097_100_oPCAN_RADAR_ffdb91f3_Tx: ComBitPosition=217, ComBitSize=7, ComSignalInitValue=0, ComSignalType=UINT8, ComHandleId=2058, ComSystemTemplateSystemSignalRef=DET_AZIMUTH_ERR_098
            DET_RANGE_VELOCITY_099_oRDR_DETECTION_097_100_oPCAN_RADAR_ab23610d_Tx: ComBitPosition=272, ComBitSize=15, ComSignalInitValue=16384, ComSignalType=UINT16, ComHandleId=2118, ComSystemTemplateSystemSignalRef=DET_RANGE_VELOCITY_099
            DET_RCS_097_oRDR_DETECTION_097_100_oPCAN_RADAR_95c31085_Tx: ComBitPosition=128, ComBitSize=8, ComSignalInitValue=128, ComSignalType=UINT8, ComHandleId=2124, ComSystemTemplateSystemSignalRef=DET_RCS_097
            DET_RCS_100_oRDR_DETECTION_097_100_oPCAN_RADAR_18ad746f_Tx: ComBitPosition=464, ComBitSize=8, ComSignalInitValue=128, ComSignalType=UINT8, ComHandleId=2127, ComSystemTemplateSystemSignalRef=DET_RCS_100
            DET_EXISTENCE_PROB_100_oRDR_DETECTION_097_100_oPCAN_RADAR_7e05c0b2_Tx: ComBitPosition=448, ComBitSize=6, ComSignalInitValue=0, ComSignalType=UINT8, ComHandleId=2088, ComSystemTemplateSystemSignalRef=DET_EXISTENCE_PROB_100
            DET_ELEVATION_100_oRDR_DETECTION_097_100_oPCAN_RADAR_2ba32da7_Tx: ComBitPosition=408, ComBitSize=8, ComSignalInitValue=0, ComSignalType=UINT8, ComHandleId=2080, ComSystemTemplateSystemSignalRef=DET_ELEVATION_100
            DET_AZIMUTH_100_oRDR_DETECTION_097_100_oPCAN_RADAR_fa10f2ab_Tx: ComBitPosition=424, ComBitSize=13, ComSignalInitValue=0, ComSignalType=UINT16, ComHandleId=2056, ComSystemTemplateSystemSignalRef=DET_AZIMUTH_100
            DET_ELEVATION_ERR_099_oRDR_DETECTION_097_100_oPCAN_RADAR_989497ea_Tx: ComBitPosition=304, ComBitSize=6, ComSignalInitValue=0, ComSignalType=UINT8, ComHandleId=2083, ComSystemTemplateSystemSignalRef=DET_ELEVATION_ERR_099
            DET_AZIMUTH_ERR_099_oRDR_DETECTION_097_100_oPCAN_RADAR_6aab4566_Tx: ComBitPosition=329, ComBitSize=7, ComSignalInitValue=0, ComSignalType=UINT8, ComHandleId=2059, ComSystemTemplateSystemSignalRef=DET_AZIMUTH_ERR_099
            DET_CONFD_AZIMUTH_099_oRDR_DETECTION_097_100_oPCAN_RADAR_ccf8da59_Tx: ComBitPosition=342, ComBitSize=2, ComSignalInitValue=0, ComSignalType=UINT8, ComHandleId=2071, ComSystemTemplateSystemSignalRef=DET_CONFD_AZIMUTH_099
            DET_HVC_FLAG_099_oRDR_DETECTION_097_100_oPCAN_RADAR_ab7fa1f5_Tx: ComBitPosition=310, ComBitSize=1, ComSignalInitValue=0, ComSignalType=BOOLEAN, ComHandleId=2091, ComSystemTemplateSystemSignalRef=DET_HVC_FLAG_099
            DET_RANGE_098_oRDR_DETECTION_097_100_oPCAN_RADAR_4bf577bd_Tx: ComBitPosition=136, ComBitSize=15, ComSignalInitValue=0, ComSignalType=UINT16, ComHandleId=2109, ComSystemTemplateSystemSignalRef=DET_RANGE_098
            DET_CONFD_ELEVATION_098_oRDR_DETECTION_097_100_oPCAN_RADAR_5b1d0f36_Tx: ComBitPosition=213, ComBitSize=2, ComSignalInitValue=0, ComSignalType=UINT8, ComHandleId=2074, ComSystemTemplateSystemSignalRef=DET_CONFD_ELEVATION_098
            DET_MH_SCAN_INDEX_4LSB_097_100_oRDR_DETECTION_097_100_oPCAN_RADAR_10241546_Tx: ComBitPosition=476, ComBitSize=4, ComSignalInitValue=0, ComSignalType=UINT8, ComHandleId=2099, ComSystemTemplateSystemSignalRef=DET_MH_SCAN_INDEX_4LSB_097_100
            DET_AZIMUTH_099_oRDR_DETECTION_097_100_oPCAN_RADAR_ce1ed093_Tx: ComBitPosition=312, ComBitSize=13, ComSignalInitValue=0, ComSignalType=UINT16, ComHandleId=2055, ComSystemTemplateSystemSignalRef=DET_AZIMUTH_099
            DET_BI_STATIC_FLAG_097_oRDR_DETECTION_097_100_oPCAN_RADAR_2152d6c4_Tx: ComBitPosition=104, ComBitSize=1, ComSignalInitValue=0, ComSignalType=BOOLEAN, ComHandleId=2065, ComSystemTemplateSystemSignalRef=DET_BI_STATIC_FLAG_097
            DET_CONFD_AZIMUTH_100_oRDR_DETECTION_097_100_oPCAN_RADAR_f8f6f861_Tx: ComBitPosition=454, ComBitSize=2, ComSignalInitValue=0, ComSignalType=UINT8, ComHandleId=2072, ComSystemTemplateSystemSignalRef=DET_CONFD_AZIMUTH_100
            DET_RCS_099_oRDR_DETECTION_097_100_oPCAN_RADAR_2ca35657_Tx: ComBitPosition=352, ComBitSize=8, ComSignalInitValue=128, ComSignalType=UINT8, ComHandleId=2126, ComSystemTemplateSystemSignalRef=DET_RCS_099
            DET_RANGE_099_oRDR_DETECTION_097_100_oPCAN_RADAR_de85a328_Tx: ComBitPosition=248, ComBitSize=15, ComSignalInitValue=0, ComSignalType=UINT16, ComHandleId=2110, ComSystemTemplateSystemSignalRef=DET_RANGE_099
            DET_ELEVATION_097_oRDR_DETECTION_097_100_oPCAN_RADAR_a6cd494d_Tx: ComBitPosition=72, ComBitSize=8, ComSignalInitValue=0, ComSignalType=UINT8, ComHandleId=2077, ComSystemTemplateSystemSignalRef=DET_ELEVATION_097
            DET_RANGE_VELOCITY_ERR_099_oRDR_DETECTION_097_100_oPCAN_RADAR_a4989abf_Tx: ComBitPosition=288, ComBitSize=8, ComSignalInitValue=0, ComSignalType=UINT8, ComHandleId=2122, ComSystemTemplateSystemSignalRef=DET_RANGE_VELOCITY_ERR_099
            DET_SUPER_RES_TARGET_099_oRDR_DETECTION_097_100_oPCAN_RADAR_c0942a30_Tx: ComBitPosition=311, ComBitSize=1, ComSignalInitValue=0, ComSignalType=BOOLEAN, ComHandleId=2134, ComSystemTemplateSystemSignalRef=DET_SUPER_RES_TARGET_099
            DET_CONFD_ELEVATION_100_oRDR_DETECTION_097_100_oPCAN_RADAR_fa63f99b_Tx: ComBitPosition=437, ComBitSize=2, ComSignalInitValue=0, ComSignalType=UINT8, ComHandleId=2076, ComSystemTemplateSystemSignalRef=DET_CONFD_ELEVATION_100
            DET_MH_CYCLE_COUNTER_097_100_oRDR_DETECTION_097_100_oPCAN_RADAR_dc0e30ca_Tx: ComBitPosition=16, ComBitSize=8, ComSignalInitValue=0, ComSignalType=UINT8, ComHandleId=2098, ComSystemTemplateSystemSignalRef=DET_MH_CYCLE_COUNTER_097_100
            DET_SNR_099_oRDR_DETECTION_097_100_oPCAN_RADAR_f10d0255_Tx: ComBitPosition=344, ComBitSize=8, ComSignalInitValue=0, ComSignalType=UINT8, ComHandleId=2130, ComSystemTemplateSystemSignalRef=DET_SNR_099
            DET_EXISTENCE_PROB_098_oRDR_DETECTION_097_100_oPCAN_RADAR_df7b361f_Tx: ComBitPosition=224, ComBitSize=6, ComSignalInitValue=0, ComSignalType=UINT8, ComHandleId=2086, ComSystemTemplateSystemSignalRef=DET_EXISTENCE_PROB_098
            DET_RCS_098_oRDR_DETECTION_097_100_oPCAN_RADAR_b9d382c2_Tx: ComBitPosition=240, ComBitSize=8, ComSignalInitValue=128, ComSignalType=UINT8, ComHandleId=2125, ComSystemTemplateSystemSignalRef=DET_RCS_098
            DET_AZIMUTH_098_oRDR_DETECTION_097_100_oPCAN_RADAR_5b6e0406_Tx: ComBitPosition=200, ComBitSize=13, ComSignalInitValue=0, ComSignalType=UINT16, ComHandleId=2054, ComSystemTemplateSystemSignalRef=DET_AZIMUTH_098
            DET_RANGE_ERR_097_oRDR_DETECTION_097_100_oPCAN_RADAR_c00d5f93_Tx: ComBitPosition=40, ComBitSize=7, ComSignalInitValue=0, ComSignalType=UINT8, ComHandleId=2112, ComSystemTemplateSystemSignalRef=DET_RANGE_ERR_097
            DET_ELEVATION_ERR_098_oRDR_DETECTION_097_100_oPCAN_RADAR_0de4437f_Tx: ComBitPosition=192, ComBitSize=6, ComSignalInitValue=0, ComSignalType=UINT8, ComHandleId=2082, ComSystemTemplateSystemSignalRef=DET_ELEVATION_ERR_098
            DET_SUPER_RES_TARGET_100_oRDR_DETECTION_097_100_oPCAN_RADAR_f49a0808_Tx: ComBitPosition=423, ComBitSize=1, ComSignalInitValue=0, ComSignalType=BOOLEAN, ComHandleId=2135, ComSystemTemplateSystemSignalRef=DET_SUPER_RES_TARGET_100
            DET_RANGE_VELOCITY_097_oRDR_DETECTION_097_100_oPCAN_RADAR_124327df_Tx: ComBitPosition=48, ComBitSize=15, ComSignalInitValue=16384, ComSignalType=UINT16, ComHandleId=2116, ComSystemTemplateSystemSignalRef=DET_RANGE_VELOCITY_097
            DET_EXISTENCE_PROB_099_oRDR_DETECTION_097_100_oPCAN_RADAR_4a0be28a_Tx: ComBitPosition=336, ComBitSize=6, ComSignalInitValue=0, ComSignalType=UINT8, ComHandleId=2087, ComSystemTemplateSystemSignalRef=DET_EXISTENCE_PROB_099
            DET_HVC_FLAG_098_oRDR_DETECTION_097_100_oPCAN_RADAR_3e0f7560_Tx: ComBitPosition=198, ComBitSize=1, ComSignalInitValue=0, ComSignalType=BOOLEAN, ComHandleId=2090, ComSystemTemplateSystemSignalRef=DET_HVC_FLAG_098
            DET_ELEVATION_ERR_097_oRDR_DETECTION_097_100_oPCAN_RADAR_21f4d138_Tx: ComBitPosition=80, ComBitSize=6, ComSignalInitValue=0, ComSignalType=UINT8, ComHandleId=2081, ComSystemTemplateSystemSignalRef=DET_ELEVATION_ERR_097
            DET_SNR_098_oRDR_DETECTION_097_100_oPCAN_RADAR_647dd6c0_Tx: ComBitPosition=232, ComBitSize=8, ComSignalInitValue=0, ComSignalType=UINT8, ComHandleId=2129, ComSystemTemplateSystemSignalRef=DET_SNR_098
            DET_CONFD_ELEVATION_097_oRDR_DETECTION_097_100_oPCAN_RADAR_770d9d71_Tx: ComBitPosition=101, ComBitSize=2, ComSignalInitValue=0, ComSignalType=UINT8, ComHandleId=2073, ComSystemTemplateSystemSignalRef=DET_CONFD_ELEVATION_097
            DET_RANGE_ERR_100_oRDR_DETECTION_097_100_oPCAN_RADAR_4d633b79_Tx: ComBitPosition=376, ComBitSize=7, ComSignalInitValue=0, ComSignalType=UINT8, ComHandleId=2115, ComSystemTemplateSystemSignalRef=DET_RANGE_ERR_100
            DET_CONFD_AZIMUTH_097_oRDR_DETECTION_097_100_oPCAN_RADAR_75989c8b_Tx: ComBitPosition=118, ComBitSize=2, ComSignalInitValue=0, ComSignalType=UINT8, ComHandleId=2069, ComSystemTemplateSystemSignalRef=DET_CONFD_AZIMUTH_097
            DET_RANGE_VELOCITY_ERR_098_oRDR_DETECTION_097_100_oPCAN_RADAR_31e84e2a_Tx: ComBitPosition=176, ComBitSize=8, ComSignalInitValue=0, ComSignalType=UINT8, ComHandleId=2121, ComSystemTemplateSystemSignalRef=DET_RANGE_VELOCITY_ERR_098
            DET_ELEVATION_098_oRDR_DETECTION_097_100_oPCAN_RADAR_8adddb0a_Tx: ComBitPosition=184, ComBitSize=8, ComSignalInitValue=0, ComSignalType=UINT8, ComHandleId=2078, ComSystemTemplateSystemSignalRef=DET_ELEVATION_098
            DET_EXISTENCE_PROB_097_oRDR_DETECTION_097_100_oPCAN_RADAR_f36ba458_Tx: ComBitPosition=112, ComBitSize=6, ComSignalInitValue=0, ComSignalType=UINT8, ComHandleId=2085, ComSystemTemplateSystemSignalRef=DET_EXISTENCE_PROB_097
            DET_SUPER_RES_TARGET_098_oRDR_DETECTION_097_100_oPCAN_RADAR_55e4fea5_Tx: ComBitPosition=199, ComBitSize=1, ComSignalInitValue=0, ComSignalType=BOOLEAN, ComHandleId=2133, ComSystemTemplateSystemSignalRef=DET_SUPER_RES_TARGET_098
            DET_BELOW_RAIN_THOLD_098_oRDR_DETECTION_097_100_oPCAN_RADAR_8e6f97c6_Tx: ComBitPosition=151, ComBitSize=1, ComSignalInitValue=0, ComSignalType=UINT8, ComHandleId=2062, ComSystemTemplateSystemSignalRef=DET_BELOW_RAIN_THOLD_098
            DET_PROB_1STAZHYPO_097_oRDR_DETECTION_097_100_oPCAN_RADAR_6c4a068c_Tx: ComBitPosition=103, ComBitSize=1, ComSignalInitValue=0, ComSignalType=BOOLEAN, ComHandleId=2104, ComSystemTemplateSystemSignalRef=DET_PROB_1STAZHYPO_097
            DET_IDM_097_oRDR_DETECTION_097_100_oPCAN_RADAR_994ddc9a_Tx: ComBitPosition=63, ComBitSize=1, ComSignalInitValue=0, ComSignalType=UINT8, ComHandleId=2093, ComSystemTemplateSystemSignalRef=DET_IDM_097
            DET_BELOW_RAIN_THOLD_100_oRDR_DETECTION_097_100_oPCAN_RADAR_2f11616b_Tx: ComBitPosition=375, ComBitSize=1, ComSignalInitValue=0, ComSignalType=UINT8, ComHandleId=2064, ComSystemTemplateSystemSignalRef=DET_BELOW_RAIN_THOLD_100
            DET_MTD_100_oRDR_DETECTION_097_100_oPCAN_RADAR_72908aab_Tx: ComBitPosition=383, ComBitSize=1, ComSignalInitValue=0, ComSignalType=UINT8, ComHandleId=2103, ComSystemTemplateSystemSignalRef=DET_MTD_100
            DET_IDM_100_oRDR_DETECTION_097_100_oPCAN_RADAR_1423b870_Tx: ComBitPosition=399, ComBitSize=1, ComSignalInitValue=0, ComSignalType=UINT8, ComHandleId=2096, ComSystemTemplateSystemSignalRef=DET_IDM_100
            DET_MTD_099_oRDR_DETECTION_097_100_oPCAN_RADAR_469ea893_Tx: ComBitPosition=271, ComBitSize=1, ComSignalInitValue=0, ComSignalType=UINT8, ComHandleId=2102, ComSystemTemplateSystemSignalRef=DET_MTD_099
            DET_PROB_1STAZHYPO_099_oRDR_DETECTION_097_100_oPCAN_RADAR_d52a405e_Tx: ComBitPosition=327, ComBitSize=1, ComSignalInitValue=0, ComSignalType=BOOLEAN, ComHandleId=2106, ComSystemTemplateSystemSignalRef=DET_PROB_1STAZHYPO_099
            DET_MTD_097_oRDR_DETECTION_097_100_oPCAN_RADAR_fffeee41_Tx: ComBitPosition=47, ComBitSize=1, ComSignalInitValue=0, ComSignalType=UINT8, ComHandleId=2100, ComSystemTemplateSystemSignalRef=DET_MTD_097
            DET_BELOW_RAIN_THOLD_097_oRDR_DETECTION_097_100_oPCAN_RADAR_a27f0581_Tx: ComBitPosition=39, ComBitSize=1, ComSignalInitValue=0, ComSignalType=UINT8, ComHandleId=2061, ComSystemTemplateSystemSignalRef=DET_BELOW_RAIN_THOLD_097
            DET_BELOW_RAIN_THOLD_099_oRDR_DETECTION_097_100_oPCAN_RADAR_1b1f4353_Tx: ComBitPosition=263, ComBitSize=1, ComSignalInitValue=0, ComSignalType=UINT8, ComHandleId=2063, ComSystemTemplateSystemSignalRef=DET_BELOW_RAIN_THOLD_099
            DET_MTD_098_oRDR_DETECTION_097_100_oPCAN_RADAR_d3ee7c06_Tx: ComBitPosition=159, ComBitSize=1, ComSignalInitValue=0, ComSignalType=UINT8, ComHandleId=2101, ComSystemTemplateSystemSignalRef=DET_MTD_098
            DET_IDM_098_oRDR_DETECTION_097_100_oPCAN_RADAR_b55d4edd_Tx: ComBitPosition=175, ComBitSize=1, ComSignalInitValue=0, ComSignalType=UINT8, ComHandleId=2094, ComSystemTemplateSystemSignalRef=DET_IDM_098
            DET_IDM_099_oRDR_DETECTION_097_100_oPCAN_RADAR_202d9a48_Tx: ComBitPosition=287, ComBitSize=1, ComSignalInitValue=0, ComSignalType=UINT8, ComHandleId=2095, ComSystemTemplateSystemSignalRef=DET_IDM_099
            DET_PROB_1STAZHYPO_100_oRDR_DETECTION_097_100_oPCAN_RADAR_e1246266_Tx: ComBitPosition=439, ComBitSize=1, ComSignalInitValue=0, ComSignalType=BOOLEAN, ComHandleId=2107, ComSystemTemplateSystemSignalRef=DET_PROB_1STAZHYPO_100
            DET_PROB_1STAZHYPO_098_oRDR_DETECTION_097_100_oPCAN_RADAR_405a94cb_Tx: ComBitPosition=215, ComBitSize=1, ComSignalInitValue=0, ComSignalType=BOOLEAN, ComHandleId=2105, ComSystemTemplateSystemSignalRef=DET_PROB_1STAZHYPO_098
        SG_Detections_377_380_oRDR_DETECTION_377_380_oPCAN_RADAR_e93056f0_Tx: ComTransferProperty=TRIGGERED, ComHandleId=96, ComSystemTemplateSignalGroupRef=SG_Detections_377_380
          83 x ComGroupSignal, all with ComSignalEndianness=LITTLE_ENDIAN, ComTransferProperty=PENDING, ComSignalAccess=ACCESS_NEEDED_BY_SWC_OR_COM:
            DET_SUPER_RES_TARGET_377_oRDR_DETECTION_377_380_oPCAN_RADAR_7ddc84bc_Tx: ComBitPosition=87, ComBitSize=1, ComSignalInitValue=0, ComSignalType=BOOLEAN, ComHandleId=7942, ComSystemTemplateSystemSignalRef=DET_SUPER_RES_TARGET_377
            DET_AZIMUTH_ERR_380_oRDR_DETECTION_377_380_oPCAN_RADAR_63c70c22_Tx: ComBitPosition=441, ComBitSize=7, ComSignalInitValue=0, ComSignalType=UINT8, ComHandleId=7870, ComSystemTemplateSystemSignalRef=DET_AZIMUTH_ERR_380
            DET_CONFD_ELEVATION_378_oRDR_DETECTION_377_380_oPCAN_RADAR_5f35e768_Tx: ComBitPosition=213, ComBitSize=2, ComSignalInitValue=0, ComSignalType=UINT8, ComHandleId=7884, ComSystemTemplateSystemSignalRef=DET_CONFD_ELEVATION_378
            DET_RANGE_VELOCITY_ERR_379_oRDR_DETECTION_377_380_oPCAN_RADAR_a0b072e1_Tx: ComBitPosition=288, ComBitSize=8, ComSignalInitValue=0, ComSignalType=UINT8, ComHandleId=7932, ComSystemTemplateSystemSignalRef=DET_RANGE_VELOCITY_ERR_379
            DET_RCS_380_oRDR_DETECTION_377_380_oPCAN_RADAR_25cf1f13_Tx: ComBitPosition=464, ComBitSize=8, ComSignalInitValue=128, ComSignalType=UINT8, ComHandleId=7937, ComSystemTemplateSystemSignalRef=DET_RCS_380
            DET_RCS_378_oRDR_DETECTION_377_380_oPCAN_RADAR_bdfb6a9c_Tx: ComBitPosition=240, ComBitSize=8, ComSignalInitValue=128, ComSignalType=UINT8, ComHandleId=7935, ComSystemTemplateSystemSignalRef=DET_RCS_378
            DET_ELEVATION_378_oRDR_DETECTION_377_380_oPCAN_RADAR_8ef53354_Tx: ComBitPosition=184, ComBitSize=8, ComSignalInitValue=0, ComSignalType=UINT8, ComHandleId=7888, ComSystemTemplateSystemSignalRef=DET_ELEVATION_378
            DET_AZIMUTH_ERR_378_oRDR_DETECTION_377_380_oPCAN_RADAR_fbf379ad_Tx: ComBitPosition=217, ComBitSize=7, ComSignalInitValue=0, ComSignalType=UINT8, ComHandleId=7868, ComSystemTemplateSystemSignalRef=DET_AZIMUTH_ERR_378
            DET_MH_SCAN_INDEX_4LSB_377_380_oRDR_DETECTION_377_380_oPCAN_RADAR_25e70040_Tx: ComBitPosition=476, ComBitSize=4, ComSignalInitValue=0, ComSignalType=UINT8, ComHandleId=7909, ComSystemTemplateSystemSignalRef=DET_MH_SCAN_INDEX_4LSB_377_380
            DET_RANGE_380_oRDR_DETECTION_377_380_oPCAN_RADAR_d7e9ea6c_Tx: ComBitPosition=360, ComBitSize=15, ComSignalInitValue=0, ComSignalType=UINT16, ComHandleId=7921, ComSystemTemplateSystemSignalRef=DET_RANGE_380
            DET_RANGE_VELOCITY_378_oRDR_DETECTION_377_380_oPCAN_RADAR_3a7b5dc6_Tx: ComBitPosition=160, ComBitSize=15, ComSignalInitValue=16384, ComSignalType=UINT16, ComHandleId=7927, ComSystemTemplateSystemSignalRef=DET_RANGE_VELOCITY_378
            DET_RANGE_VELOCITY_ERR_380_oRDR_DETECTION_377_380_oPCAN_RADAR_adf4d3fb_Tx: ComBitPosition=400, ComBitSize=8, ComSignalInitValue=0, ComSignalType=UINT8, ComHandleId=7933, ComSystemTemplateSystemSignalRef=DET_RANGE_VELOCITY_ERR_380
            DET_ELEVATION_380_oRDR_DETECTION_377_380_oPCAN_RADAR_16c146db_Tx: ComBitPosition=408, ComBitSize=8, ComSignalInitValue=0, ComSignalType=UINT8, ComHandleId=7890, ComSystemTemplateSystemSignalRef=DET_ELEVATION_380
            DET_SUPER_RES_TARGET_380_oRDR_DETECTION_377_380_oPCAN_RADAR_c9f86374_Tx: ComBitPosition=423, ComBitSize=1, ComSignalInitValue=0, ComSignalType=BOOLEAN, ComHandleId=7945, ComSystemTemplateSystemSignalRef=DET_SUPER_RES_TARGET_380
            DET_EXISTENCE_PROB_378_oRDR_DETECTION_377_380_oPCAN_RADAR_db53de41_Tx: ComBitPosition=224, ComBitSize=6, ComSignalInitValue=0, ComSignalType=UINT8, ComHandleId=7896, ComSystemTemplateSystemSignalRef=DET_EXISTENCE_PROB_378
            DET_SNR_377_oRDR_DETECTION_377_380_oPCAN_RADAR_4c45acd9_Tx: ComBitPosition=120, ComBitSize=8, ComSignalInitValue=0, ComSignalType=UINT8, ComHandleId=7938, ComSystemTemplateSystemSignalRef=DET_SNR_377
            DET_EXISTENCE_PROB_380_oRDR_DETECTION_377_380_oPCAN_RADAR_4367abce_Tx: ComBitPosition=448, ComBitSize=6, ComSignalInitValue=0, ComSignalType=UINT8, ComHandleId=7898, ComSystemTemplateSystemSignalRef=DET_EXISTENCE_PROB_380
            DET_RANGE_VELOCITY_377_oRDR_DETECTION_377_380_oPCAN_RADAR_166bcf81_Tx: ComBitPosition=48, ComBitSize=15, ComSignalInitValue=16384, ComSignalType=UINT16, ComHandleId=7926, ComSystemTemplateSystemSignalRef=DET_RANGE_VELOCITY_377
            DET_CONFD_ELEVATION_379_oRDR_DETECTION_377_380_oPCAN_RADAR_ca4533fd_Tx: ComBitPosition=325, ComBitSize=2, ComSignalInitValue=0, ComSignalType=UINT8, ComHandleId=7885, ComSystemTemplateSystemSignalRef=DET_CONFD_ELEVATION_379
            DET_ELEVATION_ERR_379_oRDR_DETECTION_377_380_oPCAN_RADAR_9cbc7fb4_Tx: ComBitPosition=304, ComBitSize=6, ComSignalInitValue=0, ComSignalType=UINT8, ComHandleId=7893, ComSystemTemplateSystemSignalRef=DET_ELEVATION_ERR_379
            DET_RANGE_ERR_377_oRDR_DETECTION_377_380_oPCAN_RADAR_c425b7cd_Tx: ComBitPosition=40, ComBitSize=7, ComSignalInitValue=0, ComSignalType=UINT8, ComHandleId=7922, ComSystemTemplateSystemSignalRef=DET_RANGE_ERR_377
            DET_RANGE_379_oRDR_DETECTION_377_380_oPCAN_RADAR_daad4b76_Tx: ComBitPosition=248, ComBitSize=15, ComSignalInitValue=0, ComSignalType=UINT16, ComHandleId=7920, ComSystemTemplateSystemSignalRef=DET_RANGE_379
            DET_RANGE_VELOCITY_379_oRDR_DETECTION_377_380_oPCAN_RADAR_af0b8953_Tx: ComBitPosition=272, ComBitSize=15, ComSignalInitValue=16384, ComSignalType=UINT16, ComHandleId=7928, ComSystemTemplateSystemSignalRef=DET_RANGE_VELOCITY_379
            DET_HVC_FLAG_380_oRDR_DETECTION_377_380_oPCAN_RADAR_a213e8b1_Tx: ComBitPosition=422, ComBitSize=1, ComSignalInitValue=0, ComSignalType=BOOLEAN, ComHandleId=7902, ComSystemTemplateSystemSignalRef=DET_HVC_FLAG_380
            DET_RANGE_ERR_379_oRDR_DETECTION_377_380_oPCAN_RADAR_7d45f11f_Tx: ComBitPosition=264, ComBitSize=7, ComSignalInitValue=0, ComSignalType=UINT8, ComHandleId=7924, ComSystemTemplateSystemSignalRef=DET_RANGE_ERR_379
            DET_BI_STATIC_FLAG_380_oRDR_DETECTION_377_380_oPCAN_RADAR_915ed952_Tx: ComBitPosition=440, ComBitSize=1, ComSignalInitValue=0, ComSignalType=BOOLEAN, ComHandleId=7878, ComSystemTemplateSystemSignalRef=DET_BI_STATIC_FLAG_380
            DET_SUPER_RES_TARGET_379_oRDR_DETECTION_377_380_oPCAN_RADAR_c4bcc26e_Tx: ComBitPosition=311, ComBitSize=1, ComSignalInitValue=0, ComSignalType=BOOLEAN, ComHandleId=7944, ComSystemTemplateSystemSignalRef=DET_SUPER_RES_TARGET_379
            DET_SUPER_RES_TARGET_378_oRDR_DETECTION_377_380_oPCAN_RADAR_51cc16fb_Tx: ComBitPosition=199, ComBitSize=1, ComSignalInitValue=0, ComSignalType=BOOLEAN, ComHandleId=7943, ComSystemTemplateSystemSignalRef=DET_SUPER_RES_TARGET_378
            DET_RANGE_377_oRDR_DETECTION_377_380_oPCAN_RADAR_63cd0da4_Tx: ComBitPosition=24, ComBitSize=15, ComSignalInitValue=0, ComSignalType=UINT16, ComHandleId=7918, ComSystemTemplateSystemSignalRef=DET_RANGE_377
            DET_SNR_378_oRDR_DETECTION_377_380_oPCAN_RADAR_60553e9e_Tx: ComBitPosition=232, ComBitSize=8, ComSignalInitValue=0, ComSignalType=UINT8, ComHandleId=7939, ComSystemTemplateSystemSignalRef=DET_SNR_378
            DET_CONFD_ELEVATION_380_oRDR_DETECTION_377_380_oPCAN_RADAR_c70192e7_Tx: ComBitPosition=437, ComBitSize=2, ComSignalInitValue=0, ComSignalType=UINT8, ComHandleId=7886, ComSystemTemplateSystemSignalRef=DET_CONFD_ELEVATION_380
            DET_AZIMUTH_378_oRDR_DETECTION_377_380_oPCAN_RADAR_5f46ec58_Tx: ComBitPosition=200, ComBitSize=13, ComSignalInitValue=0, ComSignalType=UINT16, ComHandleId=7864, ComSystemTemplateSystemSignalRef=DET_AZIMUTH_378
            DET_RANGE_ERR_378_oRDR_DETECTION_377_380_oPCAN_RADAR_e835258a_Tx: ComBitPosition=152, ComBitSize=7, ComSignalInitValue=0, ComSignalType=UINT8, ComHandleId=7923, ComSystemTemplateSystemSignalRef=DET_RANGE_ERR_378
            DET_SNR_380_oRDR_DETECTION_377_380_oPCAN_RADAR_f8614b11_Tx: ComBitPosition=456, ComBitSize=8, ComSignalInitValue=0, ComSignalType=UINT8, ComHandleId=7941, ComSystemTemplateSystemSignalRef=DET_SNR_380
            DET_RCS_377_oRDR_DETECTION_377_380_oPCAN_RADAR_91ebf8db_Tx: ComBitPosition=128, ComBitSize=8, ComSignalInitValue=128, ComSignalType=UINT8, ComHandleId=7934, ComSystemTemplateSystemSignalRef=DET_RCS_377
            DET_BI_STATIC_FLAG_377_oRDR_DETECTION_377_380_oPCAN_RADAR_257a3e9a_Tx: ComBitPosition=104, ComBitSize=1, ComSignalInitValue=0, ComSignalType=BOOLEAN, ComHandleId=7875, ComSystemTemplateSystemSignalRef=DET_BI_STATIC_FLAG_377
            DET_CONFD_AZIMUTH_377_oRDR_DETECTION_377_380_oPCAN_RADAR_71b074d5_Tx: ComBitPosition=118, ComBitSize=2, ComSignalInitValue=0, ComSignalType=UINT8, ComHandleId=7879, ComSystemTemplateSystemSignalRef=DET_CONFD_AZIMUTH_377
            DET_BI_STATIC_FLAG_379_oRDR_DETECTION_377_380_oPCAN_RADAR_9c1a7848_Tx: ComBitPosition=328, ComBitSize=1, ComSignalInitValue=0, ComSignalType=BOOLEAN, ComHandleId=7877, ComSystemTemplateSystemSignalRef=DET_BI_STATIC_FLAG_379
            DET_CONFD_AZIMUTH_379_oRDR_DETECTION_377_380_oPCAN_RADAR_c8d03207_Tx: ComBitPosition=342, ComBitSize=2, ComSignalInitValue=0, ComSignalType=UINT8, ComHandleId=7881, ComSystemTemplateSystemSignalRef=DET_CONFD_AZIMUTH_379
            DET_RANGE_ERR_380_oRDR_DETECTION_377_380_oPCAN_RADAR_70015005_Tx: ComBitPosition=376, ComBitSize=7, ComSignalInitValue=0, ComSignalType=UINT8, ComHandleId=7925, ComSystemTemplateSystemSignalRef=DET_RANGE_ERR_380
            DET_AZIMUTH_ERR_379_oRDR_DETECTION_377_380_oPCAN_RADAR_6e83ad38_Tx: ComBitPosition=329, ComBitSize=7, ComSignalInitValue=0, ComSignalType=UINT8, ComHandleId=7869, ComSystemTemplateSystemSignalRef=DET_AZIMUTH_ERR_379
            DET_RANGE_VELOCITY_ERR_378_oRDR_DETECTION_377_380_oPCAN_RADAR_35c0a674_Tx: ComBitPosition=176, ComBitSize=8, ComSignalInitValue=0, ComSignalType=UINT8, ComHandleId=7931, ComSystemTemplateSystemSignalRef=DET_RANGE_VELOCITY_ERR_378
            DET_RANGE_VELOCITY_ERR_377_oRDR_DETECTION_377_380_oPCAN_RADAR_19d03433_Tx: ComBitPosition=64, ComBitSize=8, ComSignalInitValue=0, ComSignalType=UINT8, ComHandleId=7930, ComSystemTemplateSystemSignalRef=DET_RANGE_VELOCITY_ERR_377
            DET_CONFD_AZIMUTH_378_oRDR_DETECTION_377_380_oPCAN_RADAR_5da0e692_Tx: ComBitPosition=230, ComBitSize=2, ComSignalInitValue=0, ComSignalType=UINT8, ComHandleId=7880, ComSystemTemplateSystemSignalRef=DET_CONFD_AZIMUTH_378
            DET_RANGE_378_oRDR_DETECTION_377_380_oPCAN_RADAR_4fdd9fe3_Tx: ComBitPosition=136, ComBitSize=15, ComSignalInitValue=0, ComSignalType=UINT16, ComHandleId=7919, ComSystemTemplateSystemSignalRef=DET_RANGE_378
            DET_EXISTENCE_PROB_377_oRDR_DETECTION_377_380_oPCAN_RADAR_f7434c06_Tx: ComBitPosition=112, ComBitSize=6, ComSignalInitValue=0, ComSignalType=UINT8, ComHandleId=7895, ComSystemTemplateSystemSignalRef=DET_EXISTENCE_PROB_377
            DET_ELEVATION_377_oRDR_DETECTION_377_380_oPCAN_RADAR_a2e5a113_Tx: ComBitPosition=72, ComBitSize=8, ComSignalInitValue=0, ComSignalType=UINT8, ComHandleId=7887, ComSystemTemplateSystemSignalRef=DET_ELEVATION_377
            DET_AZIMUTH_377_oRDR_DETECTION_377_380_oPCAN_RADAR_73567e1f_Tx: ComBitPosition=88, ComBitSize=13, ComSignalInitValue=0, ComSignalType=UINT16, ComHandleId=7863, ComSystemTemplateSystemSignalRef=DET_AZIMUTH_377
            DET_MH_CYCLE_COUNTER_377_380_oRDR_DETECTION_377_380_oPCAN_RADAR_e9cd25cc_Tx: ComBitPosition=16, ComBitSize=8, ComSignalInitValue=0, ComSignalType=UINT8, ComHandleId=7908, ComSystemTemplateSystemSignalRef=DET_MH_CYCLE_COUNTER_377_380
            DET_RCS_379_oRDR_DETECTION_377_380_oPCAN_RADAR_288bbe09_Tx: ComBitPosition=352, ComBitSize=8, ComSignalInitValue=128, ComSignalType=UINT8, ComHandleId=7936, ComSystemTemplateSystemSignalRef=DET_RCS_379
            DET_HVC_FLAG_379_oRDR_DETECTION_377_380_oPCAN_RADAR_af5749ab_Tx: ComBitPosition=310, ComBitSize=1, ComSignalInitValue=0, ComSignalType=BOOLEAN, ComHandleId=7901, ComSystemTemplateSystemSignalRef=DET_HVC_FLAG_379
            DET_SNR_379_oRDR_DETECTION_377_380_oPCAN_RADAR_f525ea0b_Tx: ComBitPosition=344, ComBitSize=8, ComSignalInitValue=0, ComSignalType=UINT8, ComHandleId=7940, ComSystemTemplateSystemSignalRef=DET_SNR_379
            DET_HVC_FLAG_377_oRDR_DETECTION_377_380_oPCAN_RADAR_16370f79_Tx: ComBitPosition=86, ComBitSize=1, ComSignalInitValue=0, ComSignalType=BOOLEAN, ComHandleId=7899, ComSystemTemplateSystemSignalRef=DET_HVC_FLAG_377
            DET_HVC_FLAG_378_oRDR_DETECTION_377_380_oPCAN_RADAR_3a279d3e_Tx: ComBitPosition=198, ComBitSize=1, ComSignalInitValue=0, ComSignalType=BOOLEAN, ComHandleId=7900, ComSystemTemplateSystemSignalRef=DET_HVC_FLAG_378
            DET_CONFD_ELEVATION_377_oRDR_DETECTION_377_380_oPCAN_RADAR_7325752f_Tx: ComBitPosition=101, ComBitSize=2, ComSignalInitValue=0, ComSignalType=UINT8, ComHandleId=7883, ComSystemTemplateSystemSignalRef=DET_CONFD_ELEVATION_377
            DET_AZIMUTH_380_oRDR_DETECTION_377_380_oPCAN_RADAR_c77299d7_Tx: ComBitPosition=424, ComBitSize=13, ComSignalInitValue=0, ComSignalType=UINT16, ComHandleId=7866, ComSystemTemplateSystemSignalRef=DET_AZIMUTH_380
            DET_EXISTENCE_PROB_379_oRDR_DETECTION_377_380_oPCAN_RADAR_4e230ad4_Tx: ComBitPosition=336, ComBitSize=6, ComSignalInitValue=0, ComSignalType=UINT8, ComHandleId=7897, ComSystemTemplateSystemSignalRef=DET_EXISTENCE_PROB_379
            DET_RANGE_VELOCITY_380_oRDR_DETECTION_377_380_oPCAN_RADAR_a24f2849_Tx: ComBitPosition=384, ComBitSize=15, ComSignalInitValue=16384, ComSignalType=UINT16, ComHandleId=7929, ComSystemTemplateSystemSignalRef=DET_RANGE_VELOCITY_380
            DET_CONFD_AZIMUTH_380_oRDR_DETECTION_377_380_oPCAN_RADAR_c594931d_Tx: ComBitPosition=454, ComBitSize=2, ComSignalInitValue=0, ComSignalType=UINT8, ComHandleId=7882, ComSystemTemplateSystemSignalRef=DET_CONFD_AZIMUTH_380
            DET_ELEVATION_ERR_378_oRDR_DETECTION_377_380_oPCAN_RADAR_09ccab21_Tx: ComBitPosition=192, ComBitSize=6, ComSignalInitValue=0, ComSignalType=UINT8, ComHandleId=7892, ComSystemTemplateSystemSignalRef=DET_ELEVATION_ERR_378
            DET_MH_CRC16_377_380_oRDR_DETECTION_377_380_oPCAN_RADAR_6db884fb_Tx: ComBitPosition=0, ComBitSize=16, ComSignalInitValue=0, ComSignalType=UINT16, ComHandleId=7907, ComSystemTemplateSystemSignalRef=DET_MH_CRC16_377_380
            DET_ELEVATION_379_oRDR_DETECTION_377_380_oPCAN_RADAR_1b85e7c1_Tx: ComBitPosition=296, ComBitSize=8, ComSignalInitValue=0, ComSignalType=UINT8, ComHandleId=7889, ComSystemTemplateSystemSignalRef=DET_ELEVATION_379
            DET_BI_STATIC_FLAG_378_oRDR_DETECTION_377_380_oPCAN_RADAR_096aacdd_Tx: ComBitPosition=216, ComBitSize=1, ComSignalInitValue=0, ComSignalType=BOOLEAN, ComHandleId=7876, ComSystemTemplateSystemSignalRef=DET_BI_STATIC_FLAG_378
            DET_ELEVATION_ERR_377_oRDR_DETECTION_377_380_oPCAN_RADAR_25dc3966_Tx: ComBitPosition=80, ComBitSize=6, ComSignalInitValue=0, ComSignalType=UINT8, ComHandleId=7891, ComSystemTemplateSystemSignalRef=DET_ELEVATION_ERR_377
            DET_AZIMUTH_379_oRDR_DETECTION_377_380_oPCAN_RADAR_ca3638cd_Tx: ComBitPosition=312, ComBitSize=13, ComSignalInitValue=0, ComSignalType=UINT16, ComHandleId=7865, ComSystemTemplateSystemSignalRef=DET_AZIMUTH_379
            DET_AZIMUTH_ERR_377_oRDR_DETECTION_377_380_oPCAN_RADAR_d7e3ebea_Tx: ComBitPosition=105, ComBitSize=7, ComSignalInitValue=0, ComSignalType=UINT8, ComHandleId=7867, ComSystemTemplateSystemSignalRef=DET_AZIMUTH_ERR_377
            DET_ELEVATION_ERR_380_oRDR_DETECTION_377_380_oPCAN_RADAR_91f8deae_Tx: ComBitPosition=416, ComBitSize=6, ComSignalInitValue=0, ComSignalType=UINT8, ComHandleId=7894, ComSystemTemplateSystemSignalRef=DET_ELEVATION_ERR_380
            DET_PROB_1STAZHYPO_378_oRDR_DETECTION_377_380_oPCAN_RADAR_44727c95_Tx: ComBitPosition=215, ComBitSize=1, ComSignalInitValue=0, ComSignalType=BOOLEAN, ComHandleId=7915, ComSystemTemplateSystemSignalRef=DET_PROB_1STAZHYPO_378
            DET_IDM_379_oRDR_DETECTION_377_380_oPCAN_RADAR_24057216_Tx: ComBitPosition=287, ComBitSize=1, ComSignalInitValue=0, ComSignalType=UINT8, ComHandleId=7905, ComSystemTemplateSystemSignalRef=DET_IDM_379
            DET_PROB_1STAZHYPO_379_oRDR_DETECTION_377_380_oPCAN_RADAR_d102a800_Tx: ComBitPosition=327, ComBitSize=1, ComSignalInitValue=0, ComSignalType=BOOLEAN, ComHandleId=7916, ComSystemTemplateSystemSignalRef=DET_PROB_1STAZHYPO_379
            DET_PROB_1STAZHYPO_377_oRDR_DETECTION_377_380_oPCAN_RADAR_6862eed2_Tx: ComBitPosition=103, ComBitSize=1, ComSignalInitValue=0, ComSignalType=BOOLEAN, ComHandleId=7914, ComSystemTemplateSystemSignalRef=DET_PROB_1STAZHYPO_377
            DET_MTD_379_oRDR_DETECTION_377_380_oPCAN_RADAR_42b640cd_Tx: ComBitPosition=271, ComBitSize=1, ComSignalInitValue=0, ComSignalType=UINT8, ComHandleId=7912, ComSystemTemplateSystemSignalRef=DET_MTD_379
            DET_MTD_380_oRDR_DETECTION_377_380_oPCAN_RADAR_4ff2e1d7_Tx: ComBitPosition=383, ComBitSize=1, ComSignalInitValue=0, ComSignalType=UINT8, ComHandleId=7913, ComSystemTemplateSystemSignalRef=DET_MTD_380
            DET_BELOW_RAIN_THOLD_380_oRDR_DETECTION_377_380_oPCAN_RADAR_12730a17_Tx: ComBitPosition=375, ComBitSize=1, ComSignalInitValue=0, ComSignalType=UINT8, ComHandleId=7874, ComSystemTemplateSystemSignalRef=DET_BELOW_RAIN_THOLD_380
            DET_MTD_378_oRDR_DETECTION_377_380_oPCAN_RADAR_d7c69458_Tx: ComBitPosition=159, ComBitSize=1, ComSignalInitValue=0, ComSignalType=UINT8, ComHandleId=7911, ComSystemTemplateSystemSignalRef=DET_MTD_378
            DET_BELOW_RAIN_THOLD_379_oRDR_DETECTION_377_380_oPCAN_RADAR_1f37ab0d_Tx: ComBitPosition=263, ComBitSize=1, ComSignalInitValue=0, ComSignalType=UINT8, ComHandleId=7873, ComSystemTemplateSystemSignalRef=DET_BELOW_RAIN_THOLD_379
            DET_BELOW_RAIN_THOLD_377_oRDR_DETECTION_377_380_oPCAN_RADAR_a657eddf_Tx: ComBitPosition=39, ComBitSize=1, ComSignalInitValue=0, ComSignalType=UINT8, ComHandleId=7871, ComSystemTemplateSystemSignalRef=DET_BELOW_RAIN_THOLD_377
            DET_PROB_1STAZHYPO_380_oRDR_DETECTION_377_380_oPCAN_RADAR_dc46091a_Tx: ComBitPosition=439, ComBitSize=1, ComSignalInitValue=0, ComSignalType=BOOLEAN, ComHandleId=7917, ComSystemTemplateSystemSignalRef=DET_PROB_1STAZHYPO_380
            DET_MTD_377_oRDR_DETECTION_377_380_oPCAN_RADAR_fbd6061f_Tx: ComBitPosition=47, ComBitSize=1, ComSignalInitValue=0, ComSignalType=UINT8, ComHandleId=7910, ComSystemTemplateSystemSignalRef=DET_MTD_377
            DET_IDM_380_oRDR_DETECTION_377_380_oPCAN_RADAR_2941d30c_Tx: ComBitPosition=399, ComBitSize=1, ComSignalInitValue=0, ComSignalType=UINT8, ComHandleId=7906, ComSystemTemplateSystemSignalRef=DET_IDM_380
            DET_BELOW_RAIN_THOLD_378_oRDR_DETECTION_377_380_oPCAN_RADAR_8a477f98_Tx: ComBitPosition=151, ComBitSize=1, ComSignalInitValue=0, ComSignalType=UINT8, ComHandleId=7872, ComSystemTemplateSystemSignalRef=DET_BELOW_RAIN_THOLD_378
            DET_IDM_378_oRDR_DETECTION_377_380_oPCAN_RADAR_b175a683_Tx: ComBitPosition=175, ComBitSize=1, ComSignalInitValue=0, ComSignalType=UINT8, ComHandleId=7904, ComSystemTemplateSystemSignalRef=DET_IDM_378
            DET_IDM_377_oRDR_DETECTION_377_380_oPCAN_RADAR_9d6534c4_Tx: ComBitPosition=63, ComBitSize=1, ComSignalInitValue=0, ComSignalType=UINT8, ComHandleId=7903, ComSystemTemplateSystemSignalRef=DET_IDM_377
        SG_Detections_125_128_oRDR_DETECTION_125_128_oPCAN_RADAR_d9562319_Tx: ComTransferProperty=TRIGGERED, ComHandleId=33, ComSystemTemplateSignalGroupRef=SG_Detections_125_128
          83 x ComGroupSignal, all with ComSignalEndianness=LITTLE_ENDIAN, ComTransferProperty=PENDING, ComSignalAccess=ACCESS_NEEDED_BY_SWC_OR_COM:
            DET_RANGE_VELOCITY_ERR_126_oRDR_DETECTION_125_128_oPCAN_RADAR_c6a31335_Tx: ComBitPosition=176, ComBitSize=8, ComSignalInitValue=0, ComSignalType=UINT8, ComHandleId=2702, ComSystemTemplateSystemSignalRef=DET_RANGE_VELOCITY_ERR_126
            DET_EXISTENCE_PROB_127_oRDR_DETECTION_125_128_oPCAN_RADAR_bd40bf95_Tx: ComBitPosition=336, ComBitSize=6, ComSignalInitValue=0, ComSignalType=UINT8, ComHandleId=2668, ComSystemTemplateSystemSignalRef=DET_EXISTENCE_PROB_127
            DET_CONFD_ELEVATION_128_oRDR_DETECTION_125_128_oPCAN_RADAR_153614fb_Tx: ComBitPosition=437, ComBitSize=2, ComSignalInitValue=0, ComSignalType=UINT8, ComHandleId=2657, ComSystemTemplateSystemSignalRef=DET_CONFD_ELEVATION_128
            DET_CONFD_AZIMUTH_126_oRDR_DETECTION_125_128_oPCAN_RADAR_aec353d3_Tx: ComBitPosition=230, ComBitSize=2, ComSignalInitValue=0, ComSignalType=UINT8, ComHandleId=2651, ComSystemTemplateSystemSignalRef=DET_CONFD_AZIMUTH_126
            DET_BI_STATIC_FLAG_126_oRDR_DETECTION_125_128_oPCAN_RADAR_fa09199c_Tx: ComBitPosition=216, ComBitSize=1, ComSignalInitValue=0, ComSignalType=BOOLEAN, ComHandleId=2647, ComSystemTemplateSystemSignalRef=DET_BI_STATIC_FLAG_126
            DET_BI_STATIC_FLAG_125_oRDR_DETECTION_125_128_oPCAN_RADAR_9ee96262_Tx: ComBitPosition=104, ComBitSize=1, ComSignalInitValue=0, ComSignalType=BOOLEAN, ComHandleId=2646, ComSystemTemplateSystemSignalRef=DET_BI_STATIC_FLAG_125
            DET_ELEVATION_127_oRDR_DETECTION_125_128_oPCAN_RADAR_e8e65280_Tx: ComBitPosition=296, ComBitSize=8, ComSignalInitValue=0, ComSignalType=UINT8, ComHandleId=2660, ComSystemTemplateSystemSignalRef=DET_ELEVATION_127
            DET_RANGE_126_oRDR_DETECTION_125_128_oPCAN_RADAR_bcbe2aa2_Tx: ComBitPosition=136, ComBitSize=15, ComSignalInitValue=0, ComSignalType=UINT16, ComHandleId=2690, ComSystemTemplateSystemSignalRef=DET_RANGE_126
            DET_SNR_128_oRDR_DETECTION_125_128_oPCAN_RADAR_2a56cd0d_Tx: ComBitPosition=456, ComBitSize=8, ComSignalInitValue=0, ComSignalType=UINT8, ComHandleId=2712, ComSystemTemplateSystemSignalRef=DET_SNR_128
            DET_HVC_FLAG_127_oRDR_DETECTION_125_128_oPCAN_RADAR_5c34fcea_Tx: ComBitPosition=310, ComBitSize=1, ComSignalInitValue=0, ComSignalType=BOOLEAN, ComHandleId=2672, ComSystemTemplateSystemSignalRef=DET_HVC_FLAG_127
            DET_SNR_126_oRDR_DETECTION_125_128_oPCAN_RADAR_93368bdf_Tx: ComBitPosition=232, ComBitSize=8, ComSignalInitValue=0, ComSignalType=UINT8, ComHandleId=2710, ComSystemTemplateSystemSignalRef=DET_SNR_126
            DET_SUPER_RES_TARGET_126_oRDR_DETECTION_125_128_oPCAN_RADAR_a2afa3ba_Tx: ComBitPosition=199, ComBitSize=1, ComSignalInitValue=0, ComSignalType=BOOLEAN, ComHandleId=2714, ComSystemTemplateSystemSignalRef=DET_SUPER_RES_TARGET_126
            DET_CONFD_AZIMUTH_125_oRDR_DETECTION_125_128_oPCAN_RADAR_ca23282d_Tx: ComBitPosition=118, ComBitSize=2, ComSignalInitValue=0, ComSignalType=UINT8, ComHandleId=2650, ComSystemTemplateSystemSignalRef=DET_CONFD_AZIMUTH_125
            DET_AZIMUTH_ERR_125_oRDR_DETECTION_125_128_oPCAN_RADAR_6c70b712_Tx: ComBitPosition=105, ComBitSize=7, ComSignalInitValue=0, ComSignalType=UINT8, ComHandleId=2638, ComSystemTemplateSystemSignalRef=DET_AZIMUTH_ERR_125
            DET_CONFD_AZIMUTH_127_oRDR_DETECTION_125_128_oPCAN_RADAR_3bb38746_Tx: ComBitPosition=342, ComBitSize=2, ComSignalInitValue=0, ComSignalType=UINT8, ComHandleId=2652, ComSystemTemplateSystemSignalRef=DET_CONFD_AZIMUTH_127
            DET_BI_STATIC_FLAG_127_oRDR_DETECTION_125_128_oPCAN_RADAR_6f79cd09_Tx: ComBitPosition=328, ComBitSize=1, ComSignalInitValue=0, ComSignalType=BOOLEAN, ComHandleId=2648, ComSystemTemplateSystemSignalRef=DET_BI_STATIC_FLAG_127
            DET_AZIMUTH_ERR_128_oRDR_DETECTION_125_128_oPCAN_RADAR_b1f08a3e_Tx: ComBitPosition=441, ComBitSize=7, ComSignalInitValue=0, ComSignalType=UINT8, ComHandleId=2641, ComSystemTemplateSystemSignalRef=DET_AZIMUTH_ERR_128
            DET_MH_CRC16_125_128_oRDR_DETECTION_125_128_oPCAN_RADAR_5ddef112_Tx: ComBitPosition=0, ComBitSize=16, ComSignalInitValue=0, ComSignalType=UINT16, ComHandleId=2678, ComSystemTemplateSystemSignalRef=DET_MH_CRC16_125_128
            DET_RANGE_125_oRDR_DETECTION_125_128_oPCAN_RADAR_d85e515c_Tx: ComBitPosition=24, ComBitSize=15, ComSignalInitValue=0, ComSignalType=UINT16, ComHandleId=2689, ComSystemTemplateSystemSignalRef=DET_RANGE_125
            DET_AZIMUTH_ERR_127_oRDR_DETECTION_125_128_oPCAN_RADAR_9de01879_Tx: ComBitPosition=329, ComBitSize=7, ComSignalInitValue=0, ComSignalType=UINT8, ComHandleId=2640, ComSystemTemplateSystemSignalRef=DET_AZIMUTH_ERR_127
            DET_CONFD_ELEVATION_127_oRDR_DETECTION_125_128_oPCAN_RADAR_392686bc_Tx: ComBitPosition=325, ComBitSize=2, ComSignalInitValue=0, ComSignalType=UINT8, ComHandleId=2656, ComSystemTemplateSystemSignalRef=DET_CONFD_ELEVATION_127
            DET_RANGE_128_oRDR_DETECTION_125_128_oPCAN_RADAR_05de6c70_Tx: ComBitPosition=360, ComBitSize=15, ComSignalInitValue=0, ComSignalType=UINT16, ComHandleId=2692, ComSystemTemplateSystemSignalRef=DET_RANGE_128
            DET_RANGE_ERR_125_oRDR_DETECTION_125_128_oPCAN_RADAR_7fb6eb35_Tx: ComBitPosition=40, ComBitSize=7, ComSignalInitValue=0, ComSignalType=UINT8, ComHandleId=2693, ComSystemTemplateSystemSignalRef=DET_RANGE_ERR_125
            DET_SNR_125_oRDR_DETECTION_125_128_oPCAN_RADAR_f7d6f021_Tx: ComBitPosition=120, ComBitSize=8, ComSignalInitValue=0, ComSignalType=UINT8, ComHandleId=2709, ComSystemTemplateSystemSignalRef=DET_SNR_125
            DET_SUPER_RES_TARGET_127_oRDR_DETECTION_125_128_oPCAN_RADAR_37df772f_Tx: ComBitPosition=311, ComBitSize=1, ComSignalInitValue=0, ComSignalType=BOOLEAN, ComHandleId=2715, ComSystemTemplateSystemSignalRef=DET_SUPER_RES_TARGET_127
            DET_RCS_125_oRDR_DETECTION_125_128_oPCAN_RADAR_2a78a423_Tx: ComBitPosition=128, ComBitSize=8, ComSignalInitValue=128, ComSignalType=UINT8, ComHandleId=2705, ComSystemTemplateSystemSignalRef=DET_RCS_125
            DET_SUPER_RES_TARGET_125_oRDR_DETECTION_125_128_oPCAN_RADAR_c64fd844_Tx: ComBitPosition=87, ComBitSize=1, ComSignalInitValue=0, ComSignalType=BOOLEAN, ComHandleId=2713, ComSystemTemplateSystemSignalRef=DET_SUPER_RES_TARGET_125
            DET_RANGE_ERR_127_oRDR_DETECTION_125_128_oPCAN_RADAR_8e26445e_Tx: ComBitPosition=264, ComBitSize=7, ComSignalInitValue=0, ComSignalType=UINT8, ComHandleId=2695, ComSystemTemplateSystemSignalRef=DET_RANGE_ERR_127
            DET_RCS_127_oRDR_DETECTION_125_128_oPCAN_RADAR_dbe80b48_Tx: ComBitPosition=352, ComBitSize=8, ComSignalInitValue=128, ComSignalType=UINT8, ComHandleId=2707, ComSystemTemplateSystemSignalRef=DET_RCS_127
            DET_CONFD_ELEVATION_125_oRDR_DETECTION_125_128_oPCAN_RADAR_c8b629d7_Tx: ComBitPosition=101, ComBitSize=2, ComSignalInitValue=0, ComSignalType=UINT8, ComHandleId=2654, ComSystemTemplateSystemSignalRef=DET_CONFD_ELEVATION_125
            DET_RANGE_VELOCITY_125_oRDR_DETECTION_125_128_oPCAN_RADAR_adf89379_Tx: ComBitPosition=48, ComBitSize=15, ComSignalInitValue=16384, ComSignalType=UINT16, ComHandleId=2697, ComSystemTemplateSystemSignalRef=DET_RANGE_VELOCITY_125
            DET_HVC_FLAG_126_oRDR_DETECTION_125_128_oPCAN_RADAR_c944287f_Tx: ComBitPosition=198, ComBitSize=1, ComSignalInitValue=0, ComSignalType=BOOLEAN, ComHandleId=2671, ComSystemTemplateSystemSignalRef=DET_HVC_FLAG_126
            DET_EXISTENCE_PROB_125_oRDR_DETECTION_125_128_oPCAN_RADAR_4cd010fe_Tx: ComBitPosition=112, ComBitSize=6, ComSignalInitValue=0, ComSignalType=UINT8, ComHandleId=2666, ComSystemTemplateSystemSignalRef=DET_EXISTENCE_PROB_125
            DET_MH_CYCLE_COUNTER_125_128_oRDR_DETECTION_125_128_oPCAN_RADAR_d9ab5025_Tx: ComBitPosition=16, ComBitSize=8, ComSignalInitValue=0, ComSignalType=UINT8, ComHandleId=2679, ComSystemTemplateSystemSignalRef=DET_MH_CYCLE_COUNTER_125_128
            DET_RANGE_ERR_128_oRDR_DETECTION_125_128_oPCAN_RADAR_a236d619_Tx: ComBitPosition=376, ComBitSize=7, ComSignalInitValue=0, ComSignalType=UINT8, ComHandleId=2696, ComSystemTemplateSystemSignalRef=DET_RANGE_ERR_128
            DET_ELEVATION_128_oRDR_DETECTION_125_128_oPCAN_RADAR_c4f6c0c7_Tx: ComBitPosition=408, ComBitSize=8, ComSignalInitValue=0, ComSignalType=UINT8, ComHandleId=2661, ComSystemTemplateSystemSignalRef=DET_ELEVATION_128
            DET_RANGE_127_oRDR_DETECTION_125_128_oPCAN_RADAR_29cefe37_Tx: ComBitPosition=248, ComBitSize=15, ComSignalInitValue=0, ComSignalType=UINT16, ComHandleId=2691, ComSystemTemplateSystemSignalRef=DET_RANGE_127
            DET_SNR_127_oRDR_DETECTION_125_128_oPCAN_RADAR_06465f4a_Tx: ComBitPosition=344, ComBitSize=8, ComSignalInitValue=0, ComSignalType=UINT8, ComHandleId=2711, ComSystemTemplateSystemSignalRef=DET_SNR_127
            DET_RANGE_VELOCITY_ERR_125_oRDR_DETECTION_125_128_oPCAN_RADAR_a24368cb_Tx: ComBitPosition=64, ComBitSize=8, ComSignalInitValue=0, ComSignalType=UINT8, ComHandleId=2701, ComSystemTemplateSystemSignalRef=DET_RANGE_VELOCITY_ERR_125
            DET_BI_STATIC_FLAG_128_oRDR_DETECTION_125_128_oPCAN_RADAR_43695f4e_Tx: ComBitPosition=440, ComBitSize=1, ComSignalInitValue=0, ComSignalType=BOOLEAN, ComHandleId=2649, ComSystemTemplateSystemSignalRef=DET_BI_STATIC_FLAG_128
            DET_AZIMUTH_127_oRDR_DETECTION_125_128_oPCAN_RADAR_39558d8c_Tx: ComBitPosition=312, ComBitSize=13, ComSignalInitValue=0, ComSignalType=UINT16, ComHandleId=2636, ComSystemTemplateSystemSignalRef=DET_AZIMUTH_127
            DET_ELEVATION_ERR_125_oRDR_DETECTION_125_128_oPCAN_RADAR_9e4f659e_Tx: ComBitPosition=80, ComBitSize=6, ComSignalInitValue=0, ComSignalType=UINT8, ComHandleId=2662, ComSystemTemplateSystemSignalRef=DET_ELEVATION_ERR_125
            DET_ELEVATION_ERR_127_oRDR_DETECTION_125_128_oPCAN_RADAR_6fdfcaf5_Tx: ComBitPosition=304, ComBitSize=6, ComSignalInitValue=0, ComSignalType=UINT8, ComHandleId=2664, ComSystemTemplateSystemSignalRef=DET_ELEVATION_ERR_127
            DET_ELEVATION_125_oRDR_DETECTION_125_128_oPCAN_RADAR_1976fdeb_Tx: ComBitPosition=72, ComBitSize=8, ComSignalInitValue=0, ComSignalType=UINT8, ComHandleId=2658, ComSystemTemplateSystemSignalRef=DET_ELEVATION_125
            DET_SUPER_RES_TARGET_128_oRDR_DETECTION_125_128_oPCAN_RADAR_1bcfe568_Tx: ComBitPosition=423, ComBitSize=1, ComSignalInitValue=0, ComSignalType=BOOLEAN, ComHandleId=2716, ComSystemTemplateSystemSignalRef=DET_SUPER_RES_TARGET_128
            DET_RCS_126_oRDR_DETECTION_125_128_oPCAN_RADAR_4e98dfdd_Tx: ComBitPosition=240, ComBitSize=8, ComSignalInitValue=128, ComSignalType=UINT8, ComHandleId=2706, ComSystemTemplateSystemSignalRef=DET_RCS_126
            DET_HVC_FLAG_125_oRDR_DETECTION_125_128_oPCAN_RADAR_ada45381_Tx: ComBitPosition=86, ComBitSize=1, ComSignalInitValue=0, ComSignalType=BOOLEAN, ComHandleId=2670, ComSystemTemplateSystemSignalRef=DET_HVC_FLAG_125
            DET_RANGE_VELOCITY_ERR_128_oRDR_DETECTION_125_128_oPCAN_RADAR_7fc355e7_Tx: ComBitPosition=400, ComBitSize=8, ComSignalInitValue=0, ComSignalType=UINT8, ComHandleId=2704, ComSystemTemplateSystemSignalRef=DET_RANGE_VELOCITY_ERR_128
            DET_RANGE_ERR_126_oRDR_DETECTION_125_128_oPCAN_RADAR_1b5690cb_Tx: ComBitPosition=152, ComBitSize=7, ComSignalInitValue=0, ComSignalType=UINT8, ComHandleId=2694, ComSystemTemplateSystemSignalRef=DET_RANGE_ERR_126
            DET_RCS_128_oRDR_DETECTION_125_128_oPCAN_RADAR_f7f8990f_Tx: ComBitPosition=464, ComBitSize=8, ComSignalInitValue=128, ComSignalType=UINT8, ComHandleId=2708, ComSystemTemplateSystemSignalRef=DET_RCS_128
            DET_CONFD_AZIMUTH_128_oRDR_DETECTION_125_128_oPCAN_RADAR_17a31501_Tx: ComBitPosition=454, ComBitSize=2, ComSignalInitValue=0, ComSignalType=UINT8, ComHandleId=2653, ComSystemTemplateSystemSignalRef=DET_CONFD_AZIMUTH_128
            DET_ELEVATION_ERR_126_oRDR_DETECTION_125_128_oPCAN_RADAR_faaf1e60_Tx: ComBitPosition=192, ComBitSize=6, ComSignalInitValue=0, ComSignalType=UINT8, ComHandleId=2663, ComSystemTemplateSystemSignalRef=DET_ELEVATION_ERR_126
            DET_AZIMUTH_128_oRDR_DETECTION_125_128_oPCAN_RADAR_15451fcb_Tx: ComBitPosition=424, ComBitSize=13, ComSignalInitValue=0, ComSignalType=UINT16, ComHandleId=2637, ComSystemTemplateSystemSignalRef=DET_AZIMUTH_128
            DET_EXISTENCE_PROB_128_oRDR_DETECTION_125_128_oPCAN_RADAR_91502dd2_Tx: ComBitPosition=448, ComBitSize=6, ComSignalInitValue=0, ComSignalType=UINT8, ComHandleId=2669, ComSystemTemplateSystemSignalRef=DET_EXISTENCE_PROB_128
            DET_CONFD_ELEVATION_126_oRDR_DETECTION_125_128_oPCAN_RADAR_ac565229_Tx: ComBitPosition=213, ComBitSize=2, ComSignalInitValue=0, ComSignalType=UINT8, ComHandleId=2655, ComSystemTemplateSystemSignalRef=DET_CONFD_ELEVATION_126
            DET_AZIMUTH_ERR_126_oRDR_DETECTION_125_128_oPCAN_RADAR_0890ccec_Tx: ComBitPosition=217, ComBitSize=7, ComSignalInitValue=0, ComSignalType=UINT8, ComHandleId=2639, ComSystemTemplateSystemSignalRef=DET_AZIMUTH_ERR_126
            DET_HVC_FLAG_128_oRDR_DETECTION_125_128_oPCAN_RADAR_70246ead_Tx: ComBitPosition=422, ComBitSize=1, ComSignalInitValue=0, ComSignalType=BOOLEAN, ComHandleId=2673, ComSystemTemplateSystemSignalRef=DET_HVC_FLAG_128
            DET_AZIMUTH_125_oRDR_DETECTION_125_128_oPCAN_RADAR_c8c522e7_Tx: ComBitPosition=88, ComBitSize=13, ComSignalInitValue=0, ComSignalType=UINT16, ComHandleId=2634, ComSystemTemplateSystemSignalRef=DET_AZIMUTH_125
            DET_RANGE_VELOCITY_127_oRDR_DETECTION_125_128_oPCAN_RADAR_5c683c12_Tx: ComBitPosition=272, ComBitSize=15, ComSignalInitValue=16384, ComSignalType=UINT16, ComHandleId=2699, ComSystemTemplateSystemSignalRef=DET_RANGE_VELOCITY_127
            DET_ELEVATION_ERR_128_oRDR_DETECTION_125_128_oPCAN_RADAR_43cf58b2_Tx: ComBitPosition=416, ComBitSize=6, ComSignalInitValue=0, ComSignalType=UINT8, ComHandleId=2665, ComSystemTemplateSystemSignalRef=DET_ELEVATION_ERR_128
            DET_EXISTENCE_PROB_126_oRDR_DETECTION_125_128_oPCAN_RADAR_28306b00_Tx: ComBitPosition=224, ComBitSize=6, ComSignalInitValue=0, ComSignalType=UINT8, ComHandleId=2667, ComSystemTemplateSystemSignalRef=DET_EXISTENCE_PROB_126
            DET_AZIMUTH_126_oRDR_DETECTION_125_128_oPCAN_RADAR_ac255919_Tx: ComBitPosition=200, ComBitSize=13, ComSignalInitValue=0, ComSignalType=UINT16, ComHandleId=2635, ComSystemTemplateSystemSignalRef=DET_AZIMUTH_126
            DET_ELEVATION_126_oRDR_DETECTION_125_128_oPCAN_RADAR_7d968615_Tx: ComBitPosition=184, ComBitSize=8, ComSignalInitValue=0, ComSignalType=UINT8, ComHandleId=2659, ComSystemTemplateSystemSignalRef=DET_ELEVATION_126
            DET_RANGE_VELOCITY_126_oRDR_DETECTION_125_128_oPCAN_RADAR_c918e887_Tx: ComBitPosition=160, ComBitSize=15, ComSignalInitValue=16384, ComSignalType=UINT16, ComHandleId=2698, ComSystemTemplateSystemSignalRef=DET_RANGE_VELOCITY_126
            DET_RANGE_VELOCITY_ERR_127_oRDR_DETECTION_125_128_oPCAN_RADAR_53d3c7a0_Tx: ComBitPosition=288, ComBitSize=8, ComSignalInitValue=0, ComSignalType=UINT8, ComHandleId=2703, ComSystemTemplateSystemSignalRef=DET_RANGE_VELOCITY_ERR_127
            DET_MH_SCAN_INDEX_4LSB_125_128_oRDR_DETECTION_125_128_oPCAN_RADAR_158175a9_Tx: ComBitPosition=476, ComBitSize=4, ComSignalInitValue=0, ComSignalType=UINT8, ComHandleId=2680, ComSystemTemplateSystemSignalRef=DET_MH_SCAN_INDEX_4LSB_125_128
            DET_RANGE_VELOCITY_128_oRDR_DETECTION_125_128_oPCAN_RADAR_7078ae55_Tx: ComBitPosition=384, ComBitSize=15, ComSignalInitValue=16384, ComSignalType=UINT16, ComHandleId=2700, ComSystemTemplateSystemSignalRef=DET_RANGE_VELOCITY_128
            DET_BELOW_RAIN_THOLD_125_oRDR_DETECTION_125_128_oPCAN_RADAR_1dc4b127_Tx: ComBitPosition=39, ComBitSize=1, ComSignalInitValue=0, ComSignalType=UINT8, ComHandleId=2642, ComSystemTemplateSystemSignalRef=DET_BELOW_RAIN_THOLD_125
            DET_IDM_127_oRDR_DETECTION_125_128_oPCAN_RADAR_d766c757_Tx: ComBitPosition=287, ComBitSize=1, ComSignalInitValue=0, ComSignalType=UINT8, ComHandleId=2676, ComSystemTemplateSystemSignalRef=DET_IDM_127
            DET_BELOW_RAIN_THOLD_127_oRDR_DETECTION_125_128_oPCAN_RADAR_ec541e4c_Tx: ComBitPosition=263, ComBitSize=1, ComSignalInitValue=0, ComSignalType=UINT8, ComHandleId=2644, ComSystemTemplateSystemSignalRef=DET_BELOW_RAIN_THOLD_127
            DET_PROB_1STAZHYPO_125_oRDR_DETECTION_125_128_oPCAN_RADAR_d3f1b22a_Tx: ComBitPosition=103, ComBitSize=1, ComSignalInitValue=0, ComSignalType=BOOLEAN, ComHandleId=2685, ComSystemTemplateSystemSignalRef=DET_PROB_1STAZHYPO_125
            DET_PROB_1STAZHYPO_128_oRDR_DETECTION_125_128_oPCAN_RADAR_0e718f06_Tx: ComBitPosition=439, ComBitSize=1, ComSignalInitValue=0, ComSignalType=BOOLEAN, ComHandleId=2688, ComSystemTemplateSystemSignalRef=DET_PROB_1STAZHYPO_128
            DET_BELOW_RAIN_THOLD_128_oRDR_DETECTION_125_128_oPCAN_RADAR_c0448c0b_Tx: ComBitPosition=375, ComBitSize=1, ComSignalInitValue=0, ComSignalType=UINT8, ComHandleId=2645, ComSystemTemplateSystemSignalRef=DET_BELOW_RAIN_THOLD_128
            DET_MTD_126_oRDR_DETECTION_125_128_oPCAN_RADAR_24a52119_Tx: ComBitPosition=159, ComBitSize=1, ComSignalInitValue=0, ComSignalType=UINT8, ComHandleId=2682, ComSystemTemplateSystemSignalRef=DET_MTD_126
            DET_BELOW_RAIN_THOLD_126_oRDR_DETECTION_125_128_oPCAN_RADAR_7924cad9_Tx: ComBitPosition=151, ComBitSize=1, ComSignalInitValue=0, ComSignalType=UINT8, ComHandleId=2643, ComSystemTemplateSystemSignalRef=DET_BELOW_RAIN_THOLD_126
            DET_IDM_126_oRDR_DETECTION_125_128_oPCAN_RADAR_421613c2_Tx: ComBitPosition=175, ComBitSize=1, ComSignalInitValue=0, ComSignalType=UINT8, ComHandleId=2675, ComSystemTemplateSystemSignalRef=DET_IDM_126
            DET_MTD_127_oRDR_DETECTION_125_128_oPCAN_RADAR_b1d5f58c_Tx: ComBitPosition=271, ComBitSize=1, ComSignalInitValue=0, ComSignalType=UINT8, ComHandleId=2683, ComSystemTemplateSystemSignalRef=DET_MTD_127
            DET_PROB_1STAZHYPO_126_oRDR_DETECTION_125_128_oPCAN_RADAR_b711c9d4_Tx: ComBitPosition=215, ComBitSize=1, ComSignalInitValue=0, ComSignalType=BOOLEAN, ComHandleId=2686, ComSystemTemplateSystemSignalRef=DET_PROB_1STAZHYPO_126
            DET_IDM_125_oRDR_DETECTION_125_128_oPCAN_RADAR_26f6683c_Tx: ComBitPosition=63, ComBitSize=1, ComSignalInitValue=0, ComSignalType=UINT8, ComHandleId=2674, ComSystemTemplateSystemSignalRef=DET_IDM_125
            DET_IDM_128_oRDR_DETECTION_125_128_oPCAN_RADAR_fb765510_Tx: ComBitPosition=399, ComBitSize=1, ComSignalInitValue=0, ComSignalType=UINT8, ComHandleId=2677, ComSystemTemplateSystemSignalRef=DET_IDM_128
            DET_MTD_125_oRDR_DETECTION_125_128_oPCAN_RADAR_40455ae7_Tx: ComBitPosition=47, ComBitSize=1, ComSignalInitValue=0, ComSignalType=UINT8, ComHandleId=2681, ComSystemTemplateSystemSignalRef=DET_MTD_125
            DET_PROB_1STAZHYPO_127_oRDR_DETECTION_125_128_oPCAN_RADAR_22611d41_Tx: ComBitPosition=327, ComBitSize=1, ComSignalInitValue=0, ComSignalType=BOOLEAN, ComHandleId=2687, ComSystemTemplateSystemSignalRef=DET_PROB_1STAZHYPO_127
            DET_MTD_128_oRDR_DETECTION_125_128_oPCAN_RADAR_9dc567cb_Tx: ComBitPosition=383, ComBitSize=1, ComSignalInitValue=0, ComSignalType=UINT8, ComHandleId=2684, ComSystemTemplateSystemSignalRef=DET_MTD_128
        SG_Detections_241_244_oRDR_DETECTION_241_244_oPCAN_RADAR_30f39079_Tx: ComTransferProperty=TRIGGERED, ComHandleId=62, ComSystemTemplateSignalGroupRef=SG_Detections_241_244
          83 x ComGroupSignal, all with ComSignalEndianness=LITTLE_ENDIAN, ComTransferProperty=PENDING, ComSignalAccess=ACCESS_NEEDED_BY_SWC_OR_COM:
            DET_RANGE_ERR_244_oRDR_DETECTION_241_244_oPCAN_RADAR_becbc4d0_Tx: ComBitPosition=376, ComBitSize=7, ComSignalInitValue=0, ComSignalType=UINT8, ComHandleId=5103, ComSystemTemplateSystemSignalRef=DET_RANGE_ERR_244
            DET_MH_SCAN_INDEX_4LSB_241_244_oRDR_DETECTION_241_244_oPCAN_RADAR_fc24c6c9_Tx: ComBitPosition=476, ComBitSize=4, ComSignalInitValue=0, ComSignalType=UINT8, ComHandleId=5087, ComSystemTemplateSystemSignalRef=DET_MH_SCAN_INDEX_4LSB_241_244
            DET_HVC_FLAG_242_oRDR_DETECTION_241_244_oPCAN_RADAR_a5198b98_Tx: ComBitPosition=198, ComBitSize=1, ComSignalInitValue=0, ComSignalType=BOOLEAN, ComHandleId=5078, ComSystemTemplateSystemSignalRef=DET_HVC_FLAG_242
            DET_CONFD_AZIMUTH_243_oRDR_DETECTION_241_244_oPCAN_RADAR_57ee24a1_Tx: ComBitPosition=342, ComBitSize=2, ComSignalInitValue=0, ComSignalType=UINT8, ComHandleId=5059, ComSystemTemplateSystemSignalRef=DET_CONFD_AZIMUTH_243
            DET_RANGE_242_oRDR_DETECTION_241_244_oPCAN_RADAR_d0e38945_Tx: ComBitPosition=136, ComBitSize=15, ComSignalInitValue=0, ComSignalType=UINT16, ComHandleId=5097, ComSystemTemplateSystemSignalRef=DET_RANGE_242
            DET_SNR_241_oRDR_DETECTION_241_244_oPCAN_RADAR_9b8b53c6_Tx: ComBitPosition=120, ComBitSize=8, ComSignalInitValue=0, ComSignalType=UINT8, ComHandleId=5116, ComSystemTemplateSystemSignalRef=DET_SNR_241
            DET_CONFD_ELEVATION_244_oRDR_DETECTION_241_244_oPCAN_RADAR_09cb0632_Tx: ComBitPosition=437, ComBitSize=2, ComSignalInitValue=0, ComSignalType=UINT8, ComHandleId=5064, ComSystemTemplateSystemSignalRef=DET_CONFD_ELEVATION_244
            DET_SNR_244_oRDR_DETECTION_241_244_oPCAN_RADAR_36abdfc4_Tx: ComBitPosition=456, ComBitSize=8, ComSignalInitValue=0, ComSignalType=UINT8, ComHandleId=5119, ComSystemTemplateSystemSignalRef=DET_SNR_244
            DET_RANGE_VELOCITY_242_oRDR_DETECTION_241_244_oPCAN_RADAR_a5454b60_Tx: ComBitPosition=160, ComBitSize=15, ComSignalInitValue=16384, ComSignalType=UINT16, ComHandleId=5105, ComSystemTemplateSystemSignalRef=DET_RANGE_VELOCITY_242
            DET_CONFD_ELEVATION_243_oRDR_DETECTION_241_244_oPCAN_RADAR_557b255b_Tx: ComBitPosition=325, ComBitSize=2, ComSignalInitValue=0, ComSignalType=UINT8, ComHandleId=5063, ComSystemTemplateSystemSignalRef=DET_CONFD_ELEVATION_243
            DET_RANGE_243_oRDR_DETECTION_241_244_oPCAN_RADAR_45935dd0_Tx: ComBitPosition=248, ComBitSize=15, ComSignalInitValue=0, ComSignalType=UINT16, ComHandleId=5098, ComSystemTemplateSystemSignalRef=DET_RANGE_243
            DET_AZIMUTH_ERR_242_oRDR_DETECTION_241_244_oPCAN_RADAR_64cd6f0b_Tx: ComBitPosition=217, ComBitSize=7, ComSignalInitValue=0, ComSignalType=UINT8, ComHandleId=5046, ComSystemTemplateSystemSignalRef=DET_AZIMUTH_ERR_242
            DET_AZIMUTH_ERR_244_oRDR_DETECTION_241_244_oPCAN_RADAR_ad0d98f7_Tx: ComBitPosition=441, ComBitSize=7, ComSignalInitValue=0, ComSignalType=UINT8, ComHandleId=5048, ComSystemTemplateSystemSignalRef=DET_AZIMUTH_ERR_244
            DET_RANGE_VELOCITY_ERR_244_oRDR_DETECTION_241_244_oPCAN_RADAR_633e472e_Tx: ComBitPosition=400, ComBitSize=8, ComSignalInitValue=0, ComSignalType=UINT8, ComHandleId=5111, ComSystemTemplateSystemSignalRef=DET_RANGE_VELOCITY_ERR_244
            DET_RANGE_VELOCITY_ERR_241_oRDR_DETECTION_241_244_oPCAN_RADAR_ce1ecb2c_Tx: ComBitPosition=64, ComBitSize=8, ComSignalInitValue=0, ComSignalType=UINT8, ComHandleId=5108, ComSystemTemplateSystemSignalRef=DET_RANGE_VELOCITY_ERR_241
            DET_EXISTENCE_PROB_242_oRDR_DETECTION_241_244_oPCAN_RADAR_446dc8e7_Tx: ComBitPosition=224, ComBitSize=6, ComSignalInitValue=0, ComSignalType=UINT8, ComHandleId=5074, ComSystemTemplateSystemSignalRef=DET_EXISTENCE_PROB_242
            DET_SUPER_RES_TARGET_241_oRDR_DETECTION_241_244_oPCAN_RADAR_aa127ba3_Tx: ComBitPosition=87, ComBitSize=1, ComSignalInitValue=0, ComSignalType=BOOLEAN, ComHandleId=5120, ComSystemTemplateSystemSignalRef=DET_SUPER_RES_TARGET_241
            DET_AZIMUTH_241_oRDR_DETECTION_241_244_oPCAN_RADAR_a4988100_Tx: ComBitPosition=88, ComBitSize=13, ComSignalInitValue=0, ComSignalType=UINT16, ComHandleId=5041, ComSystemTemplateSystemSignalRef=DET_AZIMUTH_241
            DET_RANGE_ERR_241_oRDR_DETECTION_241_244_oPCAN_RADAR_13eb48d2_Tx: ComBitPosition=40, ComBitSize=7, ComSignalInitValue=0, ComSignalType=UINT8, ComHandleId=5100, ComSystemTemplateSystemSignalRef=DET_RANGE_ERR_241
            DET_BI_STATIC_FLAG_241_oRDR_DETECTION_241_244_oPCAN_RADAR_f2b4c185_Tx: ComBitPosition=104, ComBitSize=1, ComSignalInitValue=0, ComSignalType=BOOLEAN, ComHandleId=5053, ComSystemTemplateSystemSignalRef=DET_BI_STATIC_FLAG_241
            DET_RCS_244_oRDR_DETECTION_241_244_oPCAN_RADAR_eb058bc6_Tx: ComBitPosition=464, ComBitSize=8, ComSignalInitValue=128, ComSignalType=UINT8, ComHandleId=5115, ComSystemTemplateSystemSignalRef=DET_RCS_244
            DET_EXISTENCE_PROB_241_oRDR_DETECTION_241_244_oPCAN_RADAR_208db319_Tx: ComBitPosition=112, ComBitSize=6, ComSignalInitValue=0, ComSignalType=UINT8, ComHandleId=5073, ComSystemTemplateSystemSignalRef=DET_EXISTENCE_PROB_241
            DET_AZIMUTH_242_oRDR_DETECTION_241_244_oPCAN_RADAR_c078fafe_Tx: ComBitPosition=200, ComBitSize=13, ComSignalInitValue=0, ComSignalType=UINT16, ComHandleId=5042, ComSystemTemplateSystemSignalRef=DET_AZIMUTH_242
            DET_ELEVATION_244_oRDR_DETECTION_241_244_oPCAN_RADAR_d80bd20e_Tx: ComBitPosition=408, ComBitSize=8, ComSignalInitValue=0, ComSignalType=UINT8, ComHandleId=5068, ComSystemTemplateSystemSignalRef=DET_ELEVATION_244
            DET_BI_STATIC_FLAG_243_oRDR_DETECTION_241_244_oPCAN_RADAR_03246eee_Tx: ComBitPosition=328, ComBitSize=1, ComSignalInitValue=0, ComSignalType=BOOLEAN, ComHandleId=5055, ComSystemTemplateSystemSignalRef=DET_BI_STATIC_FLAG_243
            DET_ELEVATION_243_oRDR_DETECTION_241_244_oPCAN_RADAR_84bbf167_Tx: ComBitPosition=296, ComBitSize=8, ComSignalInitValue=0, ComSignalType=UINT8, ComHandleId=5067, ComSystemTemplateSystemSignalRef=DET_ELEVATION_243
            DET_HVC_FLAG_243_oRDR_DETECTION_241_244_oPCAN_RADAR_30695f0d_Tx: ComBitPosition=310, ComBitSize=1, ComSignalInitValue=0, ComSignalType=BOOLEAN, ComHandleId=5079, ComSystemTemplateSystemSignalRef=DET_HVC_FLAG_243
            DET_SNR_243_oRDR_DETECTION_241_244_oPCAN_RADAR_6a1bfcad_Tx: ComBitPosition=344, ComBitSize=8, ComSignalInitValue=0, ComSignalType=UINT8, ComHandleId=5118, ComSystemTemplateSystemSignalRef=DET_SNR_243
            DET_ELEVATION_241_oRDR_DETECTION_241_244_oPCAN_RADAR_752b5e0c_Tx: ComBitPosition=72, ComBitSize=8, ComSignalInitValue=0, ComSignalType=UINT8, ComHandleId=5065, ComSystemTemplateSystemSignalRef=DET_ELEVATION_241
            DET_MH_CRC16_241_244_oRDR_DETECTION_241_244_oPCAN_RADAR_b47b4272_Tx: ComBitPosition=0, ComBitSize=16, ComSignalInitValue=0, ComSignalType=UINT16, ComHandleId=5085, ComSystemTemplateSystemSignalRef=DET_MH_CRC16_241_244
            DET_SUPER_RES_TARGET_243_oRDR_DETECTION_241_244_oPCAN_RADAR_5b82d4c8_Tx: ComBitPosition=311, ComBitSize=1, ComSignalInitValue=0, ComSignalType=BOOLEAN, ComHandleId=5122, ComSystemTemplateSystemSignalRef=DET_SUPER_RES_TARGET_243
            DET_RANGE_244_oRDR_DETECTION_241_244_oPCAN_RADAR_19237eb9_Tx: ComBitPosition=360, ComBitSize=15, ComSignalInitValue=0, ComSignalType=UINT16, ComHandleId=5099, ComSystemTemplateSystemSignalRef=DET_RANGE_244
            DET_CONFD_AZIMUTH_244_oRDR_DETECTION_241_244_oPCAN_RADAR_0b5e07c8_Tx: ComBitPosition=454, ComBitSize=2, ComSignalInitValue=0, ComSignalType=UINT8, ComHandleId=5060, ComSystemTemplateSystemSignalRef=DET_CONFD_AZIMUTH_244
            DET_CONFD_AZIMUTH_241_oRDR_DETECTION_241_244_oPCAN_RADAR_a67e8bca_Tx: ComBitPosition=118, ComBitSize=2, ComSignalInitValue=0, ComSignalType=UINT8, ComHandleId=5057, ComSystemTemplateSystemSignalRef=DET_CONFD_AZIMUTH_241
            DET_RANGE_VELOCITY_241_oRDR_DETECTION_241_244_oPCAN_RADAR_c1a5309e_Tx: ComBitPosition=48, ComBitSize=15, ComSignalInitValue=16384, ComSignalType=UINT16, ComHandleId=5104, ComSystemTemplateSystemSignalRef=DET_RANGE_VELOCITY_241
            DET_CONFD_ELEVATION_241_oRDR_DETECTION_241_244_oPCAN_RADAR_a4eb8a30_Tx: ComBitPosition=101, ComBitSize=2, ComSignalInitValue=0, ComSignalType=UINT8, ComHandleId=5061, ComSystemTemplateSystemSignalRef=DET_CONFD_ELEVATION_241
            DET_EXISTENCE_PROB_244_oRDR_DETECTION_241_244_oPCAN_RADAR_8dad3f1b_Tx: ComBitPosition=448, ComBitSize=6, ComSignalInitValue=0, ComSignalType=UINT8, ComHandleId=5076, ComSystemTemplateSystemSignalRef=DET_EXISTENCE_PROB_244
            DET_ELEVATION_242_oRDR_DETECTION_241_244_oPCAN_RADAR_11cb25f2_Tx: ComBitPosition=184, ComBitSize=8, ComSignalInitValue=0, ComSignalType=UINT8, ComHandleId=5066, ComSystemTemplateSystemSignalRef=DET_ELEVATION_242
            DET_ELEVATION_ERR_241_oRDR_DETECTION_241_244_oPCAN_RADAR_f212c679_Tx: ComBitPosition=80, ComBitSize=6, ComSignalInitValue=0, ComSignalType=UINT8, ComHandleId=5069, ComSystemTemplateSystemSignalRef=DET_ELEVATION_ERR_241
            DET_HVC_FLAG_244_oRDR_DETECTION_241_244_oPCAN_RADAR_6cd97c64_Tx: ComBitPosition=422, ComBitSize=1, ComSignalInitValue=0, ComSignalType=BOOLEAN, ComHandleId=5080, ComSystemTemplateSystemSignalRef=DET_HVC_FLAG_244
            DET_RANGE_VELOCITY_ERR_243_oRDR_DETECTION_241_244_oPCAN_RADAR_3f8e6447_Tx: ComBitPosition=288, ComBitSize=8, ComSignalInitValue=0, ComSignalType=UINT8, ComHandleId=5110, ComSystemTemplateSystemSignalRef=DET_RANGE_VELOCITY_ERR_243
            DET_MH_CYCLE_COUNTER_241_244_oRDR_DETECTION_241_244_oPCAN_RADAR_300ee345_Tx: ComBitPosition=16, ComBitSize=8, ComSignalInitValue=0, ComSignalType=UINT8, ComHandleId=5086, ComSystemTemplateSystemSignalRef=DET_MH_CYCLE_COUNTER_241_244
            DET_RANGE_241_oRDR_DETECTION_241_244_oPCAN_RADAR_b403f2bb_Tx: ComBitPosition=24, ComBitSize=15, ComSignalInitValue=0, ComSignalType=UINT16, ComHandleId=5096, ComSystemTemplateSystemSignalRef=DET_RANGE_241
            DET_SUPER_RES_TARGET_244_oRDR_DETECTION_241_244_oPCAN_RADAR_0732f7a1_Tx: ComBitPosition=423, ComBitSize=1, ComSignalInitValue=0, ComSignalType=BOOLEAN, ComHandleId=5123, ComSystemTemplateSystemSignalRef=DET_SUPER_RES_TARGET_244
            DET_EXISTENCE_PROB_243_oRDR_DETECTION_241_244_oPCAN_RADAR_d11d1c72_Tx: ComBitPosition=336, ComBitSize=6, ComSignalInitValue=0, ComSignalType=UINT8, ComHandleId=5075, ComSystemTemplateSystemSignalRef=DET_EXISTENCE_PROB_243
            DET_RANGE_VELOCITY_ERR_242_oRDR_DETECTION_241_244_oPCAN_RADAR_aafeb0d2_Tx: ComBitPosition=176, ComBitSize=8, ComSignalInitValue=0, ComSignalType=UINT8, ComHandleId=5109, ComSystemTemplateSystemSignalRef=DET_RANGE_VELOCITY_ERR_242
            DET_RCS_243_oRDR_DETECTION_241_244_oPCAN_RADAR_b7b5a8af_Tx: ComBitPosition=352, ComBitSize=8, ComSignalInitValue=128, ComSignalType=UINT8, ComHandleId=5114, ComSystemTemplateSystemSignalRef=DET_RCS_243
            DET_AZIMUTH_244_oRDR_DETECTION_241_244_oPCAN_RADAR_09b80d02_Tx: ComBitPosition=424, ComBitSize=13, ComSignalInitValue=0, ComSignalType=UINT16, ComHandleId=5044, ComSystemTemplateSystemSignalRef=DET_AZIMUTH_244
            DET_RANGE_ERR_242_oRDR_DETECTION_241_244_oPCAN_RADAR_770b332c_Tx: ComBitPosition=152, ComBitSize=7, ComSignalInitValue=0, ComSignalType=UINT8, ComHandleId=5101, ComSystemTemplateSystemSignalRef=DET_RANGE_ERR_242
            DET_AZIMUTH_243_oRDR_DETECTION_241_244_oPCAN_RADAR_55082e6b_Tx: ComBitPosition=312, ComBitSize=13, ComSignalInitValue=0, ComSignalType=UINT16, ComHandleId=5043, ComSystemTemplateSystemSignalRef=DET_AZIMUTH_243
            DET_SNR_242_oRDR_DETECTION_241_244_oPCAN_RADAR_ff6b2838_Tx: ComBitPosition=232, ComBitSize=8, ComSignalInitValue=0, ComSignalType=UINT8, ComHandleId=5117, ComSystemTemplateSystemSignalRef=DET_SNR_242
            DET_AZIMUTH_ERR_243_oRDR_DETECTION_241_244_oPCAN_RADAR_f1bdbb9e_Tx: ComBitPosition=329, ComBitSize=7, ComSignalInitValue=0, ComSignalType=UINT8, ComHandleId=5047, ComSystemTemplateSystemSignalRef=DET_AZIMUTH_ERR_243
            DET_ELEVATION_ERR_243_oRDR_DETECTION_241_244_oPCAN_RADAR_03826912_Tx: ComBitPosition=304, ComBitSize=6, ComSignalInitValue=0, ComSignalType=UINT8, ComHandleId=5071, ComSystemTemplateSystemSignalRef=DET_ELEVATION_ERR_243
            DET_CONFD_AZIMUTH_242_oRDR_DETECTION_241_244_oPCAN_RADAR_c29ef034_Tx: ComBitPosition=230, ComBitSize=2, ComSignalInitValue=0, ComSignalType=UINT8, ComHandleId=5058, ComSystemTemplateSystemSignalRef=DET_CONFD_AZIMUTH_242
            DET_BI_STATIC_FLAG_242_oRDR_DETECTION_241_244_oPCAN_RADAR_9654ba7b_Tx: ComBitPosition=216, ComBitSize=1, ComSignalInitValue=0, ComSignalType=BOOLEAN, ComHandleId=5054, ComSystemTemplateSystemSignalRef=DET_BI_STATIC_FLAG_242
            DET_ELEVATION_ERR_242_oRDR_DETECTION_241_244_oPCAN_RADAR_96f2bd87_Tx: ComBitPosition=192, ComBitSize=6, ComSignalInitValue=0, ComSignalType=UINT8, ComHandleId=5070, ComSystemTemplateSystemSignalRef=DET_ELEVATION_ERR_242
            DET_RANGE_ERR_243_oRDR_DETECTION_241_244_oPCAN_RADAR_e27be7b9_Tx: ComBitPosition=264, ComBitSize=7, ComSignalInitValue=0, ComSignalType=UINT8, ComHandleId=5102, ComSystemTemplateSystemSignalRef=DET_RANGE_ERR_243
            DET_RANGE_VELOCITY_243_oRDR_DETECTION_241_244_oPCAN_RADAR_30359ff5_Tx: ComBitPosition=272, ComBitSize=15, ComSignalInitValue=16384, ComSignalType=UINT16, ComHandleId=5106, ComSystemTemplateSystemSignalRef=DET_RANGE_VELOCITY_243
            DET_BI_STATIC_FLAG_244_oRDR_DETECTION_241_244_oPCAN_RADAR_5f944d87_Tx: ComBitPosition=440, ComBitSize=1, ComSignalInitValue=0, ComSignalType=BOOLEAN, ComHandleId=5056, ComSystemTemplateSystemSignalRef=DET_BI_STATIC_FLAG_244
            DET_HVC_FLAG_241_oRDR_DETECTION_241_244_oPCAN_RADAR_c1f9f066_Tx: ComBitPosition=86, ComBitSize=1, ComSignalInitValue=0, ComSignalType=BOOLEAN, ComHandleId=5077, ComSystemTemplateSystemSignalRef=DET_HVC_FLAG_241
            DET_AZIMUTH_ERR_241_oRDR_DETECTION_241_244_oPCAN_RADAR_002d14f5_Tx: ComBitPosition=105, ComBitSize=7, ComSignalInitValue=0, ComSignalType=UINT8, ComHandleId=5045, ComSystemTemplateSystemSignalRef=DET_AZIMUTH_ERR_241
            DET_RCS_242_oRDR_DETECTION_241_244_oPCAN_RADAR_22c57c3a_Tx: ComBitPosition=240, ComBitSize=8, ComSignalInitValue=128, ComSignalType=UINT8, ComHandleId=5113, ComSystemTemplateSystemSignalRef=DET_RCS_242
            DET_CONFD_ELEVATION_242_oRDR_DETECTION_241_244_oPCAN_RADAR_c00bf1ce_Tx: ComBitPosition=213, ComBitSize=2, ComSignalInitValue=0, ComSignalType=UINT8, ComHandleId=5062, ComSystemTemplateSystemSignalRef=DET_CONFD_ELEVATION_242
            DET_SUPER_RES_TARGET_242_oRDR_DETECTION_241_244_oPCAN_RADAR_cef2005d_Tx: ComBitPosition=199, ComBitSize=1, ComSignalInitValue=0, ComSignalType=BOOLEAN, ComHandleId=5121, ComSystemTemplateSystemSignalRef=DET_SUPER_RES_TARGET_242
            DET_RCS_241_oRDR_DETECTION_241_244_oPCAN_RADAR_462507c4_Tx: ComBitPosition=128, ComBitSize=8, ComSignalInitValue=128, ComSignalType=UINT8, ComHandleId=5112, ComSystemTemplateSystemSignalRef=DET_RCS_241
            DET_RANGE_VELOCITY_244_oRDR_DETECTION_241_244_oPCAN_RADAR_6c85bc9c_Tx: ComBitPosition=384, ComBitSize=15, ComSignalInitValue=16384, ComSignalType=UINT16, ComHandleId=5107, ComSystemTemplateSystemSignalRef=DET_RANGE_VELOCITY_244
            DET_ELEVATION_ERR_244_oRDR_DETECTION_241_244_oPCAN_RADAR_5f324a7b_Tx: ComBitPosition=416, ComBitSize=6, ComSignalInitValue=0, ComSignalType=UINT8, ComHandleId=5072, ComSystemTemplateSystemSignalRef=DET_ELEVATION_ERR_244
            DET_IDM_241_oRDR_DETECTION_241_244_oPCAN_RADAR_4aabcbdb_Tx: ComBitPosition=63, ComBitSize=1, ComSignalInitValue=0, ComSignalType=UINT8, ComHandleId=5081, ComSystemTemplateSystemSignalRef=DET_IDM_241
            DET_MTD_242_oRDR_DETECTION_241_244_oPCAN_RADAR_48f882fe_Tx: ComBitPosition=159, ComBitSize=1, ComSignalInitValue=0, ComSignalType=UINT8, ComHandleId=5089, ComSystemTemplateSystemSignalRef=DET_MTD_242
            DET_PROB_1STAZHYPO_242_oRDR_DETECTION_241_244_oPCAN_RADAR_db4c6a33_Tx: ComBitPosition=215, ComBitSize=1, ComSignalInitValue=0, ComSignalType=BOOLEAN, ComHandleId=5093, ComSystemTemplateSystemSignalRef=DET_PROB_1STAZHYPO_242
            DET_IDM_244_oRDR_DETECTION_241_244_oPCAN_RADAR_e78b47d9_Tx: ComBitPosition=399, ComBitSize=1, ComSignalInitValue=0, ComSignalType=UINT8, ComHandleId=5084, ComSystemTemplateSystemSignalRef=DET_IDM_244
            DET_MTD_244_oRDR_DETECTION_241_244_oPCAN_RADAR_81387502_Tx: ComBitPosition=383, ComBitSize=1, ComSignalInitValue=0, ComSignalType=UINT8, ComHandleId=5091, ComSystemTemplateSystemSignalRef=DET_MTD_244
            DET_PROB_1STAZHYPO_243_oRDR_DETECTION_241_244_oPCAN_RADAR_4e3cbea6_Tx: ComBitPosition=327, ComBitSize=1, ComSignalInitValue=0, ComSignalType=BOOLEAN, ComHandleId=5094, ComSystemTemplateSystemSignalRef=DET_PROB_1STAZHYPO_243
            DET_IDM_242_oRDR_DETECTION_241_244_oPCAN_RADAR_2e4bb025_Tx: ComBitPosition=175, ComBitSize=1, ComSignalInitValue=0, ComSignalType=UINT8, ComHandleId=5082, ComSystemTemplateSystemSignalRef=DET_IDM_242
            DET_PROB_1STAZHYPO_244_oRDR_DETECTION_241_244_oPCAN_RADAR_128c9dcf_Tx: ComBitPosition=439, ComBitSize=1, ComSignalInitValue=0, ComSignalType=BOOLEAN, ComHandleId=5095, ComSystemTemplateSystemSignalRef=DET_PROB_1STAZHYPO_244
            DET_PROB_1STAZHYPO_241_oRDR_DETECTION_241_244_oPCAN_RADAR_bfac11cd_Tx: ComBitPosition=103, ComBitSize=1, ComSignalInitValue=0, ComSignalType=BOOLEAN, ComHandleId=5092, ComSystemTemplateSystemSignalRef=DET_PROB_1STAZHYPO_241
            DET_BELOW_RAIN_THOLD_242_oRDR_DETECTION_241_244_oPCAN_RADAR_1579693e_Tx: ComBitPosition=151, ComBitSize=1, ComSignalInitValue=0, ComSignalType=UINT8, ComHandleId=5050, ComSystemTemplateSystemSignalRef=DET_BELOW_RAIN_THOLD_242
            DET_BELOW_RAIN_THOLD_244_oRDR_DETECTION_241_244_oPCAN_RADAR_dcb99ec2_Tx: ComBitPosition=375, ComBitSize=1, ComSignalInitValue=0, ComSignalType=UINT8, ComHandleId=5052, ComSystemTemplateSystemSignalRef=DET_BELOW_RAIN_THOLD_244
            DET_IDM_243_oRDR_DETECTION_241_244_oPCAN_RADAR_bb3b64b0_Tx: ComBitPosition=287, ComBitSize=1, ComSignalInitValue=0, ComSignalType=UINT8, ComHandleId=5083, ComSystemTemplateSystemSignalRef=DET_IDM_243
            DET_BELOW_RAIN_THOLD_241_oRDR_DETECTION_241_244_oPCAN_RADAR_719912c0_Tx: ComBitPosition=39, ComBitSize=1, ComSignalInitValue=0, ComSignalType=UINT8, ComHandleId=5049, ComSystemTemplateSystemSignalRef=DET_BELOW_RAIN_THOLD_241
            DET_MTD_243_oRDR_DETECTION_241_244_oPCAN_RADAR_dd88566b_Tx: ComBitPosition=271, ComBitSize=1, ComSignalInitValue=0, ComSignalType=UINT8, ComHandleId=5090, ComSystemTemplateSystemSignalRef=DET_MTD_243
            DET_MTD_241_oRDR_DETECTION_241_244_oPCAN_RADAR_2c18f900_Tx: ComBitPosition=47, ComBitSize=1, ComSignalInitValue=0, ComSignalType=UINT8, ComHandleId=5088, ComSystemTemplateSystemSignalRef=DET_MTD_241
            DET_BELOW_RAIN_THOLD_243_oRDR_DETECTION_241_244_oPCAN_RADAR_8009bdab_Tx: ComBitPosition=263, ComBitSize=1, ComSignalInitValue=0, ComSignalType=UINT8, ComHandleId=5051, ComSystemTemplateSystemSignalRef=DET_BELOW_RAIN_THOLD_243
