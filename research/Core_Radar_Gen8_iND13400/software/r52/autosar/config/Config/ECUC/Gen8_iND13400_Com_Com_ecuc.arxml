[part 16 of 20: package /ActiveEcuC]
AUTOSAR XML (schema 00053)
package /ActiveEcuC  (continued)
  module config Com: implementation-config-variant=VARIANT-PRE-COMPILE, module-description=Com_Impl  (continued)
    ComConfig: ComConfigurationId=0, ComRxImmediateNotificationCacheSize=0, ComRxDeferredNotificationCacheSize=1  (continued)
      109 x ComSignalGroup, all with ComSignalGroupAccess=ACCESS_NEEDED_BY_SWC_OR_COM, ComSignalGroupArrayAccess=true:  (continued)
        SG_Detections_365_368_oRDR_DETECTION_365_368_oPCAN_RADAR_36ed26c5_Tx: ComTransferProperty=TRIGGERED, ComHandleId=93, ComSystemTemplateSignalGroupRef=SG_Detections_365_368
          83 x ComGroupSignal, all with ComSignalEndianness=LITTLE_ENDIAN, ComTransferProperty=PENDING, ComSignalAccess=ACCESS_NEEDED_BY_SWC_OR_COM:
            DET_SNR_365_oRDR_DETECTION_365_368_oPCAN_RADAR_97d3b466_Tx: ComBitPosition=120, ComBitSize=8, ComSignalInitValue=0, ComSignalType=UINT8, ComHandleId=7689, ComSystemTemplateSystemSignalRef=DET_SNR_365
            DET_MH_SCAN_INDEX_4LSB_365_368_oRDR_DETECTION_365_368_oPCAN_RADAR_fa3a7075_Tx: ComBitPosition=476, ComBitSize=4, ComSignalInitValue=0, ComSignalType=UINT8, ComHandleId=7660, ComSystemTemplateSystemSignalRef=DET_MH_SCAN_INDEX_4LSB_365_368
            DET_HVC_FLAG_365_oRDR_DETECTION_365_368_oPCAN_RADAR_cda117c6_Tx: ComBitPosition=86, ComBitSize=1, ComSignalInitValue=0, ComSignalType=BOOLEAN, ComHandleId=7650, ComSystemTemplateSystemSignalRef=DET_HVC_FLAG_365
            DET_HVC_FLAG_367_oRDR_DETECTION_365_368_oPCAN_RADAR_3c31b8ad_Tx: ComBitPosition=310, ComBitSize=1, ComSignalInitValue=0, ComSignalType=BOOLEAN, ComHandleId=7652, ComSystemTemplateSystemSignalRef=DET_HVC_FLAG_367
            DET_SNR_368_oRDR_DETECTION_365_368_oPCAN_RADAR_4a53894a_Tx: ComBitPosition=456, ComBitSize=8, ComSignalInitValue=0, ComSignalType=UINT8, ComHandleId=7692, ComSystemTemplateSystemSignalRef=DET_SNR_368
            DET_ELEVATION_365_oRDR_DETECTION_365_368_oPCAN_RADAR_7973b9ac_Tx: ComBitPosition=72, ComBitSize=8, ComSignalInitValue=0, ComSignalType=UINT8, ComHandleId=7638, ComSystemTemplateSystemSignalRef=DET_ELEVATION_365
            DET_AZIMUTH_366_oRDR_DETECTION_365_368_oPCAN_RADAR_cc201d5e_Tx: ComBitPosition=200, ComBitSize=13, ComSignalInitValue=0, ComSignalType=UINT16, ComHandleId=7615, ComSystemTemplateSystemSignalRef=DET_AZIMUTH_366
            DET_AZIMUTH_ERR_367_oRDR_DETECTION_365_368_oPCAN_RADAR_fde55c3e_Tx: ComBitPosition=329, ComBitSize=7, ComSignalInitValue=0, ComSignalType=UINT8, ComHandleId=7620, ComSystemTemplateSystemSignalRef=DET_AZIMUTH_ERR_367
            DET_ELEVATION_ERR_368_oRDR_DETECTION_365_368_oPCAN_RADAR_23ca1cf5_Tx: ComBitPosition=416, ComBitSize=6, ComSignalInitValue=0, ComSignalType=UINT8, ComHandleId=7645, ComSystemTemplateSystemSignalRef=DET_ELEVATION_ERR_368
            DET_CONFD_AZIMUTH_367_oRDR_DETECTION_365_368_oPCAN_RADAR_5bb6c301_Tx: ComBitPosition=342, ComBitSize=2, ComSignalInitValue=0, ComSignalType=UINT8, ComHandleId=7632, ComSystemTemplateSystemSignalRef=DET_CONFD_AZIMUTH_367
            DET_EXISTENCE_PROB_366_oRDR_DETECTION_365_368_oPCAN_RADAR_48352f47_Tx: ComBitPosition=224, ComBitSize=6, ComSignalInitValue=0, ComSignalType=UINT8, ComHandleId=7647, ComSystemTemplateSystemSignalRef=DET_EXISTENCE_PROB_366
            DET_RANGE_366_oRDR_DETECTION_365_368_oPCAN_RADAR_dcbb6ee5_Tx: ComBitPosition=136, ComBitSize=15, ComSignalInitValue=0, ComSignalType=UINT16, ComHandleId=7670, ComSystemTemplateSystemSignalRef=DET_RANGE_366
            DET_RCS_367_oRDR_DETECTION_365_368_oPCAN_RADAR_bbed4f0f_Tx: ComBitPosition=352, ComBitSize=8, ComSignalInitValue=128, ComSignalType=UINT8, ComHandleId=7687, ComSystemTemplateSystemSignalRef=DET_RCS_367
            DET_RANGE_ERR_365_oRDR_DETECTION_365_368_oPCAN_RADAR_1fb3af72_Tx: ComBitPosition=40, ComBitSize=7, ComSignalInitValue=0, ComSignalType=UINT8, ComHandleId=7673, ComSystemTemplateSystemSignalRef=DET_RANGE_ERR_365
            DET_AZIMUTH_367_oRDR_DETECTION_365_368_oPCAN_RADAR_5950c9cb_Tx: ComBitPosition=312, ComBitSize=13, ComSignalInitValue=0, ComSignalType=UINT16, ComHandleId=7616, ComSystemTemplateSystemSignalRef=DET_AZIMUTH_367
            DET_RANGE_367_oRDR_DETECTION_365_368_oPCAN_RADAR_49cbba70_Tx: ComBitPosition=248, ComBitSize=15, ComSignalInitValue=0, ComSignalType=UINT16, ComHandleId=7671, ComSystemTemplateSystemSignalRef=DET_RANGE_367
            DET_SNR_367_oRDR_DETECTION_365_368_oPCAN_RADAR_66431b0d_Tx: ComBitPosition=344, ComBitSize=8, ComSignalInitValue=0, ComSignalType=UINT8, ComHandleId=7691, ComSystemTemplateSystemSignalRef=DET_SNR_367
            DET_RANGE_VELOCITY_368_oRDR_DETECTION_365_368_oPCAN_RADAR_107dea12_Tx: ComBitPosition=384, ComBitSize=15, ComSignalInitValue=16384, ComSignalType=UINT16, ComHandleId=7680, ComSystemTemplateSystemSignalRef=DET_RANGE_VELOCITY_368
            DET_EXISTENCE_PROB_368_oRDR_DETECTION_365_368_oPCAN_RADAR_f1556995_Tx: ComBitPosition=448, ComBitSize=6, ComSignalInitValue=0, ComSignalType=UINT8, ComHandleId=7649, ComSystemTemplateSystemSignalRef=DET_EXISTENCE_PROB_368
            DET_BI_STATIC_FLAG_365_oRDR_DETECTION_365_368_oPCAN_RADAR_feec2625_Tx: ComBitPosition=104, ComBitSize=1, ComSignalInitValue=0, ComSignalType=BOOLEAN, ComHandleId=7626, ComSystemTemplateSystemSignalRef=DET_BI_STATIC_FLAG_365
            DET_RANGE_VELOCITY_ERR_367_oRDR_DETECTION_365_368_oPCAN_RADAR_33d683e7_Tx: ComBitPosition=288, ComBitSize=8, ComSignalInitValue=0, ComSignalType=UINT8, ComHandleId=7683, ComSystemTemplateSystemSignalRef=DET_RANGE_VELOCITY_ERR_367
            DET_RCS_366_oRDR_DETECTION_365_368_oPCAN_RADAR_2e9d9b9a_Tx: ComBitPosition=240, ComBitSize=8, ComSignalInitValue=128, ComSignalType=UINT8, ComHandleId=7686, ComSystemTemplateSystemSignalRef=DET_RCS_366
            DET_RCS_365_oRDR_DETECTION_365_368_oPCAN_RADAR_4a7de064_Tx: ComBitPosition=128, ComBitSize=8, ComSignalInitValue=128, ComSignalType=UINT8, ComHandleId=7685, ComSystemTemplateSystemSignalRef=DET_RCS_365
            DET_HVC_FLAG_366_oRDR_DETECTION_365_368_oPCAN_RADAR_a9416c38_Tx: ComBitPosition=198, ComBitSize=1, ComSignalInitValue=0, ComSignalType=BOOLEAN, ComHandleId=7651, ComSystemTemplateSystemSignalRef=DET_HVC_FLAG_366
            DET_RANGE_ERR_368_oRDR_DETECTION_365_368_oPCAN_RADAR_c233925e_Tx: ComBitPosition=376, ComBitSize=7, ComSignalInitValue=0, ComSignalType=UINT8, ComHandleId=7676, ComSystemTemplateSystemSignalRef=DET_RANGE_ERR_368
            DET_SNR_366_oRDR_DETECTION_365_368_oPCAN_RADAR_f333cf98_Tx: ComBitPosition=232, ComBitSize=8, ComSignalInitValue=0, ComSignalType=UINT8, ComHandleId=7690, ComSystemTemplateSystemSignalRef=DET_SNR_366
            DET_EXISTENCE_PROB_365_oRDR_DETECTION_365_368_oPCAN_RADAR_2cd554b9_Tx: ComBitPosition=112, ComBitSize=6, ComSignalInitValue=0, ComSignalType=UINT8, ComHandleId=7646, ComSystemTemplateSystemSignalRef=DET_EXISTENCE_PROB_365
            DET_SUPER_RES_TARGET_366_oRDR_DETECTION_365_368_oPCAN_RADAR_c2aae7fd_Tx: ComBitPosition=199, ComBitSize=1, ComSignalInitValue=0, ComSignalType=BOOLEAN, ComHandleId=7694, ComSystemTemplateSystemSignalRef=DET_SUPER_RES_TARGET_366
            DET_RANGE_ERR_367_oRDR_DETECTION_365_368_oPCAN_RADAR_ee230019_Tx: ComBitPosition=264, ComBitSize=7, ComSignalInitValue=0, ComSignalType=UINT8, ComHandleId=7675, ComSystemTemplateSystemSignalRef=DET_RANGE_ERR_367
            DET_AZIMUTH_365_oRDR_DETECTION_365_368_oPCAN_RADAR_a8c066a0_Tx: ComBitPosition=88, ComBitSize=13, ComSignalInitValue=0, ComSignalType=UINT16, ComHandleId=7614, ComSystemTemplateSystemSignalRef=DET_AZIMUTH_365
            DET_SUPER_RES_TARGET_367_oRDR_DETECTION_365_368_oPCAN_RADAR_57da3368_Tx: ComBitPosition=311, ComBitSize=1, ComSignalInitValue=0, ComSignalType=BOOLEAN, ComHandleId=7695, ComSystemTemplateSystemSignalRef=DET_SUPER_RES_TARGET_367
            DET_RANGE_ERR_366_oRDR_DETECTION_365_368_oPCAN_RADAR_7b53d48c_Tx: ComBitPosition=152, ComBitSize=7, ComSignalInitValue=0, ComSignalType=UINT8, ComHandleId=7674, ComSystemTemplateSystemSignalRef=DET_RANGE_ERR_366
            DET_AZIMUTH_ERR_366_oRDR_DETECTION_365_368_oPCAN_RADAR_689588ab_Tx: ComBitPosition=217, ComBitSize=7, ComSignalInitValue=0, ComSignalType=UINT8, ComHandleId=7619, ComSystemTemplateSystemSignalRef=DET_AZIMUTH_ERR_366
            DET_HVC_FLAG_368_oRDR_DETECTION_365_368_oPCAN_RADAR_10212aea_Tx: ComBitPosition=422, ComBitSize=1, ComSignalInitValue=0, ComSignalType=BOOLEAN, ComHandleId=7653, ComSystemTemplateSystemSignalRef=DET_HVC_FLAG_368
            DET_RANGE_365_oRDR_DETECTION_365_368_oPCAN_RADAR_b85b151b_Tx: ComBitPosition=24, ComBitSize=15, ComSignalInitValue=0, ComSignalType=UINT16, ComHandleId=7669, ComSystemTemplateSystemSignalRef=DET_RANGE_365
            DET_CONFD_AZIMUTH_366_oRDR_DETECTION_365_368_oPCAN_RADAR_cec61794_Tx: ComBitPosition=230, ComBitSize=2, ComSignalInitValue=0, ComSignalType=UINT8, ComHandleId=7631, ComSystemTemplateSystemSignalRef=DET_CONFD_AZIMUTH_366
            DET_ELEVATION_ERR_365_oRDR_DETECTION_365_368_oPCAN_RADAR_fe4a21d9_Tx: ComBitPosition=80, ComBitSize=6, ComSignalInitValue=0, ComSignalType=UINT8, ComHandleId=7642, ComSystemTemplateSystemSignalRef=DET_ELEVATION_ERR_365
            DET_RCS_368_oRDR_DETECTION_365_368_oPCAN_RADAR_97fddd48_Tx: ComBitPosition=464, ComBitSize=8, ComSignalInitValue=128, ComSignalType=UINT8, ComHandleId=7688, ComSystemTemplateSystemSignalRef=DET_RCS_368
            DET_RANGE_VELOCITY_ERR_366_oRDR_DETECTION_365_368_oPCAN_RADAR_a6a65772_Tx: ComBitPosition=176, ComBitSize=8, ComSignalInitValue=0, ComSignalType=UINT8, ComHandleId=7682, ComSystemTemplateSystemSignalRef=DET_RANGE_VELOCITY_ERR_366
            DET_SUPER_RES_TARGET_368_oRDR_DETECTION_365_368_oPCAN_RADAR_7bcaa12f_Tx: ComBitPosition=423, ComBitSize=1, ComSignalInitValue=0, ComSignalType=BOOLEAN, ComHandleId=7696, ComSystemTemplateSystemSignalRef=DET_SUPER_RES_TARGET_368
            DET_AZIMUTH_ERR_368_oRDR_DETECTION_365_368_oPCAN_RADAR_d1f5ce79_Tx: ComBitPosition=441, ComBitSize=7, ComSignalInitValue=0, ComSignalType=UINT8, ComHandleId=7621, ComSystemTemplateSystemSignalRef=DET_AZIMUTH_ERR_368
            DET_MH_CRC16_365_368_oRDR_DETECTION_365_368_oPCAN_RADAR_b265f4ce_Tx: ComBitPosition=0, ComBitSize=16, ComSignalInitValue=0, ComSignalType=UINT16, ComHandleId=7658, ComSystemTemplateSystemSignalRef=DET_MH_CRC16_365_368
            DET_CONFD_AZIMUTH_365_oRDR_DETECTION_365_368_oPCAN_RADAR_aa266c6a_Tx: ComBitPosition=118, ComBitSize=2, ComSignalInitValue=0, ComSignalType=UINT8, ComHandleId=7630, ComSystemTemplateSystemSignalRef=DET_CONFD_AZIMUTH_365
            DET_AZIMUTH_ERR_365_oRDR_DETECTION_365_368_oPCAN_RADAR_0c75f355_Tx: ComBitPosition=105, ComBitSize=7, ComSignalInitValue=0, ComSignalType=UINT8, ComHandleId=7618, ComSystemTemplateSystemSignalRef=DET_AZIMUTH_ERR_365
            DET_MH_CYCLE_COUNTER_365_368_oRDR_DETECTION_365_368_oPCAN_RADAR_361055f9_Tx: ComBitPosition=16, ComBitSize=8, ComSignalInitValue=0, ComSignalType=UINT8, ComHandleId=7659, ComSystemTemplateSystemSignalRef=DET_MH_CYCLE_COUNTER_365_368
            DET_BI_STATIC_FLAG_366_oRDR_DETECTION_365_368_oPCAN_RADAR_9a0c5ddb_Tx: ComBitPosition=216, ComBitSize=1, ComSignalInitValue=0, ComSignalType=BOOLEAN, ComHandleId=7627, ComSystemTemplateSystemSignalRef=DET_BI_STATIC_FLAG_366
            DET_BI_STATIC_FLAG_368_oRDR_DETECTION_365_368_oPCAN_RADAR_236c1b09_Tx: ComBitPosition=440, ComBitSize=1, ComSignalInitValue=0, ComSignalType=BOOLEAN, ComHandleId=7629, ComSystemTemplateSystemSignalRef=DET_BI_STATIC_FLAG_368
            DET_RANGE_VELOCITY_366_oRDR_DETECTION_365_368_oPCAN_RADAR_a91dacc0_Tx: ComBitPosition=160, ComBitSize=15, ComSignalInitValue=16384, ComSignalType=UINT16, ComHandleId=7678, ComSystemTemplateSystemSignalRef=DET_RANGE_VELOCITY_366
            DET_CONFD_ELEVATION_368_oRDR_DETECTION_365_368_oPCAN_RADAR_753350bc_Tx: ComBitPosition=437, ComBitSize=2, ComSignalInitValue=0, ComSignalType=UINT8, ComHandleId=7637, ComSystemTemplateSystemSignalRef=DET_CONFD_ELEVATION_368
            DET_ELEVATION_ERR_366_oRDR_DETECTION_365_368_oPCAN_RADAR_9aaa5a27_Tx: ComBitPosition=192, ComBitSize=6, ComSignalInitValue=0, ComSignalType=UINT8, ComHandleId=7643, ComSystemTemplateSystemSignalRef=DET_ELEVATION_ERR_366
            DET_ELEVATION_366_oRDR_DETECTION_365_368_oPCAN_RADAR_1d93c252_Tx: ComBitPosition=184, ComBitSize=8, ComSignalInitValue=0, ComSignalType=UINT8, ComHandleId=7639, ComSystemTemplateSystemSignalRef=DET_ELEVATION_366
            DET_SUPER_RES_TARGET_365_oRDR_DETECTION_365_368_oPCAN_RADAR_a64a9c03_Tx: ComBitPosition=87, ComBitSize=1, ComSignalInitValue=0, ComSignalType=BOOLEAN, ComHandleId=7693, ComSystemTemplateSystemSignalRef=DET_SUPER_RES_TARGET_365
            DET_RANGE_VELOCITY_ERR_365_oRDR_DETECTION_365_368_oPCAN_RADAR_c2462c8c_Tx: ComBitPosition=64, ComBitSize=8, ComSignalInitValue=0, ComSignalType=UINT8, ComHandleId=7681, ComSystemTemplateSystemSignalRef=DET_RANGE_VELOCITY_ERR_365
            DET_RANGE_VELOCITY_365_oRDR_DETECTION_365_368_oPCAN_RADAR_cdfdd73e_Tx: ComBitPosition=48, ComBitSize=15, ComSignalInitValue=16384, ComSignalType=UINT16, ComHandleId=7677, ComSystemTemplateSystemSignalRef=DET_RANGE_VELOCITY_365
            DET_ELEVATION_367_oRDR_DETECTION_365_368_oPCAN_RADAR_88e316c7_Tx: ComBitPosition=296, ComBitSize=8, ComSignalInitValue=0, ComSignalType=UINT8, ComHandleId=7640, ComSystemTemplateSystemSignalRef=DET_ELEVATION_367
            DET_CONFD_AZIMUTH_368_oRDR_DETECTION_365_368_oPCAN_RADAR_77a65146_Tx: ComBitPosition=454, ComBitSize=2, ComSignalInitValue=0, ComSignalType=UINT8, ComHandleId=7633, ComSystemTemplateSystemSignalRef=DET_CONFD_AZIMUTH_368
            DET_CONFD_ELEVATION_367_oRDR_DETECTION_365_368_oPCAN_RADAR_5923c2fb_Tx: ComBitPosition=325, ComBitSize=2, ComSignalInitValue=0, ComSignalType=UINT8, ComHandleId=7636, ComSystemTemplateSystemSignalRef=DET_CONFD_ELEVATION_367
            DET_ELEVATION_368_oRDR_DETECTION_365_368_oPCAN_RADAR_a4f38480_Tx: ComBitPosition=408, ComBitSize=8, ComSignalInitValue=0, ComSignalType=UINT8, ComHandleId=7641, ComSystemTemplateSystemSignalRef=DET_ELEVATION_368
            DET_RANGE_VELOCITY_367_oRDR_DETECTION_365_368_oPCAN_RADAR_3c6d7855_Tx: ComBitPosition=272, ComBitSize=15, ComSignalInitValue=16384, ComSignalType=UINT16, ComHandleId=7679, ComSystemTemplateSystemSignalRef=DET_RANGE_VELOCITY_367
            DET_ELEVATION_ERR_367_oRDR_DETECTION_365_368_oPCAN_RADAR_0fda8eb2_Tx: ComBitPosition=304, ComBitSize=6, ComSignalInitValue=0, ComSignalType=UINT8, ComHandleId=7644, ComSystemTemplateSystemSignalRef=DET_ELEVATION_ERR_367
            DET_CONFD_ELEVATION_366_oRDR_DETECTION_365_368_oPCAN_RADAR_cc53166e_Tx: ComBitPosition=213, ComBitSize=2, ComSignalInitValue=0, ComSignalType=UINT8, ComHandleId=7635, ComSystemTemplateSystemSignalRef=DET_CONFD_ELEVATION_366
            DET_RANGE_368_oRDR_DETECTION_365_368_oPCAN_RADAR_65db2837_Tx: ComBitPosition=360, ComBitSize=15, ComSignalInitValue=0, ComSignalType=UINT16, ComHandleId=7672, ComSystemTemplateSystemSignalRef=DET_RANGE_368
            DET_AZIMUTH_368_oRDR_DETECTION_365_368_oPCAN_RADAR_75405b8c_Tx: ComBitPosition=424, ComBitSize=13, ComSignalInitValue=0, ComSignalType=UINT16, ComHandleId=7617, ComSystemTemplateSystemSignalRef=DET_AZIMUTH_368
            DET_EXISTENCE_PROB_367_oRDR_DETECTION_365_368_oPCAN_RADAR_dd45fbd2_Tx: ComBitPosition=336, ComBitSize=6, ComSignalInitValue=0, ComSignalType=UINT8, ComHandleId=7648, ComSystemTemplateSystemSignalRef=DET_EXISTENCE_PROB_367
            DET_CONFD_ELEVATION_365_oRDR_DETECTION_365_368_oPCAN_RADAR_a8b36d90_Tx: ComBitPosition=101, ComBitSize=2, ComSignalInitValue=0, ComSignalType=UINT8, ComHandleId=7634, ComSystemTemplateSystemSignalRef=DET_CONFD_ELEVATION_365
            DET_BI_STATIC_FLAG_367_oRDR_DETECTION_365_368_oPCAN_RADAR_0f7c894e_Tx: ComBitPosition=328, ComBitSize=1, ComSignalInitValue=0, ComSignalType=BOOLEAN, ComHandleId=7628, ComSystemTemplateSystemSignalRef=DET_BI_STATIC_FLAG_367
            DET_RANGE_VELOCITY_ERR_368_oRDR_DETECTION_365_368_oPCAN_RADAR_1fc611a0_Tx: ComBitPosition=400, ComBitSize=8, ComSignalInitValue=0, ComSignalType=UINT8, ComHandleId=7684, ComSystemTemplateSystemSignalRef=DET_RANGE_VELOCITY_ERR_368
            DET_IDM_365_oRDR_DETECTION_365_368_oPCAN_RADAR_46f32c7b_Tx: ComBitPosition=63, ComBitSize=1, ComSignalInitValue=0, ComSignalType=UINT8, ComHandleId=7654, ComSystemTemplateSystemSignalRef=DET_IDM_365
            DET_MTD_366_oRDR_DETECTION_365_368_oPCAN_RADAR_44a0655e_Tx: ComBitPosition=159, ComBitSize=1, ComSignalInitValue=0, ComSignalType=UINT8, ComHandleId=7662, ComSystemTemplateSystemSignalRef=DET_MTD_366
            DET_MTD_365_oRDR_DETECTION_365_368_oPCAN_RADAR_20401ea0_Tx: ComBitPosition=47, ComBitSize=1, ComSignalInitValue=0, ComSignalType=UINT8, ComHandleId=7661, ComSystemTemplateSystemSignalRef=DET_MTD_365
            DET_IDM_366_oRDR_DETECTION_365_368_oPCAN_RADAR_22135785_Tx: ComBitPosition=175, ComBitSize=1, ComSignalInitValue=0, ComSignalType=UINT8, ComHandleId=7655, ComSystemTemplateSystemSignalRef=DET_IDM_366
            DET_BELOW_RAIN_THOLD_367_oRDR_DETECTION_365_368_oPCAN_RADAR_8c515a0b_Tx: ComBitPosition=263, ComBitSize=1, ComSignalInitValue=0, ComSignalType=UINT8, ComHandleId=7624, ComSystemTemplateSystemSignalRef=DET_BELOW_RAIN_THOLD_367
            DET_IDM_367_oRDR_DETECTION_365_368_oPCAN_RADAR_b7638310_Tx: ComBitPosition=287, ComBitSize=1, ComSignalInitValue=0, ComSignalType=UINT8, ComHandleId=7656, ComSystemTemplateSystemSignalRef=DET_IDM_367
            DET_PROB_1STAZHYPO_368_oRDR_DETECTION_365_368_oPCAN_RADAR_6e74cb41_Tx: ComBitPosition=439, ComBitSize=1, ComSignalInitValue=0, ComSignalType=BOOLEAN, ComHandleId=7668, ComSystemTemplateSystemSignalRef=DET_PROB_1STAZHYPO_368
            DET_IDM_368_oRDR_DETECTION_365_368_oPCAN_RADAR_9b731157_Tx: ComBitPosition=399, ComBitSize=1, ComSignalInitValue=0, ComSignalType=UINT8, ComHandleId=7657, ComSystemTemplateSystemSignalRef=DET_IDM_368
            DET_BELOW_RAIN_THOLD_365_oRDR_DETECTION_365_368_oPCAN_RADAR_7dc1f560_Tx: ComBitPosition=39, ComBitSize=1, ComSignalInitValue=0, ComSignalType=UINT8, ComHandleId=7622, ComSystemTemplateSystemSignalRef=DET_BELOW_RAIN_THOLD_365
            DET_PROB_1STAZHYPO_365_oRDR_DETECTION_365_368_oPCAN_RADAR_b3f4f66d_Tx: ComBitPosition=103, ComBitSize=1, ComSignalInitValue=0, ComSignalType=BOOLEAN, ComHandleId=7665, ComSystemTemplateSystemSignalRef=DET_PROB_1STAZHYPO_365
            DET_MTD_367_oRDR_DETECTION_365_368_oPCAN_RADAR_d1d0b1cb_Tx: ComBitPosition=271, ComBitSize=1, ComSignalInitValue=0, ComSignalType=UINT8, ComHandleId=7663, ComSystemTemplateSystemSignalRef=DET_MTD_367
            DET_BELOW_RAIN_THOLD_366_oRDR_DETECTION_365_368_oPCAN_RADAR_19218e9e_Tx: ComBitPosition=151, ComBitSize=1, ComSignalInitValue=0, ComSignalType=UINT8, ComHandleId=7623, ComSystemTemplateSystemSignalRef=DET_BELOW_RAIN_THOLD_366
            DET_MTD_368_oRDR_DETECTION_365_368_oPCAN_RADAR_fdc0238c_Tx: ComBitPosition=383, ComBitSize=1, ComSignalInitValue=0, ComSignalType=UINT8, ComHandleId=7664, ComSystemTemplateSystemSignalRef=DET_MTD_368
            DET_PROB_1STAZHYPO_367_oRDR_DETECTION_365_368_oPCAN_RADAR_42645906_Tx: ComBitPosition=327, ComBitSize=1, ComSignalInitValue=0, ComSignalType=BOOLEAN, ComHandleId=7667, ComSystemTemplateSystemSignalRef=DET_PROB_1STAZHYPO_367
            DET_BELOW_RAIN_THOLD_368_oRDR_DETECTION_365_368_oPCAN_RADAR_a041c84c_Tx: ComBitPosition=375, ComBitSize=1, ComSignalInitValue=0, ComSignalType=UINT8, ComHandleId=7625, ComSystemTemplateSystemSignalRef=DET_BELOW_RAIN_THOLD_368
            DET_PROB_1STAZHYPO_366_oRDR_DETECTION_365_368_oPCAN_RADAR_d7148d93_Tx: ComBitPosition=215, ComBitSize=1, ComSignalInitValue=0, ComSignalType=BOOLEAN, ComHandleId=7666, ComSystemTemplateSystemSignalRef=DET_PROB_1STAZHYPO_366
        SG_Detections_237_240_oRDR_DETECTION_237_240_oPCAN_RADAR_2e8c87a0_Tx: ComTransferProperty=TRIGGERED, ComHandleId=61, ComSystemTemplateSignalGroupRef=SG_Detections_237_240
          83 x ComGroupSignal, all with ComSignalEndianness=LITTLE_ENDIAN, ComTransferProperty=PENDING, ComSignalAccess=ACCESS_NEEDED_BY_SWC_OR_COM:
            DET_SUPER_RES_TARGET_240_oRDR_DETECTION_237_240_oPCAN_RADAR_b9c178cc_Tx: ComBitPosition=423, ComBitSize=1, ComSignalInitValue=0, ComSignalType=BOOLEAN, ComHandleId=5040, ComSystemTemplateSystemSignalRef=DET_SUPER_RES_TARGET_240
            DET_AZIMUTH_ERR_238_oRDR_DETECTION_237_240_oPCAN_RADAR_576ccf6b_Tx: ComBitPosition=217, ComBitSize=7, ComSignalInitValue=0, ComSignalType=UINT8, ComHandleId=4963, ComSystemTemplateSystemSignalRef=DET_AZIMUTH_ERR_238
            DET_HVC_FLAG_238_oRDR_DETECTION_237_240_oPCAN_RADAR_96b82bf8_Tx: ComBitPosition=198, ComBitSize=1, ComSignalInitValue=0, ComSignalType=BOOLEAN, ComHandleId=4995, ComSystemTemplateSystemSignalRef=DET_HVC_FLAG_238
            DET_SUPER_RES_TARGET_239_oRDR_DETECTION_237_240_oPCAN_RADAR_682374a8_Tx: ComBitPosition=311, ComBitSize=1, ComSignalInitValue=0, ComSignalType=BOOLEAN, ComHandleId=5039, ComSystemTemplateSystemSignalRef=DET_SUPER_RES_TARGET_239
            DET_SNR_240_oRDR_DETECTION_237_240_oPCAN_RADAR_885850a9_Tx: ComBitPosition=456, ComBitSize=8, ComSignalInitValue=0, ComSignalType=UINT8, ComHandleId=5036, ComSystemTemplateSystemSignalRef=DET_SNR_240
            DET_RANGE_240_oRDR_DETECTION_237_240_oPCAN_RADAR_a7d0f1d4_Tx: ComBitPosition=360, ComBitSize=15, ComSignalInitValue=0, ComSignalType=UINT16, ComHandleId=5016, ComSystemTemplateSystemSignalRef=DET_RANGE_240
            DET_EXISTENCE_PROB_240_oRDR_DETECTION_237_240_oPCAN_RADAR_335eb076_Tx: ComBitPosition=448, ComBitSize=6, ComSignalInitValue=0, ComSignalType=UINT8, ComHandleId=4993, ComSystemTemplateSystemSignalRef=DET_EXISTENCE_PROB_240
            DET_ELEVATION_ERR_240_oRDR_DETECTION_237_240_oPCAN_RADAR_e1c1c516_Tx: ComBitPosition=416, ComBitSize=6, ComSignalInitValue=0, ComSignalType=UINT8, ComHandleId=4989, ComSystemTemplateSystemSignalRef=DET_ELEVATION_ERR_240
            DET_CONFD_ELEVATION_239_oRDR_DETECTION_237_240_oPCAN_RADAR_66da853b_Tx: ComBitPosition=325, ComBitSize=2, ComSignalInitValue=0, ComSignalType=UINT8, ComHandleId=4980, ComSystemTemplateSystemSignalRef=DET_CONFD_ELEVATION_239
            DET_AZIMUTH_ERR_239_oRDR_DETECTION_237_240_oPCAN_RADAR_c21c1bfe_Tx: ComBitPosition=329, ComBitSize=7, ComSignalInitValue=0, ComSignalType=UINT8, ComHandleId=4964, ComSystemTemplateSystemSignalRef=DET_AZIMUTH_ERR_239
            DET_BI_STATIC_FLAG_240_oRDR_DETECTION_237_240_oPCAN_RADAR_e167c2ea_Tx: ComBitPosition=440, ComBitSize=1, ComSignalInitValue=0, ComSignalType=BOOLEAN, ComHandleId=4973, ComSystemTemplateSystemSignalRef=DET_BI_STATIC_FLAG_240
            DET_HVC_FLAG_237_oRDR_DETECTION_237_240_oPCAN_RADAR_baa8b9bf_Tx: ComBitPosition=86, ComBitSize=1, ComSignalInitValue=0, ComSignalType=BOOLEAN, ComHandleId=4994, ComSystemTemplateSystemSignalRef=DET_HVC_FLAG_237
            DET_RCS_239_oRDR_DETECTION_237_240_oPCAN_RADAR_841408cf_Tx: ComBitPosition=352, ComBitSize=8, ComSignalInitValue=128, ComSignalType=UINT8, ComHandleId=5031, ComSystemTemplateSystemSignalRef=DET_RCS_239
            DET_RCS_240_oRDR_DETECTION_237_240_oPCAN_RADAR_55f604ab_Tx: ComBitPosition=464, ComBitSize=8, ComSignalInitValue=128, ComSignalType=UINT8, ComHandleId=5032, ComSystemTemplateSystemSignalRef=DET_RCS_240
            DET_RANGE_237_oRDR_DETECTION_237_240_oPCAN_RADAR_cf52bb62_Tx: ComBitPosition=24, ComBitSize=15, ComSignalInitValue=0, ComSignalType=UINT16, ComHandleId=5013, ComSystemTemplateSystemSignalRef=DET_RANGE_237
            DET_BI_STATIC_FLAG_237_oRDR_DETECTION_237_240_oPCAN_RADAR_89e5885c_Tx: ComBitPosition=104, ComBitSize=1, ComSignalInitValue=0, ComSignalType=BOOLEAN, ComHandleId=4970, ComSystemTemplateSystemSignalRef=DET_BI_STATIC_FLAG_237
            DET_CONFD_AZIMUTH_240_oRDR_DETECTION_237_240_oPCAN_RADAR_b5ad88a5_Tx: ComBitPosition=454, ComBitSize=2, ComSignalInitValue=0, ComSignalType=UINT8, ComHandleId=4977, ComSystemTemplateSystemSignalRef=DET_CONFD_AZIMUTH_240
            DET_ELEVATION_237_oRDR_DETECTION_237_240_oPCAN_RADAR_0e7a17d5_Tx: ComBitPosition=72, ComBitSize=8, ComSignalInitValue=0, ComSignalType=UINT8, ComHandleId=4982, ComSystemTemplateSystemSignalRef=DET_ELEVATION_237
            DET_ELEVATION_240_oRDR_DETECTION_237_240_oPCAN_RADAR_66f85d63_Tx: ComBitPosition=408, ComBitSize=8, ComSignalInitValue=0, ComSignalType=UINT8, ComHandleId=4985, ComSystemTemplateSystemSignalRef=DET_ELEVATION_240
            DET_RCS_237_oRDR_DETECTION_237_240_oPCAN_RADAR_3d744e1d_Tx: ComBitPosition=128, ComBitSize=8, ComSignalInitValue=128, ComSignalType=UINT8, ComHandleId=5029, ComSystemTemplateSystemSignalRef=DET_RCS_237
            DET_RANGE_VELOCITY_237_oRDR_DETECTION_237_240_oPCAN_RADAR_baf47947_Tx: ComBitPosition=48, ComBitSize=15, ComSignalInitValue=16384, ComSignalType=UINT16, ComHandleId=5021, ComSystemTemplateSystemSignalRef=DET_RANGE_VELOCITY_237
            DET_SUPER_RES_TARGET_238_oRDR_DETECTION_237_240_oPCAN_RADAR_fd53a03d_Tx: ComBitPosition=199, ComBitSize=1, ComSignalInitValue=0, ComSignalType=BOOLEAN, ComHandleId=5038, ComSystemTemplateSystemSignalRef=DET_SUPER_RES_TARGET_238
            DET_CONFD_ELEVATION_238_oRDR_DETECTION_237_240_oPCAN_RADAR_f3aa51ae_Tx: ComBitPosition=213, ComBitSize=2, ComSignalInitValue=0, ComSignalType=UINT8, ComHandleId=4979, ComSystemTemplateSystemSignalRef=DET_CONFD_ELEVATION_238
            DET_HVC_FLAG_239_oRDR_DETECTION_237_240_oPCAN_RADAR_03c8ff6d_Tx: ComBitPosition=310, ComBitSize=1, ComSignalInitValue=0, ComSignalType=BOOLEAN, ComHandleId=4996, ComSystemTemplateSystemSignalRef=DET_HVC_FLAG_239
            DET_HVC_FLAG_240_oRDR_DETECTION_237_240_oPCAN_RADAR_d22af309_Tx: ComBitPosition=422, ComBitSize=1, ComSignalInitValue=0, ComSignalType=BOOLEAN, ComHandleId=4997, ComSystemTemplateSystemSignalRef=DET_HVC_FLAG_240
            DET_MH_SCAN_INDEX_4LSB_237_240_oRDR_DETECTION_237_240_oPCAN_RADAR_e25bd110_Tx: ComBitPosition=476, ComBitSize=4, ComSignalInitValue=0, ComSignalType=UINT8, ComHandleId=5004, ComSystemTemplateSystemSignalRef=DET_MH_SCAN_INDEX_4LSB_237_240
            DET_RANGE_ERR_237_oRDR_DETECTION_237_240_oPCAN_RADAR_68ba010b_Tx: ComBitPosition=40, ComBitSize=7, ComSignalInitValue=0, ComSignalType=UINT8, ComHandleId=5017, ComSystemTemplateSystemSignalRef=DET_RANGE_ERR_237
            DET_EXISTENCE_PROB_239_oRDR_DETECTION_237_240_oPCAN_RADAR_e2bcbc12_Tx: ComBitPosition=336, ComBitSize=6, ComSignalInitValue=0, ComSignalType=UINT8, ComHandleId=4992, ComSystemTemplateSystemSignalRef=DET_EXISTENCE_PROB_239
            DET_RANGE_ERR_239_oRDR_DETECTION_237_240_oPCAN_RADAR_d1da47d9_Tx: ComBitPosition=264, ComBitSize=7, ComSignalInitValue=0, ComSignalType=UINT8, ComHandleId=5019, ComSystemTemplateSystemSignalRef=DET_RANGE_ERR_239
            DET_CONFD_AZIMUTH_237_oRDR_DETECTION_237_240_oPCAN_RADAR_dd2fc213_Tx: ComBitPosition=118, ComBitSize=2, ComSignalInitValue=0, ComSignalType=UINT8, ComHandleId=4974, ComSystemTemplateSystemSignalRef=DET_CONFD_AZIMUTH_237
            DET_MH_CRC16_237_240_oRDR_DETECTION_237_240_oPCAN_RADAR_aa0455ab_Tx: ComBitPosition=0, ComBitSize=16, ComSignalInitValue=0, ComSignalType=UINT16, ComHandleId=5002, ComSystemTemplateSystemSignalRef=DET_MH_CRC16_237_240
            DET_RANGE_VELOCITY_239_oRDR_DETECTION_237_240_oPCAN_RADAR_03943f95_Tx: ComBitPosition=272, ComBitSize=15, ComSignalInitValue=16384, ComSignalType=UINT16, ComHandleId=5023, ComSystemTemplateSystemSignalRef=DET_RANGE_VELOCITY_239
            DET_EXISTENCE_PROB_238_oRDR_DETECTION_237_240_oPCAN_RADAR_77cc6887_Tx: ComBitPosition=224, ComBitSize=6, ComSignalInitValue=0, ComSignalType=UINT8, ComHandleId=4991, ComSystemTemplateSystemSignalRef=DET_EXISTENCE_PROB_238
            DET_RANGE_ERR_240_oRDR_DETECTION_237_240_oPCAN_RADAR_00384bbd_Tx: ComBitPosition=376, ComBitSize=7, ComSignalInitValue=0, ComSignalType=UINT8, ComHandleId=5020, ComSystemTemplateSystemSignalRef=DET_RANGE_ERR_240
            DET_SNR_237_oRDR_DETECTION_237_240_oPCAN_RADAR_e0da1a1f_Tx: ComBitPosition=120, ComBitSize=8, ComSignalInitValue=0, ComSignalType=UINT8, ComHandleId=5033, ComSystemTemplateSystemSignalRef=DET_SNR_237
            DET_SUPER_RES_TARGET_237_oRDR_DETECTION_237_240_oPCAN_RADAR_d143327a_Tx: ComBitPosition=87, ComBitSize=1, ComSignalInitValue=0, ComSignalType=BOOLEAN, ComHandleId=5037, ComSystemTemplateSystemSignalRef=DET_SUPER_RES_TARGET_237
            DET_AZIMUTH_ERR_240_oRDR_DETECTION_237_240_oPCAN_RADAR_13fe179a_Tx: ComBitPosition=441, ComBitSize=7, ComSignalInitValue=0, ComSignalType=UINT8, ComHandleId=4965, ComSystemTemplateSystemSignalRef=DET_AZIMUTH_ERR_240
            DET_RANGE_ERR_238_oRDR_DETECTION_237_240_oPCAN_RADAR_44aa934c_Tx: ComBitPosition=152, ComBitSize=7, ComSignalInitValue=0, ComSignalType=UINT8, ComHandleId=5018, ComSystemTemplateSystemSignalRef=DET_RANGE_ERR_238
            DET_AZIMUTH_ERR_237_oRDR_DETECTION_237_240_oPCAN_RADAR_7b7c5d2c_Tx: ComBitPosition=105, ComBitSize=7, ComSignalInitValue=0, ComSignalType=UINT8, ComHandleId=4962, ComSystemTemplateSystemSignalRef=DET_AZIMUTH_ERR_237
            DET_AZIMUTH_240_oRDR_DETECTION_237_240_oPCAN_RADAR_b74b826f_Tx: ComBitPosition=424, ComBitSize=13, ComSignalInitValue=0, ComSignalType=UINT16, ComHandleId=4961, ComSystemTemplateSystemSignalRef=DET_AZIMUTH_240
            DET_EXISTENCE_PROB_237_oRDR_DETECTION_237_240_oPCAN_RADAR_5bdcfac0_Tx: ComBitPosition=112, ComBitSize=6, ComSignalInitValue=0, ComSignalType=UINT8, ComHandleId=4990, ComSystemTemplateSystemSignalRef=DET_EXISTENCE_PROB_237
            DET_CONFD_ELEVATION_240_oRDR_DETECTION_237_240_oPCAN_RADAR_b738895f_Tx: ComBitPosition=437, ComBitSize=2, ComSignalInitValue=0, ComSignalType=UINT8, ComHandleId=4981, ComSystemTemplateSystemSignalRef=DET_CONFD_ELEVATION_240
            DET_AZIMUTH_237_oRDR_DETECTION_237_240_oPCAN_RADAR_dfc9c8d9_Tx: ComBitPosition=88, ComBitSize=13, ComSignalInitValue=0, ComSignalType=UINT16, ComHandleId=4958, ComSystemTemplateSystemSignalRef=DET_AZIMUTH_237
            DET_RCS_238_oRDR_DETECTION_237_240_oPCAN_RADAR_1164dc5a_Tx: ComBitPosition=240, ComBitSize=8, ComSignalInitValue=128, ComSignalType=UINT8, ComHandleId=5030, ComSystemTemplateSystemSignalRef=DET_RCS_238
            DET_MH_CYCLE_COUNTER_237_240_oRDR_DETECTION_237_240_oPCAN_RADAR_2e71f49c_Tx: ComBitPosition=16, ComBitSize=8, ComSignalInitValue=0, ComSignalType=UINT8, ComHandleId=5003, ComSystemTemplateSystemSignalRef=DET_MH_CYCLE_COUNTER_237_240
            DET_ELEVATION_238_oRDR_DETECTION_237_240_oPCAN_RADAR_226a8592_Tx: ComBitPosition=184, ComBitSize=8, ComSignalInitValue=0, ComSignalType=UINT8, ComHandleId=4983, ComSystemTemplateSystemSignalRef=DET_ELEVATION_238
            DET_AZIMUTH_238_oRDR_DETECTION_237_240_oPCAN_RADAR_f3d95a9e_Tx: ComBitPosition=200, ComBitSize=13, ComSignalInitValue=0, ComSignalType=UINT16, ComHandleId=4959, ComSystemTemplateSystemSignalRef=DET_AZIMUTH_238
            DET_SNR_239_oRDR_DETECTION_237_240_oPCAN_RADAR_59ba5ccd_Tx: ComBitPosition=344, ComBitSize=8, ComSignalInitValue=0, ComSignalType=UINT8, ComHandleId=5035, ComSystemTemplateSystemSignalRef=DET_SNR_239
            DET_RANGE_VELOCITY_ERR_239_oRDR_DETECTION_237_240_oPCAN_RADAR_0c2fc427_Tx: ComBitPosition=288, ComBitSize=8, ComSignalInitValue=0, ComSignalType=UINT8, ComHandleId=5027, ComSystemTemplateSystemSignalRef=DET_RANGE_VELOCITY_ERR_239
            DET_RANGE_238_oRDR_DETECTION_237_240_oPCAN_RADAR_e3422925_Tx: ComBitPosition=136, ComBitSize=15, ComSignalInitValue=0, ComSignalType=UINT16, ComHandleId=5014, ComSystemTemplateSystemSignalRef=DET_RANGE_238
            DET_BI_STATIC_FLAG_239_oRDR_DETECTION_237_240_oPCAN_RADAR_3085ce8e_Tx: ComBitPosition=328, ComBitSize=1, ComSignalInitValue=0, ComSignalType=BOOLEAN, ComHandleId=4972, ComSystemTemplateSystemSignalRef=DET_BI_STATIC_FLAG_239
            DET_ELEVATION_ERR_238_oRDR_DETECTION_237_240_oPCAN_RADAR_a5531de7_Tx: ComBitPosition=192, ComBitSize=6, ComSignalInitValue=0, ComSignalType=UINT8, ComHandleId=4987, ComSystemTemplateSystemSignalRef=DET_ELEVATION_ERR_238
            DET_SNR_238_oRDR_DETECTION_237_240_oPCAN_RADAR_ccca8858_Tx: ComBitPosition=232, ComBitSize=8, ComSignalInitValue=0, ComSignalType=UINT8, ComHandleId=5034, ComSystemTemplateSystemSignalRef=DET_SNR_238
            DET_ELEVATION_ERR_239_oRDR_DETECTION_237_240_oPCAN_RADAR_3023c972_Tx: ComBitPosition=304, ComBitSize=6, ComSignalInitValue=0, ComSignalType=UINT8, ComHandleId=4988, ComSystemTemplateSystemSignalRef=DET_ELEVATION_ERR_239
            DET_RANGE_VELOCITY_240_oRDR_DETECTION_237_240_oPCAN_RADAR_d27633f1_Tx: ComBitPosition=384, ComBitSize=15, ComSignalInitValue=16384, ComSignalType=UINT16, ComHandleId=5024, ComSystemTemplateSystemSignalRef=DET_RANGE_VELOCITY_240
            DET_CONFD_AZIMUTH_238_oRDR_DETECTION_237_240_oPCAN_RADAR_f13f5054_Tx: ComBitPosition=230, ComBitSize=2, ComSignalInitValue=0, ComSignalType=UINT8, ComHandleId=4975, ComSystemTemplateSystemSignalRef=DET_CONFD_AZIMUTH_238
            DET_RANGE_VELOCITY_238_oRDR_DETECTION_237_240_oPCAN_RADAR_96e4eb00_Tx: ComBitPosition=160, ComBitSize=15, ComSignalInitValue=16384, ComSignalType=UINT16, ComHandleId=5022, ComSystemTemplateSystemSignalRef=DET_RANGE_VELOCITY_238
            DET_AZIMUTH_239_oRDR_DETECTION_237_240_oPCAN_RADAR_66a98e0b_Tx: ComBitPosition=312, ComBitSize=13, ComSignalInitValue=0, ComSignalType=UINT16, ComHandleId=4960, ComSystemTemplateSystemSignalRef=DET_AZIMUTH_239
            DET_ELEVATION_239_oRDR_DETECTION_237_240_oPCAN_RADAR_b71a5107_Tx: ComBitPosition=296, ComBitSize=8, ComSignalInitValue=0, ComSignalType=UINT8, ComHandleId=4984, ComSystemTemplateSystemSignalRef=DET_ELEVATION_239
            DET_ELEVATION_ERR_237_oRDR_DETECTION_237_240_oPCAN_RADAR_89438fa0_Tx: ComBitPosition=80, ComBitSize=6, ComSignalInitValue=0, ComSignalType=UINT8, ComHandleId=4986, ComSystemTemplateSystemSignalRef=DET_ELEVATION_ERR_237
            DET_RANGE_VELOCITY_ERR_237_oRDR_DETECTION_237_240_oPCAN_RADAR_b54f82f5_Tx: ComBitPosition=64, ComBitSize=8, ComSignalInitValue=0, ComSignalType=UINT8, ComHandleId=5025, ComSystemTemplateSystemSignalRef=DET_RANGE_VELOCITY_ERR_237
            DET_RANGE_VELOCITY_ERR_240_oRDR_DETECTION_237_240_oPCAN_RADAR_ddcdc843_Tx: ComBitPosition=400, ComBitSize=8, ComSignalInitValue=0, ComSignalType=UINT8, ComHandleId=5028, ComSystemTemplateSystemSignalRef=DET_RANGE_VELOCITY_ERR_240
            DET_CONFD_ELEVATION_237_oRDR_DETECTION_237_240_oPCAN_RADAR_dfbac3e9_Tx: ComBitPosition=101, ComBitSize=2, ComSignalInitValue=0, ComSignalType=UINT8, ComHandleId=4978, ComSystemTemplateSystemSignalRef=DET_CONFD_ELEVATION_237
            DET_RANGE_VELOCITY_ERR_238_oRDR_DETECTION_237_240_oPCAN_RADAR_995f10b2_Tx: ComBitPosition=176, ComBitSize=8, ComSignalInitValue=0, ComSignalType=UINT8, ComHandleId=5026, ComSystemTemplateSystemSignalRef=DET_RANGE_VELOCITY_ERR_238
            DET_RANGE_239_oRDR_DETECTION_237_240_oPCAN_RADAR_7632fdb0_Tx: ComBitPosition=248, ComBitSize=15, ComSignalInitValue=0, ComSignalType=UINT16, ComHandleId=5015, ComSystemTemplateSystemSignalRef=DET_RANGE_239
            DET_BI_STATIC_FLAG_238_oRDR_DETECTION_237_240_oPCAN_RADAR_a5f51a1b_Tx: ComBitPosition=216, ComBitSize=1, ComSignalInitValue=0, ComSignalType=BOOLEAN, ComHandleId=4971, ComSystemTemplateSystemSignalRef=DET_BI_STATIC_FLAG_238
            DET_CONFD_AZIMUTH_239_oRDR_DETECTION_237_240_oPCAN_RADAR_644f84c1_Tx: ComBitPosition=342, ComBitSize=2, ComSignalInitValue=0, ComSignalType=UINT8, ComHandleId=4976, ComSystemTemplateSystemSignalRef=DET_CONFD_AZIMUTH_239
            DET_BELOW_RAIN_THOLD_238_oRDR_DETECTION_237_240_oPCAN_RADAR_26d8c95e_Tx: ComBitPosition=151, ComBitSize=1, ComSignalInitValue=0, ComSignalType=UINT8, ComHandleId=4967, ComSystemTemplateSystemSignalRef=DET_BELOW_RAIN_THOLD_238
            DET_MTD_239_oRDR_DETECTION_237_240_oPCAN_RADAR_ee29f60b_Tx: ComBitPosition=271, ComBitSize=1, ComSignalInitValue=0, ComSignalType=UINT8, ComHandleId=5007, ComSystemTemplateSystemSignalRef=DET_MTD_239
            DET_IDM_237_oRDR_DETECTION_237_240_oPCAN_RADAR_31fa8202_Tx: ComBitPosition=63, ComBitSize=1, ComSignalInitValue=0, ComSignalType=UINT8, ComHandleId=4998, ComSystemTemplateSystemSignalRef=DET_IDM_237
            DET_BELOW_RAIN_THOLD_237_oRDR_DETECTION_237_240_oPCAN_RADAR_0ac85b19_Tx: ComBitPosition=39, ComBitSize=1, ComSignalInitValue=0, ComSignalType=UINT8, ComHandleId=4966, ComSystemTemplateSystemSignalRef=DET_BELOW_RAIN_THOLD_237
            DET_PROB_1STAZHYPO_237_oRDR_DETECTION_237_240_oPCAN_RADAR_c4fd5814_Tx: ComBitPosition=103, ComBitSize=1, ComSignalInitValue=0, ComSignalType=BOOLEAN, ComHandleId=5009, ComSystemTemplateSystemSignalRef=DET_PROB_1STAZHYPO_237
            DET_IDM_240_oRDR_DETECTION_237_240_oPCAN_RADAR_5978c8b4_Tx: ComBitPosition=399, ComBitSize=1, ComSignalInitValue=0, ComSignalType=UINT8, ComHandleId=5001, ComSystemTemplateSystemSignalRef=DET_IDM_240
            DET_IDM_239_oRDR_DETECTION_237_240_oPCAN_RADAR_889ac4d0_Tx: ComBitPosition=287, ComBitSize=1, ComSignalInitValue=0, ComSignalType=UINT8, ComHandleId=5000, ComSystemTemplateSystemSignalRef=DET_IDM_239
            DET_MTD_238_oRDR_DETECTION_237_240_oPCAN_RADAR_7b59229e_Tx: ComBitPosition=159, ComBitSize=1, ComSignalInitValue=0, ComSignalType=UINT8, ComHandleId=5006, ComSystemTemplateSystemSignalRef=DET_MTD_238
            DET_MTD_240_oRDR_DETECTION_237_240_oPCAN_RADAR_3fcbfa6f_Tx: ComBitPosition=383, ComBitSize=1, ComSignalInitValue=0, ComSignalType=UINT8, ComHandleId=5008, ComSystemTemplateSystemSignalRef=DET_MTD_240
            DET_BELOW_RAIN_THOLD_240_oRDR_DETECTION_237_240_oPCAN_RADAR_624a11af_Tx: ComBitPosition=375, ComBitSize=1, ComSignalInitValue=0, ComSignalType=UINT8, ComHandleId=4969, ComSystemTemplateSystemSignalRef=DET_BELOW_RAIN_THOLD_240
            DET_MTD_237_oRDR_DETECTION_237_240_oPCAN_RADAR_5749b0d9_Tx: ComBitPosition=47, ComBitSize=1, ComSignalInitValue=0, ComSignalType=UINT8, ComHandleId=5005, ComSystemTemplateSystemSignalRef=DET_MTD_237
            DET_PROB_1STAZHYPO_240_oRDR_DETECTION_237_240_oPCAN_RADAR_ac7f12a2_Tx: ComBitPosition=439, ComBitSize=1, ComSignalInitValue=0, ComSignalType=BOOLEAN, ComHandleId=5012, ComSystemTemplateSystemSignalRef=DET_PROB_1STAZHYPO_240
            DET_IDM_238_oRDR_DETECTION_237_240_oPCAN_RADAR_1dea1045_Tx: ComBitPosition=175, ComBitSize=1, ComSignalInitValue=0, ComSignalType=UINT8, ComHandleId=4999, ComSystemTemplateSystemSignalRef=DET_IDM_238
            DET_BELOW_RAIN_THOLD_239_oRDR_DETECTION_237_240_oPCAN_RADAR_b3a81dcb_Tx: ComBitPosition=263, ComBitSize=1, ComSignalInitValue=0, ComSignalType=UINT8, ComHandleId=4968, ComSystemTemplateSystemSignalRef=DET_BELOW_RAIN_THOLD_239
            DET_PROB_1STAZHYPO_239_oRDR_DETECTION_237_240_oPCAN_RADAR_7d9d1ec6_Tx: ComBitPosition=327, ComBitSize=1, ComSignalInitValue=0, ComSignalType=BOOLEAN, ComHandleId=5011, ComSystemTemplateSystemSignalRef=DET_PROB_1STAZHYPO_239
            DET_PROB_1STAZHYPO_238_oRDR_DETECTION_237_240_oPCAN_RADAR_e8edca53_Tx: ComBitPosition=215, ComBitSize=1, ComSignalInitValue=0, ComSignalType=BOOLEAN, ComHandleId=5010, ComSystemTemplateSystemSignalRef=DET_PROB_1STAZHYPO_238
        SG_RadarHeader_oRDR_HEADER_001_oPCAN_RADAR_48334d97_Tx: ComTransferProperty=TRIGGERED, ComHandleId=106, ComSystemTemplateSignalGroupRef=SG_RadarHeader
          36 x ComGroupSignal, all with ComTransferProperty=PENDING, ComSignalAccess=ACCESS_NEEDED_BY_SWC_OR_COM:
            HED_FOV_HOR_MIN_oRDR_HEADER_001_oPCAN_RADAR_445229a9_Tx: ComBitPosition=128, ComBitSize=8, ComSignalEndianness=LITTLE_ENDIAN, ComSignalInitValue=0, ComSignalType=UINT8, ComHandleId=8410, ComSystemTemplateSystemSignalRef=HED_FOV_HOR_MIN
            HED_OPERATION_MODE_oRDR_HEADER_001_oPCAN_RADAR_5d181f82_Tx: ComBitPosition=315, ComBitSize=3, ComSignalEndianness=LITTLE_ENDIAN, ComSignalInitValue=0, ComSignalType=UINT8, ComHandleId=8420, ComSystemTemplateSystemSignalRef=HED_OPERATION_MODE
            HED_PROCESSED_RANGE_oRDR_HEADER_001_oPCAN_RADAR_d69f60f9_Tx: ComBitPosition=160, ComBitSize=9, ComSignalEndianness=LITTLE_ENDIAN, ComSignalInitValue=0, ComSignalType=UINT16, ComHandleId=8421, ComSystemTemplateSystemSignalRef=HED_PROCESSED_RANGE
            HED_DATA_QUALIFIER_oRDR_HEADER_001_oPCAN_RADAR_df26d8e4_Tx: ComBitPosition=44, ComBitSize=3, ComSignalEndianness=LITTLE_ENDIAN, ComSignalInitValue=1, ComSignalType=UINT8, ComHandleId=8401, ComSystemTemplateSystemSignalRef=HED_DATA_QUALIFIER
            HED_DET_SPEED_RANGE_MAX_oRDR_HEADER_001_oPCAN_RADAR_d83b01a3_Tx: ComBitPosition=96, ComBitSize=16, ComSignalEndianness=LITTLE_ENDIAN, ComSignalInitValue=32768, ComSignalType=UINT16, ComHandleId=8407, ComSystemTemplateSystemSignalRef=HED_DET_SPEED_RANGE_MAX
            HED_SENSOR_TIME_STAMP_NS_oRDR_HEADER_001_oPCAN_RADAR_3b625701_Tx: ComBitPosition=224, ComBitSize=32, ComSignalEndianness=LITTLE_ENDIAN, ComSignalInitValue=0, ComSignalType=UINT32, ComHandleId=8427, ComSystemTemplateSystemSignalRef=HED_SENSOR_TIME_STAMP_NS
            HED_MH_CYCLE_COUNTER_oRDR_HEADER_001_oPCAN_RADAR_d6fb5718_Tx: ComBitPosition=16, ComBitSize=8, ComSignalEndianness=LITTLE_ENDIAN, ComSignalInitValue=0, ComSignalType=UINT8, ComHandleId=8417, ComSystemTemplateSystemSignalRef=HED_MH_CYCLE_COUNTER
            HED_MAX_NUM_OF_DETECTIONS_oRDR_HEADER_001_oPCAN_RADAR_a13979cd_Tx: ComBitPosition=352, ComBitSize=9, ComSignalEndianness=LITTLE_ENDIAN, ComSignalInitValue=0, ComSignalType=UINT16, ComHandleId=8415, ComSystemTemplateSystemSignalRef=HED_MAX_NUM_OF_DETECTIONS
            HED_TIME_SYNC_SRC_MASTER_oRDR_HEADER_001_oPCAN_RADAR_cf69d55e_Tx: ComBitPosition=169, ComBitSize=1, ComSignalEndianness=LITTLE_ENDIAN, ComSignalInitValue=0, ComSignalType=UINT8, ComHandleId=8430, ComSystemTemplateSystemSignalRef=HED_TIME_SYNC_SRC_MASTER
            HED_FOV_VER_MIN_oRDR_HEADER_001_oPCAN_RADAR_bb5d9b09_Tx: ComBitPosition=144, ComBitSize=8, ComSignalEndianness=LITTLE_ENDIAN, ComSignalInitValue=0, ComSignalType=UINT8, ComHandleId=8412, ComSystemTemplateSystemSignalRef=HED_FOV_VER_MIN
            HED_LOOK_INDEX_oRDR_HEADER_001_oPCAN_RADAR_a9c5ac4d_Tx: ComBitPosition=208, ComBitSize=16, ComSignalEndianness=LITTLE_ENDIAN, ComSignalInitValue=0, ComSignalType=UINT16, ComHandleId=8414, ComSystemTemplateSystemSignalRef=HED_LOOK_INDEX
            HED_LOOK_ID_oRDR_HEADER_001_oPCAN_RADAR_d5499e41_Tx: ComBitPosition=42, ComBitSize=2, ComSignalEndianness=LITTLE_ENDIAN, ComSignalInitValue=0, ComSignalType=UINT8, ComHandleId=8413, ComSystemTemplateSystemSignalRef=HED_LOOK_ID
            HED_NUM_OF_VALID_DETECTIONS_oRDR_HEADER_001_oPCAN_RADAR_561f5894_Tx: ComBitPosition=33, ComBitSize=9, ComSignalEndianness=LITTLE_ENDIAN, ComSignalInitValue=0, ComSignalType=UINT16, ComHandleId=8419, ComSystemTemplateSystemSignalRef=HED_NUM_OF_VALID_DETECTIONS
            HED_ALIGN_VER_REF_oRDR_HEADER_001_oPCAN_RADAR_e021d36b_Tx: ComBitPosition=174, ComBitSize=10, ComSignalEndianness=LITTLE_ENDIAN, ComSignalInitValue=0, ComSignalType=UINT16, ComHandleId=8399, ComSystemTemplateSystemSignalRef=HED_ALIGN_VER_REF
            HED_DET_BI_STATIC_COUNT_oRDR_HEADER_001_oPCAN_RADAR_2c7e7841_Tx: ComBitPosition=288, ComBitSize=8, ComSignalEndianness=LITTLE_ENDIAN, ComSignalInitValue=0, ComSignalType=UINT8, ComHandleId=8402, ComSystemTemplateSystemSignalRef=HED_DET_BI_STATIC_COUNT
            HED_SLOPE_CORR_EXECUTIONFLAG_oRDR_HEADER_001_oPCAN_RADAR_1dd90300_Tx: ComBitPosition=172, ComBitSize=2, ComSignalEndianness=LITTLE_ENDIAN, ComSignalInitValue=0, ComSignalType=UINT8, ComHandleId=8429, ComSystemTemplateSystemSignalRef=HED_SLOPE_CORR_EXECUTIONFLAG
            HED_TIME_SYNC_VALIDITY_FLAG_oRDR_HEADER_001_oPCAN_RADAR_e68b9aad_Tx: ComBitPosition=170, ComBitSize=2, ComSignalEndianness=LITTLE_ENDIAN, ComSignalInitValue=0, ComSignalType=UINT8, ComHandleId=8431, ComSystemTemplateSystemSignalRef=HED_TIME_SYNC_VALIDITY_FLAG
            HED_ALIGN_HOR_REF_oRDR_HEADER_001_oPCAN_RADAR_1f2e61cb_Tx: ComBitPosition=184, ComBitSize=13, ComSignalEndianness=LITTLE_ENDIAN, ComSignalInitValue=0, ComSignalType=UINT16, ComHandleId=8398, ComSystemTemplateSystemSignalRef=HED_ALIGN_HOR_REF
            HED_MH_CRC16_oRDR_HEADER_001_oPCAN_RADAR_c11c9aeb_Tx: ComBitPosition=0, ComBitSize=16, ComSignalEndianness=LITTLE_ENDIAN, ComSignalInitValue=0, ComSignalType=UINT16, ComHandleId=8416, ComSystemTemplateSystemSignalRef=HED_MH_CRC16
            HED_DET_RANGE_MIN_oRDR_HEADER_001_oPCAN_RADAR_8745ffc9_Tx: ComBitPosition=80, ComBitSize=16, ComSignalEndianness=LITTLE_ENDIAN, ComSignalInitValue=0, ComSignalType=UINT16, ComHandleId=8406, ComSystemTemplateSystemSignalRef=HED_DET_RANGE_MIN
            HED_SCAN_INDEX_oRDR_HEADER_001_oPCAN_RADAR_f1dfa1e3_Tx: ComBitPosition=48, ComBitSize=16, ComSignalEndianness=LITTLE_ENDIAN, ComSignalInitValue=0, ComSignalType=UINT16, ComHandleId=8426, ComSystemTemplateSystemSignalRef=HED_SCAN_INDEX
            HED_FOV_HOR_MAX_oRDR_HEADER_001_oPCAN_RADAR_6b8d6a34_Tx: ComBitPosition=136, ComBitSize=8, ComSignalEndianness=LITTLE_ENDIAN, ComSignalInitValue=0, ComSignalType=UINT8, ComHandleId=8409, ComSystemTemplateSystemSignalRef=HED_FOV_HOR_MAX
            HED_DET_NUM_OF_1PASS_oRDR_HEADER_001_oPCAN_RADAR_4c4276c1_Tx: ComBitPosition=296, ComBitSize=10, ComSignalEndianness=LITTLE_ENDIAN, ComSignalInitValue=0, ComSignalType=UINT16, ComHandleId=8403, ComSystemTemplateSystemSignalRef=HED_DET_NUM_OF_1PASS
            HED_DET_NUM_OF_2PASS_oRDR_HEADER_001_oPCAN_RADAR_1755c7d4_Tx: ComBitPosition=306, ComBitSize=9, ComSignalEndianness=LITTLE_ENDIAN, ComSignalInitValue=0, ComSignalType=UINT16, ComHandleId=8404, ComSystemTemplateSystemSignalRef=HED_DET_NUM_OF_2PASS
            HED_FOV_VER_MAX_oRDR_HEADER_001_oPCAN_RADAR_9482d894_Tx: ComBitPosition=152, ComBitSize=8, ComSignalEndianness=LITTLE_ENDIAN, ComSignalInitValue=0, ComSignalType=UINT8, ComHandleId=8411, ComSystemTemplateSystemSignalRef=HED_FOV_VER_MAX
            HED_NUM_OF_RESTBINS_USED_oRDR_HEADER_001_oPCAN_RADAR_accc4f32_Tx: ComBitPosition=24, ComBitSize=9, ComSignalEndianness=LITTLE_ENDIAN, ComSignalInitValue=0, ComSignalType=UINT16, ComHandleId=8418, ComSystemTemplateSystemSignalRef=HED_NUM_OF_RESTBINS_USED
            HED_DET_SPEED_RANGE_MIN_oRDR_HEADER_001_oPCAN_RADAR_f7e4423e_Tx: ComBitPosition=112, ComBitSize=16, ComSignalEndianness=LITTLE_ENDIAN, ComSignalInitValue=32768, ComSignalType=UINT16, ComHandleId=8408, ComSystemTemplateSystemSignalRef=HED_DET_SPEED_RANGE_MIN
            HED_TRIGGER_TIME_oRDR_HEADER_001_oPCAN_RADAR_c994f046_Tx: ComBitPosition=320, ComBitSize=32, ComSignalEndianness=LITTLE_ENDIAN, ComSignalInitValue=0, ComSignalType=UINT32, ComHandleId=8432, ComSystemTemplateSystemSignalRef=HED_TRIGGER_TIME
            HED_DET_RANGE_MAX_oRDR_HEADER_001_oPCAN_RADAR_a89abc54_Tx: ComBitPosition=64, ComBitSize=16, ComSignalEndianness=LITTLE_ENDIAN, ComSignalInitValue=0, ComSignalType=UINT16, ComHandleId=8405, ComSystemTemplateSystemSignalRef=HED_DET_RANGE_MAX
            HED_SENSOR_TIME_STAMP_SEC_oRDR_HEADER_001_oPCAN_RADAR_6281522c_Tx: ComBitPosition=256, ComBitSize=32, ComSignalEndianness=LITTLE_ENDIAN, ComSignalInitValue=0, ComSignalType=UINT32, ComHandleId=8428, ComSystemTemplateSystemSignalRef=HED_SENSOR_TIME_STAMP_SEC
            HED_RDR_HEADER_CMAC_oRDR_HEADER_001_oPCAN_RADAR_6d131f27_Tx: ComBitPosition=472, ComSignalEndianness=opaque, ComSignalInitValue=0 0 0 0 0, ComSignalLength=5, ComSignalType=UINT8_N, ComHandleId=8422, ComSystemTemplateSystemSignalRef=HED_RDR_HEADER_CMAC
            HED_Rain_Level_oRDR_HEADER_001_oPCAN_RADAR_7b3bcf0b_Tx: ComBitPosition=318, ComBitSize=2, ComSignalEndianness=LITTLE_ENDIAN, ComSignalInitValue=0, ComSignalType=UINT8, ComHandleId=8425, ComSystemTemplateSystemSignalRef=HED_Rain_Level
            HED_Auth_CRC32_oRDR_HEADER_001_oPCAN_RADAR_fe7f3dd8_Tx: ComBitPosition=376, ComBitSize=32, ComSignalEndianness=LITTLE_ENDIAN, ComSignalInitValue=0, ComSignalType=UINT32, ComHandleId=8400, ComSystemTemplateSystemSignalRef=HED_Auth_CRC32
            HED_V_WRAPPING_oRDR_HEADER_001_oPCAN_RADAR_036e7d98_Tx: ComBitPosition=197, ComBitSize=11, ComSignalEndianness=LITTLE_ENDIAN, ComSignalInitValue=0, ComSignalType=UINT16, ComHandleId=8433, ComSystemTemplateSystemSignalRef=HED_V_WRAPPING
            HED_RDR_HEADER_FV_oRDR_HEADER_001_oPCAN_RADAR_de313513_Tx: ComBitPosition=416, ComSignalEndianness=opaque, ComSignalInitValue=0 0 0 0 0 0 0, ComSignalLength=7, ComSignalType=UINT8_N, ComHandleId=8423, ComSystemTemplateSystemSignalRef=HED_RDR_HEADER_FV
            HED_R_WRAPPING_oRDR_HEADER_001_oPCAN_RADAR_58de80d3_Tx: ComBitPosition=368, ComBitSize=8, ComSignalEndianness=LITTLE_ENDIAN, ComSignalInitValue=90, ComSignalType=UINT8, ComHandleId=8424, ComSystemTemplateSystemSignalRef=HED_R_WRAPPING
        SG_Detections_089_092_oRDR_DETECTION_089_092_oPCAN_RADAR_e22704c4_Tx: ComTransferProperty=TRIGGERED, ComHandleId=24, ComSystemTemplateSignalGroupRef=SG_Detections_089_092
          83 x ComGroupSignal, all with ComSignalEndianness=LITTLE_ENDIAN, ComTransferProperty=PENDING, ComSignalAccess=ACCESS_NEEDED_BY_SWC_OR_COM:
            DET_RANGE_092_oRDR_DETECTION_089_092_oPCAN_RADAR_1342b66c_Tx: ComBitPosition=360, ComBitSize=15, ComSignalInitValue=0, ComSignalType=UINT16, ComHandleId=1945, ComSystemTemplateSystemSignalRef=DET_RANGE_092
            DET_ELEVATION_092_oRDR_DETECTION_089_092_oPCAN_RADAR_d26a1adb_Tx: ComBitPosition=408, ComBitSize=8, ComSignalInitValue=0, ComSignalType=UINT8, ComHandleId=1914, ComSystemTemplateSystemSignalRef=DET_ELEVATION_092
            DET_CONFD_AZIMUTH_089_oRDR_DETECTION_089_092_oPCAN_RADAR_958f12d2_Tx: ComBitPosition=118, ComBitSize=2, ComSignalInitValue=0, ComSignalType=UINT8, ComHandleId=1903, ComSystemTemplateSystemSignalRef=DET_CONFD_AZIMUTH_089
            DET_CONFD_AZIMUTH_092_oRDR_DETECTION_089_092_oPCAN_RADAR_013fcf1d_Tx: ComBitPosition=454, ComBitSize=2, ComSignalInitValue=0, ComSignalType=UINT8, ComHandleId=1906, ComSystemTemplateSystemSignalRef=DET_CONFD_AZIMUTH_092
            DET_RANGE_090_oRDR_DETECTION_089_092_oPCAN_RADAR_e2d21907_Tx: ComBitPosition=136, ComBitSize=15, ComSignalInitValue=0, ComSignalType=UINT16, ComHandleId=1943, ComSystemTemplateSystemSignalRef=DET_RANGE_090
            DET_RANGE_VELOCITY_ERR_090_oRDR_DETECTION_089_092_oPCAN_RADAR_98cf2090_Tx: ComBitPosition=176, ComBitSize=8, ComSignalInitValue=0, ComSignalType=UINT8, ComHandleId=1955, ComSystemTemplateSystemSignalRef=DET_RANGE_VELOCITY_ERR_090
            DET_SUPER_RES_TARGET_090_oRDR_DETECTION_089_092_oPCAN_RADAR_fcc3901f_Tx: ComBitPosition=199, ComBitSize=1, ComSignalInitValue=0, ComSignalType=BOOLEAN, ComHandleId=1967, ComSystemTemplateSystemSignalRef=DET_SUPER_RES_TARGET_090
            DET_HVC_FLAG_089_oRDR_DETECTION_089_092_oPCAN_RADAR_f208697e_Tx: ComBitPosition=86, ComBitSize=1, ComSignalInitValue=0, ComSignalType=BOOLEAN, ComHandleId=1923, ComSystemTemplateSystemSignalRef=DET_HVC_FLAG_089
            DET_RANGE_089_oRDR_DETECTION_089_092_oPCAN_RADAR_87f26ba3_Tx: ComBitPosition=24, ComBitSize=15, ComSignalInitValue=0, ComSignalType=UINT16, ComHandleId=1942, ComSystemTemplateSystemSignalRef=DET_RANGE_089
            DET_BI_STATIC_FLAG_089_oRDR_DETECTION_089_092_oPCAN_RADAR_c145589d_Tx: ComBitPosition=104, ComBitSize=1, ComSignalInitValue=0, ComSignalType=BOOLEAN, ComHandleId=1899, ComSystemTemplateSystemSignalRef=DET_BI_STATIC_FLAG_089
            DET_RANGE_VELOCITY_089_oRDR_DETECTION_089_092_oPCAN_RADAR_f254a986_Tx: ComBitPosition=48, ComBitSize=15, ComSignalInitValue=16384, ComSignalType=UINT16, ComHandleId=1950, ComSystemTemplateSystemSignalRef=DET_RANGE_VELOCITY_089
            DET_BI_STATIC_FLAG_092_oRDR_DETECTION_089_092_oPCAN_RADAR_55f58552_Tx: ComBitPosition=440, ComBitSize=1, ComSignalInitValue=0, ComSignalType=BOOLEAN, ComHandleId=1902, ComSystemTemplateSystemSignalRef=DET_BI_STATIC_FLAG_092
            DET_AZIMUTH_089_oRDR_DETECTION_089_092_oPCAN_RADAR_97691818_Tx: ComBitPosition=88, ComBitSize=13, ComSignalInitValue=0, ComSignalType=UINT16, ComHandleId=1887, ComSystemTemplateSystemSignalRef=DET_AZIMUTH_089
            DET_AZIMUTH_ERR_092_oRDR_DETECTION_089_092_oPCAN_RADAR_a76c5022_Tx: ComBitPosition=441, ComBitSize=7, ComSignalInitValue=0, ComSignalType=UINT8, ComHandleId=1894, ComSystemTemplateSystemSignalRef=DET_AZIMUTH_ERR_092
            DET_ELEVATION_089_oRDR_DETECTION_089_092_oPCAN_RADAR_46dac714_Tx: ComBitPosition=72, ComBitSize=8, ComSignalInitValue=0, ComSignalType=UINT8, ComHandleId=1911, ComSystemTemplateSystemSignalRef=DET_ELEVATION_089
            DET_MH_CRC16_089_092_oRDR_DETECTION_089_092_oPCAN_RADAR_66afd6cf_Tx: ComBitPosition=0, ComBitSize=16, ComSignalInitValue=0, ComSignalType=UINT16, ComHandleId=1931, ComSystemTemplateSystemSignalRef=DET_MH_CRC16_089_092
            DET_EXISTENCE_PROB_092_oRDR_DETECTION_089_092_oPCAN_RADAR_87ccf7ce_Tx: ComBitPosition=448, ComBitSize=6, ComSignalInitValue=0, ComSignalType=UINT8, ComHandleId=1922, ComSystemTemplateSystemSignalRef=DET_EXISTENCE_PROB_092
            DET_BI_STATIC_FLAG_090_oRDR_DETECTION_089_092_oPCAN_RADAR_a4652a39_Tx: ComBitPosition=216, ComBitSize=1, ComSignalInitValue=0, ComSignalType=BOOLEAN, ComHandleId=1900, ComSystemTemplateSystemSignalRef=DET_BI_STATIC_FLAG_090
            DET_SUPER_RES_TARGET_092_oRDR_DETECTION_089_092_oPCAN_RADAR_0d533f74_Tx: ComBitPosition=423, ComBitSize=1, ComSignalInitValue=0, ComSignalType=BOOLEAN, ComHandleId=1969, ComSystemTemplateSystemSignalRef=DET_SUPER_RES_TARGET_092
            DET_AZIMUTH_ERR_090_oRDR_DETECTION_089_092_oPCAN_RADAR_56fcff49_Tx: ComBitPosition=217, ComBitSize=7, ComSignalInitValue=0, ComSignalType=UINT8, ComHandleId=1892, ComSystemTemplateSystemSignalRef=DET_AZIMUTH_ERR_090
            DET_AZIMUTH_ERR_091_oRDR_DETECTION_089_092_oPCAN_RADAR_c38c2bdc_Tx: ComBitPosition=329, ComBitSize=7, ComSignalInitValue=0, ComSignalType=UINT8, ComHandleId=1893, ComSystemTemplateSystemSignalRef=DET_AZIMUTH_ERR_091
            DET_BI_STATIC_FLAG_091_oRDR_DETECTION_089_092_oPCAN_RADAR_3115feac_Tx: ComBitPosition=328, ComBitSize=1, ComSignalInitValue=0, ComSignalType=BOOLEAN, ComHandleId=1901, ComSystemTemplateSystemSignalRef=DET_BI_STATIC_FLAG_091
            DET_RCS_091_oRDR_DETECTION_089_092_oPCAN_RADAR_858438ed_Tx: ComBitPosition=352, ComBitSize=8, ComSignalInitValue=128, ComSignalType=UINT8, ComHandleId=1960, ComSystemTemplateSystemSignalRef=DET_RCS_091
            DET_SNR_092_oRDR_DETECTION_089_092_oPCAN_RADAR_3cca1711_Tx: ComBitPosition=456, ComBitSize=8, ComSignalInitValue=0, ComSignalType=UINT8, ComHandleId=1965, ComSystemTemplateSystemSignalRef=DET_SNR_092
            DET_CONFD_ELEVATION_090_oRDR_DETECTION_089_092_oPCAN_RADAR_f23a618c_Tx: ComBitPosition=213, ComBitSize=2, ComSignalInitValue=0, ComSignalType=UINT8, ComHandleId=1908, ComSystemTemplateSystemSignalRef=DET_CONFD_ELEVATION_090
            DET_SUPER_RES_TARGET_091_oRDR_DETECTION_089_092_oPCAN_RADAR_69b3448a_Tx: ComBitPosition=311, ComBitSize=1, ComSignalInitValue=0, ComSignalType=BOOLEAN, ComHandleId=1968, ComSystemTemplateSystemSignalRef=DET_SUPER_RES_TARGET_091
            DET_ELEVATION_ERR_091_oRDR_DETECTION_089_092_oPCAN_RADAR_31b3f950_Tx: ComBitPosition=304, ComBitSize=6, ComSignalInitValue=0, ComSignalType=UINT8, ComHandleId=1917, ComSystemTemplateSystemSignalRef=DET_ELEVATION_ERR_091
            DET_ELEVATION_090_oRDR_DETECTION_089_092_oPCAN_RADAR_23fab5b0_Tx: ComBitPosition=184, ComBitSize=8, ComSignalInitValue=0, ComSignalType=UINT8, ComHandleId=1912, ComSystemTemplateSystemSignalRef=DET_ELEVATION_090
            DET_RANGE_ERR_089_oRDR_DETECTION_089_092_oPCAN_RADAR_201ad1ca_Tx: ComBitPosition=40, ComBitSize=7, ComSignalInitValue=0, ComSignalType=UINT8, ComHandleId=1946, ComSystemTemplateSystemSignalRef=DET_RANGE_ERR_089
            DET_RANGE_091_oRDR_DETECTION_089_092_oPCAN_RADAR_77a2cd92_Tx: ComBitPosition=248, ComBitSize=15, ComSignalInitValue=0, ComSignalType=UINT16, ComHandleId=1944, ComSystemTemplateSystemSignalRef=DET_RANGE_091
            DET_CONFD_AZIMUTH_090_oRDR_DETECTION_089_092_oPCAN_RADAR_f0af6076_Tx: ComBitPosition=230, ComBitSize=2, ComSignalInitValue=0, ComSignalType=UINT8, ComHandleId=1904, ComSystemTemplateSystemSignalRef=DET_CONFD_AZIMUTH_090
            DET_MH_CYCLE_COUNTER_089_092_oRDR_DETECTION_089_092_oPCAN_RADAR_e2da77f8_Tx: ComBitPosition=16, ComBitSize=8, ComSignalInitValue=0, ComSignalType=UINT8, ComHandleId=1932, ComSystemTemplateSystemSignalRef=DET_MH_CYCLE_COUNTER_089_092
            DET_RANGE_VELOCITY_091_oRDR_DETECTION_089_092_oPCAN_RADAR_02040fb7_Tx: ComBitPosition=272, ComBitSize=15, ComSignalInitValue=16384, ComSignalType=UINT16, ComHandleId=1952, ComSystemTemplateSystemSignalRef=DET_RANGE_VELOCITY_091
            DET_MH_SCAN_INDEX_4LSB_089_092_oRDR_DETECTION_089_092_oPCAN_RADAR_2ef05274_Tx: ComBitPosition=476, ComBitSize=4, ComSignalInitValue=0, ComSignalType=UINT8, ComHandleId=1933, ComSystemTemplateSystemSignalRef=DET_MH_SCAN_INDEX_4LSB_089_092
            DET_HVC_FLAG_091_oRDR_DETECTION_089_092_oPCAN_RADAR_0258cf4f_Tx: ComBitPosition=310, ComBitSize=1, ComSignalInitValue=0, ComSignalType=BOOLEAN, ComHandleId=1925, ComSystemTemplateSystemSignalRef=DET_HVC_FLAG_091
            DET_RANGE_VELOCITY_ERR_091_oRDR_DETECTION_089_092_oPCAN_RADAR_0dbff405_Tx: ComBitPosition=288, ComBitSize=8, ComSignalInitValue=0, ComSignalType=UINT8, ComHandleId=1956, ComSystemTemplateSystemSignalRef=DET_RANGE_VELOCITY_ERR_091
            DET_ELEVATION_091_oRDR_DETECTION_089_092_oPCAN_RADAR_b68a6125_Tx: ComBitPosition=296, ComBitSize=8, ComSignalInitValue=0, ComSignalType=UINT8, ComHandleId=1913, ComSystemTemplateSystemSignalRef=DET_ELEVATION_091
            DET_EXISTENCE_PROB_090_oRDR_DETECTION_089_092_oPCAN_RADAR_765c58a5_Tx: ComBitPosition=224, ComBitSize=6, ComSignalInitValue=0, ComSignalType=UINT8, ComHandleId=1920, ComSystemTemplateSystemSignalRef=DET_EXISTENCE_PROB_090
            DET_RANGE_VELOCITY_092_oRDR_DETECTION_089_092_oPCAN_RADAR_66e47449_Tx: ComBitPosition=384, ComBitSize=15, ComSignalInitValue=16384, ComSignalType=UINT16, ComHandleId=1953, ComSystemTemplateSystemSignalRef=DET_RANGE_VELOCITY_092
            DET_CONFD_ELEVATION_092_oRDR_DETECTION_089_092_oPCAN_RADAR_03aacee7_Tx: ComBitPosition=437, ComBitSize=2, ComSignalInitValue=0, ComSignalType=UINT8, ComHandleId=1910, ComSystemTemplateSystemSignalRef=DET_CONFD_ELEVATION_092
            DET_RCS_090_oRDR_DETECTION_089_092_oPCAN_RADAR_10f4ec78_Tx: ComBitPosition=240, ComBitSize=8, ComSignalInitValue=128, ComSignalType=UINT8, ComHandleId=1959, ComSystemTemplateSystemSignalRef=DET_RCS_090
            DET_ELEVATION_ERR_092_oRDR_DETECTION_089_092_oPCAN_RADAR_555382ae_Tx: ComBitPosition=416, ComBitSize=6, ComSignalInitValue=0, ComSignalType=UINT8, ComHandleId=1918, ComSystemTemplateSystemSignalRef=DET_ELEVATION_ERR_092
            DET_RANGE_ERR_092_oRDR_DETECTION_089_092_oPCAN_RADAR_b4aa0c05_Tx: ComBitPosition=376, ComBitSize=7, ComSignalInitValue=0, ComSignalType=UINT8, ComHandleId=1949, ComSystemTemplateSystemSignalRef=DET_RANGE_ERR_092
            DET_RANGE_VELOCITY_090_oRDR_DETECTION_089_092_oPCAN_RADAR_9774db22_Tx: ComBitPosition=160, ComBitSize=15, ComSignalInitValue=16384, ComSignalType=UINT16, ComHandleId=1951, ComSystemTemplateSystemSignalRef=DET_RANGE_VELOCITY_090
            DET_CONFD_ELEVATION_091_oRDR_DETECTION_089_092_oPCAN_RADAR_674ab519_Tx: ComBitPosition=325, ComBitSize=2, ComSignalInitValue=0, ComSignalType=UINT8, ComHandleId=1909, ComSystemTemplateSystemSignalRef=DET_CONFD_ELEVATION_091
            DET_SUPER_RES_TARGET_089_oRDR_DETECTION_089_092_oPCAN_RADAR_99e3e2bb_Tx: ComBitPosition=87, ComBitSize=1, ComSignalInitValue=0, ComSignalType=BOOLEAN, ComHandleId=1966, ComSystemTemplateSystemSignalRef=DET_SUPER_RES_TARGET_089
            DET_AZIMUTH_ERR_089_oRDR_DETECTION_089_092_oPCAN_RADAR_33dc8ded_Tx: ComBitPosition=105, ComBitSize=7, ComSignalInitValue=0, ComSignalType=UINT8, ComHandleId=1891, ComSystemTemplateSystemSignalRef=DET_AZIMUTH_ERR_089
            DET_RANGE_VELOCITY_ERR_089_oRDR_DETECTION_089_092_oPCAN_RADAR_fdef5234_Tx: ComBitPosition=64, ComBitSize=8, ComSignalInitValue=0, ComSignalType=UINT8, ComHandleId=1954, ComSystemTemplateSystemSignalRef=DET_RANGE_VELOCITY_ERR_089
            DET_ELEVATION_ERR_089_oRDR_DETECTION_089_092_oPCAN_RADAR_c1e35f61_Tx: ComBitPosition=80, ComBitSize=6, ComSignalInitValue=0, ComSignalType=UINT8, ComHandleId=1915, ComSystemTemplateSystemSignalRef=DET_ELEVATION_ERR_089
            DET_AZIMUTH_090_oRDR_DETECTION_089_092_oPCAN_RADAR_f2496abc_Tx: ComBitPosition=200, ComBitSize=13, ComSignalInitValue=0, ComSignalType=UINT16, ComHandleId=1888, ComSystemTemplateSystemSignalRef=DET_AZIMUTH_090
            DET_AZIMUTH_092_oRDR_DETECTION_089_092_oPCAN_RADAR_03d9c5d7_Tx: ComBitPosition=424, ComBitSize=13, ComSignalInitValue=0, ComSignalType=UINT16, ComHandleId=1890, ComSystemTemplateSystemSignalRef=DET_AZIMUTH_092
            DET_HVC_FLAG_090_oRDR_DETECTION_089_092_oPCAN_RADAR_97281bda_Tx: ComBitPosition=198, ComBitSize=1, ComSignalInitValue=0, ComSignalType=BOOLEAN, ComHandleId=1924, ComSystemTemplateSystemSignalRef=DET_HVC_FLAG_090
            DET_EXISTENCE_PROB_091_oRDR_DETECTION_089_092_oPCAN_RADAR_e32c8c30_Tx: ComBitPosition=336, ComBitSize=6, ComSignalInitValue=0, ComSignalType=UINT8, ComHandleId=1921, ComSystemTemplateSystemSignalRef=DET_EXISTENCE_PROB_091
            DET_SNR_089_oRDR_DETECTION_089_092_oPCAN_RADAR_a87acade_Tx: ComBitPosition=120, ComBitSize=8, ComSignalInitValue=0, ComSignalType=UINT8, ComHandleId=1962, ComSystemTemplateSystemSignalRef=DET_SNR_089
            DET_AZIMUTH_091_oRDR_DETECTION_089_092_oPCAN_RADAR_6739be29_Tx: ComBitPosition=312, ComBitSize=13, ComSignalInitValue=0, ComSignalType=UINT16, ComHandleId=1889, ComSystemTemplateSystemSignalRef=DET_AZIMUTH_091
            DET_RANGE_ERR_091_oRDR_DETECTION_089_092_oPCAN_RADAR_d04a77fb_Tx: ComBitPosition=264, ComBitSize=7, ComSignalInitValue=0, ComSignalType=UINT8, ComHandleId=1948, ComSystemTemplateSystemSignalRef=DET_RANGE_ERR_091
            DET_CONFD_AZIMUTH_091_oRDR_DETECTION_089_092_oPCAN_RADAR_65dfb4e3_Tx: ComBitPosition=342, ComBitSize=2, ComSignalInitValue=0, ComSignalType=UINT8, ComHandleId=1905, ComSystemTemplateSystemSignalRef=DET_CONFD_AZIMUTH_091
            DET_ELEVATION_ERR_090_oRDR_DETECTION_089_092_oPCAN_RADAR_a4c32dc5_Tx: ComBitPosition=192, ComBitSize=6, ComSignalInitValue=0, ComSignalType=UINT8, ComHandleId=1916, ComSystemTemplateSystemSignalRef=DET_ELEVATION_ERR_090
            DET_EXISTENCE_PROB_089_oRDR_DETECTION_089_092_oPCAN_RADAR_137c2a01_Tx: ComBitPosition=112, ComBitSize=6, ComSignalInitValue=0, ComSignalType=UINT8, ComHandleId=1919, ComSystemTemplateSystemSignalRef=DET_EXISTENCE_PROB_089
            DET_CONFD_ELEVATION_089_oRDR_DETECTION_089_092_oPCAN_RADAR_971a1328_Tx: ComBitPosition=101, ComBitSize=2, ComSignalInitValue=0, ComSignalType=UINT8, ComHandleId=1907, ComSystemTemplateSystemSignalRef=DET_CONFD_ELEVATION_089
            DET_HVC_FLAG_092_oRDR_DETECTION_089_092_oPCAN_RADAR_66b8b4b1_Tx: ComBitPosition=422, ComBitSize=1, ComSignalInitValue=0, ComSignalType=BOOLEAN, ComHandleId=1926, ComSystemTemplateSystemSignalRef=DET_HVC_FLAG_092
            DET_SNR_091_oRDR_DETECTION_089_092_oPCAN_RADAR_582a6cef_Tx: ComBitPosition=344, ComBitSize=8, ComSignalInitValue=0, ComSignalType=UINT8, ComHandleId=1964, ComSystemTemplateSystemSignalRef=DET_SNR_091
            DET_RANGE_ERR_090_oRDR_DETECTION_089_092_oPCAN_RADAR_453aa36e_Tx: ComBitPosition=152, ComBitSize=7, ComSignalInitValue=0, ComSignalType=UINT8, ComHandleId=1947, ComSystemTemplateSystemSignalRef=DET_RANGE_ERR_090
            DET_RCS_092_oRDR_DETECTION_089_092_oPCAN_RADAR_e1644313_Tx: ComBitPosition=464, ComBitSize=8, ComSignalInitValue=128, ComSignalType=UINT8, ComHandleId=1961, ComSystemTemplateSystemSignalRef=DET_RCS_092
            DET_SNR_090_oRDR_DETECTION_089_092_oPCAN_RADAR_cd5ab87a_Tx: ComBitPosition=232, ComBitSize=8, ComSignalInitValue=0, ComSignalType=UINT8, ComHandleId=1963, ComSystemTemplateSystemSignalRef=DET_SNR_090
            DET_RANGE_VELOCITY_ERR_092_oRDR_DETECTION_089_092_oPCAN_RADAR_695f8ffb_Tx: ComBitPosition=400, ComBitSize=8, ComSignalInitValue=0, ComSignalType=UINT8, ComHandleId=1957, ComSystemTemplateSystemSignalRef=DET_RANGE_VELOCITY_ERR_092
            DET_RCS_089_oRDR_DETECTION_089_092_oPCAN_RADAR_75d49edc_Tx: ComBitPosition=128, ComBitSize=8, ComSignalInitValue=128, ComSignalType=UINT8, ComHandleId=1958, ComSystemTemplateSystemSignalRef=DET_RCS_089
            DET_BELOW_RAIN_THOLD_091_oRDR_DETECTION_089_092_oPCAN_RADAR_b2382de9_Tx: ComBitPosition=263, ComBitSize=1, ComSignalInitValue=0, ComSignalType=UINT8, ComHandleId=1897, ComSystemTemplateSystemSignalRef=DET_BELOW_RAIN_THOLD_091
            DET_MTD_092_oRDR_DETECTION_089_092_oPCAN_RADAR_8b59bdd7_Tx: ComBitPosition=383, ComBitSize=1, ComSignalInitValue=0, ComSignalType=UINT8, ComHandleId=1937, ComSystemTemplateSystemSignalRef=DET_MTD_092
            DET_BELOW_RAIN_THOLD_090_oRDR_DETECTION_089_092_oPCAN_RADAR_2748f97c_Tx: ComBitPosition=151, ComBitSize=1, ComSignalInitValue=0, ComSignalType=UINT8, ComHandleId=1896, ComSystemTemplateSystemSignalRef=DET_BELOW_RAIN_THOLD_090
            DET_PROB_1STAZHYPO_091_oRDR_DETECTION_089_092_oPCAN_RADAR_7c0d2ee4_Tx: ComBitPosition=327, ComBitSize=1, ComSignalInitValue=0, ComSignalType=BOOLEAN, ComHandleId=1940, ComSystemTemplateSystemSignalRef=DET_PROB_1STAZHYPO_091
            DET_PROB_1STAZHYPO_092_oRDR_DETECTION_089_092_oPCAN_RADAR_18ed551a_Tx: ComBitPosition=439, ComBitSize=1, ComSignalInitValue=0, ComSignalType=BOOLEAN, ComHandleId=1941, ComSystemTemplateSystemSignalRef=DET_PROB_1STAZHYPO_092
            DET_MTD_089_oRDR_DETECTION_089_092_oPCAN_RADAR_1fe96018_Tx: ComBitPosition=47, ComBitSize=1, ComSignalInitValue=0, ComSignalType=UINT8, ComHandleId=1934, ComSystemTemplateSystemSignalRef=DET_MTD_089
            DET_IDM_092_oRDR_DETECTION_089_092_oPCAN_RADAR_edea8f0c_Tx: ComBitPosition=399, ComBitSize=1, ComSignalInitValue=0, ComSignalType=UINT8, ComHandleId=1930, ComSystemTemplateSystemSignalRef=DET_IDM_092
            DET_MTD_091_oRDR_DETECTION_089_092_oPCAN_RADAR_efb9c629_Tx: ComBitPosition=271, ComBitSize=1, ComSignalInitValue=0, ComSignalType=UINT8, ComHandleId=1936, ComSystemTemplateSystemSignalRef=DET_MTD_091
            DET_IDM_089_oRDR_DETECTION_089_092_oPCAN_RADAR_795a52c3_Tx: ComBitPosition=63, ComBitSize=1, ComSignalInitValue=0, ComSignalType=UINT8, ComHandleId=1927, ComSystemTemplateSystemSignalRef=DET_IDM_089
            DET_IDM_091_oRDR_DETECTION_089_092_oPCAN_RADAR_890af4f2_Tx: ComBitPosition=287, ComBitSize=1, ComSignalInitValue=0, ComSignalType=UINT8, ComHandleId=1929, ComSystemTemplateSystemSignalRef=DET_IDM_091
            DET_BELOW_RAIN_THOLD_089_oRDR_DETECTION_089_092_oPCAN_RADAR_42688bd8_Tx: ComBitPosition=39, ComBitSize=1, ComSignalInitValue=0, ComSignalType=UINT8, ComHandleId=1895, ComSystemTemplateSystemSignalRef=DET_BELOW_RAIN_THOLD_089
            DET_MTD_090_oRDR_DETECTION_089_092_oPCAN_RADAR_7ac912bc_Tx: ComBitPosition=159, ComBitSize=1, ComSignalInitValue=0, ComSignalType=UINT8, ComHandleId=1935, ComSystemTemplateSystemSignalRef=DET_MTD_090
            DET_IDM_090_oRDR_DETECTION_089_092_oPCAN_RADAR_1c7a2067_Tx: ComBitPosition=175, ComBitSize=1, ComSignalInitValue=0, ComSignalType=UINT8, ComHandleId=1928, ComSystemTemplateSystemSignalRef=DET_IDM_090
            DET_BELOW_RAIN_THOLD_092_oRDR_DETECTION_089_092_oPCAN_RADAR_d6d85617_Tx: ComBitPosition=375, ComBitSize=1, ComSignalInitValue=0, ComSignalType=UINT8, ComHandleId=1898, ComSystemTemplateSystemSignalRef=DET_BELOW_RAIN_THOLD_092
            DET_PROB_1STAZHYPO_089_oRDR_DETECTION_089_092_oPCAN_RADAR_8c5d88d5_Tx: ComBitPosition=103, ComBitSize=1, ComSignalInitValue=0, ComSignalType=BOOLEAN, ComHandleId=1938, ComSystemTemplateSystemSignalRef=DET_PROB_1STAZHYPO_089
            DET_PROB_1STAZHYPO_090_oRDR_DETECTION_089_092_oPCAN_RADAR_e97dfa71_Tx: ComBitPosition=215, ComBitSize=1, ComSignalInitValue=0, ComSignalType=BOOLEAN, ComHandleId=1939, ComSystemTemplateSystemSignalRef=DET_PROB_1STAZHYPO_090
        SG_Detections_265_268_oRDR_DETECTION_265_268_oPCAN_RADAR_74450479_Tx: ComTransferProperty=TRIGGERED, ComHandleId=68, ComSystemTemplateSignalGroupRef=SG_Detections_265_268
          83 x ComGroupSignal, all with ComSignalEndianness=LITTLE_ENDIAN, ComTransferProperty=PENDING, ComSignalAccess=ACCESS_NEEDED_BY_SWC_OR_COM:
            DET_AZIMUTH_ERR_265_oRDR_DETECTION_265_268_oPCAN_RADAR_efe45507_Tx: ComBitPosition=105, ComBitSize=7, ComSignalInitValue=0, ComSignalType=UINT8, ComHandleId=5543, ComSystemTemplateSystemSignalRef=DET_AZIMUTH_ERR_265
            DET_CONFD_AZIMUTH_268_oRDR_DETECTION_265_268_oPCAN_RADAR_9437f714_Tx: ComBitPosition=454, ComBitSize=2, ComSignalInitValue=0, ComSignalType=UINT8, ComHandleId=5558, ComSystemTemplateSystemSignalRef=DET_CONFD_AZIMUTH_268
            DET_MH_CYCLE_COUNTER_265_268_oRDR_DETECTION_265_268_oPCAN_RADAR_74b87745_Tx: ComBitPosition=16, ComBitSize=8, ComSignalInitValue=0, ComSignalType=UINT8, ComHandleId=5584, ComSystemTemplateSystemSignalRef=DET_MH_CYCLE_COUNTER_265_268
            DET_BI_STATIC_FLAG_267_oRDR_DETECTION_265_268_oPCAN_RADAR_eced2f1c_Tx: ComBitPosition=328, ComBitSize=1, ComSignalInitValue=0, ComSignalType=BOOLEAN, ComHandleId=5553, ComSystemTemplateSystemSignalRef=DET_BI_STATIC_FLAG_267
            DET_RANGE_ERR_267_oRDR_DETECTION_265_268_oPCAN_RADAR_0db2a64b_Tx: ComBitPosition=264, ComBitSize=7, ComSignalInitValue=0, ComSignalType=UINT8, ComHandleId=5600, ComSystemTemplateSystemSignalRef=DET_RANGE_ERR_267
            DET_RCS_266_oRDR_DETECTION_265_268_oPCAN_RADAR_cd0c3dc8_Tx: ComBitPosition=240, ComBitSize=8, ComSignalInitValue=128, ComSignalType=UINT8, ComHandleId=5611, ComSystemTemplateSystemSignalRef=DET_RCS_266
            DET_RANGE_VELOCITY_ERR_265_oRDR_DETECTION_265_268_oPCAN_RADAR_21d78ade_Tx: ComBitPosition=64, ComBitSize=8, ComSignalInitValue=0, ComSignalType=UINT8, ComHandleId=5606, ComSystemTemplateSystemSignalRef=DET_RANGE_VELOCITY_ERR_265
            DET_HVC_FLAG_268_oRDR_DETECTION_265_268_oPCAN_RADAR_f3b08cb8_Tx: ComBitPosition=422, ComBitSize=1, ComSignalInitValue=0, ComSignalType=BOOLEAN, ComHandleId=5578, ComSystemTemplateSystemSignalRef=DET_HVC_FLAG_268
            DET_SUPER_RES_TARGET_267_oRDR_DETECTION_265_268_oPCAN_RADAR_b44b953a_Tx: ComBitPosition=311, ComBitSize=1, ComSignalInitValue=0, ComSignalType=BOOLEAN, ComHandleId=5620, ComSystemTemplateSystemSignalRef=DET_SUPER_RES_TARGET_267
            DET_RANGE_VELOCITY_266_oRDR_DETECTION_265_268_oPCAN_RADAR_4a8c0a92_Tx: ComBitPosition=160, ComBitSize=15, ComSignalInitValue=16384, ComSignalType=UINT16, ComHandleId=5603, ComSystemTemplateSystemSignalRef=DET_RANGE_VELOCITY_266
            DET_RANGE_VELOCITY_ERR_267_oRDR_DETECTION_265_268_oPCAN_RADAR_d04725b5_Tx: ComBitPosition=288, ComBitSize=8, ComSignalInitValue=0, ComSignalType=UINT8, ComHandleId=5608, ComSystemTemplateSystemSignalRef=DET_RANGE_VELOCITY_ERR_267
            DET_SUPER_RES_TARGET_266_oRDR_DETECTION_265_268_oPCAN_RADAR_213b41af_Tx: ComBitPosition=199, ComBitSize=1, ComSignalInitValue=0, ComSignalType=BOOLEAN, ComHandleId=5619, ComSystemTemplateSystemSignalRef=DET_SUPER_RES_TARGET_266
            DET_ELEVATION_ERR_265_oRDR_DETECTION_265_268_oPCAN_RADAR_1ddb878b_Tx: ComBitPosition=80, ComBitSize=6, ComSignalInitValue=0, ComSignalType=UINT8, ComHandleId=5567, ComSystemTemplateSystemSignalRef=DET_ELEVATION_ERR_265
            DET_AZIMUTH_267_oRDR_DETECTION_265_268_oPCAN_RADAR_bac16f99_Tx: ComBitPosition=312, ComBitSize=13, ComSignalInitValue=0, ComSignalType=UINT16, ComHandleId=5541, ComSystemTemplateSystemSignalRef=DET_AZIMUTH_267
            DET_HVC_FLAG_266_oRDR_DETECTION_265_268_oPCAN_RADAR_4ad0ca6a_Tx: ComBitPosition=198, ComBitSize=1, ComSignalInitValue=0, ComSignalType=BOOLEAN, ComHandleId=5576, ComSystemTemplateSystemSignalRef=DET_HVC_FLAG_266
            DET_AZIMUTH_268_oRDR_DETECTION_265_268_oPCAN_RADAR_96d1fdde_Tx: ComBitPosition=424, ComBitSize=13, ComSignalInitValue=0, ComSignalType=UINT16, ComHandleId=5542, ComSystemTemplateSystemSignalRef=DET_AZIMUTH_268
            DET_ELEVATION_ERR_268_oRDR_DETECTION_265_268_oPCAN_RADAR_c05bbaa7_Tx: ComBitPosition=416, ComBitSize=6, ComSignalInitValue=0, ComSignalType=UINT8, ComHandleId=5570, ComSystemTemplateSystemSignalRef=DET_ELEVATION_ERR_268
            DET_RANGE_265_oRDR_DETECTION_265_268_oPCAN_RADAR_5bcab349_Tx: ComBitPosition=24, ComBitSize=15, ComSignalInitValue=0, ComSignalType=UINT16, ComHandleId=5594, ComSystemTemplateSystemSignalRef=DET_RANGE_265
            DET_CONFD_AZIMUTH_267_oRDR_DETECTION_265_268_oPCAN_RADAR_b8276553_Tx: ComBitPosition=342, ComBitSize=2, ComSignalInitValue=0, ComSignalType=UINT8, ComHandleId=5557, ComSystemTemplateSystemSignalRef=DET_CONFD_AZIMUTH_267
            DET_EXISTENCE_PROB_267_oRDR_DETECTION_265_268_oPCAN_RADAR_3ed45d80_Tx: ComBitPosition=336, ComBitSize=6, ComSignalInitValue=0, ComSignalType=UINT8, ComHandleId=5573, ComSystemTemplateSystemSignalRef=DET_EXISTENCE_PROB_267
            DET_RANGE_VELOCITY_ERR_268_oRDR_DETECTION_265_268_oPCAN_RADAR_fc57b7f2_Tx: ComBitPosition=400, ComBitSize=8, ComSignalInitValue=0, ComSignalType=UINT8, ComHandleId=5609, ComSystemTemplateSystemSignalRef=DET_RANGE_VELOCITY_ERR_268
            DET_HVC_FLAG_267_oRDR_DETECTION_265_268_oPCAN_RADAR_dfa01eff_Tx: ComBitPosition=310, ComBitSize=1, ComSignalInitValue=0, ComSignalType=BOOLEAN, ComHandleId=5577, ComSystemTemplateSystemSignalRef=DET_HVC_FLAG_267
            DET_RANGE_ERR_265_oRDR_DETECTION_265_268_oPCAN_RADAR_fc220920_Tx: ComBitPosition=40, ComBitSize=7, ComSignalInitValue=0, ComSignalType=UINT8, ComHandleId=5598, ComSystemTemplateSystemSignalRef=DET_RANGE_ERR_265
            DET_CONFD_ELEVATION_265_oRDR_DETECTION_265_268_oPCAN_RADAR_4b22cbc2_Tx: ComBitPosition=101, ComBitSize=2, ComSignalInitValue=0, ComSignalType=UINT8, ComHandleId=5559, ComSystemTemplateSystemSignalRef=DET_CONFD_ELEVATION_265
            DET_SUPER_RES_TARGET_268_oRDR_DETECTION_265_268_oPCAN_RADAR_985b077d_Tx: ComBitPosition=423, ComBitSize=1, ComSignalInitValue=0, ComSignalType=BOOLEAN, ComHandleId=5621, ComSystemTemplateSystemSignalRef=DET_SUPER_RES_TARGET_268
            DET_ELEVATION_267_oRDR_DETECTION_265_268_oPCAN_RADAR_6b72b095_Tx: ComBitPosition=296, ComBitSize=8, ComSignalInitValue=0, ComSignalType=UINT8, ComHandleId=5565, ComSystemTemplateSystemSignalRef=DET_ELEVATION_267
            DET_CONFD_AZIMUTH_266_oRDR_DETECTION_265_268_oPCAN_RADAR_2d57b1c6_Tx: ComBitPosition=230, ComBitSize=2, ComSignalInitValue=0, ComSignalType=UINT8, ComHandleId=5556, ComSystemTemplateSystemSignalRef=DET_CONFD_AZIMUTH_266
            DET_HVC_FLAG_265_oRDR_DETECTION_265_268_oPCAN_RADAR_2e30b194_Tx: ComBitPosition=86, ComBitSize=1, ComSignalInitValue=0, ComSignalType=BOOLEAN, ComHandleId=5575, ComSystemTemplateSystemSignalRef=DET_HVC_FLAG_265
            DET_RANGE_VELOCITY_ERR_266_oRDR_DETECTION_265_268_oPCAN_RADAR_4537f120_Tx: ComBitPosition=176, ComBitSize=8, ComSignalInitValue=0, ComSignalType=UINT8, ComHandleId=5607, ComSystemTemplateSystemSignalRef=DET_RANGE_VELOCITY_ERR_266
            DET_AZIMUTH_ERR_266_oRDR_DETECTION_265_268_oPCAN_RADAR_8b042ef9_Tx: ComBitPosition=217, ComBitSize=7, ComSignalInitValue=0, ComSignalType=UINT8, ComHandleId=5544, ComSystemTemplateSystemSignalRef=DET_AZIMUTH_ERR_266
            DET_RCS_265_oRDR_DETECTION_265_268_oPCAN_RADAR_a9ec4636_Tx: ComBitPosition=128, ComBitSize=8, ComSignalInitValue=128, ComSignalType=UINT8, ComHandleId=5610, ComSystemTemplateSystemSignalRef=DET_RCS_265
            DET_CONFD_AZIMUTH_265_oRDR_DETECTION_265_268_oPCAN_RADAR_49b7ca38_Tx: ComBitPosition=118, ComBitSize=2, ComSignalInitValue=0, ComSignalType=UINT8, ComHandleId=5555, ComSystemTemplateSystemSignalRef=DET_CONFD_AZIMUTH_265
            DET_ELEVATION_266_oRDR_DETECTION_265_268_oPCAN_RADAR_fe026400_Tx: ComBitPosition=184, ComBitSize=8, ComSignalInitValue=0, ComSignalType=UINT8, ComHandleId=5564, ComSystemTemplateSystemSignalRef=DET_ELEVATION_266
            DET_ELEVATION_265_oRDR_DETECTION_265_268_oPCAN_RADAR_9ae21ffe_Tx: ComBitPosition=72, ComBitSize=8, ComSignalInitValue=0, ComSignalType=UINT8, ComHandleId=5563, ComSystemTemplateSystemSignalRef=DET_ELEVATION_265
            DET_EXISTENCE_PROB_265_oRDR_DETECTION_265_268_oPCAN_RADAR_cf44f2eb_Tx: ComBitPosition=112, ComBitSize=6, ComSignalInitValue=0, ComSignalType=UINT8, ComHandleId=5571, ComSystemTemplateSystemSignalRef=DET_EXISTENCE_PROB_265
            DET_AZIMUTH_ERR_267_oRDR_DETECTION_265_268_oPCAN_RADAR_1e74fa6c_Tx: ComBitPosition=329, ComBitSize=7, ComSignalInitValue=0, ComSignalType=UINT8, ComHandleId=5545, ComSystemTemplateSystemSignalRef=DET_AZIMUTH_ERR_267
            DET_SUPER_RES_TARGET_265_oRDR_DETECTION_265_268_oPCAN_RADAR_45db3a51_Tx: ComBitPosition=87, ComBitSize=1, ComSignalInitValue=0, ComSignalType=BOOLEAN, ComHandleId=5618, ComSystemTemplateSystemSignalRef=DET_SUPER_RES_TARGET_265
            DET_RANGE_ERR_266_oRDR_DETECTION_265_268_oPCAN_RADAR_98c272de_Tx: ComBitPosition=152, ComBitSize=7, ComSignalInitValue=0, ComSignalType=UINT8, ComHandleId=5599, ComSystemTemplateSystemSignalRef=DET_RANGE_ERR_266
            DET_EXISTENCE_PROB_268_oRDR_DETECTION_265_268_oPCAN_RADAR_12c4cfc7_Tx: ComBitPosition=448, ComBitSize=6, ComSignalInitValue=0, ComSignalType=UINT8, ComHandleId=5574, ComSystemTemplateSystemSignalRef=DET_EXISTENCE_PROB_268
            DET_MH_SCAN_INDEX_4LSB_265_268_oRDR_DETECTION_265_268_oPCAN_RADAR_b89252c9_Tx: ComBitPosition=476, ComBitSize=4, ComSignalInitValue=0, ComSignalType=UINT8, ComHandleId=5585, ComSystemTemplateSystemSignalRef=DET_MH_SCAN_INDEX_4LSB_265_268
            DET_RANGE_268_oRDR_DETECTION_265_268_oPCAN_RADAR_864a8e65_Tx: ComBitPosition=360, ComBitSize=15, ComSignalInitValue=0, ComSignalType=UINT16, ComHandleId=5597, ComSystemTemplateSystemSignalRef=DET_RANGE_268
            DET_RANGE_VELOCITY_267_oRDR_DETECTION_265_268_oPCAN_RADAR_dffcde07_Tx: ComBitPosition=272, ComBitSize=15, ComSignalInitValue=16384, ComSignalType=UINT16, ComHandleId=5604, ComSystemTemplateSystemSignalRef=DET_RANGE_VELOCITY_267
            DET_RANGE_VELOCITY_268_oRDR_DETECTION_265_268_oPCAN_RADAR_f3ec4c40_Tx: ComBitPosition=384, ComBitSize=15, ComSignalInitValue=16384, ComSignalType=UINT16, ComHandleId=5605, ComSystemTemplateSystemSignalRef=DET_RANGE_VELOCITY_268
            DET_BI_STATIC_FLAG_266_oRDR_DETECTION_265_268_oPCAN_RADAR_799dfb89_Tx: ComBitPosition=216, ComBitSize=1, ComSignalInitValue=0, ComSignalType=BOOLEAN, ComHandleId=5552, ComSystemTemplateSystemSignalRef=DET_BI_STATIC_FLAG_266
            DET_RANGE_VELOCITY_265_oRDR_DETECTION_265_268_oPCAN_RADAR_2e6c716c_Tx: ComBitPosition=48, ComBitSize=15, ComSignalInitValue=16384, ComSignalType=UINT16, ComHandleId=5602, ComSystemTemplateSystemSignalRef=DET_RANGE_VELOCITY_265
            DET_BI_STATIC_FLAG_265_oRDR_DETECTION_265_268_oPCAN_RADAR_1d7d8077_Tx: ComBitPosition=104, ComBitSize=1, ComSignalInitValue=0, ComSignalType=BOOLEAN, ComHandleId=5551, ComSystemTemplateSystemSignalRef=DET_BI_STATIC_FLAG_265
            DET_BI_STATIC_FLAG_268_oRDR_DETECTION_265_268_oPCAN_RADAR_c0fdbd5b_Tx: ComBitPosition=440, ComBitSize=1, ComSignalInitValue=0, ComSignalType=BOOLEAN, ComHandleId=5554, ComSystemTemplateSystemSignalRef=DET_BI_STATIC_FLAG_268
            DET_ELEVATION_ERR_267_oRDR_DETECTION_265_268_oPCAN_RADAR_ec4b28e0_Tx: ComBitPosition=304, ComBitSize=6, ComSignalInitValue=0, ComSignalType=UINT8, ComHandleId=5569, ComSystemTemplateSystemSignalRef=DET_ELEVATION_ERR_267
            DET_CONFD_ELEVATION_266_oRDR_DETECTION_265_268_oPCAN_RADAR_2fc2b03c_Tx: ComBitPosition=213, ComBitSize=2, ComSignalInitValue=0, ComSignalType=UINT8, ComHandleId=5560, ComSystemTemplateSystemSignalRef=DET_CONFD_ELEVATION_266
            DET_ELEVATION_268_oRDR_DETECTION_265_268_oPCAN_RADAR_476222d2_Tx: ComBitPosition=408, ComBitSize=8, ComSignalInitValue=0, ComSignalType=UINT8, ComHandleId=5566, ComSystemTemplateSystemSignalRef=DET_ELEVATION_268
            DET_EXISTENCE_PROB_266_oRDR_DETECTION_265_268_oPCAN_RADAR_aba48915_Tx: ComBitPosition=224, ComBitSize=6, ComSignalInitValue=0, ComSignalType=UINT8, ComHandleId=5572, ComSystemTemplateSystemSignalRef=DET_EXISTENCE_PROB_266
            DET_RANGE_266_oRDR_DETECTION_265_268_oPCAN_RADAR_3f2ac8b7_Tx: ComBitPosition=136, ComBitSize=15, ComSignalInitValue=0, ComSignalType=UINT16, ComHandleId=5595, ComSystemTemplateSystemSignalRef=DET_RANGE_266
            DET_MH_CRC16_265_268_oRDR_DETECTION_265_268_oPCAN_RADAR_f0cdd672_Tx: ComBitPosition=0, ComBitSize=16, ComSignalInitValue=0, ComSignalType=UINT16, ComHandleId=5583, ComSystemTemplateSystemSignalRef=DET_MH_CRC16_265_268
            DET_SNR_267_oRDR_DETECTION_265_268_oPCAN_RADAR_85d2bd5f_Tx: ComBitPosition=344, ComBitSize=8, ComSignalInitValue=0, ComSignalType=UINT8, ComHandleId=5616, ComSystemTemplateSystemSignalRef=DET_SNR_267
            DET_CONFD_ELEVATION_268_oRDR_DETECTION_265_268_oPCAN_RADAR_96a2f6ee_Tx: ComBitPosition=437, ComBitSize=2, ComSignalInitValue=0, ComSignalType=UINT8, ComHandleId=5562, ComSystemTemplateSystemSignalRef=DET_CONFD_ELEVATION_268
            DET_AZIMUTH_ERR_268_oRDR_DETECTION_265_268_oPCAN_RADAR_3264682b_Tx: ComBitPosition=441, ComBitSize=7, ComSignalInitValue=0, ComSignalType=UINT8, ComHandleId=5546, ComSystemTemplateSystemSignalRef=DET_AZIMUTH_ERR_268
            DET_RANGE_ERR_268_oRDR_DETECTION_265_268_oPCAN_RADAR_21a2340c_Tx: ComBitPosition=376, ComBitSize=7, ComSignalInitValue=0, ComSignalType=UINT8, ComHandleId=5601, ComSystemTemplateSystemSignalRef=DET_RANGE_ERR_268
            DET_CONFD_ELEVATION_267_oRDR_DETECTION_265_268_oPCAN_RADAR_bab264a9_Tx: ComBitPosition=325, ComBitSize=2, ComSignalInitValue=0, ComSignalType=UINT8, ComHandleId=5561, ComSystemTemplateSystemSignalRef=DET_CONFD_ELEVATION_267
            DET_RCS_268_oRDR_DETECTION_265_268_oPCAN_RADAR_746c7b1a_Tx: ComBitPosition=464, ComBitSize=8, ComSignalInitValue=128, ComSignalType=UINT8, ComHandleId=5613, ComSystemTemplateSystemSignalRef=DET_RCS_268
            DET_ELEVATION_ERR_266_oRDR_DETECTION_265_268_oPCAN_RADAR_793bfc75_Tx: ComBitPosition=192, ComBitSize=6, ComSignalInitValue=0, ComSignalType=UINT8, ComHandleId=5568, ComSystemTemplateSystemSignalRef=DET_ELEVATION_ERR_266
            DET_SNR_268_oRDR_DETECTION_265_268_oPCAN_RADAR_a9c22f18_Tx: ComBitPosition=456, ComBitSize=8, ComSignalInitValue=0, ComSignalType=UINT8, ComHandleId=5617, ComSystemTemplateSystemSignalRef=DET_SNR_268
            DET_RCS_267_oRDR_DETECTION_265_268_oPCAN_RADAR_587ce95d_Tx: ComBitPosition=352, ComBitSize=8, ComSignalInitValue=128, ComSignalType=UINT8, ComHandleId=5612, ComSystemTemplateSystemSignalRef=DET_RCS_267
            DET_RANGE_267_oRDR_DETECTION_265_268_oPCAN_RADAR_aa5a1c22_Tx: ComBitPosition=248, ComBitSize=15, ComSignalInitValue=0, ComSignalType=UINT16, ComHandleId=5596, ComSystemTemplateSystemSignalRef=DET_RANGE_267
            DET_SNR_266_oRDR_DETECTION_265_268_oPCAN_RADAR_10a269ca_Tx: ComBitPosition=232, ComBitSize=8, ComSignalInitValue=0, ComSignalType=UINT8, ComHandleId=5615, ComSystemTemplateSystemSignalRef=DET_SNR_266
            DET_AZIMUTH_266_oRDR_DETECTION_265_268_oPCAN_RADAR_2fb1bb0c_Tx: ComBitPosition=200, ComBitSize=13, ComSignalInitValue=0, ComSignalType=UINT16, ComHandleId=5540, ComSystemTemplateSystemSignalRef=DET_AZIMUTH_266
            DET_AZIMUTH_265_oRDR_DETECTION_265_268_oPCAN_RADAR_4b51c0f2_Tx: ComBitPosition=88, ComBitSize=13, ComSignalInitValue=0, ComSignalType=UINT16, ComHandleId=5539, ComSystemTemplateSystemSignalRef=DET_AZIMUTH_265
            DET_SNR_265_oRDR_DETECTION_265_268_oPCAN_RADAR_74421234_Tx: ComBitPosition=120, ComBitSize=8, ComSignalInitValue=0, ComSignalType=UINT8, ComHandleId=5614, ComSystemTemplateSystemSignalRef=DET_SNR_265
            DET_IDM_267_oRDR_DETECTION_265_268_oPCAN_RADAR_54f22542_Tx: ComBitPosition=287, ComBitSize=1, ComSignalInitValue=0, ComSignalType=UINT8, ComHandleId=5581, ComSystemTemplateSystemSignalRef=DET_IDM_267
            DET_IDM_268_oRDR_DETECTION_265_268_oPCAN_RADAR_78e2b705_Tx: ComBitPosition=399, ComBitSize=1, ComSignalInitValue=0, ComSignalType=UINT8, ComHandleId=5582, ComSystemTemplateSystemSignalRef=DET_IDM_268
            DET_PROB_1STAZHYPO_265_oRDR_DETECTION_265_268_oPCAN_RADAR_5065503f_Tx: ComBitPosition=103, ComBitSize=1, ComSignalInitValue=0, ComSignalType=BOOLEAN, ComHandleId=5590, ComSystemTemplateSystemSignalRef=DET_PROB_1STAZHYPO_265
            DET_MTD_265_oRDR_DETECTION_265_268_oPCAN_RADAR_c3d1b8f2_Tx: ComBitPosition=47, ComBitSize=1, ComSignalInitValue=0, ComSignalType=UINT8, ComHandleId=5586, ComSystemTemplateSystemSignalRef=DET_MTD_265
            DET_BELOW_RAIN_THOLD_266_oRDR_DETECTION_265_268_oPCAN_RADAR_fab028cc_Tx: ComBitPosition=151, ComBitSize=1, ComSignalInitValue=0, ComSignalType=UINT8, ComHandleId=5548, ComSystemTemplateSystemSignalRef=DET_BELOW_RAIN_THOLD_266
            DET_MTD_268_oRDR_DETECTION_265_268_oPCAN_RADAR_1e5185de_Tx: ComBitPosition=383, ComBitSize=1, ComSignalInitValue=0, ComSignalType=UINT8, ComHandleId=5589, ComSystemTemplateSystemSignalRef=DET_MTD_268
            DET_BELOW_RAIN_THOLD_268_oRDR_DETECTION_265_268_oPCAN_RADAR_43d06e1e_Tx: ComBitPosition=375, ComBitSize=1, ComSignalInitValue=0, ComSignalType=UINT8, ComHandleId=5550, ComSystemTemplateSystemSignalRef=DET_BELOW_RAIN_THOLD_268
            DET_BELOW_RAIN_THOLD_265_oRDR_DETECTION_265_268_oPCAN_RADAR_9e505332_Tx: ComBitPosition=39, ComBitSize=1, ComSignalInitValue=0, ComSignalType=UINT8, ComHandleId=5547, ComSystemTemplateSystemSignalRef=DET_BELOW_RAIN_THOLD_265
            DET_PROB_1STAZHYPO_267_oRDR_DETECTION_265_268_oPCAN_RADAR_a1f5ff54_Tx: ComBitPosition=327, ComBitSize=1, ComSignalInitValue=0, ComSignalType=BOOLEAN, ComHandleId=5592, ComSystemTemplateSystemSignalRef=DET_PROB_1STAZHYPO_267
            DET_PROB_1STAZHYPO_268_oRDR_DETECTION_265_268_oPCAN_RADAR_8de56d13_Tx: ComBitPosition=439, ComBitSize=1, ComSignalInitValue=0, ComSignalType=BOOLEAN, ComHandleId=5593, ComSystemTemplateSystemSignalRef=DET_PROB_1STAZHYPO_268
            DET_IDM_266_oRDR_DETECTION_265_268_oPCAN_RADAR_c182f1d7_Tx: ComBitPosition=175, ComBitSize=1, ComSignalInitValue=0, ComSignalType=UINT8, ComHandleId=5580, ComSystemTemplateSystemSignalRef=DET_IDM_266
            DET_IDM_265_oRDR_DETECTION_265_268_oPCAN_RADAR_a5628a29_Tx: ComBitPosition=63, ComBitSize=1, ComSignalInitValue=0, ComSignalType=UINT8, ComHandleId=5579, ComSystemTemplateSystemSignalRef=DET_IDM_265
            DET_PROB_1STAZHYPO_266_oRDR_DETECTION_265_268_oPCAN_RADAR_34852bc1_Tx: ComBitPosition=215, ComBitSize=1, ComSignalInitValue=0, ComSignalType=BOOLEAN, ComHandleId=5591, ComSystemTemplateSystemSignalRef=DET_PROB_1STAZHYPO_266
            DET_MTD_266_oRDR_DETECTION_265_268_oPCAN_RADAR_a731c30c_Tx: ComBitPosition=159, ComBitSize=1, ComSignalInitValue=0, ComSignalType=UINT8, ComHandleId=5587, ComSystemTemplateSystemSignalRef=DET_MTD_266
            DET_BELOW_RAIN_THOLD_267_oRDR_DETECTION_265_268_oPCAN_RADAR_6fc0fc59_Tx: ComBitPosition=263, ComBitSize=1, ComSignalInitValue=0, ComSignalType=UINT8, ComHandleId=5549, ComSystemTemplateSystemSignalRef=DET_BELOW_RAIN_THOLD_267
            DET_MTD_267_oRDR_DETECTION_265_268_oPCAN_RADAR_32411799_Tx: ComBitPosition=271, ComBitSize=1, ComSignalInitValue=0, ComSignalType=UINT8, ComHandleId=5588, ComSystemTemplateSystemSignalRef=DET_MTD_267
        SG_Detections_277_280_oRDR_DETECTION_277_280_oPCAN_RADAR_ab98744c_Tx: ComTransferProperty=TRIGGERED, ComHandleId=71, ComSystemTemplateSignalGroupRef=SG_Detections_277_280
          83 x ComGroupSignal, all with ComSignalEndianness=LITTLE_ENDIAN, ComTransferProperty=PENDING, ComSignalAccess=ACCESS_NEEDED_BY_SWC_OR_COM:
            DET_CONFD_AZIMUTH_279_oRDR_DETECTION_277_280_oPCAN_RADAR_2b419455_Tx: ComBitPosition=342, ComBitSize=2, ComSignalInitValue=0, ComSignalType=UINT8, ComHandleId=5806, ComSystemTemplateSystemSignalRef=DET_CONFD_AZIMUTH_279
            DET_CONFD_AZIMUTH_280_oRDR_DETECTION_277_280_oPCAN_RADAR_2605354f_Tx: ComBitPosition=454, ComBitSize=2, ComSignalInitValue=0, ComSignalType=UINT8, ComHandleId=5807, ComSystemTemplateSystemSignalRef=DET_CONFD_AZIMUTH_280
            DET_RANGE_VELOCITY_ERR_277_oRDR_DETECTION_277_280_oPCAN_RADAR_fa419261_Tx: ComBitPosition=64, ComBitSize=8, ComSignalInitValue=0, ComSignalType=UINT8, ComHandleId=5855, ComSystemTemplateSystemSignalRef=DET_RANGE_VELOCITY_ERR_277
            DET_SNR_279_oRDR_DETECTION_277_280_oPCAN_RADAR_16b44c59_Tx: ComBitPosition=344, ComBitSize=8, ComSignalInitValue=0, ComSignalType=UINT8, ComHandleId=5865, ComSystemTemplateSystemSignalRef=DET_SNR_279
            DET_AZIMUTH_ERR_279_oRDR_DETECTION_277_280_oPCAN_RADAR_8d120b6a_Tx: ComBitPosition=329, ComBitSize=7, ComSignalInitValue=0, ComSignalType=UINT8, ComHandleId=5794, ComSystemTemplateSystemSignalRef=DET_AZIMUTH_ERR_279
            DET_SUPER_RES_TARGET_279_oRDR_DETECTION_277_280_oPCAN_RADAR_272d643c_Tx: ComBitPosition=311, ComBitSize=1, ComSignalInitValue=0, ComSignalType=BOOLEAN, ComHandleId=5869, ComSystemTemplateSystemSignalRef=DET_SUPER_RES_TARGET_279
            DET_HVC_FLAG_279_oRDR_DETECTION_277_280_oPCAN_RADAR_4cc6eff9_Tx: ComBitPosition=310, ComBitSize=1, ComSignalInitValue=0, ComSignalType=BOOLEAN, ComHandleId=5826, ComSystemTemplateSystemSignalRef=DET_HVC_FLAG_279
            DET_RCS_279_oRDR_DETECTION_277_280_oPCAN_RADAR_cb1a185b_Tx: ComBitPosition=352, ComBitSize=8, ComSignalInitValue=128, ComSignalType=UINT8, ComHandleId=5861, ComSystemTemplateSystemSignalRef=DET_RCS_279
            DET_BI_STATIC_FLAG_277_oRDR_DETECTION_277_280_oPCAN_RADAR_c6eb98c8_Tx: ComBitPosition=104, ComBitSize=1, ComSignalInitValue=0, ComSignalType=BOOLEAN, ComHandleId=5800, ComSystemTemplateSystemSignalRef=DET_BI_STATIC_FLAG_277
            DET_RANGE_278_oRDR_DETECTION_277_280_oPCAN_RADAR_ac4c39b1_Tx: ComBitPosition=136, ComBitSize=15, ComSignalInitValue=0, ComSignalType=UINT16, ComHandleId=5844, ComSystemTemplateSystemSignalRef=DET_RANGE_278
            DET_RANGE_279_oRDR_DETECTION_277_280_oPCAN_RADAR_393ced24_Tx: ComBitPosition=248, ComBitSize=15, ComSignalInitValue=0, ComSignalType=UINT16, ComHandleId=5845, ComSystemTemplateSystemSignalRef=DET_RANGE_279
            DET_AZIMUTH_ERR_278_oRDR_DETECTION_277_280_oPCAN_RADAR_1862dfff_Tx: ComBitPosition=217, ComBitSize=7, ComSignalInitValue=0, ComSignalType=UINT8, ComHandleId=5793, ComSystemTemplateSystemSignalRef=DET_AZIMUTH_ERR_278
            DET_ELEVATION_ERR_278_oRDR_DETECTION_277_280_oPCAN_RADAR_ea5d0d73_Tx: ComBitPosition=192, ComBitSize=6, ComSignalInitValue=0, ComSignalType=UINT8, ComHandleId=5817, ComSystemTemplateSystemSignalRef=DET_ELEVATION_ERR_278
            DET_MH_CYCLE_COUNTER_277_280_oRDR_DETECTION_277_280_oPCAN_RADAR_ab650770_Tx: ComBitPosition=16, ComBitSize=8, ComSignalInitValue=0, ComSignalType=UINT8, ComHandleId=5833, ComSystemTemplateSystemSignalRef=DET_MH_CYCLE_COUNTER_277_280
            DET_RANGE_ERR_277_oRDR_DETECTION_277_280_oPCAN_RADAR_27b4119f_Tx: ComBitPosition=40, ComBitSize=7, ComSignalInitValue=0, ComSignalType=UINT8, ComHandleId=5847, ComSystemTemplateSystemSignalRef=DET_RANGE_ERR_277
            DET_CONFD_ELEVATION_280_oRDR_DETECTION_277_280_oPCAN_RADAR_249034b5_Tx: ComBitPosition=437, ComBitSize=2, ComSignalInitValue=0, ComSignalType=UINT8, ComHandleId=5811, ComSystemTemplateSystemSignalRef=DET_CONFD_ELEVATION_280
            DET_CONFD_AZIMUTH_278_oRDR_DETECTION_277_280_oPCAN_RADAR_be3140c0_Tx: ComBitPosition=230, ComBitSize=2, ComSignalInitValue=0, ComSignalType=UINT8, ComHandleId=5805, ComSystemTemplateSystemSignalRef=DET_CONFD_AZIMUTH_278
            DET_RANGE_VELOCITY_278_oRDR_DETECTION_277_280_oPCAN_RADAR_d9eafb94_Tx: ComBitPosition=160, ComBitSize=15, ComSignalInitValue=16384, ComSignalType=UINT16, ComHandleId=5852, ComSystemTemplateSystemSignalRef=DET_RANGE_VELOCITY_278
            DET_ELEVATION_ERR_280_oRDR_DETECTION_277_280_oPCAN_RADAR_726978fc_Tx: ComBitPosition=416, ComBitSize=6, ComSignalInitValue=0, ComSignalType=UINT8, ComHandleId=5819, ComSystemTemplateSystemSignalRef=DET_ELEVATION_ERR_280
            DET_RANGE_VELOCITY_279_oRDR_DETECTION_277_280_oPCAN_RADAR_4c9a2f01_Tx: ComBitPosition=272, ComBitSize=15, ComSignalInitValue=16384, ComSignalType=UINT16, ComHandleId=5853, ComSystemTemplateSystemSignalRef=DET_RANGE_VELOCITY_279
            DET_BI_STATIC_FLAG_278_oRDR_DETECTION_277_280_oPCAN_RADAR_eafb0a8f_Tx: ComBitPosition=216, ComBitSize=1, ComSignalInitValue=0, ComSignalType=BOOLEAN, ComHandleId=5801, ComSystemTemplateSystemSignalRef=DET_BI_STATIC_FLAG_278
            DET_RANGE_VELOCITY_ERR_280_oRDR_DETECTION_277_280_oPCAN_RADAR_4e6575a9_Tx: ComBitPosition=400, ComBitSize=8, ComSignalInitValue=0, ComSignalType=UINT8, ComHandleId=5858, ComSystemTemplateSystemSignalRef=DET_RANGE_VELOCITY_ERR_280
            DET_HVC_FLAG_277_oRDR_DETECTION_277_280_oPCAN_RADAR_f5a6a92b_Tx: ComBitPosition=86, ComBitSize=1, ComSignalInitValue=0, ComSignalType=BOOLEAN, ComHandleId=5824, ComSystemTemplateSystemSignalRef=DET_HVC_FLAG_277
            DET_SUPER_RES_TARGET_280_oRDR_DETECTION_277_280_oPCAN_RADAR_2a69c526_Tx: ComBitPosition=423, ComBitSize=1, ComSignalInitValue=0, ComSignalType=BOOLEAN, ComHandleId=5870, ComSystemTemplateSystemSignalRef=DET_SUPER_RES_TARGET_280
            DET_AZIMUTH_280_oRDR_DETECTION_277_280_oPCAN_RADAR_24e33f85_Tx: ComBitPosition=424, ComBitSize=13, ComSignalInitValue=0, ComSignalType=UINT16, ComHandleId=5791, ComSystemTemplateSystemSignalRef=DET_AZIMUTH_280
            DET_MH_CRC16_277_280_oRDR_DETECTION_277_280_oPCAN_RADAR_2f10a647_Tx: ComBitPosition=0, ComBitSize=16, ComSignalInitValue=0, ComSignalType=UINT16, ComHandleId=5832, ComSystemTemplateSystemSignalRef=DET_MH_CRC16_277_280
            DET_SUPER_RES_TARGET_277_oRDR_DETECTION_277_280_oPCAN_RADAR_9e4d22ee_Tx: ComBitPosition=87, ComBitSize=1, ComSignalInitValue=0, ComSignalType=BOOLEAN, ComHandleId=5867, ComSystemTemplateSystemSignalRef=DET_SUPER_RES_TARGET_277
            DET_BI_STATIC_FLAG_279_oRDR_DETECTION_277_280_oPCAN_RADAR_7f8bde1a_Tx: ComBitPosition=328, ComBitSize=1, ComSignalInitValue=0, ComSignalType=BOOLEAN, ComHandleId=5802, ComSystemTemplateSystemSignalRef=DET_BI_STATIC_FLAG_279
            DET_BI_STATIC_FLAG_280_oRDR_DETECTION_277_280_oPCAN_RADAR_72cf7f00_Tx: ComBitPosition=440, ComBitSize=1, ComSignalInitValue=0, ComSignalType=BOOLEAN, ComHandleId=5803, ComSystemTemplateSystemSignalRef=DET_BI_STATIC_FLAG_280
            DET_RANGE_VELOCITY_280_oRDR_DETECTION_277_280_oPCAN_RADAR_41de8e1b_Tx: ComBitPosition=384, ComBitSize=15, ComSignalInitValue=16384, ComSignalType=UINT16, ComHandleId=5854, ComSystemTemplateSystemSignalRef=DET_RANGE_VELOCITY_280
            DET_ELEVATION_277_oRDR_DETECTION_277_280_oPCAN_RADAR_41740741_Tx: ComBitPosition=72, ComBitSize=8, ComSignalInitValue=0, ComSignalType=UINT8, ComHandleId=5812, ComSystemTemplateSystemSignalRef=DET_ELEVATION_277
            DET_ELEVATION_280_oRDR_DETECTION_277_280_oPCAN_RADAR_f550e089_Tx: ComBitPosition=408, ComBitSize=8, ComSignalInitValue=0, ComSignalType=UINT8, ComHandleId=5815, ComSystemTemplateSystemSignalRef=DET_ELEVATION_280
            DET_EXISTENCE_PROB_277_oRDR_DETECTION_277_280_oPCAN_RADAR_14d2ea54_Tx: ComBitPosition=112, ComBitSize=6, ComSignalInitValue=0, ComSignalType=UINT8, ComHandleId=5820, ComSystemTemplateSystemSignalRef=DET_EXISTENCE_PROB_277
            DET_RANGE_VELOCITY_ERR_278_oRDR_DETECTION_277_280_oPCAN_RADAR_d6510026_Tx: ComBitPosition=176, ComBitSize=8, ComSignalInitValue=0, ComSignalType=UINT8, ComHandleId=5856, ComSystemTemplateSystemSignalRef=DET_RANGE_VELOCITY_ERR_278
            DET_AZIMUTH_278_oRDR_DETECTION_277_280_oPCAN_RADAR_bcd74a0a_Tx: ComBitPosition=200, ComBitSize=13, ComSignalInitValue=0, ComSignalType=UINT16, ComHandleId=5789, ComSystemTemplateSystemSignalRef=DET_AZIMUTH_278
            DET_RANGE_ERR_278_oRDR_DETECTION_277_280_oPCAN_RADAR_0ba483d8_Tx: ComBitPosition=152, ComBitSize=7, ComSignalInitValue=0, ComSignalType=UINT8, ComHandleId=5848, ComSystemTemplateSystemSignalRef=DET_RANGE_ERR_278
            DET_CONFD_ELEVATION_278_oRDR_DETECTION_277_280_oPCAN_RADAR_bca4413a_Tx: ComBitPosition=213, ComBitSize=2, ComSignalInitValue=0, ComSignalType=UINT8, ComHandleId=5809, ComSystemTemplateSystemSignalRef=DET_CONFD_ELEVATION_278
            DET_EXISTENCE_PROB_278_oRDR_DETECTION_277_280_oPCAN_RADAR_38c27813_Tx: ComBitPosition=224, ComBitSize=6, ComSignalInitValue=0, ComSignalType=UINT8, ComHandleId=5821, ComSystemTemplateSystemSignalRef=DET_EXISTENCE_PROB_278
            DET_EXISTENCE_PROB_279_oRDR_DETECTION_277_280_oPCAN_RADAR_adb2ac86_Tx: ComBitPosition=336, ComBitSize=6, ComSignalInitValue=0, ComSignalType=UINT8, ComHandleId=5822, ComSystemTemplateSystemSignalRef=DET_EXISTENCE_PROB_279
            DET_SNR_278_oRDR_DETECTION_277_280_oPCAN_RADAR_83c498cc_Tx: ComBitPosition=232, ComBitSize=8, ComSignalInitValue=0, ComSignalType=UINT8, ComHandleId=5864, ComSystemTemplateSystemSignalRef=DET_SNR_278
            DET_ELEVATION_278_oRDR_DETECTION_277_280_oPCAN_RADAR_6d649506_Tx: ComBitPosition=184, ComBitSize=8, ComSignalInitValue=0, ComSignalType=UINT8, ComHandleId=5813, ComSystemTemplateSystemSignalRef=DET_ELEVATION_278
            DET_MH_SCAN_INDEX_4LSB_277_280_oRDR_DETECTION_277_280_oPCAN_RADAR_674f22fc_Tx: ComBitPosition=476, ComBitSize=4, ComSignalInitValue=0, ComSignalType=UINT8, ComHandleId=5834, ComSystemTemplateSystemSignalRef=DET_MH_SCAN_INDEX_4LSB_277_280
            DET_ELEVATION_279_oRDR_DETECTION_277_280_oPCAN_RADAR_f8144193_Tx: ComBitPosition=296, ComBitSize=8, ComSignalInitValue=0, ComSignalType=UINT8, ComHandleId=5814, ComSystemTemplateSystemSignalRef=DET_ELEVATION_279
            DET_RCS_280_oRDR_DETECTION_277_280_oPCAN_RADAR_c65eb941_Tx: ComBitPosition=464, ComBitSize=8, ComSignalInitValue=128, ComSignalType=UINT8, ComHandleId=5862, ComSystemTemplateSystemSignalRef=DET_RCS_280
            DET_AZIMUTH_ERR_280_oRDR_DETECTION_277_280_oPCAN_RADAR_8056aa70_Tx: ComBitPosition=441, ComBitSize=7, ComSignalInitValue=0, ComSignalType=UINT8, ComHandleId=5795, ComSystemTemplateSystemSignalRef=DET_AZIMUTH_ERR_280
            DET_CONFD_ELEVATION_279_oRDR_DETECTION_277_280_oPCAN_RADAR_29d495af_Tx: ComBitPosition=325, ComBitSize=2, ComSignalInitValue=0, ComSignalType=UINT8, ComHandleId=5810, ComSystemTemplateSystemSignalRef=DET_CONFD_ELEVATION_279
            DET_RCS_277_oRDR_DETECTION_277_280_oPCAN_RADAR_727a5e89_Tx: ComBitPosition=128, ComBitSize=8, ComSignalInitValue=128, ComSignalType=UINT8, ComHandleId=5859, ComSystemTemplateSystemSignalRef=DET_RCS_277
            DET_CONFD_ELEVATION_277_oRDR_DETECTION_277_280_oPCAN_RADAR_90b4d37d_Tx: ComBitPosition=101, ComBitSize=2, ComSignalInitValue=0, ComSignalType=UINT8, ComHandleId=5808, ComSystemTemplateSystemSignalRef=DET_CONFD_ELEVATION_277
            DET_HVC_FLAG_280_oRDR_DETECTION_277_280_oPCAN_RADAR_41824ee3_Tx: ComBitPosition=422, ComBitSize=1, ComSignalInitValue=0, ComSignalType=BOOLEAN, ComHandleId=5827, ComSystemTemplateSystemSignalRef=DET_HVC_FLAG_280
            DET_RANGE_277_oRDR_DETECTION_277_280_oPCAN_RADAR_805cabf6_Tx: ComBitPosition=24, ComBitSize=15, ComSignalInitValue=0, ComSignalType=UINT16, ComHandleId=5843, ComSystemTemplateSystemSignalRef=DET_RANGE_277
            DET_RCS_278_oRDR_DETECTION_277_280_oPCAN_RADAR_5e6accce_Tx: ComBitPosition=240, ComBitSize=8, ComSignalInitValue=128, ComSignalType=UINT8, ComHandleId=5860, ComSystemTemplateSystemSignalRef=DET_RCS_278
            DET_AZIMUTH_279_oRDR_DETECTION_277_280_oPCAN_RADAR_29a79e9f_Tx: ComBitPosition=312, ComBitSize=13, ComSignalInitValue=0, ComSignalType=UINT16, ComHandleId=5790, ComSystemTemplateSystemSignalRef=DET_AZIMUTH_279
            DET_SNR_280_oRDR_DETECTION_277_280_oPCAN_RADAR_1bf0ed43_Tx: ComBitPosition=456, ComBitSize=8, ComSignalInitValue=0, ComSignalType=UINT8, ComHandleId=5866, ComSystemTemplateSystemSignalRef=DET_SNR_280
            DET_RANGE_VELOCITY_ERR_279_oRDR_DETECTION_277_280_oPCAN_RADAR_4321d4b3_Tx: ComBitPosition=288, ComBitSize=8, ComSignalInitValue=0, ComSignalType=UINT8, ComHandleId=5857, ComSystemTemplateSystemSignalRef=DET_RANGE_VELOCITY_ERR_279
            DET_ELEVATION_ERR_279_oRDR_DETECTION_277_280_oPCAN_RADAR_7f2dd9e6_Tx: ComBitPosition=304, ComBitSize=6, ComSignalInitValue=0, ComSignalType=UINT8, ComHandleId=5818, ComSystemTemplateSystemSignalRef=DET_ELEVATION_ERR_279
            DET_SNR_277_oRDR_DETECTION_277_280_oPCAN_RADAR_afd40a8b_Tx: ComBitPosition=120, ComBitSize=8, ComSignalInitValue=0, ComSignalType=UINT8, ComHandleId=5863, ComSystemTemplateSystemSignalRef=DET_SNR_277
            DET_AZIMUTH_277_oRDR_DETECTION_277_280_oPCAN_RADAR_90c7d84d_Tx: ComBitPosition=88, ComBitSize=13, ComSignalInitValue=0, ComSignalType=UINT16, ComHandleId=5788, ComSystemTemplateSystemSignalRef=DET_AZIMUTH_277
            DET_RANGE_ERR_279_oRDR_DETECTION_277_280_oPCAN_RADAR_9ed4574d_Tx: ComBitPosition=264, ComBitSize=7, ComSignalInitValue=0, ComSignalType=UINT8, ComHandleId=5849, ComSystemTemplateSystemSignalRef=DET_RANGE_ERR_279
            DET_ELEVATION_ERR_277_oRDR_DETECTION_277_280_oPCAN_RADAR_c64d9f34_Tx: ComBitPosition=80, ComBitSize=6, ComSignalInitValue=0, ComSignalType=UINT8, ComHandleId=5816, ComSystemTemplateSystemSignalRef=DET_ELEVATION_ERR_277
            DET_RANGE_VELOCITY_277_oRDR_DETECTION_277_280_oPCAN_RADAR_f5fa69d3_Tx: ComBitPosition=48, ComBitSize=15, ComSignalInitValue=16384, ComSignalType=UINT16, ComHandleId=5851, ComSystemTemplateSystemSignalRef=DET_RANGE_VELOCITY_277
            DET_EXISTENCE_PROB_280_oRDR_DETECTION_277_280_oPCAN_RADAR_a0f60d9c_Tx: ComBitPosition=448, ComBitSize=6, ComSignalInitValue=0, ComSignalType=UINT8, ComHandleId=5823, ComSystemTemplateSystemSignalRef=DET_EXISTENCE_PROB_280
            DET_RANGE_280_oRDR_DETECTION_277_280_oPCAN_RADAR_34784c3e_Tx: ComBitPosition=360, ComBitSize=15, ComSignalInitValue=0, ComSignalType=UINT16, ComHandleId=5846, ComSystemTemplateSystemSignalRef=DET_RANGE_280
            DET_HVC_FLAG_278_oRDR_DETECTION_277_280_oPCAN_RADAR_d9b63b6c_Tx: ComBitPosition=198, ComBitSize=1, ComSignalInitValue=0, ComSignalType=BOOLEAN, ComHandleId=5825, ComSystemTemplateSystemSignalRef=DET_HVC_FLAG_278
            DET_CONFD_AZIMUTH_277_oRDR_DETECTION_277_280_oPCAN_RADAR_9221d287_Tx: ComBitPosition=118, ComBitSize=2, ComSignalInitValue=0, ComSignalType=UINT8, ComHandleId=5804, ComSystemTemplateSystemSignalRef=DET_CONFD_AZIMUTH_277
            DET_SUPER_RES_TARGET_278_oRDR_DETECTION_277_280_oPCAN_RADAR_b25db0a9_Tx: ComBitPosition=199, ComBitSize=1, ComSignalInitValue=0, ComSignalType=BOOLEAN, ComHandleId=5868, ComSystemTemplateSystemSignalRef=DET_SUPER_RES_TARGET_278
            DET_RANGE_ERR_280_oRDR_DETECTION_277_280_oPCAN_RADAR_9390f657_Tx: ComBitPosition=376, ComBitSize=7, ComSignalInitValue=0, ComSignalType=UINT8, ComHandleId=5850, ComSystemTemplateSystemSignalRef=DET_RANGE_ERR_280
            DET_AZIMUTH_ERR_277_oRDR_DETECTION_277_280_oPCAN_RADAR_34724db8_Tx: ComBitPosition=105, ComBitSize=7, ComSignalInitValue=0, ComSignalType=UINT8, ComHandleId=5792, ComSystemTemplateSystemSignalRef=DET_AZIMUTH_ERR_277
            DET_BELOW_RAIN_THOLD_279_oRDR_DETECTION_277_280_oPCAN_RADAR_fca60d5f_Tx: ComBitPosition=263, ComBitSize=1, ComSignalInitValue=0, ComSignalType=UINT8, ComHandleId=5798, ComSystemTemplateSystemSignalRef=DET_BELOW_RAIN_THOLD_279
            DET_BELOW_RAIN_THOLD_280_oRDR_DETECTION_277_280_oPCAN_RADAR_f1e2ac45_Tx: ComBitPosition=375, ComBitSize=1, ComSignalInitValue=0, ComSignalType=UINT8, ComHandleId=5799, ComSystemTemplateSystemSignalRef=DET_BELOW_RAIN_THOLD_280
            DET_IDM_279_oRDR_DETECTION_277_280_oPCAN_RADAR_c794d444_Tx: ComBitPosition=287, ComBitSize=1, ComSignalInitValue=0, ComSignalType=UINT8, ComHandleId=5830, ComSystemTemplateSystemSignalRef=DET_IDM_279
            DET_BELOW_RAIN_THOLD_277_oRDR_DETECTION_277_280_oPCAN_RADAR_45c64b8d_Tx: ComBitPosition=39, ComBitSize=1, ComSignalInitValue=0, ComSignalType=UINT8, ComHandleId=5796, ComSystemTemplateSystemSignalRef=DET_BELOW_RAIN_THOLD_277
            DET_MTD_277_oRDR_DETECTION_277_280_oPCAN_RADAR_1847a04d_Tx: ComBitPosition=47, ComBitSize=1, ComSignalInitValue=0, ComSignalType=UINT8, ComHandleId=5835, ComSystemTemplateSystemSignalRef=DET_MTD_277
            DET_IDM_278_oRDR_DETECTION_277_280_oPCAN_RADAR_52e400d1_Tx: ComBitPosition=175, ComBitSize=1, ComSignalInitValue=0, ComSignalType=UINT8, ComHandleId=5829, ComSystemTemplateSystemSignalRef=DET_IDM_278
            DET_MTD_278_oRDR_DETECTION_277_280_oPCAN_RADAR_3457320a_Tx: ComBitPosition=159, ComBitSize=1, ComSignalInitValue=0, ComSignalType=UINT8, ComHandleId=5836, ComSystemTemplateSystemSignalRef=DET_MTD_278
            DET_PROB_1STAZHYPO_278_oRDR_DETECTION_277_280_oPCAN_RADAR_a7e3dac7_Tx: ComBitPosition=215, ComBitSize=1, ComSignalInitValue=0, ComSignalType=BOOLEAN, ComHandleId=5840, ComSystemTemplateSystemSignalRef=DET_PROB_1STAZHYPO_278
            DET_IDM_277_oRDR_DETECTION_277_280_oPCAN_RADAR_7ef49296_Tx: ComBitPosition=63, ComBitSize=1, ComSignalInitValue=0, ComSignalType=UINT8, ComHandleId=5828, ComSystemTemplateSystemSignalRef=DET_IDM_277
            DET_MTD_279_oRDR_DETECTION_277_280_oPCAN_RADAR_a127e69f_Tx: ComBitPosition=271, ComBitSize=1, ComSignalInitValue=0, ComSignalType=UINT8, ComHandleId=5837, ComSystemTemplateSystemSignalRef=DET_MTD_279
            DET_PROB_1STAZHYPO_277_oRDR_DETECTION_277_280_oPCAN_RADAR_8bf34880_Tx: ComBitPosition=103, ComBitSize=1, ComSignalInitValue=0, ComSignalType=BOOLEAN, ComHandleId=5839, ComSystemTemplateSystemSignalRef=DET_PROB_1STAZHYPO_277
            DET_PROB_1STAZHYPO_280_oRDR_DETECTION_277_280_oPCAN_RADAR_3fd7af48_Tx: ComBitPosition=439, ComBitSize=1, ComSignalInitValue=0, ComSignalType=BOOLEAN, ComHandleId=5842, ComSystemTemplateSystemSignalRef=DET_PROB_1STAZHYPO_280
            DET_IDM_280_oRDR_DETECTION_277_280_oPCAN_RADAR_cad0755e_Tx: ComBitPosition=399, ComBitSize=1, ComSignalInitValue=0, ComSignalType=UINT8, ComHandleId=5831, ComSystemTemplateSystemSignalRef=DET_IDM_280
            DET_BELOW_RAIN_THOLD_278_oRDR_DETECTION_277_280_oPCAN_RADAR_69d6d9ca_Tx: ComBitPosition=151, ComBitSize=1, ComSignalInitValue=0, ComSignalType=UINT8, ComHandleId=5797, ComSystemTemplateSystemSignalRef=DET_BELOW_RAIN_THOLD_278
            DET_PROB_1STAZHYPO_279_oRDR_DETECTION_277_280_oPCAN_RADAR_32930e52_Tx: ComBitPosition=327, ComBitSize=1, ComSignalInitValue=0, ComSignalType=BOOLEAN, ComHandleId=5841, ComSystemTemplateSystemSignalRef=DET_PROB_1STAZHYPO_279
            DET_MTD_280_oRDR_DETECTION_277_280_oPCAN_RADAR_ac634785_Tx: ComBitPosition=383, ComBitSize=1, ComSignalInitValue=0, ComSignalType=UINT8, ComHandleId=5838, ComSystemTemplateSystemSignalRef=DET_MTD_280
        SG_Detections_385_388_oRDR_DETECTION_385_388_oPCAN_RADAR_bca5477b_Tx: ComTransferProperty=TRIGGERED, ComHandleId=98, ComSystemTemplateSignalGroupRef=SG_Detections_385_388
          83 x ComGroupSignal, all with ComSignalEndianness=LITTLE_ENDIAN, ComTransferProperty=PENDING, ComSignalAccess=ACCESS_NEEDED_BY_SWC_OR_COM:
            DET_ELEVATION_388_oRDR_DETECTION_385_388_oPCAN_RADAR_1e211037_Tx: ComBitPosition=408, ComBitSize=8, ComSignalInitValue=0, ComSignalType=UINT8, ComHandleId=8056, ComSystemTemplateSystemSignalRef=DET_ELEVATION_388
            DET_RANGE_VELOCITY_387_oRDR_DETECTION_385_388_oPCAN_RADAR_86bfece2_Tx: ComBitPosition=272, ComBitSize=15, ComSignalInitValue=16384, ComSignalType=UINT16, ComHandleId=8094, ComSystemTemplateSystemSignalRef=DET_RANGE_VELOCITY_387
            DET_EXISTENCE_PROB_386_oRDR_DETECTION_385_388_oPCAN_RADAR_f2e7bbf0_Tx: ComBitPosition=224, ComBitSize=6, ComSignalInitValue=0, ComSignalType=UINT8, ComHandleId=8062, ComSystemTemplateSystemSignalRef=DET_EXISTENCE_PROB_386
            DET_RANGE_VELOCITY_ERR_388_oRDR_DETECTION_385_388_oPCAN_RADAR_a5148517_Tx: ComBitPosition=400, ComBitSize=8, ComSignalInitValue=0, ComSignalType=UINT8, ComHandleId=8099, ComSystemTemplateSystemSignalRef=DET_RANGE_VELOCITY_ERR_388
            DET_CONFD_AZIMUTH_387_oRDR_DETECTION_385_388_oPCAN_RADAR_e16457b6_Tx: ComBitPosition=342, ComBitSize=2, ComSignalInitValue=0, ComSignalType=UINT8, ComHandleId=8047, ComSystemTemplateSystemSignalRef=DET_CONFD_AZIMUTH_387
            DET_RCS_387_oRDR_DETECTION_385_388_oPCAN_RADAR_013fdbb8_Tx: ComBitPosition=352, ComBitSize=8, ComSignalInitValue=128, ComSignalType=UINT8, ComHandleId=8102, ComSystemTemplateSystemSignalRef=DET_RCS_387
            DET_AZIMUTH_385_oRDR_DETECTION_385_388_oPCAN_RADAR_1212f217_Tx: ComBitPosition=88, ComBitSize=13, ComSignalInitValue=0, ComSignalType=UINT16, ComHandleId=8029, ComSystemTemplateSystemSignalRef=DET_AZIMUTH_385
            DET_EXISTENCE_PROB_385_oRDR_DETECTION_385_388_oPCAN_RADAR_9607c00e_Tx: ComBitPosition=112, ComBitSize=6, ComSignalInitValue=0, ComSignalType=UINT8, ComHandleId=8061, ComSystemTemplateSystemSignalRef=DET_EXISTENCE_PROB_385
            DET_BI_STATIC_FLAG_388_oRDR_DETECTION_385_388_oPCAN_RADAR_99be8fbe_Tx: ComBitPosition=440, ComBitSize=1, ComSignalInitValue=0, ComSignalType=BOOLEAN, ComHandleId=8044, ComSystemTemplateSystemSignalRef=DET_BI_STATIC_FLAG_388
            DET_CONFD_AZIMUTH_388_oRDR_DETECTION_385_388_oPCAN_RADAR_cd74c5f1_Tx: ComBitPosition=454, ComBitSize=2, ComSignalInitValue=0, ComSignalType=UINT8, ComHandleId=8048, ComSystemTemplateSystemSignalRef=DET_CONFD_AZIMUTH_388
            DET_RANGE_ERR_386_oRDR_DETECTION_385_388_oPCAN_RADAR_c181403b_Tx: ComBitPosition=152, ComBitSize=7, ComSignalInitValue=0, ComSignalType=UINT8, ComHandleId=8089, ComSystemTemplateSystemSignalRef=DET_RANGE_ERR_386
            DET_SUPER_RES_TARGET_387_oRDR_DETECTION_385_388_oPCAN_RADAR_ed08a7df_Tx: ComBitPosition=311, ComBitSize=1, ComSignalInitValue=0, ComSignalType=BOOLEAN, ComHandleId=8110, ComSystemTemplateSystemSignalRef=DET_SUPER_RES_TARGET_387
            DET_SNR_386_oRDR_DETECTION_385_388_oPCAN_RADAR_49e15b2f_Tx: ComBitPosition=232, ComBitSize=8, ComSignalInitValue=0, ComSignalType=UINT8, ComHandleId=8105, ComSystemTemplateSystemSignalRef=DET_SNR_386
            DET_EXISTENCE_PROB_387_oRDR_DETECTION_385_388_oPCAN_RADAR_67976f65_Tx: ComBitPosition=336, ComBitSize=6, ComSignalInitValue=0, ComSignalType=UINT8, ComHandleId=8063, ComSystemTemplateSystemSignalRef=DET_EXISTENCE_PROB_387
            DET_CONFD_AZIMUTH_386_oRDR_DETECTION_385_388_oPCAN_RADAR_74148323_Tx: ComBitPosition=230, ComBitSize=2, ComSignalInitValue=0, ComSignalType=UINT8, ComHandleId=8046, ComSystemTemplateSystemSignalRef=DET_CONFD_AZIMUTH_386
            DET_RCS_388_oRDR_DETECTION_385_388_oPCAN_RADAR_2d2f49ff_Tx: ComBitPosition=464, ComBitSize=8, ComSignalInitValue=128, ComSignalType=UINT8, ComHandleId=8103, ComSystemTemplateSystemSignalRef=DET_RCS_388
            DET_RANGE_ERR_387_oRDR_DETECTION_385_388_oPCAN_RADAR_54f194ae_Tx: ComBitPosition=264, ComBitSize=7, ComSignalInitValue=0, ComSignalType=UINT8, ComHandleId=8090, ComSystemTemplateSystemSignalRef=DET_RANGE_ERR_387
            DET_ELEVATION_ERR_386_oRDR_DETECTION_385_388_oPCAN_RADAR_2078ce90_Tx: ComBitPosition=192, ComBitSize=6, ComSignalInitValue=0, ComSignalType=UINT8, ComHandleId=8058, ComSystemTemplateSystemSignalRef=DET_ELEVATION_ERR_386
            DET_ELEVATION_387_oRDR_DETECTION_385_388_oPCAN_RADAR_32318270_Tx: ComBitPosition=296, ComBitSize=8, ComSignalInitValue=0, ComSignalType=UINT8, ComHandleId=8055, ComSystemTemplateSystemSignalRef=DET_ELEVATION_387
            DET_CONFD_ELEVATION_388_oRDR_DETECTION_385_388_oPCAN_RADAR_cfe1c40b_Tx: ComBitPosition=437, ComBitSize=2, ComSignalInitValue=0, ComSignalType=UINT8, ComHandleId=8052, ComSystemTemplateSystemSignalRef=DET_CONFD_ELEVATION_388
            DET_RCS_385_oRDR_DETECTION_385_388_oPCAN_RADAR_f0af74d3_Tx: ComBitPosition=128, ComBitSize=8, ComSignalInitValue=128, ComSignalType=UINT8, ComHandleId=8100, ComSystemTemplateSystemSignalRef=DET_RCS_385
            DET_AZIMUTH_ERR_385_oRDR_DETECTION_385_388_oPCAN_RADAR_b6a767e2_Tx: ComBitPosition=105, ComBitSize=7, ComSignalInitValue=0, ComSignalType=UINT8, ComHandleId=8033, ComSystemTemplateSystemSignalRef=DET_AZIMUTH_ERR_385
            DET_RANGE_VELOCITY_385_oRDR_DETECTION_385_388_oPCAN_RADAR_772f4389_Tx: ComBitPosition=48, ComBitSize=15, ComSignalInitValue=16384, ComSignalType=UINT16, ComHandleId=8092, ComSystemTemplateSystemSignalRef=DET_RANGE_VELOCITY_385
            DET_ELEVATION_386_oRDR_DETECTION_385_388_oPCAN_RADAR_a74156e5_Tx: ComBitPosition=184, ComBitSize=8, ComSignalInitValue=0, ComSignalType=UINT8, ComHandleId=8054, ComSystemTemplateSystemSignalRef=DET_ELEVATION_386
            DET_AZIMUTH_ERR_386_oRDR_DETECTION_385_388_oPCAN_RADAR_d2471c1c_Tx: ComBitPosition=217, ComBitSize=7, ComSignalInitValue=0, ComSignalType=UINT8, ComHandleId=8034, ComSystemTemplateSystemSignalRef=DET_AZIMUTH_ERR_386
            DET_RANGE_ERR_388_oRDR_DETECTION_385_388_oPCAN_RADAR_78e106e9_Tx: ComBitPosition=376, ComBitSize=7, ComSignalInitValue=0, ComSignalType=UINT8, ComHandleId=8091, ComSystemTemplateSystemSignalRef=DET_RANGE_ERR_388
            DET_SUPER_RES_TARGET_386_oRDR_DETECTION_385_388_oPCAN_RADAR_7878734a_Tx: ComBitPosition=199, ComBitSize=1, ComSignalInitValue=0, ComSignalType=BOOLEAN, ComHandleId=8109, ComSystemTemplateSystemSignalRef=DET_SUPER_RES_TARGET_386
            DET_ELEVATION_385_oRDR_DETECTION_385_388_oPCAN_RADAR_c3a12d1b_Tx: ComBitPosition=72, ComBitSize=8, ComSignalInitValue=0, ComSignalType=UINT8, ComHandleId=8053, ComSystemTemplateSystemSignalRef=DET_ELEVATION_385
            DET_RANGE_ERR_385_oRDR_DETECTION_385_388_oPCAN_RADAR_a5613bc5_Tx: ComBitPosition=40, ComBitSize=7, ComSignalInitValue=0, ComSignalType=UINT8, ComHandleId=8088, ComSystemTemplateSystemSignalRef=DET_RANGE_ERR_385
            DET_AZIMUTH_386_oRDR_DETECTION_385_388_oPCAN_RADAR_76f289e9_Tx: ComBitPosition=200, ComBitSize=13, ComSignalInitValue=0, ComSignalType=UINT16, ComHandleId=8030, ComSystemTemplateSystemSignalRef=DET_AZIMUTH_386
            DET_ELEVATION_ERR_388_oRDR_DETECTION_385_388_oPCAN_RADAR_99188842_Tx: ComBitPosition=416, ComBitSize=6, ComSignalInitValue=0, ComSignalType=UINT8, ComHandleId=8060, ComSystemTemplateSystemSignalRef=DET_ELEVATION_ERR_388
            DET_ELEVATION_ERR_385_oRDR_DETECTION_385_388_oPCAN_RADAR_4498b56e_Tx: ComBitPosition=80, ComBitSize=6, ComSignalInitValue=0, ComSignalType=UINT8, ComHandleId=8057, ComSystemTemplateSystemSignalRef=DET_ELEVATION_ERR_385
            DET_MH_SCAN_INDEX_4LSB_385_388_oRDR_DETECTION_385_388_oPCAN_RADAR_707211cb_Tx: ComBitPosition=476, ComBitSize=4, ComSignalInitValue=0, ComSignalType=UINT8, ComHandleId=8075, ComSystemTemplateSystemSignalRef=DET_MH_SCAN_INDEX_4LSB_385_388
            DET_RCS_386_oRDR_DETECTION_385_388_oPCAN_RADAR_944f0f2d_Tx: ComBitPosition=240, ComBitSize=8, ComSignalInitValue=128, ComSignalType=UINT8, ComHandleId=8101, ComSystemTemplateSystemSignalRef=DET_RCS_386
            DET_CONFD_ELEVATION_386_oRDR_DETECTION_385_388_oPCAN_RADAR_768182d9_Tx: ComBitPosition=213, ComBitSize=2, ComSignalInitValue=0, ComSignalType=UINT8, ComHandleId=8050, ComSystemTemplateSystemSignalRef=DET_CONFD_ELEVATION_386
            DET_SUPER_RES_TARGET_385_oRDR_DETECTION_385_388_oPCAN_RADAR_1c9808b4_Tx: ComBitPosition=87, ComBitSize=1, ComSignalInitValue=0, ComSignalType=BOOLEAN, ComHandleId=8108, ComSystemTemplateSystemSignalRef=DET_SUPER_RES_TARGET_385
            DET_MH_CYCLE_COUNTER_385_388_oRDR_DETECTION_385_388_oPCAN_RADAR_bc583447_Tx: ComBitPosition=16, ComBitSize=8, ComSignalInitValue=0, ComSignalType=UINT8, ComHandleId=8074, ComSystemTemplateSystemSignalRef=DET_MH_CYCLE_COUNTER_385_388
            DET_CONFD_ELEVATION_385_oRDR_DETECTION_385_388_oPCAN_RADAR_1261f927_Tx: ComBitPosition=101, ComBitSize=2, ComSignalInitValue=0, ComSignalType=UINT8, ComHandleId=8049, ComSystemTemplateSystemSignalRef=DET_CONFD_ELEVATION_385
            DET_RANGE_387_oRDR_DETECTION_385_388_oPCAN_RADAR_f3192ec7_Tx: ComBitPosition=248, ComBitSize=15, ComSignalInitValue=0, ComSignalType=UINT16, ComHandleId=8086, ComSystemTemplateSystemSignalRef=DET_RANGE_387
            DET_AZIMUTH_388_oRDR_DETECTION_385_388_oPCAN_RADAR_cf92cf3b_Tx: ComBitPosition=424, ComBitSize=13, ComSignalInitValue=0, ComSignalType=UINT16, ComHandleId=8032, ComSystemTemplateSystemSignalRef=DET_AZIMUTH_388
            DET_HVC_FLAG_385_oRDR_DETECTION_385_388_oPCAN_RADAR_77738371_Tx: ComBitPosition=86, ComBitSize=1, ComSignalInitValue=0, ComSignalType=BOOLEAN, ComHandleId=8065, ComSystemTemplateSystemSignalRef=DET_HVC_FLAG_385
            DET_RANGE_VELOCITY_ERR_387_oRDR_DETECTION_385_388_oPCAN_RADAR_89041750_Tx: ComBitPosition=288, ComBitSize=8, ComSignalInitValue=0, ComSignalType=UINT8, ComHandleId=8098, ComSystemTemplateSystemSignalRef=DET_RANGE_VELOCITY_ERR_387
            DET_SNR_385_oRDR_DETECTION_385_388_oPCAN_RADAR_2d0120d1_Tx: ComBitPosition=120, ComBitSize=8, ComSignalInitValue=0, ComSignalType=UINT8, ComHandleId=8104, ComSystemTemplateSystemSignalRef=DET_SNR_385
            DET_RANGE_388_oRDR_DETECTION_385_388_oPCAN_RADAR_df09bc80_Tx: ComBitPosition=360, ComBitSize=15, ComSignalInitValue=0, ComSignalType=UINT16, ComHandleId=8087, ComSystemTemplateSystemSignalRef=DET_RANGE_388
            DET_BI_STATIC_FLAG_386_oRDR_DETECTION_385_388_oPCAN_RADAR_20dec96c_Tx: ComBitPosition=216, ComBitSize=1, ComSignalInitValue=0, ComSignalType=BOOLEAN, ComHandleId=8042, ComSystemTemplateSystemSignalRef=DET_BI_STATIC_FLAG_386
            DET_HVC_FLAG_386_oRDR_DETECTION_385_388_oPCAN_RADAR_1393f88f_Tx: ComBitPosition=198, ComBitSize=1, ComSignalInitValue=0, ComSignalType=BOOLEAN, ComHandleId=8066, ComSystemTemplateSystemSignalRef=DET_HVC_FLAG_386
            DET_CONFD_AZIMUTH_385_oRDR_DETECTION_385_388_oPCAN_RADAR_10f4f8dd_Tx: ComBitPosition=118, ComBitSize=2, ComSignalInitValue=0, ComSignalType=UINT8, ComHandleId=8045, ComSystemTemplateSystemSignalRef=DET_CONFD_AZIMUTH_385
            DET_RANGE_VELOCITY_386_oRDR_DETECTION_385_388_oPCAN_RADAR_13cf3877_Tx: ComBitPosition=160, ComBitSize=15, ComSignalInitValue=16384, ComSignalType=UINT16, ComHandleId=8093, ComSystemTemplateSystemSignalRef=DET_RANGE_VELOCITY_386
            DET_EXISTENCE_PROB_388_oRDR_DETECTION_385_388_oPCAN_RADAR_4b87fd22_Tx: ComBitPosition=448, ComBitSize=6, ComSignalInitValue=0, ComSignalType=UINT8, ComHandleId=8064, ComSystemTemplateSystemSignalRef=DET_EXISTENCE_PROB_388
            DET_BI_STATIC_FLAG_385_oRDR_DETECTION_385_388_oPCAN_RADAR_443eb292_Tx: ComBitPosition=104, ComBitSize=1, ComSignalInitValue=0, ComSignalType=BOOLEAN, ComHandleId=8041, ComSystemTemplateSystemSignalRef=DET_BI_STATIC_FLAG_385
            DET_RANGE_VELOCITY_388_oRDR_DETECTION_385_388_oPCAN_RADAR_aaaf7ea5_Tx: ComBitPosition=384, ComBitSize=15, ComSignalInitValue=16384, ComSignalType=UINT16, ComHandleId=8095, ComSystemTemplateSystemSignalRef=DET_RANGE_VELOCITY_388
            DET_HVC_FLAG_387_oRDR_DETECTION_385_388_oPCAN_RADAR_86e32c1a_Tx: ComBitPosition=310, ComBitSize=1, ComSignalInitValue=0, ComSignalType=BOOLEAN, ComHandleId=8067, ComSystemTemplateSystemSignalRef=DET_HVC_FLAG_387
            DET_CONFD_ELEVATION_387_oRDR_DETECTION_385_388_oPCAN_RADAR_e3f1564c_Tx: ComBitPosition=325, ComBitSize=2, ComSignalInitValue=0, ComSignalType=UINT8, ComHandleId=8051, ComSystemTemplateSystemSignalRef=DET_CONFD_ELEVATION_387
            DET_AZIMUTH_387_oRDR_DETECTION_385_388_oPCAN_RADAR_e3825d7c_Tx: ComBitPosition=312, ComBitSize=13, ComSignalInitValue=0, ComSignalType=UINT16, ComHandleId=8031, ComSystemTemplateSystemSignalRef=DET_AZIMUTH_387
            DET_RANGE_385_oRDR_DETECTION_385_388_oPCAN_RADAR_028981ac_Tx: ComBitPosition=24, ComBitSize=15, ComSignalInitValue=0, ComSignalType=UINT16, ComHandleId=8084, ComSystemTemplateSystemSignalRef=DET_RANGE_385
            DET_RANGE_VELOCITY_ERR_385_oRDR_DETECTION_385_388_oPCAN_RADAR_7894b83b_Tx: ComBitPosition=64, ComBitSize=8, ComSignalInitValue=0, ComSignalType=UINT8, ComHandleId=8096, ComSystemTemplateSystemSignalRef=DET_RANGE_VELOCITY_ERR_385
            DET_AZIMUTH_ERR_388_oRDR_DETECTION_385_388_oPCAN_RADAR_6b275ace_Tx: ComBitPosition=441, ComBitSize=7, ComSignalInitValue=0, ComSignalType=UINT8, ComHandleId=8036, ComSystemTemplateSystemSignalRef=DET_AZIMUTH_ERR_388
            DET_SUPER_RES_TARGET_388_oRDR_DETECTION_385_388_oPCAN_RADAR_c1183598_Tx: ComBitPosition=423, ComBitSize=1, ComSignalInitValue=0, ComSignalType=BOOLEAN, ComHandleId=8111, ComSystemTemplateSystemSignalRef=DET_SUPER_RES_TARGET_388
            DET_RANGE_VELOCITY_ERR_386_oRDR_DETECTION_385_388_oPCAN_RADAR_1c74c3c5_Tx: ComBitPosition=176, ComBitSize=8, ComSignalInitValue=0, ComSignalType=UINT8, ComHandleId=8097, ComSystemTemplateSystemSignalRef=DET_RANGE_VELOCITY_ERR_386
            DET_ELEVATION_ERR_387_oRDR_DETECTION_385_388_oPCAN_RADAR_b5081a05_Tx: ComBitPosition=304, ComBitSize=6, ComSignalInitValue=0, ComSignalType=UINT8, ComHandleId=8059, ComSystemTemplateSystemSignalRef=DET_ELEVATION_ERR_387
            DET_MH_CRC16_385_388_oRDR_DETECTION_385_388_oPCAN_RADAR_382d9570_Tx: ComBitPosition=0, ComBitSize=16, ComSignalInitValue=0, ComSignalType=UINT16, ComHandleId=8073, ComSystemTemplateSystemSignalRef=DET_MH_CRC16_385_388
            DET_SNR_387_oRDR_DETECTION_385_388_oPCAN_RADAR_dc918fba_Tx: ComBitPosition=344, ComBitSize=8, ComSignalInitValue=0, ComSignalType=UINT8, ComHandleId=8106, ComSystemTemplateSystemSignalRef=DET_SNR_387
            DET_SNR_388_oRDR_DETECTION_385_388_oPCAN_RADAR_f0811dfd_Tx: ComBitPosition=456, ComBitSize=8, ComSignalInitValue=0, ComSignalType=UINT8, ComHandleId=8107, ComSystemTemplateSystemSignalRef=DET_SNR_388
            DET_BI_STATIC_FLAG_387_oRDR_DETECTION_385_388_oPCAN_RADAR_b5ae1df9_Tx: ComBitPosition=328, ComBitSize=1, ComSignalInitValue=0, ComSignalType=BOOLEAN, ComHandleId=8043, ComSystemTemplateSystemSignalRef=DET_BI_STATIC_FLAG_387
            DET_RANGE_386_oRDR_DETECTION_385_388_oPCAN_RADAR_6669fa52_Tx: ComBitPosition=136, ComBitSize=15, ComSignalInitValue=0, ComSignalType=UINT16, ComHandleId=8085, ComSystemTemplateSystemSignalRef=DET_RANGE_386
            DET_AZIMUTH_ERR_387_oRDR_DETECTION_385_388_oPCAN_RADAR_4737c889_Tx: ComBitPosition=329, ComBitSize=7, ComSignalInitValue=0, ComSignalType=UINT8, ComHandleId=8035, ComSystemTemplateSystemSignalRef=DET_AZIMUTH_ERR_387
            DET_HVC_FLAG_388_oRDR_DETECTION_385_388_oPCAN_RADAR_aaf3be5d_Tx: ComBitPosition=422, ComBitSize=1, ComSignalInitValue=0, ComSignalType=BOOLEAN, ComHandleId=8068, ComSystemTemplateSystemSignalRef=DET_HVC_FLAG_388
            DET_MTD_386_oRDR_DETECTION_385_388_oPCAN_RADAR_fe72f1e9_Tx: ComBitPosition=159, ComBitSize=1, ComSignalInitValue=0, ComSignalType=UINT8, ComHandleId=8077, ComSystemTemplateSystemSignalRef=DET_MTD_386
            DET_IDM_385_oRDR_DETECTION_385_388_oPCAN_RADAR_fc21b8cc_Tx: ComBitPosition=63, ComBitSize=1, ComSignalInitValue=0, ComSignalType=UINT8, ComHandleId=8069, ComSystemTemplateSystemSignalRef=DET_IDM_385
            DET_PROB_1STAZHYPO_386_oRDR_DETECTION_385_388_oPCAN_RADAR_6dc61924_Tx: ComBitPosition=215, ComBitSize=1, ComSignalInitValue=0, ComSignalType=BOOLEAN, ComHandleId=8081, ComSystemTemplateSystemSignalRef=DET_PROB_1STAZHYPO_386
            DET_BELOW_RAIN_THOLD_386_oRDR_DETECTION_385_388_oPCAN_RADAR_a3f31a29_Tx: ComBitPosition=151, ComBitSize=1, ComSignalInitValue=0, ComSignalType=UINT8, ComHandleId=8038, ComSystemTemplateSystemSignalRef=DET_BELOW_RAIN_THOLD_386
            DET_MTD_388_oRDR_DETECTION_385_388_oPCAN_RADAR_4712b73b_Tx: ComBitPosition=383, ComBitSize=1, ComSignalInitValue=0, ComSignalType=UINT8, ComHandleId=8079, ComSystemTemplateSystemSignalRef=DET_MTD_388
            DET_PROB_1STAZHYPO_388_oRDR_DETECTION_385_388_oPCAN_RADAR_d4a65ff6_Tx: ComBitPosition=439, ComBitSize=1, ComSignalInitValue=0, ComSignalType=BOOLEAN, ComHandleId=8083, ComSystemTemplateSystemSignalRef=DET_PROB_1STAZHYPO_388
            DET_BELOW_RAIN_THOLD_387_oRDR_DETECTION_385_388_oPCAN_RADAR_3683cebc_Tx: ComBitPosition=263, ComBitSize=1, ComSignalInitValue=0, ComSignalType=UINT8, ComHandleId=8039, ComSystemTemplateSystemSignalRef=DET_BELOW_RAIN_THOLD_387
            DET_BELOW_RAIN_THOLD_385_oRDR_DETECTION_385_388_oPCAN_RADAR_c71361d7_Tx: ComBitPosition=39, ComBitSize=1, ComSignalInitValue=0, ComSignalType=UINT8, ComHandleId=8037, ComSystemTemplateSystemSignalRef=DET_BELOW_RAIN_THOLD_385
            DET_IDM_386_oRDR_DETECTION_385_388_oPCAN_RADAR_98c1c332_Tx: ComBitPosition=175, ComBitSize=1, ComSignalInitValue=0, ComSignalType=UINT8, ComHandleId=8070, ComSystemTemplateSystemSignalRef=DET_IDM_386
            DET_IDM_388_oRDR_DETECTION_385_388_oPCAN_RADAR_21a185e0_Tx: ComBitPosition=399, ComBitSize=1, ComSignalInitValue=0, ComSignalType=UINT8, ComHandleId=8072, ComSystemTemplateSystemSignalRef=DET_IDM_388
            DET_PROB_1STAZHYPO_385_oRDR_DETECTION_385_388_oPCAN_RADAR_092662da_Tx: ComBitPosition=103, ComBitSize=1, ComSignalInitValue=0, ComSignalType=BOOLEAN, ComHandleId=8080, ComSystemTemplateSystemSignalRef=DET_PROB_1STAZHYPO_385
            DET_MTD_387_oRDR_DETECTION_385_388_oPCAN_RADAR_6b02257c_Tx: ComBitPosition=271, ComBitSize=1, ComSignalInitValue=0, ComSignalType=UINT8, ComHandleId=8078, ComSystemTemplateSystemSignalRef=DET_MTD_387
            DET_BELOW_RAIN_THOLD_388_oRDR_DETECTION_385_388_oPCAN_RADAR_1a935cfb_Tx: ComBitPosition=375, ComBitSize=1, ComSignalInitValue=0, ComSignalType=UINT8, ComHandleId=8040, ComSystemTemplateSystemSignalRef=DET_BELOW_RAIN_THOLD_388
            DET_MTD_385_oRDR_DETECTION_385_388_oPCAN_RADAR_9a928a17_Tx: ComBitPosition=47, ComBitSize=1, ComSignalInitValue=0, ComSignalType=UINT8, ComHandleId=8076, ComSystemTemplateSystemSignalRef=DET_MTD_385
            DET_PROB_1STAZHYPO_387_oRDR_DETECTION_385_388_oPCAN_RADAR_f8b6cdb1_Tx: ComBitPosition=327, ComBitSize=1, ComSignalInitValue=0, ComSignalType=BOOLEAN, ComHandleId=8082, ComSystemTemplateSystemSignalRef=DET_PROB_1STAZHYPO_387
            DET_IDM_387_oRDR_DETECTION_385_388_oPCAN_RADAR_0db117a7_Tx: ComBitPosition=287, ComBitSize=1, ComSignalInitValue=0, ComSignalType=UINT8, ComHandleId=8071, ComSystemTemplateSystemSignalRef=DET_IDM_387
        SG_Detections_129_132_oRDR_DETECTION_129_132_oPCAN_RADAR_402c0762_Tx: ComTransferProperty=TRIGGERED, ComHandleId=34, ComSystemTemplateSignalGroupRef=SG_Detections_129_132
          83 x ComGroupSignal, all with ComSignalEndianness=LITTLE_ENDIAN, ComTransferProperty=PENDING, ComSignalAccess=ACCESS_NEEDED_BY_SWC_OR_COM:
            DET_AZIMUTH_ERR_129_oRDR_DETECTION_129_132_oPCAN_RADAR_16c8b1aa_Tx: ComBitPosition=105, ComBitSize=7, ComSignalInitValue=0, ComSignalType=UINT8, ComHandleId=2721, ComSystemTemplateSystemSignalRef=DET_AZIMUTH_ERR_129
            DET_RANGE_131_oRDR_DETECTION_129_132_oPCAN_RADAR_52b6f1d5_Tx: ComBitPosition=248, ComBitSize=15, ComSignalInitValue=0, ComSignalType=UINT16, ComHandleId=2774, ComSystemTemplateSystemSignalRef=DET_RANGE_131
            DET_SUPER_RES_TARGET_129_oRDR_DETECTION_129_132_oPCAN_RADAR_bcf7defc_Tx: ComBitPosition=87, ComBitSize=1, ComSignalInitValue=0, ComSignalType=BOOLEAN, ComHandleId=2796, ComSystemTemplateSystemSignalRef=DET_SUPER_RES_TARGET_129
            DET_AZIMUTH_129_oRDR_DETECTION_129_132_oPCAN_RADAR_b27d245f_Tx: ComBitPosition=88, ComBitSize=13, ComSignalInitValue=0, ComSignalType=UINT16, ComHandleId=2717, ComSystemTemplateSystemSignalRef=DET_AZIMUTH_129
            DET_BI_STATIC_FLAG_129_oRDR_DETECTION_129_132_oPCAN_RADAR_e45164da_Tx: ComBitPosition=104, ComBitSize=1, ComSignalInitValue=0, ComSignalType=BOOLEAN, ComHandleId=2729, ComSystemTemplateSystemSignalRef=DET_BI_STATIC_FLAG_129
            DET_RCS_131_oRDR_DETECTION_129_132_oPCAN_RADAR_a09004aa_Tx: ComBitPosition=352, ComBitSize=8, ComSignalInitValue=128, ComSignalType=UINT8, ComHandleId=2790, ComSystemTemplateSystemSignalRef=DET_RCS_131
            DET_RCS_132_oRDR_DETECTION_129_132_oPCAN_RADAR_c4707f54_Tx: ComBitPosition=464, ComBitSize=8, ComSignalInitValue=128, ComSignalType=UINT8, ComHandleId=2791, ComSystemTemplateSystemSignalRef=DET_RCS_132
            DET_RANGE_ERR_132_oRDR_DETECTION_129_132_oPCAN_RADAR_91be3042_Tx: ComBitPosition=376, ComBitSize=7, ComSignalInitValue=0, ComSignalType=UINT8, ComHandleId=2779, ComSystemTemplateSystemSignalRef=DET_RANGE_ERR_132
            DET_HVC_FLAG_129_oRDR_DETECTION_129_132_oPCAN_RADAR_d71c5539_Tx: ComBitPosition=86, ComBitSize=1, ComSignalInitValue=0, ComSignalType=BOOLEAN, ComHandleId=2753, ComSystemTemplateSystemSignalRef=DET_HVC_FLAG_129
            DET_RANGE_VELOCITY_132_oRDR_DETECTION_129_132_oPCAN_RADAR_43f0480e_Tx: ComBitPosition=384, ComBitSize=15, ComSignalInitValue=16384, ComSignalType=UINT16, ComHandleId=2783, ComSystemTemplateSystemSignalRef=DET_RANGE_VELOCITY_132
            DET_AZIMUTH_131_oRDR_DETECTION_129_132_oPCAN_RADAR_422d826e_Tx: ComBitPosition=312, ComBitSize=13, ComSignalInitValue=0, ComSignalType=UINT16, ComHandleId=2719, ComSystemTemplateSystemSignalRef=DET_AZIMUTH_131
            DET_ELEVATION_130_oRDR_DETECTION_129_132_oPCAN_RADAR_06ee89f7_Tx: ComBitPosition=184, ComBitSize=8, ComSignalInitValue=0, ComSignalType=UINT8, ComHandleId=2742, ComSystemTemplateSystemSignalRef=DET_ELEVATION_130
            DET_SUPER_RES_TARGET_131_oRDR_DETECTION_129_132_oPCAN_RADAR_4ca778cd_Tx: ComBitPosition=311, ComBitSize=1, ComSignalInitValue=0, ComSignalType=BOOLEAN, ComHandleId=2798, ComSystemTemplateSystemSignalRef=DET_SUPER_RES_TARGET_131
            DET_BI_STATIC_FLAG_132_oRDR_DETECTION_129_132_oPCAN_RADAR_70e1b915_Tx: ComBitPosition=440, ComBitSize=1, ComSignalInitValue=0, ComSignalType=BOOLEAN, ComHandleId=2732, ComSystemTemplateSystemSignalRef=DET_BI_STATIC_FLAG_132
            DET_RANGE_VELOCITY_ERR_131_oRDR_DETECTION_129_132_oPCAN_RADAR_28abc842_Tx: ComBitPosition=288, ComBitSize=8, ComSignalInitValue=0, ComSignalType=UINT8, ComHandleId=2786, ComSystemTemplateSystemSignalRef=DET_RANGE_VELOCITY_ERR_131
            DET_CONFD_ELEVATION_131_oRDR_DETECTION_129_132_oPCAN_RADAR_425e895e_Tx: ComBitPosition=325, ComBitSize=2, ComSignalInitValue=0, ComSignalType=UINT8, ComHandleId=2739, ComSystemTemplateSystemSignalRef=DET_CONFD_ELEVATION_131
            DET_ELEVATION_ERR_132_oRDR_DETECTION_129_132_oPCAN_RADAR_7047bee9_Tx: ComBitPosition=416, ComBitSize=6, ComSignalInitValue=0, ComSignalType=UINT8, ComHandleId=2748, ComSystemTemplateSystemSignalRef=DET_ELEVATION_ERR_132
            DET_SUPER_RES_TARGET_132_oRDR_DETECTION_129_132_oPCAN_RADAR_28470333_Tx: ComBitPosition=423, ComBitSize=1, ComSignalInitValue=0, ComSignalType=BOOLEAN, ComHandleId=2799, ComSystemTemplateSystemSignalRef=DET_SUPER_RES_TARGET_132
            DET_AZIMUTH_130_oRDR_DETECTION_129_132_oPCAN_RADAR_d75d56fb_Tx: ComBitPosition=200, ComBitSize=13, ComSignalInitValue=0, ComSignalType=UINT16, ComHandleId=2718, ComSystemTemplateSystemSignalRef=DET_AZIMUTH_130
            DET_AZIMUTH_ERR_131_oRDR_DETECTION_129_132_oPCAN_RADAR_e698179b_Tx: ComBitPosition=329, ComBitSize=7, ComSignalInitValue=0, ComSignalType=UINT8, ComHandleId=2723, ComSystemTemplateSystemSignalRef=DET_AZIMUTH_ERR_131
            DET_RANGE_VELOCITY_130_oRDR_DETECTION_129_132_oPCAN_RADAR_b260e765_Tx: ComBitPosition=160, ComBitSize=15, ComSignalInitValue=16384, ComSignalType=UINT16, ComHandleId=2781, ComSystemTemplateSystemSignalRef=DET_RANGE_VELOCITY_130
            DET_BI_STATIC_FLAG_131_oRDR_DETECTION_129_132_oPCAN_RADAR_1401c2eb_Tx: ComBitPosition=328, ComBitSize=1, ComSignalInitValue=0, ComSignalType=BOOLEAN, ComHandleId=2731, ComSystemTemplateSystemSignalRef=DET_BI_STATIC_FLAG_131
            DET_SNR_129_oRDR_DETECTION_129_132_oPCAN_RADAR_8d6ef699_Tx: ComBitPosition=120, ComBitSize=8, ComSignalInitValue=0, ComSignalType=UINT8, ComHandleId=2792, ComSystemTemplateSystemSignalRef=DET_SNR_129
            DET_RANGE_132_oRDR_DETECTION_129_132_oPCAN_RADAR_36568a2b_Tx: ComBitPosition=360, ComBitSize=15, ComSignalInitValue=0, ComSignalType=UINT16, ComHandleId=2775, ComSystemTemplateSystemSignalRef=DET_RANGE_132
            DET_ELEVATION_ERR_130_oRDR_DETECTION_129_132_oPCAN_RADAR_81d71182_Tx: ComBitPosition=192, ComBitSize=6, ComSignalInitValue=0, ComSignalType=UINT8, ComHandleId=2746, ComSystemTemplateSystemSignalRef=DET_ELEVATION_ERR_130
            DET_RANGE_129_oRDR_DETECTION_129_132_oPCAN_RADAR_a2e657e4_Tx: ComBitPosition=24, ComBitSize=15, ComSignalInitValue=0, ComSignalType=UINT16, ComHandleId=2772, ComSystemTemplateSystemSignalRef=DET_RANGE_129
            DET_MH_CYCLE_COUNTER_129_132_oRDR_DETECTION_129_132_oPCAN_RADAR_40d1745e_Tx: ComBitPosition=16, ComBitSize=8, ComSignalInitValue=0, ComSignalType=UINT8, ComHandleId=2762, ComSystemTemplateSystemSignalRef=DET_MH_CYCLE_COUNTER_129_132
            DET_RANGE_VELOCITY_129_oRDR_DETECTION_129_132_oPCAN_RADAR_d74095c1_Tx: ComBitPosition=48, ComBitSize=15, ComSignalInitValue=16384, ComSignalType=UINT16, ComHandleId=2780, ComSystemTemplateSystemSignalRef=DET_RANGE_VELOCITY_129
            DET_CONFD_AZIMUTH_130_oRDR_DETECTION_129_132_oPCAN_RADAR_d5bb5c31_Tx: ComBitPosition=230, ComBitSize=2, ComSignalInitValue=0, ComSignalType=UINT8, ComHandleId=2734, ComSystemTemplateSystemSignalRef=DET_CONFD_AZIMUTH_130
            DET_RANGE_130_oRDR_DETECTION_129_132_oPCAN_RADAR_c7c62540_Tx: ComBitPosition=136, ComBitSize=15, ComSignalInitValue=0, ComSignalType=UINT16, ComHandleId=2773, ComSystemTemplateSystemSignalRef=DET_RANGE_130
            DET_EXISTENCE_PROB_129_oRDR_DETECTION_129_132_oPCAN_RADAR_36681646_Tx: ComBitPosition=112, ComBitSize=6, ComSignalInitValue=0, ComSignalType=UINT8, ComHandleId=2749, ComSystemTemplateSystemSignalRef=DET_EXISTENCE_PROB_129
            DET_RANGE_VELOCITY_ERR_129_oRDR_DETECTION_129_132_oPCAN_RADAR_d8fb6e73_Tx: ComBitPosition=64, ComBitSize=8, ComSignalInitValue=0, ComSignalType=UINT8, ComHandleId=2784, ComSystemTemplateSystemSignalRef=DET_RANGE_VELOCITY_ERR_129
            DET_AZIMUTH_ERR_132_oRDR_DETECTION_129_132_oPCAN_RADAR_82786c65_Tx: ComBitPosition=441, ComBitSize=7, ComSignalInitValue=0, ComSignalType=UINT8, ComHandleId=2724, ComSystemTemplateSystemSignalRef=DET_AZIMUTH_ERR_132
            DET_RANGE_ERR_130_oRDR_DETECTION_129_132_oPCAN_RADAR_602e9f29_Tx: ComBitPosition=152, ComBitSize=7, ComSignalInitValue=0, ComSignalType=UINT8, ComHandleId=2777, ComSystemTemplateSystemSignalRef=DET_RANGE_ERR_130
            DET_AZIMUTH_132_oRDR_DETECTION_129_132_oPCAN_RADAR_26cdf990_Tx: ComBitPosition=424, ComBitSize=13, ComSignalInitValue=0, ComSignalType=UINT16, ComHandleId=2720, ComSystemTemplateSystemSignalRef=DET_AZIMUTH_132
            DET_HVC_FLAG_131_oRDR_DETECTION_129_132_oPCAN_RADAR_274cf308_Tx: ComBitPosition=310, ComBitSize=1, ComSignalInitValue=0, ComSignalType=BOOLEAN, ComHandleId=2755, ComSystemTemplateSystemSignalRef=DET_HVC_FLAG_131
            DET_CONFD_ELEVATION_129_oRDR_DETECTION_129_132_oPCAN_RADAR_b20e2f6f_Tx: ComBitPosition=101, ComBitSize=2, ComSignalInitValue=0, ComSignalType=UINT8, ComHandleId=2737, ComSystemTemplateSystemSignalRef=DET_CONFD_ELEVATION_129
            DET_ELEVATION_ERR_131_oRDR_DETECTION_129_132_oPCAN_RADAR_14a7c517_Tx: ComBitPosition=304, ComBitSize=6, ComSignalInitValue=0, ComSignalType=UINT8, ComHandleId=2747, ComSystemTemplateSystemSignalRef=DET_ELEVATION_ERR_131
            DET_SUPER_RES_TARGET_130_oRDR_DETECTION_129_132_oPCAN_RADAR_d9d7ac58_Tx: ComBitPosition=199, ComBitSize=1, ComSignalInitValue=0, ComSignalType=BOOLEAN, ComHandleId=2797, ComSystemTemplateSystemSignalRef=DET_SUPER_RES_TARGET_130
            DET_ELEVATION_131_oRDR_DETECTION_129_132_oPCAN_RADAR_939e5d62_Tx: ComBitPosition=296, ComBitSize=8, ComSignalInitValue=0, ComSignalType=UINT8, ComHandleId=2743, ComSystemTemplateSystemSignalRef=DET_ELEVATION_131
            DET_EXISTENCE_PROB_131_oRDR_DETECTION_129_132_oPCAN_RADAR_c638b077_Tx: ComBitPosition=336, ComBitSize=6, ComSignalInitValue=0, ComSignalType=UINT8, ComHandleId=2751, ComSystemTemplateSystemSignalRef=DET_EXISTENCE_PROB_131
            DET_HVC_FLAG_132_oRDR_DETECTION_129_132_oPCAN_RADAR_43ac88f6_Tx: ComBitPosition=422, ComBitSize=1, ComSignalInitValue=0, ComSignalType=BOOLEAN, ComHandleId=2756, ComSystemTemplateSystemSignalRef=DET_HVC_FLAG_132
            DET_CONFD_AZIMUTH_132_oRDR_DETECTION_129_132_oPCAN_RADAR_242bf35a_Tx: ComBitPosition=454, ComBitSize=2, ComSignalInitValue=0, ComSignalType=UINT8, ComHandleId=2736, ComSystemTemplateSystemSignalRef=DET_CONFD_AZIMUTH_132
            DET_RCS_130_oRDR_DETECTION_129_132_oPCAN_RADAR_35e0d03f_Tx: ComBitPosition=240, ComBitSize=8, ComSignalInitValue=128, ComSignalType=UINT8, ComHandleId=2789, ComSystemTemplateSystemSignalRef=DET_RCS_130
            DET_EXISTENCE_PROB_130_oRDR_DETECTION_129_132_oPCAN_RADAR_534864e2_Tx: ComBitPosition=224, ComBitSize=6, ComSignalInitValue=0, ComSignalType=UINT8, ComHandleId=2750, ComSystemTemplateSystemSignalRef=DET_EXISTENCE_PROB_130
            DET_RANGE_VELOCITY_ERR_132_oRDR_DETECTION_129_132_oPCAN_RADAR_4c4bb3bc_Tx: ComBitPosition=400, ComBitSize=8, ComSignalInitValue=0, ComSignalType=UINT8, ComHandleId=2787, ComSystemTemplateSystemSignalRef=DET_RANGE_VELOCITY_ERR_132
            DET_MH_CRC16_129_132_oRDR_DETECTION_129_132_oPCAN_RADAR_c4a4d569_Tx: ComBitPosition=0, ComBitSize=16, ComSignalInitValue=0, ComSignalType=UINT16, ComHandleId=2761, ComSystemTemplateSystemSignalRef=DET_MH_CRC16_129_132
            DET_SNR_130_oRDR_DETECTION_129_132_oPCAN_RADAR_e84e843d_Tx: ComBitPosition=232, ComBitSize=8, ComSignalInitValue=0, ComSignalType=UINT8, ComHandleId=2793, ComSystemTemplateSystemSignalRef=DET_SNR_130
            DET_RANGE_ERR_131_oRDR_DETECTION_129_132_oPCAN_RADAR_f55e4bbc_Tx: ComBitPosition=264, ComBitSize=7, ComSignalInitValue=0, ComSignalType=UINT8, ComHandleId=2778, ComSystemTemplateSystemSignalRef=DET_RANGE_ERR_131
            DET_SNR_132_oRDR_DETECTION_129_132_oPCAN_RADAR_19de2b56_Tx: ComBitPosition=456, ComBitSize=8, ComSignalInitValue=0, ComSignalType=UINT8, ComHandleId=2795, ComSystemTemplateSystemSignalRef=DET_SNR_132
            DET_RANGE_ERR_129_oRDR_DETECTION_129_132_oPCAN_RADAR_050eed8d_Tx: ComBitPosition=40, ComBitSize=7, ComSignalInitValue=0, ComSignalType=UINT8, ComHandleId=2776, ComSystemTemplateSystemSignalRef=DET_RANGE_ERR_129
            DET_CONFD_ELEVATION_130_oRDR_DETECTION_129_132_oPCAN_RADAR_d72e5dcb_Tx: ComBitPosition=213, ComBitSize=2, ComSignalInitValue=0, ComSignalType=UINT8, ComHandleId=2738, ComSystemTemplateSystemSignalRef=DET_CONFD_ELEVATION_130
            DET_ELEVATION_ERR_129_oRDR_DETECTION_129_132_oPCAN_RADAR_e4f76326_Tx: ComBitPosition=80, ComBitSize=6, ComSignalInitValue=0, ComSignalType=UINT8, ComHandleId=2745, ComSystemTemplateSystemSignalRef=DET_ELEVATION_ERR_129
            DET_BI_STATIC_FLAG_130_oRDR_DETECTION_129_132_oPCAN_RADAR_8171167e_Tx: ComBitPosition=216, ComBitSize=1, ComSignalInitValue=0, ComSignalType=BOOLEAN, ComHandleId=2730, ComSystemTemplateSystemSignalRef=DET_BI_STATIC_FLAG_130
            DET_RCS_129_oRDR_DETECTION_129_132_oPCAN_RADAR_50c0a29b_Tx: ComBitPosition=128, ComBitSize=8, ComSignalInitValue=128, ComSignalType=UINT8, ComHandleId=2788, ComSystemTemplateSystemSignalRef=DET_RCS_129
            DET_CONFD_AZIMUTH_129_oRDR_DETECTION_129_132_oPCAN_RADAR_b09b2e95_Tx: ComBitPosition=118, ComBitSize=2, ComSignalInitValue=0, ComSignalType=UINT8, ComHandleId=2733, ComSystemTemplateSystemSignalRef=DET_CONFD_AZIMUTH_129
            DET_RANGE_VELOCITY_ERR_130_oRDR_DETECTION_129_132_oPCAN_RADAR_bddb1cd7_Tx: ComBitPosition=176, ComBitSize=8, ComSignalInitValue=0, ComSignalType=UINT8, ComHandleId=2785, ComSystemTemplateSystemSignalRef=DET_RANGE_VELOCITY_ERR_130
            DET_HVC_FLAG_130_oRDR_DETECTION_129_132_oPCAN_RADAR_b23c279d_Tx: ComBitPosition=198, ComBitSize=1, ComSignalInitValue=0, ComSignalType=BOOLEAN, ComHandleId=2754, ComSystemTemplateSystemSignalRef=DET_HVC_FLAG_130
            DET_RANGE_VELOCITY_131_oRDR_DETECTION_129_132_oPCAN_RADAR_271033f0_Tx: ComBitPosition=272, ComBitSize=15, ComSignalInitValue=16384, ComSignalType=UINT16, ComHandleId=2782, ComSystemTemplateSystemSignalRef=DET_RANGE_VELOCITY_131
            DET_CONFD_AZIMUTH_131_oRDR_DETECTION_129_132_oPCAN_RADAR_40cb88a4_Tx: ComBitPosition=342, ComBitSize=2, ComSignalInitValue=0, ComSignalType=UINT8, ComHandleId=2735, ComSystemTemplateSystemSignalRef=DET_CONFD_AZIMUTH_131
            DET_ELEVATION_129_oRDR_DETECTION_129_132_oPCAN_RADAR_63cefb53_Tx: ComBitPosition=72, ComBitSize=8, ComSignalInitValue=0, ComSignalType=UINT8, ComHandleId=2741, ComSystemTemplateSystemSignalRef=DET_ELEVATION_129
            DET_SNR_131_oRDR_DETECTION_129_132_oPCAN_RADAR_7d3e50a8_Tx: ComBitPosition=344, ComBitSize=8, ComSignalInitValue=0, ComSignalType=UINT8, ComHandleId=2794, ComSystemTemplateSystemSignalRef=DET_SNR_131
            DET_CONFD_ELEVATION_132_oRDR_DETECTION_129_132_oPCAN_RADAR_26bef2a0_Tx: ComBitPosition=437, ComBitSize=2, ComSignalInitValue=0, ComSignalType=UINT8, ComHandleId=2740, ComSystemTemplateSystemSignalRef=DET_CONFD_ELEVATION_132
            DET_ELEVATION_132_oRDR_DETECTION_129_132_oPCAN_RADAR_f77e269c_Tx: ComBitPosition=408, ComBitSize=8, ComSignalInitValue=0, ComSignalType=UINT8, ComHandleId=2744, ComSystemTemplateSystemSignalRef=DET_ELEVATION_132
            DET_EXISTENCE_PROB_132_oRDR_DETECTION_129_132_oPCAN_RADAR_a2d8cb89_Tx: ComBitPosition=448, ComBitSize=6, ComSignalInitValue=0, ComSignalType=UINT8, ComHandleId=2752, ComSystemTemplateSystemSignalRef=DET_EXISTENCE_PROB_132
            DET_MH_SCAN_INDEX_4LSB_129_132_oRDR_DETECTION_129_132_oPCAN_RADAR_8cfb51d2_Tx: ComBitPosition=476, ComBitSize=4, ComSignalInitValue=0, ComSignalType=UINT8, ComHandleId=2763, ComSystemTemplateSystemSignalRef=DET_MH_SCAN_INDEX_4LSB_129_132
            DET_AZIMUTH_ERR_130_oRDR_DETECTION_129_132_oPCAN_RADAR_73e8c30e_Tx: ComBitPosition=217, ComBitSize=7, ComSignalInitValue=0, ComSignalType=UINT8, ComHandleId=2722, ComSystemTemplateSystemSignalRef=DET_AZIMUTH_ERR_130
            DET_PROB_1STAZHYPO_129_oRDR_DETECTION_129_132_oPCAN_RADAR_a949b492_Tx: ComBitPosition=103, ComBitSize=1, ComSignalInitValue=0, ComSignalType=BOOLEAN, ComHandleId=2768, ComSystemTemplateSystemSignalRef=DET_PROB_1STAZHYPO_129
            DET_PROB_1STAZHYPO_130_oRDR_DETECTION_129_132_oPCAN_RADAR_cc69c636_Tx: ComBitPosition=215, ComBitSize=1, ComSignalInitValue=0, ComSignalType=BOOLEAN, ComHandleId=2769, ComSystemTemplateSystemSignalRef=DET_PROB_1STAZHYPO_130
            DET_IDM_131_oRDR_DETECTION_129_132_oPCAN_RADAR_ac1ec8b5_Tx: ComBitPosition=287, ComBitSize=1, ComSignalInitValue=0, ComSignalType=UINT8, ComHandleId=2759, ComSystemTemplateSystemSignalRef=DET_IDM_131
            DET_BELOW_RAIN_THOLD_131_oRDR_DETECTION_129_132_oPCAN_RADAR_972c11ae_Tx: ComBitPosition=263, ComBitSize=1, ComSignalInitValue=0, ComSignalType=UINT8, ComHandleId=2727, ComSystemTemplateSystemSignalRef=DET_BELOW_RAIN_THOLD_131
            DET_BELOW_RAIN_THOLD_129_oRDR_DETECTION_129_132_oPCAN_RADAR_677cb79f_Tx: ComBitPosition=39, ComBitSize=1, ComSignalInitValue=0, ComSignalType=UINT8, ComHandleId=2725, ComSystemTemplateSystemSignalRef=DET_BELOW_RAIN_THOLD_129
            DET_IDM_129_oRDR_DETECTION_129_132_oPCAN_RADAR_5c4e6e84_Tx: ComBitPosition=63, ComBitSize=1, ComSignalInitValue=0, ComSignalType=UINT8, ComHandleId=2757, ComSystemTemplateSystemSignalRef=DET_IDM_129
            DET_MTD_132_oRDR_DETECTION_129_132_oPCAN_RADAR_ae4d8190_Tx: ComBitPosition=383, ComBitSize=1, ComSignalInitValue=0, ComSignalType=UINT8, ComHandleId=2767, ComSystemTemplateSystemSignalRef=DET_MTD_132
            DET_IDM_132_oRDR_DETECTION_129_132_oPCAN_RADAR_c8feb34b_Tx: ComBitPosition=399, ComBitSize=1, ComSignalInitValue=0, ComSignalType=UINT8, ComHandleId=2760, ComSystemTemplateSystemSignalRef=DET_IDM_132
            DET_MTD_130_oRDR_DETECTION_129_132_oPCAN_RADAR_5fdd2efb_Tx: ComBitPosition=159, ComBitSize=1, ComSignalInitValue=0, ComSignalType=UINT8, ComHandleId=2765, ComSystemTemplateSystemSignalRef=DET_MTD_130
            DET_MTD_131_oRDR_DETECTION_129_132_oPCAN_RADAR_caadfa6e_Tx: ComBitPosition=271, ComBitSize=1, ComSignalInitValue=0, ComSignalType=UINT8, ComHandleId=2766, ComSystemTemplateSystemSignalRef=DET_MTD_131
            DET_BELOW_RAIN_THOLD_132_oRDR_DETECTION_129_132_oPCAN_RADAR_f3cc6a50_Tx: ComBitPosition=375, ComBitSize=1, ComSignalInitValue=0, ComSignalType=UINT8, ComHandleId=2728, ComSystemTemplateSystemSignalRef=DET_BELOW_RAIN_THOLD_132
            DET_MTD_129_oRDR_DETECTION_129_132_oPCAN_RADAR_3afd5c5f_Tx: ComBitPosition=47, ComBitSize=1, ComSignalInitValue=0, ComSignalType=UINT8, ComHandleId=2764, ComSystemTemplateSystemSignalRef=DET_MTD_129
            DET_BELOW_RAIN_THOLD_130_oRDR_DETECTION_129_132_oPCAN_RADAR_025cc53b_Tx: ComBitPosition=151, ComBitSize=1, ComSignalInitValue=0, ComSignalType=UINT8, ComHandleId=2726, ComSystemTemplateSystemSignalRef=DET_BELOW_RAIN_THOLD_130
            DET_IDM_130_oRDR_DETECTION_129_132_oPCAN_RADAR_396e1c20_Tx: ComBitPosition=175, ComBitSize=1, ComSignalInitValue=0, ComSignalType=UINT8, ComHandleId=2758, ComSystemTemplateSystemSignalRef=DET_IDM_130
            DET_PROB_1STAZHYPO_132_oRDR_DETECTION_129_132_oPCAN_RADAR_3df9695d_Tx: ComBitPosition=439, ComBitSize=1, ComSignalInitValue=0, ComSignalType=BOOLEAN, ComHandleId=2771, ComSystemTemplateSystemSignalRef=DET_PROB_1STAZHYPO_132
            DET_PROB_1STAZHYPO_131_oRDR_DETECTION_129_132_oPCAN_RADAR_591912a3_Tx: ComBitPosition=327, ComBitSize=1, ComSignalInitValue=0, ComSignalType=BOOLEAN, ComHandleId=2770, ComSystemTemplateSystemSignalRef=DET_PROB_1STAZHYPO_131
        SG_Detections_177_180_oRDR_DETECTION_177_180_oPCAN_RADAR_6c601388_Tx: ComTransferProperty=TRIGGERED, ComHandleId=46, ComSystemTemplateSignalGroupRef=SG_Detections_177_180
          83 x ComGroupSignal, all with ComSignalEndianness=LITTLE_ENDIAN, ComTransferProperty=PENDING, ComSignalAccess=ACCESS_NEEDED_BY_SWC_OR_COM:
            DET_RANGE_VELOCITY_ERR_179_oRDR_DETECTION_177_180_oPCAN_RADAR_bce23804_Tx: ComBitPosition=288, ComBitSize=8, ComSignalInitValue=0, ComSignalType=UINT8, ComHandleId=3782, ComSystemTemplateSystemSignalRef=DET_RANGE_VELOCITY_ERR_179
            DET_ELEVATION_180_oRDR_DETECTION_177_180_oPCAN_RADAR_0a930c3e_Tx: ComBitPosition=408, ComBitSize=8, ComSignalInitValue=0, ComSignalType=UINT8, ComHandleId=3740, ComSystemTemplateSystemSignalRef=DET_ELEVATION_180
            DET_SNR_180_oRDR_DETECTION_177_180_oPCAN_RADAR_e43301f4_Tx: ComBitPosition=456, ComBitSize=8, ComSignalInitValue=0, ComSignalType=UINT8, ComHandleId=3791, ComSystemTemplateSystemSignalRef=DET_SNR_180
            DET_RANGE_ERR_180_oRDR_DETECTION_177_180_oPCAN_RADAR_6c531ae0_Tx: ComBitPosition=376, ComBitSize=7, ComSignalInitValue=0, ComSignalType=UINT8, ComHandleId=3775, ComSystemTemplateSystemSignalRef=DET_RANGE_ERR_180
            DET_MH_CYCLE_COUNTER_177_180_oRDR_DETECTION_177_180_oPCAN_RADAR_6c9d60b4_Tx: ComBitPosition=16, ComBitSize=8, ComSignalInitValue=0, ComSignalType=UINT8, ComHandleId=3758, ComSystemTemplateSystemSignalRef=DET_MH_CYCLE_COUNTER_177_180
            DET_AZIMUTH_ERR_179_oRDR_DETECTION_177_180_oPCAN_RADAR_72d1e7dd_Tx: ComBitPosition=329, ComBitSize=7, ComSignalInitValue=0, ComSignalType=UINT8, ComHandleId=3719, ComSystemTemplateSystemSignalRef=DET_AZIMUTH_ERR_179
            DET_SNR_179_oRDR_DETECTION_177_180_oPCAN_RADAR_e977a0ee_Tx: ComBitPosition=344, ComBitSize=8, ComSignalInitValue=0, ComSignalType=UINT8, ComHandleId=3790, ComSystemTemplateSystemSignalRef=DET_SNR_179
            DET_SUPER_RES_TARGET_178_oRDR_DETECTION_177_180_oPCAN_RADAR_4d9e5c1e_Tx: ComBitPosition=199, ComBitSize=1, ComSignalInitValue=0, ComSignalType=BOOLEAN, ComHandleId=3793, ComSystemTemplateSystemSignalRef=DET_SUPER_RES_TARGET_178
            DET_RCS_179_oRDR_DETECTION_177_180_oPCAN_RADAR_34d9f4ec_Tx: ComBitPosition=352, ComBitSize=8, ComSignalInitValue=128, ComSignalType=UINT8, ComHandleId=3786, ComSystemTemplateSystemSignalRef=DET_RCS_179
            DET_HVC_FLAG_179_oRDR_DETECTION_177_180_oPCAN_RADAR_b305034e_Tx: ComBitPosition=310, ComBitSize=1, ComSignalInitValue=0, ComSignalType=BOOLEAN, ComHandleId=3751, ComSystemTemplateSystemSignalRef=DET_HVC_FLAG_179
            DET_ELEVATION_177_oRDR_DETECTION_177_180_oPCAN_RADAR_beb7ebf6_Tx: ComBitPosition=72, ComBitSize=8, ComSignalInitValue=0, ComSignalType=UINT8, ComHandleId=3737, ComSystemTemplateSystemSignalRef=DET_ELEVATION_177
            DET_SUPER_RES_TARGET_177_oRDR_DETECTION_177_180_oPCAN_RADAR_618ece59_Tx: ComBitPosition=87, ComBitSize=1, ComSignalInitValue=0, ComSignalType=BOOLEAN, ComHandleId=3792, ComSystemTemplateSystemSignalRef=DET_SUPER_RES_TARGET_177
            DET_RANGE_VELOCITY_180_oRDR_DETECTION_177_180_oPCAN_RADAR_be1d62ac_Tx: ComBitPosition=384, ComBitSize=15, ComSignalInitValue=16384, ComSignalType=UINT16, ComHandleId=3779, ComSystemTemplateSystemSignalRef=DET_RANGE_VELOCITY_180
            DET_AZIMUTH_178_oRDR_DETECTION_177_180_oPCAN_RADAR_4314a6bd_Tx: ComBitPosition=200, ComBitSize=13, ComSignalInitValue=0, ComSignalType=UINT16, ComHandleId=3714, ComSystemTemplateSystemSignalRef=DET_AZIMUTH_178
            DET_ELEVATION_178_oRDR_DETECTION_177_180_oPCAN_RADAR_92a779b1_Tx: ComBitPosition=184, ComBitSize=8, ComSignalInitValue=0, ComSignalType=UINT8, ComHandleId=3738, ComSystemTemplateSystemSignalRef=DET_ELEVATION_178
            DET_ELEVATION_179_oRDR_DETECTION_177_180_oPCAN_RADAR_07d7ad24_Tx: ComBitPosition=296, ComBitSize=8, ComSignalInitValue=0, ComSignalType=UINT8, ComHandleId=3739, ComSystemTemplateSystemSignalRef=DET_ELEVATION_179
            DET_EXISTENCE_PROB_179_oRDR_DETECTION_177_180_oPCAN_RADAR_52714031_Tx: ComBitPosition=336, ComBitSize=6, ComSignalInitValue=0, ComSignalType=UINT8, ComHandleId=3747, ComSystemTemplateSystemSignalRef=DET_EXISTENCE_PROB_179
            DET_MH_CRC16_177_180_oRDR_DETECTION_177_180_oPCAN_RADAR_e8e8c183_Tx: ComBitPosition=0, ComBitSize=16, ComSignalInitValue=0, ComSignalType=UINT16, ComHandleId=3757, ComSystemTemplateSystemSignalRef=DET_MH_CRC16_177_180
            DET_HVC_FLAG_178_oRDR_DETECTION_177_180_oPCAN_RADAR_2675d7db_Tx: ComBitPosition=198, ComBitSize=1, ComSignalInitValue=0, ComSignalType=BOOLEAN, ComHandleId=3750, ComSystemTemplateSystemSignalRef=DET_HVC_FLAG_178
            DET_ELEVATION_ERR_178_oRDR_DETECTION_177_180_oPCAN_RADAR_159ee1c4_Tx: ComBitPosition=192, ComBitSize=6, ComSignalInitValue=0, ComSignalType=UINT8, ComHandleId=3742, ComSystemTemplateSystemSignalRef=DET_ELEVATION_ERR_178
            DET_RCS_178_oRDR_DETECTION_177_180_oPCAN_RADAR_a1a92079_Tx: ComBitPosition=240, ComBitSize=8, ComSignalInitValue=128, ComSignalType=UINT8, ComHandleId=3785, ComSystemTemplateSystemSignalRef=DET_RCS_178
            DET_MH_SCAN_INDEX_4LSB_177_180_oRDR_DETECTION_177_180_oPCAN_RADAR_a0b74538_Tx: ComBitPosition=476, ComBitSize=4, ComSignalInitValue=0, ComSignalType=UINT8, ComHandleId=3759, ComSystemTemplateSystemSignalRef=DET_MH_SCAN_INDEX_4LSB_177_180
            DET_AZIMUTH_ERR_180_oRDR_DETECTION_177_180_oPCAN_RADAR_7f9546c7_Tx: ComBitPosition=441, ComBitSize=7, ComSignalInitValue=0, ComSignalType=UINT8, ComHandleId=3720, ComSystemTemplateSystemSignalRef=DET_AZIMUTH_ERR_180
            DET_CONFD_ELEVATION_180_oRDR_DETECTION_177_180_oPCAN_RADAR_db53d802_Tx: ComBitPosition=437, ComBitSize=2, ComSignalInitValue=0, ComSignalType=UINT8, ComHandleId=3736, ComSystemTemplateSystemSignalRef=DET_CONFD_ELEVATION_180
            DET_RANGE_ERR_178_oRDR_DETECTION_177_180_oPCAN_RADAR_f4676f6f_Tx: ComBitPosition=152, ComBitSize=7, ComSignalInitValue=0, ComSignalType=UINT8, ComHandleId=3773, ComSystemTemplateSystemSignalRef=DET_RANGE_ERR_178
            DET_AZIMUTH_180_oRDR_DETECTION_177_180_oPCAN_RADAR_db20d332_Tx: ComBitPosition=424, ComBitSize=13, ComSignalInitValue=0, ComSignalType=UINT16, ComHandleId=3716, ComSystemTemplateSystemSignalRef=DET_AZIMUTH_180
            DET_SUPER_RES_TARGET_179_oRDR_DETECTION_177_180_oPCAN_RADAR_d8ee888b_Tx: ComBitPosition=311, ComBitSize=1, ComSignalInitValue=0, ComSignalType=BOOLEAN, ComHandleId=3794, ComSystemTemplateSystemSignalRef=DET_SUPER_RES_TARGET_179
            DET_RCS_180_oRDR_DETECTION_177_180_oPCAN_RADAR_399d55f6_Tx: ComBitPosition=464, ComBitSize=8, ComSignalInitValue=128, ComSignalType=UINT8, ComHandleId=3787, ComSystemTemplateSystemSignalRef=DET_RCS_180
            DET_RANGE_VELOCITY_ERR_177_oRDR_DETECTION_177_180_oPCAN_RADAR_05827ed6_Tx: ComBitPosition=64, ComBitSize=8, ComSignalInitValue=0, ComSignalType=UINT8, ComHandleId=3780, ComSystemTemplateSystemSignalRef=DET_RANGE_VELOCITY_ERR_177
            DET_RANGE_179_oRDR_DETECTION_177_180_oPCAN_RADAR_c6ff0193_Tx: ComBitPosition=248, ComBitSize=15, ComSignalInitValue=0, ComSignalType=UINT16, ComHandleId=3770, ComSystemTemplateSystemSignalRef=DET_RANGE_179
            DET_RANGE_VELOCITY_177_oRDR_DETECTION_177_180_oPCAN_RADAR_0a398564_Tx: ComBitPosition=48, ComBitSize=15, ComSignalInitValue=16384, ComSignalType=UINT16, ComHandleId=3776, ComSystemTemplateSystemSignalRef=DET_RANGE_VELOCITY_177
            DET_CONFD_AZIMUTH_177_oRDR_DETECTION_177_180_oPCAN_RADAR_6de23e30_Tx: ComBitPosition=118, ComBitSize=2, ComSignalInitValue=0, ComSignalType=UINT8, ComHandleId=3729, ComSystemTemplateSystemSignalRef=DET_CONFD_AZIMUTH_177
            DET_AZIMUTH_179_oRDR_DETECTION_177_180_oPCAN_RADAR_d6647228_Tx: ComBitPosition=312, ComBitSize=13, ComSignalInitValue=0, ComSignalType=UINT16, ComHandleId=3715, ComSystemTemplateSystemSignalRef=DET_AZIMUTH_179
            DET_BI_STATIC_FLAG_178_oRDR_DETECTION_177_180_oPCAN_RADAR_1538e638_Tx: ComBitPosition=216, ComBitSize=1, ComSignalInitValue=0, ComSignalType=BOOLEAN, ComHandleId=3726, ComSystemTemplateSystemSignalRef=DET_BI_STATIC_FLAG_178
            DET_EXISTENCE_PROB_180_oRDR_DETECTION_177_180_oPCAN_RADAR_5f35e12b_Tx: ComBitPosition=448, ComBitSize=6, ComSignalInitValue=0, ComSignalType=UINT8, ComHandleId=3748, ComSystemTemplateSystemSignalRef=DET_EXISTENCE_PROB_180
            DET_CONFD_AZIMUTH_179_oRDR_DETECTION_177_180_oPCAN_RADAR_d48278e2_Tx: ComBitPosition=342, ComBitSize=2, ComSignalInitValue=0, ComSignalType=UINT8, ComHandleId=3731, ComSystemTemplateSystemSignalRef=DET_CONFD_AZIMUTH_179
            DET_CONFD_ELEVATION_179_oRDR_DETECTION_177_180_oPCAN_RADAR_d6177918_Tx: ComBitPosition=325, ComBitSize=2, ComSignalInitValue=0, ComSignalType=UINT8, ComHandleId=3735, ComSystemTemplateSystemSignalRef=DET_CONFD_ELEVATION_179
            DET_CONFD_ELEVATION_177_oRDR_DETECTION_177_180_oPCAN_RADAR_6f773fca_Tx: ComBitPosition=101, ComBitSize=2, ComSignalInitValue=0, ComSignalType=UINT8, ComHandleId=3733, ComSystemTemplateSystemSignalRef=DET_CONFD_ELEVATION_177
            DET_CONFD_ELEVATION_178_oRDR_DETECTION_177_180_oPCAN_RADAR_4367ad8d_Tx: ComBitPosition=213, ComBitSize=2, ComSignalInitValue=0, ComSignalType=UINT8, ComHandleId=3734, ComSystemTemplateSystemSignalRef=DET_CONFD_ELEVATION_178
            DET_SNR_178_oRDR_DETECTION_177_180_oPCAN_RADAR_7c07747b_Tx: ComBitPosition=232, ComBitSize=8, ComSignalInitValue=0, ComSignalType=UINT8, ComHandleId=3789, ComSystemTemplateSystemSignalRef=DET_SNR_178
            DET_HVC_FLAG_180_oRDR_DETECTION_177_180_oPCAN_RADAR_be41a254_Tx: ComBitPosition=422, ComBitSize=1, ComSignalInitValue=0, ComSignalType=BOOLEAN, ComHandleId=3752, ComSystemTemplateSystemSignalRef=DET_HVC_FLAG_180
            DET_RCS_177_oRDR_DETECTION_177_180_oPCAN_RADAR_8db9b23e_Tx: ComBitPosition=128, ComBitSize=8, ComSignalInitValue=128, ComSignalType=UINT8, ComHandleId=3784, ComSystemTemplateSystemSignalRef=DET_RCS_177
            DET_SUPER_RES_TARGET_180_oRDR_DETECTION_177_180_oPCAN_RADAR_d5aa2991_Tx: ComBitPosition=423, ComBitSize=1, ComSignalInitValue=0, ComSignalType=BOOLEAN, ComHandleId=3795, ComSystemTemplateSystemSignalRef=DET_SUPER_RES_TARGET_180
            DET_ELEVATION_ERR_177_oRDR_DETECTION_177_180_oPCAN_RADAR_398e7383_Tx: ComBitPosition=80, ComBitSize=6, ComSignalInitValue=0, ComSignalType=UINT8, ComHandleId=3741, ComSystemTemplateSystemSignalRef=DET_ELEVATION_ERR_177
            DET_RANGE_177_oRDR_DETECTION_177_180_oPCAN_RADAR_7f9f4741_Tx: ComBitPosition=24, ComBitSize=15, ComSignalInitValue=0, ComSignalType=UINT16, ComHandleId=3768, ComSystemTemplateSystemSignalRef=DET_RANGE_177
            DET_ELEVATION_ERR_180_oRDR_DETECTION_177_180_oPCAN_RADAR_8daa944b_Tx: ComBitPosition=416, ComBitSize=6, ComSignalInitValue=0, ComSignalType=UINT8, ComHandleId=3744, ComSystemTemplateSystemSignalRef=DET_ELEVATION_ERR_180
            DET_RANGE_VELOCITY_178_oRDR_DETECTION_177_180_oPCAN_RADAR_26291723_Tx: ComBitPosition=160, ComBitSize=15, ComSignalInitValue=16384, ComSignalType=UINT16, ComHandleId=3777, ComSystemTemplateSystemSignalRef=DET_RANGE_VELOCITY_178
            DET_AZIMUTH_ERR_177_oRDR_DETECTION_177_180_oPCAN_RADAR_cbb1a10f_Tx: ComBitPosition=105, ComBitSize=7, ComSignalInitValue=0, ComSignalType=UINT8, ComHandleId=3717, ComSystemTemplateSystemSignalRef=DET_AZIMUTH_ERR_177
            DET_CONFD_AZIMUTH_178_oRDR_DETECTION_177_180_oPCAN_RADAR_41f2ac77_Tx: ComBitPosition=230, ComBitSize=2, ComSignalInitValue=0, ComSignalType=UINT8, ComHandleId=3730, ComSystemTemplateSystemSignalRef=DET_CONFD_AZIMUTH_178
            DET_ELEVATION_ERR_179_oRDR_DETECTION_177_180_oPCAN_RADAR_80ee3551_Tx: ComBitPosition=304, ComBitSize=6, ComSignalInitValue=0, ComSignalType=UINT8, ComHandleId=3743, ComSystemTemplateSystemSignalRef=DET_ELEVATION_ERR_179
            DET_BI_STATIC_FLAG_180_oRDR_DETECTION_177_180_oPCAN_RADAR_8d0c93b7_Tx: ComBitPosition=440, ComBitSize=1, ComSignalInitValue=0, ComSignalType=BOOLEAN, ComHandleId=3728, ComSystemTemplateSystemSignalRef=DET_BI_STATIC_FLAG_180
            DET_RANGE_ERR_179_oRDR_DETECTION_177_180_oPCAN_RADAR_6117bbfa_Tx: ComBitPosition=264, ComBitSize=7, ComSignalInitValue=0, ComSignalType=UINT8, ComHandleId=3774, ComSystemTemplateSystemSignalRef=DET_RANGE_ERR_179
            DET_EXISTENCE_PROB_177_oRDR_DETECTION_177_180_oPCAN_RADAR_eb1106e3_Tx: ComBitPosition=112, ComBitSize=6, ComSignalInitValue=0, ComSignalType=UINT8, ComHandleId=3745, ComSystemTemplateSystemSignalRef=DET_EXISTENCE_PROB_177
            DET_RANGE_VELOCITY_ERR_178_oRDR_DETECTION_177_180_oPCAN_RADAR_2992ec91_Tx: ComBitPosition=176, ComBitSize=8, ComSignalInitValue=0, ComSignalType=UINT8, ComHandleId=3781, ComSystemTemplateSystemSignalRef=DET_RANGE_VELOCITY_ERR_178
            DET_RANGE_VELOCITY_ERR_180_oRDR_DETECTION_177_180_oPCAN_RADAR_b1a6991e_Tx: ComBitPosition=400, ComBitSize=8, ComSignalInitValue=0, ComSignalType=UINT8, ComHandleId=3783, ComSystemTemplateSystemSignalRef=DET_RANGE_VELOCITY_ERR_180
            DET_HVC_FLAG_177_oRDR_DETECTION_177_180_oPCAN_RADAR_0a65459c_Tx: ComBitPosition=86, ComBitSize=1, ComSignalInitValue=0, ComSignalType=BOOLEAN, ComHandleId=3749, ComSystemTemplateSystemSignalRef=DET_HVC_FLAG_177
            DET_BI_STATIC_FLAG_177_oRDR_DETECTION_177_180_oPCAN_RADAR_3928747f_Tx: ComBitPosition=104, ComBitSize=1, ComSignalInitValue=0, ComSignalType=BOOLEAN, ComHandleId=3725, ComSystemTemplateSystemSignalRef=DET_BI_STATIC_FLAG_177
            DET_EXISTENCE_PROB_178_oRDR_DETECTION_177_180_oPCAN_RADAR_c70194a4_Tx: ComBitPosition=224, ComBitSize=6, ComSignalInitValue=0, ComSignalType=UINT8, ComHandleId=3746, ComSystemTemplateSystemSignalRef=DET_EXISTENCE_PROB_178
            DET_RANGE_ERR_177_oRDR_DETECTION_177_180_oPCAN_RADAR_d877fd28_Tx: ComBitPosition=40, ComBitSize=7, ComSignalInitValue=0, ComSignalType=UINT8, ComHandleId=3772, ComSystemTemplateSystemSignalRef=DET_RANGE_ERR_177
            DET_RANGE_180_oRDR_DETECTION_177_180_oPCAN_RADAR_cbbba089_Tx: ComBitPosition=360, ComBitSize=15, ComSignalInitValue=0, ComSignalType=UINT16, ComHandleId=3771, ComSystemTemplateSystemSignalRef=DET_RANGE_180
            DET_AZIMUTH_ERR_178_oRDR_DETECTION_177_180_oPCAN_RADAR_e7a13348_Tx: ComBitPosition=217, ComBitSize=7, ComSignalInitValue=0, ComSignalType=UINT8, ComHandleId=3718, ComSystemTemplateSystemSignalRef=DET_AZIMUTH_ERR_178
            DET_BI_STATIC_FLAG_179_oRDR_DETECTION_177_180_oPCAN_RADAR_804832ad_Tx: ComBitPosition=328, ComBitSize=1, ComSignalInitValue=0, ComSignalType=BOOLEAN, ComHandleId=3727, ComSystemTemplateSystemSignalRef=DET_BI_STATIC_FLAG_179
            DET_AZIMUTH_177_oRDR_DETECTION_177_180_oPCAN_RADAR_6f0434fa_Tx: ComBitPosition=88, ComBitSize=13, ComSignalInitValue=0, ComSignalType=UINT16, ComHandleId=3713, ComSystemTemplateSystemSignalRef=DET_AZIMUTH_177
            DET_RANGE_VELOCITY_179_oRDR_DETECTION_177_180_oPCAN_RADAR_b359c3b6_Tx: ComBitPosition=272, ComBitSize=15, ComSignalInitValue=16384, ComSignalType=UINT16, ComHandleId=3778, ComSystemTemplateSystemSignalRef=DET_RANGE_VELOCITY_179
            DET_SNR_177_oRDR_DETECTION_177_180_oPCAN_RADAR_5017e63c_Tx: ComBitPosition=120, ComBitSize=8, ComSignalInitValue=0, ComSignalType=UINT8, ComHandleId=3788, ComSystemTemplateSystemSignalRef=DET_SNR_177
            DET_RANGE_178_oRDR_DETECTION_177_180_oPCAN_RADAR_538fd506_Tx: ComBitPosition=136, ComBitSize=15, ComSignalInitValue=0, ComSignalType=UINT16, ComHandleId=3769, ComSystemTemplateSystemSignalRef=DET_RANGE_178
            DET_CONFD_AZIMUTH_180_oRDR_DETECTION_177_180_oPCAN_RADAR_d9c6d9f8_Tx: ComBitPosition=454, ComBitSize=2, ComSignalInitValue=0, ComSignalType=UINT8, ComHandleId=3732, ComSystemTemplateSystemSignalRef=DET_CONFD_AZIMUTH_180
            DET_MTD_180_oRDR_DETECTION_177_180_oPCAN_RADAR_53a0ab32_Tx: ComBitPosition=383, ComBitSize=1, ComSignalInitValue=0, ComSignalType=UINT8, ComHandleId=3763, ComSystemTemplateSystemSignalRef=DET_MTD_180
            DET_PROB_1STAZHYPO_177_oRDR_DETECTION_177_180_oPCAN_RADAR_7430a437_Tx: ComBitPosition=103, ComBitSize=1, ComSignalInitValue=0, ComSignalType=BOOLEAN, ComHandleId=3764, ComSystemTemplateSystemSignalRef=DET_PROB_1STAZHYPO_177
            DET_IDM_177_oRDR_DETECTION_177_180_oPCAN_RADAR_81377e21_Tx: ComBitPosition=63, ComBitSize=1, ComSignalInitValue=0, ComSignalType=UINT8, ComHandleId=3753, ComSystemTemplateSystemSignalRef=DET_IDM_177
            DET_MTD_179_oRDR_DETECTION_177_180_oPCAN_RADAR_5ee40a28_Tx: ComBitPosition=271, ComBitSize=1, ComSignalInitValue=0, ComSignalType=UINT8, ComHandleId=3762, ComSystemTemplateSystemSignalRef=DET_MTD_179
            DET_MTD_178_oRDR_DETECTION_177_180_oPCAN_RADAR_cb94debd_Tx: ComBitPosition=159, ComBitSize=1, ComSignalInitValue=0, ComSignalType=UINT8, ComHandleId=3761, ComSystemTemplateSystemSignalRef=DET_MTD_178
            DET_BELOW_RAIN_THOLD_177_oRDR_DETECTION_177_180_oPCAN_RADAR_ba05a73a_Tx: ComBitPosition=39, ComBitSize=1, ComSignalInitValue=0, ComSignalType=UINT8, ComHandleId=3721, ComSystemTemplateSystemSignalRef=DET_BELOW_RAIN_THOLD_177
            DET_IDM_179_oRDR_DETECTION_177_180_oPCAN_RADAR_385738f3_Tx: ComBitPosition=287, ComBitSize=1, ComSignalInitValue=0, ComSignalType=UINT8, ComHandleId=3755, ComSystemTemplateSystemSignalRef=DET_IDM_179
            DET_MTD_177_oRDR_DETECTION_177_180_oPCAN_RADAR_e7844cfa_Tx: ComBitPosition=47, ComBitSize=1, ComSignalInitValue=0, ComSignalType=UINT8, ComHandleId=3760, ComSystemTemplateSystemSignalRef=DET_MTD_177
            DET_IDM_180_oRDR_DETECTION_177_180_oPCAN_RADAR_351399e9_Tx: ComBitPosition=399, ComBitSize=1, ComSignalInitValue=0, ComSignalType=UINT8, ComHandleId=3756, ComSystemTemplateSystemSignalRef=DET_IDM_180
            DET_PROB_1STAZHYPO_178_oRDR_DETECTION_177_180_oPCAN_RADAR_58203670_Tx: ComBitPosition=215, ComBitSize=1, ComSignalInitValue=0, ComSignalType=BOOLEAN, ComHandleId=3765, ComSystemTemplateSystemSignalRef=DET_PROB_1STAZHYPO_178
            DET_IDM_178_oRDR_DETECTION_177_180_oPCAN_RADAR_ad27ec66_Tx: ComBitPosition=175, ComBitSize=1, ComSignalInitValue=0, ComSignalType=UINT8, ComHandleId=3754, ComSystemTemplateSystemSignalRef=DET_IDM_178
            DET_BELOW_RAIN_THOLD_178_oRDR_DETECTION_177_180_oPCAN_RADAR_9615357d_Tx: ComBitPosition=151, ComBitSize=1, ComSignalInitValue=0, ComSignalType=UINT8, ComHandleId=3722, ComSystemTemplateSystemSignalRef=DET_BELOW_RAIN_THOLD_178
            DET_BELOW_RAIN_THOLD_180_oRDR_DETECTION_177_180_oPCAN_RADAR_0e2140f2_Tx: ComBitPosition=375, ComBitSize=1, ComSignalInitValue=0, ComSignalType=UINT8, ComHandleId=3724, ComSystemTemplateSystemSignalRef=DET_BELOW_RAIN_THOLD_180
            DET_PROB_1STAZHYPO_179_oRDR_DETECTION_177_180_oPCAN_RADAR_cd50e2e5_Tx: ComBitPosition=327, ComBitSize=1, ComSignalInitValue=0, ComSignalType=BOOLEAN, ComHandleId=3766, ComSystemTemplateSystemSignalRef=DET_PROB_1STAZHYPO_179
            DET_PROB_1STAZHYPO_180_oRDR_DETECTION_177_180_oPCAN_RADAR_c01443ff_Tx: ComBitPosition=439, ComBitSize=1, ComSignalInitValue=0, ComSignalType=BOOLEAN, ComHandleId=3767, ComSystemTemplateSystemSignalRef=DET_PROB_1STAZHYPO_180
            DET_BELOW_RAIN_THOLD_179_oRDR_DETECTION_177_180_oPCAN_RADAR_0365e1e8_Tx: ComBitPosition=263, ComBitSize=1, ComSignalInitValue=0, ComSignalType=UINT8, ComHandleId=3723, ComSystemTemplateSystemSignalRef=DET_BELOW_RAIN_THOLD_179
      ComMainFunctionTx_Periodic (ComMainFunctionTx): ComMainTxTimeBase=0.025, ComMainFunctionTxHandleId=1
      SG_Fusion_Detections_085_088_oRDR_FUSION_DET_085_088_oPCAN_RADAR_9d71d877_Rx (ComSignalGroup):
        ComTimeout = 0
        ComTransferProperty = PENDING
        ComSignalGroupAccess = ACCESS_NEEDED_BY_SWC_OR_COM
        ComHandleId = 29
        ComSignalGroupArrayAccess = true
        ComSystemTemplateSignalGroupRef = SG_Fusion_Detections_085_088
        83 x ComGroupSignal, all with ComSignalEndianness=LITTLE_ENDIAN, ComSignalInitValue=0, ComSignalAccess=ACCESS_NEEDED_BY_SWC_OR_COM:
          DET_RANGE_VELOCITY_ERR_085_Rx_oRDR_FUSION_DET_085_088_oPCAN_RADAR_3e87e5d7_Rx: ComBitPosition=64, ComBitSize=8, ComSignalType=UINT8, ComHandleId=1884, ComSystemTemplateSystemSignalRef=DET_RANGE_VELOCITY_ERR_085_Rx
          DET_AZIMUTH_ERR_085_Rx_oRDR_FUSION_DET_085_088_oPCAN_RADAR_6bb9eb4e_Rx: ComBitPosition=105, ComBitSize=7, ComSignalType=UINT8, ComHandleId=1821, ComSystemTemplateSystemSignalRef=DET_AZIMUTH_ERR_085_Rx
          DET_AZIMUTH_087_Rx_oRDR_FUSION_DET_085_088_oPCAN_RADAR_ec286803_Rx: ComBitPosition=312, ComBitSize=13, ComSignalType=UINT16, ComHandleId=1819, ComSystemTemplateSystemSignalRef=DET_AZIMUTH_087_Rx
          DET_RANGE_ERR_087_Rx_oRDR_FUSION_DET_085_088_oPCAN_RADAR_af1cb8c4_Rx: ComBitPosition=264, ComBitSize=7, ComSignalType=UINT8, ComHandleId=1878, ComSystemTemplateSystemSignalRef=DET_RANGE_ERR_087_Rx
          DET_ELEVATION_088_Rx_oRDR_FUSION_DET_085_088_oPCAN_RADAR_9e59c827_Rx: ComBitPosition=408, ComBitSize=8, ComSignalType=UINT8, ComHandleId=1844, ComSystemTemplateSystemSignalRef=DET_ELEVATION_088_Rx
          DET_EXISTENCE_PROB_085_Rx_oRDR_FUSION_DET_085_088_oPCAN_RADAR_be4ec20a_Rx: ComBitPosition=112, ComBitSize=6, ComSignalType=UINT8, ComHandleId=1849, ComSystemTemplateSystemSignalRef=DET_EXISTENCE_PROB_085_Rx
          DET_CONFD_AZIMUTH_085_Rx_oRDR_FUSION_DET_085_088_oPCAN_RADAR_9b9df43e_Rx: ComBitPosition=118, ComBitSize=2, ComSignalType=UINT8, ComHandleId=1833, ComSystemTemplateSystemSignalRef=DET_CONFD_AZIMUTH_085_Rx
          DET_PROB_1STAZHYPO_085_Rx_oRDR_FUSION_DET_085_088_oPCAN_RADAR_21abfefc_Rx: ComBitPosition=103, ComBitSize=1, ComSignalType=BOOLEAN, ComHandleId=1868, ComSystemTemplateSystemSignalRef=DET_PROB_1STAZHYPO_085_Rx
          DET_HVC_FLAG_088_Rx_oRDR_FUSION_DET_085_088_oPCAN_RADAR_66267f22_Rx: ComBitPosition=422, ComBitSize=1, ComSignalType=BOOLEAN, ComHandleId=1856, ComSystemTemplateSystemSignalRef=DET_HVC_FLAG_088_Rx
          DET_IDM_088_Rx_oRDR_FUSION_DET_085_088_oPCAN_RADAR_53e7866a_Rx: ComBitPosition=399, ComBitSize=1, ComSignalType=BOOLEAN, ComHandleId=1860, ComSystemTemplateSystemSignalRef=DET_IDM_088_Rx
          DET_HVC_FLAG_086_Rx_oRDR_FUSION_DET_085_088_oPCAN_RADAR_492c9fcd_Rx: ComBitPosition=198, ComBitSize=1, ComSignalType=BOOLEAN, ComHandleId=1854, ComSystemTemplateSystemSignalRef=DET_HVC_FLAG_086_Rx
          DET_MH_SCAN_INDEX_4LSB_085_088_Rx_oRDR_FUSION_DET_085_088_oPCAN_RADAR_e8ede572_Rx: ComBitPosition=476, ComBitSize=4, ComSignalType=UINT8, ComHandleId=1863, ComSystemTemplateSystemSignalRef=DET_MH_SCAN_INDEX_4LSB_085_088_Rx
          DET_AZIMUTH_ERR_087_Rx_oRDR_FUSION_DET_085_088_oPCAN_RADAR_ee41c981_Rx: ComBitPosition=329, ComBitSize=7, ComSignalType=UINT8, ComHandleId=1823, ComSystemTemplateSystemSignalRef=DET_AZIMUTH_ERR_087_Rx
          DET_ELEVATION_ERR_086_Rx_oRDR_FUSION_DET_085_088_oPCAN_RADAR_63ea0a17_Rx: ComBitPosition=192, ComBitSize=6, ComSignalType=UINT8, ComHandleId=1846, ComSystemTemplateSystemSignalRef=DET_ELEVATION_ERR_086_Rx
          DET_RANGE_088_Rx_oRDR_FUSION_DET_085_088_oPCAN_RADAR_7fa0468c_Rx: ComBitPosition=360, ComBitSize=15, ComSignalType=UINT16, ComHandleId=1875, ComSystemTemplateSystemSignalRef=DET_RANGE_088_Rx
          DET_SNR_088_Rx_oRDR_FUSION_DET_085_088_oPCAN_RADAR_66c42680_Rx: ComBitPosition=456, ComBitSize=8, ComSignalType=UINT8, ComHandleId=1895, ComSystemTemplateSystemSignalRef=DET_SNR_088_Rx
          DET_ELEVATION_ERR_085_Rx_oRDR_FUSION_DET_085_088_oPCAN_RADAR_4956ba9f_Rx: ComBitPosition=80, ComBitSize=6, ComSignalType=UINT8, ComHandleId=1845, ComSystemTemplateSystemSignalRef=DET_ELEVATION_ERR_085_Rx
          DET_RANGE_VELOCITY_ERR_087_Rx_oRDR_FUSION_DET_085_088_oPCAN_RADAR_bb7fc718_Rx: ComBitPosition=288, ComBitSize=8, ComSignalType=UINT8, ComHandleId=1886, ComSystemTemplateSystemSignalRef=DET_RANGE_VELOCITY_ERR_087_Rx
          DET_SNR_087_Rx_oRDR_FUSION_DET_085_088_oPCAN_RADAR_e68a5428_Rx: ComBitPosition=344, ComBitSize=8, ComSignalType=UINT8, ComHandleId=1894, ComSystemTemplateSystemSignalRef=DET_SNR_087_Rx
          DET_RANGE_VELOCITY_ERR_088_Rx_oRDR_FUSION_DET_085_088_oPCAN_RADAR_3b31b5b0_Rx: ComBitPosition=400, ComBitSize=8, ComSignalType=UINT8, ComHandleId=1887, ComSystemTemplateSystemSignalRef=DET_RANGE_VELOCITY_ERR_088_Rx
          DET_PROB_1STAZHYPO_088_Rx_oRDR_FUSION_DET_085_088_oPCAN_RADAR_241dae9b_Rx: ComBitPosition=439, ComBitSize=1, ComSignalType=BOOLEAN, ComHandleId=1871, ComSystemTemplateSystemSignalRef=DET_PROB_1STAZHYPO_088_Rx
          DET_BI_STATIC_FLAG_086_Rx_oRDR_FUSION_DET_085_088_oPCAN_RADAR_5248aee2_Rx: ComBitPosition=216, ComBitSize=1, ComSignalType=BOOLEAN, ComHandleId=1830, ComSystemTemplateSystemSignalRef=DET_BI_STATIC_FLAG_086_Rx
          DET_RANGE_VELOCITY_086_Rx_oRDR_FUSION_DET_085_088_oPCAN_RADAR_8d5f259d_Rx: ComBitPosition=160, ComBitSize=15, ComSignalType=UINT16, ComHandleId=1881, ComSystemTemplateSystemSignalRef=DET_RANGE_VELOCITY_086_Rx
          DET_AZIMUTH_088_Rx_oRDR_FUSION_DET_085_088_oPCAN_RADAR_6c661aab_Rx: ComBitPosition=424, ComBitSize=13, ComSignalType=UINT16, ComHandleId=1820, ComSystemTemplateSystemSignalRef=DET_AZIMUTH_088_Rx
          DET_RANGE_085_Rx_oRDR_FUSION_DET_085_088_oPCAN_RADAR_7a1616eb_Rx: ComBitPosition=24, ComBitSize=15, ComSignalType=UINT16, ComHandleId=1872, ComSystemTemplateSystemSignalRef=DET_RANGE_085_Rx
          DET_EXISTENCE_PROB_087_Rx_oRDR_FUSION_DET_085_088_oPCAN_RADAR_3bb6e0c5_Rx: ComBitPosition=336, ComBitSize=6, ComSignalType=UINT8, ComHandleId=1851, ComSystemTemplateSystemSignalRef=DET_EXISTENCE_PROB_087_Rx
          DET_SNR_085_Rx_oRDR_FUSION_DET_085_088_oPCAN_RADAR_637276e7_Rx: ComBitPosition=120, ComBitSize=8, ComSignalType=UINT8, ComHandleId=1892, ComSystemTemplateSystemSignalRef=DET_SNR_085_Rx
          DET_SUPER_RES_TARGET_086_Rx_oRDR_FUSION_DET_085_088_oPCAN_RADAR_8235e76f_Rx: ComBitPosition=199, ComBitSize=1, ComSignalType=BOOLEAN, ComHandleId=1897, ComSystemTemplateSystemSignalRef=DET_SUPER_RES_TARGET_086_Rx
          DET_BI_STATIC_FLAG_087_Rx_oRDR_FUSION_DET_085_088_oPCAN_RADAR_fd0c3ca5_Rx: ComBitPosition=328, ComBitSize=1, ComSignalType=BOOLEAN, ComHandleId=1831, ComSystemTemplateSystemSignalRef=DET_BI_STATIC_FLAG_087_Rx
          DET_ELEVATION_086_Rx_oRDR_FUSION_DET_085_088_oPCAN_RADAR_b15328c8_Rx: ComBitPosition=184, ComBitSize=8, ComSignalType=UINT8, ComHandleId=1842, ComSystemTemplateSystemSignalRef=DET_ELEVATION_086_Rx
          DET_MTD_085_Rx_oRDR_FUSION_DET_085_088_oPCAN_RADAR_ebd2e07d_Rx: ComBitPosition=47, ComBitSize=1, ComSignalType=BOOLEAN, ComHandleId=1864, ComSystemTemplateSystemSignalRef=DET_MTD_085_Rx
          DET_ELEVATION_087_Rx_oRDR_FUSION_DET_085_088_oPCAN_RADAR_1e17ba8f_Rx: ComBitPosition=296, ComBitSize=8, ComSignalType=UINT8, ComHandleId=1843, ComSystemTemplateSystemSignalRef=DET_ELEVATION_087_Rx
          DET_CONFD_AZIMUTH_087_Rx_oRDR_FUSION_DET_085_088_oPCAN_RADAR_1e65d6f1_Rx: ComBitPosition=342, ComBitSize=2, ComSignalType=UINT8, ComHandleId=1835, ComSystemTemplateSystemSignalRef=DET_CONFD_AZIMUTH_087_Rx
          DET_AZIMUTH_ERR_086_Rx_oRDR_FUSION_DET_085_088_oPCAN_RADAR_41055bc6_Rx: ComBitPosition=217, ComBitSize=7, ComSignalType=UINT8, ComHandleId=1822, ComSystemTemplateSystemSignalRef=DET_AZIMUTH_ERR_086_Rx
          DET_RANGE_ERR_085_Rx_oRDR_FUSION_DET_085_088_oPCAN_RADAR_2ae49a0b_Rx: ComBitPosition=40, ComBitSize=7, ComSignalType=UINT8, ComHandleId=1876, ComSystemTemplateSystemSignalRef=DET_RANGE_ERR_085_Rx
          DET_RCS_085_Rx_oRDR_FUSION_DET_085_088_oPCAN_RADAR_6a28070e_Rx: ComBitPosition=128, ComBitSize=8, ComSignalType=UINT8, ComHandleId=1888, ComSystemTemplateSystemSignalRef=DET_RCS_085_Rx
          DET_SUPER_RES_TARGET_088_Rx_oRDR_FUSION_DET_085_088_oPCAN_RADAR_ad3f0780_Rx: ComBitPosition=423, ComBitSize=1, ComSignalType=BOOLEAN, ComHandleId=1899, ComSystemTemplateSystemSignalRef=DET_SUPER_RES_TARGET_088_Rx
          DET_MTD_088_Rx_oRDR_FUSION_DET_085_088_oPCAN_RADAR_ee64b01a_Rx: ComBitPosition=383, ComBitSize=1, ComSignalType=BOOLEAN, ComHandleId=1867, ComSystemTemplateSystemSignalRef=DET_MTD_088_Rx
          DET_PROB_1STAZHYPO_087_Rx_oRDR_FUSION_DET_085_088_oPCAN_RADAR_a453dc33_Rx: ComBitPosition=327, ComBitSize=1, ComSignalType=BOOLEAN, ComHandleId=1870, ComSystemTemplateSystemSignalRef=DET_PROB_1STAZHYPO_087_Rx
          DET_RANGE_VELOCITY_088_Rx_oRDR_FUSION_DET_085_088_oPCAN_RADAR_a255c572_Rx: ComBitPosition=384, ComBitSize=15, ComSignalType=UINT16, ComHandleId=1883, ComSystemTemplateSystemSignalRef=DET_RANGE_VELOCITY_088_Rx
          DET_RCS_088_Rx_oRDR_FUSION_DET_085_088_oPCAN_RADAR_6f9e5769_Rx: ComBitPosition=464, ComBitSize=8, ComSignalType=UINT8, ComHandleId=1891, ComSystemTemplateSystemSignalRef=DET_RCS_088_Rx
          DET_BELOW_RAIN_THOLD_088_Rx_oRDR_FUSION_DET_085_088_oPCAN_RADAR_0adce51e_Rx: ComBitPosition=375, ComBitSize=1, ComSignalType=BOOLEAN, ComHandleId=1828, ComSystemTemplateSystemSignalRef=DET_BELOW_RAIN_THOLD_088_Rx
          DET_BELOW_RAIN_THOLD_086_Rx_oRDR_FUSION_DET_085_088_oPCAN_RADAR_25d605f1_Rx: ComBitPosition=151, ComBitSize=1, ComSignalType=BOOLEAN, ComHandleId=1826, ComSystemTemplateSystemSignalRef=DET_BELOW_RAIN_THOLD_086_Rx
          DET_EXISTENCE_PROB_086_Rx_oRDR_FUSION_DET_085_088_oPCAN_RADAR_94f27282_Rx: ComBitPosition=224, ComBitSize=6, ComSignalType=UINT8, ComHandleId=1850, ComSystemTemplateSystemSignalRef=DET_EXISTENCE_PROB_086_Rx
          DET_RCS_086_Rx_oRDR_FUSION_DET_085_088_oPCAN_RADAR_4094b786_Rx: ComBitPosition=240, ComBitSize=8, ComSignalType=UINT8, ComHandleId=1889, ComSystemTemplateSystemSignalRef=DET_RCS_086_Rx
          DET_IDM_087_Rx_oRDR_FUSION_DET_085_088_oPCAN_RADAR_d3a9f4c2_Rx: ComBitPosition=287, ComBitSize=1, ComSignalType=BOOLEAN, ComHandleId=1859, ComSystemTemplateSystemSignalRef=DET_IDM_087_Rx
          DET_IDM_086_Rx_oRDR_FUSION_DET_085_088_oPCAN_RADAR_7ced6685_Rx: ComBitPosition=175, ComBitSize=1, ComSignalType=BOOLEAN, ComHandleId=1858, ComSystemTemplateSystemSignalRef=DET_IDM_086_Rx
          DET_SUPER_RES_TARGET_085_Rx_oRDR_FUSION_DET_085_088_oPCAN_RADAR_a88957e7_Rx: ComBitPosition=87, ComBitSize=1, ComSignalType=BOOLEAN, ComHandleId=1896, ComSystemTemplateSystemSignalRef=DET_SUPER_RES_TARGET_085_Rx
          DET_SNR_086_Rx_oRDR_FUSION_DET_085_088_oPCAN_RADAR_49cec66f_Rx: ComBitPosition=232, ComBitSize=8, ComSignalType=UINT8, ComHandleId=1893, ComSystemTemplateSystemSignalRef=DET_SNR_086_Rx
          DET_CONFD_ELEVATION_087_Rx_oRDR_FUSION_DET_085_088_oPCAN_RADAR_14445576_Rx: ComBitPosition=325, ComBitSize=2, ComSignalType=UINT8, ComHandleId=1839, ComSystemTemplateSystemSignalRef=DET_CONFD_ELEVATION_087_Rx
          DET_ELEVATION_085_Rx_oRDR_FUSION_DET_085_088_oPCAN_RADAR_9bef9840_Rx: ComBitPosition=72, ComBitSize=8, ComSignalType=UINT8, ComHandleId=1841, ComSystemTemplateSystemSignalRef=DET_ELEVATION_085_Rx
          DET_CONFD_AZIMUTH_088_Rx_oRDR_FUSION_DET_085_088_oPCAN_RADAR_9e2ba459_Rx: ComBitPosition=454, ComBitSize=2, ComSignalType=UINT8, ComHandleId=1836, ComSystemTemplateSystemSignalRef=DET_CONFD_AZIMUTH_088_Rx
          DET_ELEVATION_ERR_088_Rx_oRDR_FUSION_DET_085_088_oPCAN_RADAR_4ce0eaf8_Rx: ComBitPosition=416, ComBitSize=6, ComSignalType=UINT8, ComHandleId=1848, ComSystemTemplateSystemSignalRef=DET_ELEVATION_ERR_088_Rx
          DET_RCS_087_Rx_oRDR_FUSION_DET_085_088_oPCAN_RADAR_efd025c1_Rx: ComBitPosition=352, ComBitSize=8, ComSignalType=UINT8, ComHandleId=1890, ComSystemTemplateSystemSignalRef=DET_RCS_087_Rx
          DET_EXISTENCE_PROB_088_Rx_oRDR_FUSION_DET_085_088_oPCAN_RADAR_bbf8926d_Rx: ComBitPosition=448, ComBitSize=6, ComSignalType=UINT8, ComHandleId=1852, ComSystemTemplateSystemSignalRef=DET_EXISTENCE_PROB_088_Rx
          DET_BELOW_RAIN_THOLD_085_Rx_oRDR_FUSION_DET_085_088_oPCAN_RADAR_0f6ab579_Rx: ComBitPosition=39, ComBitSize=1, ComSignalType=BOOLEAN, ComHandleId=1825, ComSystemTemplateSystemSignalRef=DET_BELOW_RAIN_THOLD_085_Rx
          DET_AZIMUTH_085_Rx_oRDR_FUSION_DET_085_088_oPCAN_RADAR_69d04acc_Rx: ComBitPosition=88, ComBitSize=13, ComSignalType=UINT16, ComHandleId=1817, ComSystemTemplateSystemSignalRef=DET_AZIMUTH_085_Rx
          DET_CONFD_ELEVATION_088_Rx_oRDR_FUSION_DET_085_088_oPCAN_RADAR_940a27de_Rx: ComBitPosition=437, ComBitSize=2, ComSignalType=UINT8, ComHandleId=1840, ComSystemTemplateSystemSignalRef=DET_CONFD_ELEVATION_088_Rx
          DET_SUPER_RES_TARGET_087_Rx_oRDR_FUSION_DET_085_088_oPCAN_RADAR_2d717528_Rx: ComBitPosition=311, ComBitSize=1, ComSignalType=BOOLEAN, ComHandleId=1898, ComSystemTemplateSystemSignalRef=DET_SUPER_RES_TARGET_087_Rx
          DET_CONFD_AZIMUTH_086_Rx_oRDR_FUSION_DET_085_088_oPCAN_RADAR_b12144b6_Rx: ComBitPosition=230, ComBitSize=2, ComSignalType=UINT8, ComHandleId=1834, ComSystemTemplateSystemSignalRef=DET_CONFD_AZIMUTH_086_Rx
          DET_BI_STATIC_FLAG_085_Rx_oRDR_FUSION_DET_085_088_oPCAN_RADAR_78f41e6a_Rx: ComBitPosition=104, ComBitSize=1, ComSignalType=BOOLEAN, ComHandleId=1829, ComSystemTemplateSystemSignalRef=DET_BI_STATIC_FLAG_085_Rx
          DET_BI_STATIC_FLAG_088_Rx_oRDR_FUSION_DET_085_088_oPCAN_RADAR_7d424e0d_Rx: ComBitPosition=440, ComBitSize=1, ComSignalType=BOOLEAN, ComHandleId=1832, ComSystemTemplateSystemSignalRef=DET_BI_STATIC_FLAG_088_Rx
          DET_RANGE_086_Rx_oRDR_FUSION_DET_085_088_oPCAN_RADAR_50aaa663_Rx: ComBitPosition=136, ComBitSize=15, ComSignalType=UINT16, ComHandleId=1873, ComSystemTemplateSystemSignalRef=DET_RANGE_086_Rx
          DET_RANGE_VELOCITY_ERR_086_Rx_oRDR_FUSION_DET_085_088_oPCAN_RADAR_143b555f_Rx: ComBitPosition=176, ComBitSize=8, ComSignalType=UINT8, ComHandleId=1885, ComSystemTemplateSystemSignalRef=DET_RANGE_VELOCITY_ERR_086_Rx
          DET_MH_CRC16_085_088_Rx_oRDR_FUSION_DET_085_088_oPCAN_RADAR_8186178c_Rx: ComBitPosition=0, ComBitSize=16, ComSignalType=UINT16, ComHandleId=1861, ComSystemTemplateSystemSignalRef=DET_MH_CRC16_085_088_Rx
          DET_RANGE_ERR_086_Rx_oRDR_FUSION_DET_085_088_oPCAN_RADAR_00582a83_Rx: ComBitPosition=152, ComBitSize=7, ComSignalType=UINT8, ComHandleId=1877, ComSystemTemplateSystemSignalRef=DET_RANGE_ERR_086_Rx
          DET_CONFD_ELEVATION_086_Rx_oRDR_FUSION_DET_085_088_oPCAN_RADAR_bb00c731_Rx: ComBitPosition=213, ComBitSize=2, ComSignalType=UINT8, ComHandleId=1838, ComSystemTemplateSystemSignalRef=DET_CONFD_ELEVATION_086_Rx
          DET_HVC_FLAG_085_Rx_oRDR_FUSION_DET_085_088_oPCAN_RADAR_63902f45_Rx: ComBitPosition=86, ComBitSize=1, ComSignalType=BOOLEAN, ComHandleId=1853, ComSystemTemplateSystemSignalRef=DET_HVC_FLAG_085_Rx
          DET_AZIMUTH_ERR_088_Rx_oRDR_FUSION_DET_085_088_oPCAN_RADAR_6e0fbb29_Rx: ComBitPosition=441, ComBitSize=7, ComSignalType=UINT8, ComHandleId=1824, ComSystemTemplateSystemSignalRef=DET_AZIMUTH_ERR_088_Rx
          DET_MH_CYCLE_COUNTER_085_088_Rx_oRDR_FUSION_DET_085_088_oPCAN_RADAR_8c5d2a49_Rx: ComBitPosition=16, ComBitSize=8, ComSignalType=UINT8, ComHandleId=1862, ComSystemTemplateSystemSignalRef=DET_MH_CYCLE_COUNTER_085_088_Rx
          DET_CONFD_ELEVATION_085_Rx_oRDR_FUSION_DET_085_088_oPCAN_RADAR_91bc77b9_Rx: ComBitPosition=101, ComBitSize=2, ComSignalType=UINT8, ComHandleId=1837, ComSystemTemplateSystemSignalRef=DET_CONFD_ELEVATION_085_Rx
          DET_RANGE_ERR_088_Rx_oRDR_FUSION_DET_085_088_oPCAN_RADAR_2f52ca6c_Rx: ComBitPosition=376, ComBitSize=7, ComSignalType=UINT8, ComHandleId=1879, ComSystemTemplateSystemSignalRef=DET_RANGE_ERR_088_Rx
          DET_ELEVATION_ERR_087_Rx_oRDR_FUSION_DET_085_088_oPCAN_RADAR_ccae9850_Rx: ComBitPosition=304, ComBitSize=6, ComSignalType=UINT8, ComHandleId=1847, ComSystemTemplateSystemSignalRef=DET_ELEVATION_ERR_087_Rx
          DET_MTD_087_Rx_oRDR_FUSION_DET_085_088_oPCAN_RADAR_6e2ac2b2_Rx: ComBitPosition=271, ComBitSize=1, ComSignalType=BOOLEAN, ComHandleId=1866, ComSystemTemplateSystemSignalRef=DET_MTD_087_Rx
          DET_IDM_085_Rx_oRDR_FUSION_DET_085_088_oPCAN_RADAR_5651d60d_Rx: ComBitPosition=63, ComBitSize=1, ComSignalType=BOOLEAN, ComHandleId=1857, ComSystemTemplateSystemSignalRef=DET_IDM_085_Rx
          DET_MTD_086_Rx_oRDR_FUSION_DET_085_088_oPCAN_RADAR_c16e50f5_Rx: ComBitPosition=159, ComBitSize=1, ComSignalType=BOOLEAN, ComHandleId=1865, ComSystemTemplateSystemSignalRef=DET_MTD_086_Rx
          DET_BELOW_RAIN_THOLD_087_Rx_oRDR_FUSION_DET_085_088_oPCAN_RADAR_8a9297b6_Rx: ComBitPosition=263, ComBitSize=1, ComSignalType=BOOLEAN, ComHandleId=1827, ComSystemTemplateSystemSignalRef=DET_BELOW_RAIN_THOLD_087_Rx
          DET_PROB_1STAZHYPO_086_Rx_oRDR_FUSION_DET_085_088_oPCAN_RADAR_0b174e74_Rx: ComBitPosition=215, ComBitSize=1, ComSignalType=BOOLEAN, ComHandleId=1869, ComSystemTemplateSystemSignalRef=DET_PROB_1STAZHYPO_086_Rx
          DET_RANGE_VELOCITY_087_Rx_oRDR_FUSION_DET_085_088_oPCAN_RADAR_221bb7da_Rx: ComBitPosition=272, ComBitSize=15, ComSignalType=UINT16, ComHandleId=1882, ComSystemTemplateSystemSignalRef=DET_RANGE_VELOCITY_087_Rx
          DET_RANGE_087_Rx_oRDR_FUSION_DET_085_088_oPCAN_RADAR_ffee3424_Rx: ComBitPosition=248, ComBitSize=15, ComSignalType=UINT16, ComHandleId=1874, ComSystemTemplateSystemSignalRef=DET_RANGE_087_Rx
          DET_AZIMUTH_086_Rx_oRDR_FUSION_DET_085_088_oPCAN_RADAR_436cfa44_Rx: ComBitPosition=200, ComBitSize=13, ComSignalType=UINT16, ComHandleId=1818, ComSystemTemplateSystemSignalRef=DET_AZIMUTH_086_Rx
          DET_RANGE_VELOCITY_085_Rx_oRDR_FUSION_DET_085_088_oPCAN_RADAR_a7e39515_Rx: ComBitPosition=48, ComBitSize=15, ComSignalType=UINT16, ComHandleId=1880, ComSystemTemplateSystemSignalRef=DET_RANGE_VELOCITY_085_Rx
          DET_HVC_FLAG_087_Rx_oRDR_FUSION_DET_085_088_oPCAN_RADAR_e6680d8a_Rx: ComBitPosition=310, ComBitSize=1, ComSignalType=BOOLEAN, ComHandleId=1855, ComSystemTemplateSystemSignalRef=DET_HVC_FLAG_087_Rx
