[part 17 of 20: package /ActiveEcuC]
AUTOSAR XML (schema 00053)
package /ActiveEcuC  (continued)
  module config Com: implementation-config-variant=VARIANT-PRE-COMPILE, module-description=Com_Impl  (continued)
    ComConfig: ComConfigurationId=0, ComRxImmediateNotificationCacheSize=0, ComRxDeferredNotificationCacheSize=1  (continued)
      SG_Fusion_Detections_069_072_oRDR_FUSION_DET_069_072_oPCAN_RADAR_98a9029f_Rx (ComSignalGroup):
        ComTimeout = 0
        ComTransferProperty = PENDING
        ComSignalGroupAccess = ACCESS_NEEDED_BY_SWC_OR_COM
        ComHandleId = 25
        ComSignalGroupArrayAccess = true
        ComSystemTemplateSignalGroupRef = SG_Fusion_Detections_069_072
        83 x ComGroupSignal, all with ComSignalEndianness=LITTLE_ENDIAN, ComSignalInitValue=0, ComSignalAccess=ACCESS_NEEDED_BY_SWC_OR_COM:
          DET_AZIMUTH_ERR_070_Rx_oRDR_FUSION_DET_069_072_oPCAN_RADAR_2c0ff776_Rx: ComBitPosition=217, ComBitSize=7, ComSignalType=UINT8, ComHandleId=1490, ComSystemTemplateSystemSignalRef=DET_AZIMUTH_ERR_070_Rx
          DET_AZIMUTH_ERR_072_Rx_oRDR_FUSION_DET_069_072_oPCAN_RADAR_a9f7d5b9_Rx: ComBitPosition=441, ComBitSize=7, ComSignalType=UINT8, ComHandleId=1492, ComSystemTemplateSystemSignalRef=DET_AZIMUTH_ERR_072_Rx
          DET_RCS_070_Rx_oRDR_FUSION_DET_069_072_oPCAN_RADAR_2d9e1b36_Rx: ComBitPosition=240, ComBitSize=8, ComSignalType=UINT8, ComHandleId=1557, ComSystemTemplateSystemSignalRef=DET_RCS_070_Rx
          DET_MTD_072_Rx_oRDR_FUSION_DET_069_072_oPCAN_RADAR_299cde8a_Rx: ComBitPosition=383, ComBitSize=1, ComSignalType=BOOLEAN, ComHandleId=1535, ComSystemTemplateSystemSignalRef=DET_MTD_072_Rx
          DET_MH_CYCLE_COUNTER_069_072_Rx_oRDR_FUSION_DET_069_072_oPCAN_RADAR_0a45cc8d_Rx: ComBitPosition=16, ComBitSize=8, ComSignalType=UINT8, ComHandleId=1530, ComSystemTemplateSystemSignalRef=DET_MH_CYCLE_COUNTER_069_072_Rx
          DET_MTD_070_Rx_oRDR_FUSION_DET_069_072_oPCAN_RADAR_ac64fc45_Rx: ComBitPosition=159, ComBitSize=1, ComSignalType=BOOLEAN, ComHandleId=1533, ComSystemTemplateSystemSignalRef=DET_MTD_070_Rx
          DET_BELOW_RAIN_THOLD_070_Rx_oRDR_FUSION_DET_069_072_oPCAN_RADAR_48dca941_Rx: ComBitPosition=151, ComBitSize=1, ComSignalType=BOOLEAN, ComHandleId=1494, ComSystemTemplateSystemSignalRef=DET_BELOW_RAIN_THOLD_070_Rx
          DET_RANGE_VELOCITY_ERR_072_Rx_oRDR_FUSION_DET_069_072_oPCAN_RADAR_fcc9db20_Rx: ComBitPosition=400, ComBitSize=8, ComSignalType=UINT8, ComHandleId=1555, ComSystemTemplateSystemSignalRef=DET_RANGE_VELOCITY_ERR_072_Rx
          DET_IDM_070_Rx_oRDR_FUSION_DET_069_072_oPCAN_RADAR_11e7ca35_Rx: ComBitPosition=175, ComBitSize=1, ComSignalType=BOOLEAN, ComHandleId=1526, ComSystemTemplateSystemSignalRef=DET_IDM_070_Rx
          DET_RANGE_072_Rx_oRDR_FUSION_DET_069_072_oPCAN_RADAR_b858281c_Rx: ComBitPosition=360, ComBitSize=15, ComSignalType=UINT16, ComHandleId=1543, ComSystemTemplateSystemSignalRef=DET_RANGE_072_Rx
          DET_HVC_FLAG_071_Rx_oRDR_FUSION_DET_069_072_oPCAN_RADAR_8b62a13a_Rx: ComBitPosition=310, ComBitSize=1, ComSignalType=BOOLEAN, ComHandleId=1523, ComSystemTemplateSystemSignalRef=DET_HVC_FLAG_071_Rx
          DET_MH_CRC16_069_072_Rx_oRDR_FUSION_DET_069_072_oPCAN_RADAR_079ef148_Rx: ComBitPosition=0, ComBitSize=16, ComSignalType=UINT16, ComHandleId=1529, ComSystemTemplateSystemSignalRef=DET_MH_CRC16_069_072_Rx
          DET_EXISTENCE_PROB_072_Rx_oRDR_FUSION_DET_069_072_oPCAN_RADAR_7c00fcfd_Rx: ComBitPosition=448, ComBitSize=6, ComSignalType=UINT8, ComHandleId=1520, ComSystemTemplateSystemSignalRef=DET_EXISTENCE_PROB_072_Rx
          DET_RCS_069_Rx_oRDR_FUSION_DET_069_072_oPCAN_RADAR_10be982f_Rx: ComBitPosition=128, ComBitSize=8, ComSignalType=UINT8, ComHandleId=1556, ComSystemTemplateSystemSignalRef=DET_RCS_069_Rx
          DET_SUPER_RES_TARGET_069_Rx_oRDR_FUSION_DET_069_072_oPCAN_RADAR_d21fc8c6_Rx: ComBitPosition=87, ComBitSize=1, ComSignalType=BOOLEAN, ComHandleId=1564, ComSystemTemplateSystemSignalRef=DET_SUPER_RES_TARGET_069_Rx
          DET_RANGE_VELOCITY_071_Rx_oRDR_FUSION_DET_069_072_oPCAN_RADAR_4f111b6a_Rx: ComBitPosition=272, ComBitSize=15, ComSignalType=UINT16, ComHandleId=1550, ComSystemTemplateSystemSignalRef=DET_RANGE_VELOCITY_071_Rx
          DET_IDM_071_Rx_oRDR_FUSION_DET_069_072_oPCAN_RADAR_bea35872_Rx: ComBitPosition=287, ComBitSize=1, ComSignalType=BOOLEAN, ComHandleId=1527, ComSystemTemplateSystemSignalRef=DET_IDM_071_Rx
          DET_CONFD_ELEVATION_072_Rx_oRDR_FUSION_DET_069_072_oPCAN_RADAR_53f2494e_Rx: ComBitPosition=437, ComBitSize=2, ComSignalType=UINT8, ComHandleId=1508, ComSystemTemplateSystemSignalRef=DET_CONFD_ELEVATION_072_Rx
          DET_BI_STATIC_FLAG_069_Rx_oRDR_FUSION_DET_069_072_oPCAN_RADAR_0262814b_Rx: ComBitPosition=104, ComBitSize=1, ComSignalType=BOOLEAN, ComHandleId=1497, ComSystemTemplateSystemSignalRef=DET_BI_STATIC_FLAG_069_Rx
          DET_IDM_069_Rx_oRDR_FUSION_DET_069_072_oPCAN_RADAR_2cc7492c_Rx: ComBitPosition=63, ComBitSize=1, ComSignalType=BOOLEAN, ComHandleId=1525, ComSystemTemplateSystemSignalRef=DET_IDM_069_Rx
          DET_PROB_1STAZHYPO_071_Rx_oRDR_FUSION_DET_069_072_oPCAN_RADAR_c9597083_Rx: ComBitPosition=327, ComBitSize=1, ComSignalType=BOOLEAN, ComHandleId=1538, ComSystemTemplateSystemSignalRef=DET_PROB_1STAZHYPO_071_Rx
          DET_PROB_1STAZHYPO_072_Rx_oRDR_FUSION_DET_069_072_oPCAN_RADAR_e3e5c00b_Rx: ComBitPosition=439, ComBitSize=1, ComSignalType=BOOLEAN, ComHandleId=1539, ComSystemTemplateSystemSignalRef=DET_PROB_1STAZHYPO_072_Rx
          DET_HVC_FLAG_069_Rx_oRDR_FUSION_DET_069_072_oPCAN_RADAR_1906b064_Rx: ComBitPosition=86, ComBitSize=1, ComSignalType=BOOLEAN, ComHandleId=1521, ComSystemTemplateSystemSignalRef=DET_HVC_FLAG_069_Rx
          DET_RANGE_VELOCITY_ERR_071_Rx_oRDR_FUSION_DET_069_072_oPCAN_RADAR_d6756ba8_Rx: ComBitPosition=288, ComBitSize=8, ComSignalType=UINT8, ComHandleId=1554, ComSystemTemplateSystemSignalRef=DET_RANGE_VELOCITY_ERR_071_Rx
          DET_CONFD_AZIMUTH_071_Rx_oRDR_FUSION_DET_069_072_oPCAN_RADAR_736f7a41_Rx: ComBitPosition=342, ComBitSize=2, ComSignalType=UINT8, ComHandleId=1503, ComSystemTemplateSystemSignalRef=DET_CONFD_AZIMUTH_071_Rx
          DET_RANGE_VELOCITY_070_Rx_oRDR_FUSION_DET_069_072_oPCAN_RADAR_e055892d_Rx: ComBitPosition=160, ComBitSize=15, ComSignalType=UINT16, ComHandleId=1549, ComSystemTemplateSystemSignalRef=DET_RANGE_VELOCITY_070_Rx
          DET_AZIMUTH_070_Rx_oRDR_FUSION_DET_069_072_oPCAN_RADAR_2e6656f4_Rx: ComBitPosition=200, ComBitSize=13, ComSignalType=UINT16, ComHandleId=1486, ComSystemTemplateSystemSignalRef=DET_AZIMUTH_070_Rx
          DET_RANGE_ERR_072_Rx_oRDR_FUSION_DET_069_072_oPCAN_RADAR_e8aaa4fc_Rx: ComBitPosition=376, ComBitSize=7, ComSignalType=UINT8, ComHandleId=1547, ComSystemTemplateSystemSignalRef=DET_RANGE_ERR_072_Rx
          DET_BELOW_RAIN_THOLD_069_Rx_oRDR_FUSION_DET_069_072_oPCAN_RADAR_75fc2a58_Rx: ComBitPosition=39, ComBitSize=1, ComSignalType=BOOLEAN, ComHandleId=1493, ComSystemTemplateSystemSignalRef=DET_BELOW_RAIN_THOLD_069_Rx
          DET_CONFD_ELEVATION_071_Rx_oRDR_FUSION_DET_069_072_oPCAN_RADAR_794ef9c6_Rx: ComBitPosition=325, ComBitSize=2, ComSignalType=UINT8, ComHandleId=1507, ComSystemTemplateSystemSignalRef=DET_CONFD_ELEVATION_071_Rx
          DET_AZIMUTH_071_Rx_oRDR_FUSION_DET_069_072_oPCAN_RADAR_8122c4b3_Rx: ComBitPosition=312, ComBitSize=13, ComSignalType=UINT16, ComHandleId=1487, ComSystemTemplateSystemSignalRef=DET_AZIMUTH_071_Rx
          DET_ELEVATION_ERR_072_Rx_oRDR_FUSION_DET_069_072_oPCAN_RADAR_8b188468_Rx: ComBitPosition=416, ComBitSize=6, ComSignalType=UINT8, ComHandleId=1516, ComSystemTemplateSystemSignalRef=DET_ELEVATION_ERR_072_Rx
          DET_HVC_FLAG_072_Rx_oRDR_FUSION_DET_069_072_oPCAN_RADAR_a1de11b2_Rx: ComBitPosition=422, ComBitSize=1, ComSignalType=BOOLEAN, ComHandleId=1524, ComSystemTemplateSystemSignalRef=DET_HVC_FLAG_072_Rx
          DET_SNR_070_Rx_oRDR_FUSION_DET_069_072_oPCAN_RADAR_24c46adf_Rx: ComBitPosition=232, ComBitSize=8, ComSignalType=UINT8, ComHandleId=1561, ComSystemTemplateSystemSignalRef=DET_SNR_070_Rx
          DET_BELOW_RAIN_THOLD_071_Rx_oRDR_FUSION_DET_069_072_oPCAN_RADAR_e7983b06_Rx: ComBitPosition=263, ComBitSize=1, ComSignalType=BOOLEAN, ComHandleId=1495, ComSystemTemplateSystemSignalRef=DET_BELOW_RAIN_THOLD_071_Rx
          DET_SNR_072_Rx_oRDR_FUSION_DET_069_072_oPCAN_RADAR_a13c4810_Rx: ComBitPosition=456, ComBitSize=8, ComSignalType=UINT8, ComHandleId=1563, ComSystemTemplateSystemSignalRef=DET_SNR_072_Rx
          DET_BI_STATIC_FLAG_072_Rx_oRDR_FUSION_DET_069_072_oPCAN_RADAR_baba209d_Rx: ComBitPosition=440, ComBitSize=1, ComSignalType=BOOLEAN, ComHandleId=1500, ComSystemTemplateSystemSignalRef=DET_BI_STATIC_FLAG_072_Rx
          DET_ELEVATION_071_Rx_oRDR_FUSION_DET_069_072_oPCAN_RADAR_731d163f_Rx: ComBitPosition=296, ComBitSize=8, ComSignalType=UINT8, ComHandleId=1511, ComSystemTemplateSystemSignalRef=DET_ELEVATION_071_Rx
          DET_PROB_1STAZHYPO_069_Rx_oRDR_FUSION_DET_069_072_oPCAN_RADAR_5b3d61dd_Rx: ComBitPosition=103, ComBitSize=1, ComSignalType=BOOLEAN, ComHandleId=1536, ComSystemTemplateSystemSignalRef=DET_PROB_1STAZHYPO_069_Rx
          DET_RANGE_071_Rx_oRDR_FUSION_DET_069_072_oPCAN_RADAR_92e49894_Rx: ComBitPosition=248, ComBitSize=15, ComSignalType=UINT16, ComHandleId=1542, ComSystemTemplateSystemSignalRef=DET_RANGE_071_Rx
          DET_SNR_071_Rx_oRDR_FUSION_DET_069_072_oPCAN_RADAR_8b80f898_Rx: ComBitPosition=344, ComBitSize=8, ComSignalType=UINT8, ComHandleId=1562, ComSystemTemplateSystemSignalRef=DET_SNR_071_Rx
          DET_AZIMUTH_072_Rx_oRDR_FUSION_DET_069_072_oPCAN_RADAR_ab9e743b_Rx: ComBitPosition=424, ComBitSize=13, ComSignalType=UINT16, ComHandleId=1488, ComSystemTemplateSystemSignalRef=DET_AZIMUTH_072_Rx
          DET_SNR_069_Rx_oRDR_FUSION_DET_069_072_oPCAN_RADAR_19e4e9c6_Rx: ComBitPosition=120, ComBitSize=8, ComSignalType=UINT8, ComHandleId=1560, ComSystemTemplateSystemSignalRef=DET_SNR_069_Rx
          DET_SUPER_RES_TARGET_072_Rx_oRDR_FUSION_DET_069_072_oPCAN_RADAR_6ac76910_Rx: ComBitPosition=423, ComBitSize=1, ComSignalType=BOOLEAN, ComHandleId=1567, ComSystemTemplateSystemSignalRef=DET_SUPER_RES_TARGET_072_Rx
          DET_AZIMUTH_ERR_069_Rx_oRDR_FUSION_DET_069_072_oPCAN_RADAR_112f746f_Rx: ComBitPosition=105, ComBitSize=7, ComSignalType=UINT8, ComHandleId=1489, ComSystemTemplateSystemSignalRef=DET_AZIMUTH_ERR_069_Rx
          DET_SUPER_RES_TARGET_070_Rx_oRDR_FUSION_DET_069_072_oPCAN_RADAR_ef3f4bdf_Rx: ComBitPosition=199, ComBitSize=1, ComSignalType=BOOLEAN, ComHandleId=1565, ComSystemTemplateSystemSignalRef=DET_SUPER_RES_TARGET_070_Rx
          DET_RANGE_ERR_069_Rx_oRDR_FUSION_DET_069_072_oPCAN_RADAR_5072052a_Rx: ComBitPosition=40, ComBitSize=7, ComSignalType=UINT8, ComHandleId=1544, ComSystemTemplateSystemSignalRef=DET_RANGE_ERR_069_Rx
          DET_RANGE_VELOCITY_069_Rx_oRDR_FUSION_DET_069_072_oPCAN_RADAR_dd750a34_Rx: ComBitPosition=48, ComBitSize=15, ComSignalType=UINT16, ComHandleId=1548, ComSystemTemplateSystemSignalRef=DET_RANGE_VELOCITY_069_Rx
          DET_EXISTENCE_PROB_070_Rx_oRDR_FUSION_DET_069_072_oPCAN_RADAR_f9f8de32_Rx: ComBitPosition=224, ComBitSize=6, ComSignalType=UINT8, ComHandleId=1518, ComSystemTemplateSystemSignalRef=DET_EXISTENCE_PROB_070_Rx
          DET_RANGE_VELOCITY_ERR_070_Rx_oRDR_FUSION_DET_069_072_oPCAN_RADAR_7931f9ef_Rx: ComBitPosition=176, ComBitSize=8, ComSignalType=UINT8, ComHandleId=1553, ComSystemTemplateSystemSignalRef=DET_RANGE_VELOCITY_ERR_070_Rx
          DET_CONFD_AZIMUTH_072_Rx_oRDR_FUSION_DET_069_072_oPCAN_RADAR_59d3cac9_Rx: ComBitPosition=454, ComBitSize=2, ComSignalType=UINT8, ComHandleId=1504, ComSystemTemplateSystemSignalRef=DET_CONFD_AZIMUTH_072_Rx
          DET_HVC_FLAG_070_Rx_oRDR_FUSION_DET_069_072_oPCAN_RADAR_2426337d_Rx: ComBitPosition=198, ComBitSize=1, ComSignalType=BOOLEAN, ComHandleId=1522, ComSystemTemplateSystemSignalRef=DET_HVC_FLAG_070_Rx
          DET_RANGE_ERR_070_Rx_oRDR_FUSION_DET_069_072_oPCAN_RADAR_6d528633_Rx: ComBitPosition=152, ComBitSize=7, ComSignalType=UINT8, ComHandleId=1545, ComSystemTemplateSystemSignalRef=DET_RANGE_ERR_070_Rx
          DET_RCS_072_Rx_oRDR_FUSION_DET_069_072_oPCAN_RADAR_a86639f9_Rx: ComBitPosition=464, ComBitSize=8, ComSignalType=UINT8, ComHandleId=1559, ComSystemTemplateSystemSignalRef=DET_RCS_072_Rx
          DET_BELOW_RAIN_THOLD_072_Rx_oRDR_FUSION_DET_069_072_oPCAN_RADAR_cd248b8e_Rx: ComBitPosition=375, ComBitSize=1, ComSignalType=BOOLEAN, ComHandleId=1496, ComSystemTemplateSystemSignalRef=DET_BELOW_RAIN_THOLD_072_Rx
          DET_ELEVATION_ERR_071_Rx_oRDR_FUSION_DET_069_072_oPCAN_RADAR_a1a434e0_Rx: ComBitPosition=304, ComBitSize=6, ComSignalType=UINT8, ComHandleId=1515, ComSystemTemplateSystemSignalRef=DET_ELEVATION_ERR_071_Rx
          DET_RANGE_069_Rx_oRDR_FUSION_DET_069_072_oPCAN_RADAR_008089ca_Rx: ComBitPosition=24, ComBitSize=15, ComSignalType=UINT16, ComHandleId=1540, ComSystemTemplateSystemSignalRef=DET_RANGE_069_Rx
          DET_ELEVATION_ERR_070_Rx_oRDR_FUSION_DET_069_072_oPCAN_RADAR_0ee0a6a7_Rx: ComBitPosition=192, ComBitSize=6, ComSignalType=UINT8, ComHandleId=1514, ComSystemTemplateSystemSignalRef=DET_ELEVATION_ERR_070_Rx
          DET_MTD_071_Rx_oRDR_FUSION_DET_069_072_oPCAN_RADAR_03206e02_Rx: ComBitPosition=271, ComBitSize=1, ComSignalType=BOOLEAN, ComHandleId=1534, ComSystemTemplateSystemSignalRef=DET_MTD_071_Rx
          DET_RANGE_ERR_071_Rx_oRDR_FUSION_DET_069_072_oPCAN_RADAR_c2161474_Rx: ComBitPosition=264, ComBitSize=7, ComSignalType=UINT8, ComHandleId=1546, ComSystemTemplateSystemSignalRef=DET_RANGE_ERR_071_Rx
          DET_EXISTENCE_PROB_071_Rx_oRDR_FUSION_DET_069_072_oPCAN_RADAR_56bc4c75_Rx: ComBitPosition=336, ComBitSize=6, ComSignalType=UINT8, ComHandleId=1519, ComSystemTemplateSystemSignalRef=DET_EXISTENCE_PROB_071_Rx
          DET_ELEVATION_069_Rx_oRDR_FUSION_DET_069_072_oPCAN_RADAR_e1790761_Rx: ComBitPosition=72, ComBitSize=8, ComSignalType=UINT8, ComHandleId=1509, ComSystemTemplateSystemSignalRef=DET_ELEVATION_069_Rx
          DET_SUPER_RES_TARGET_071_Rx_oRDR_FUSION_DET_069_072_oPCAN_RADAR_407bd998_Rx: ComBitPosition=311, ComBitSize=1, ComSignalType=BOOLEAN, ComHandleId=1566, ComSystemTemplateSystemSignalRef=DET_SUPER_RES_TARGET_071_Rx
          DET_BI_STATIC_FLAG_071_Rx_oRDR_FUSION_DET_069_072_oPCAN_RADAR_90069015_Rx: ComBitPosition=328, ComBitSize=1, ComSignalType=BOOLEAN, ComHandleId=1499, ComSystemTemplateSystemSignalRef=DET_BI_STATIC_FLAG_071_Rx
          DET_AZIMUTH_069_Rx_oRDR_FUSION_DET_069_072_oPCAN_RADAR_1346d5ed_Rx: ComBitPosition=88, ComBitSize=13, ComSignalType=UINT16, ComHandleId=1485, ComSystemTemplateSystemSignalRef=DET_AZIMUTH_069_Rx
          DET_AZIMUTH_ERR_071_Rx_oRDR_FUSION_DET_069_072_oPCAN_RADAR_834b6531_Rx: ComBitPosition=329, ComBitSize=7, ComSignalType=UINT8, ComHandleId=1491, ComSystemTemplateSystemSignalRef=DET_AZIMUTH_ERR_071_Rx
          DET_IDM_072_Rx_oRDR_FUSION_DET_069_072_oPCAN_RADAR_941fe8fa_Rx: ComBitPosition=399, ComBitSize=1, ComSignalType=BOOLEAN, ComHandleId=1528, ComSystemTemplateSystemSignalRef=DET_IDM_072_Rx
          DET_ELEVATION_072_Rx_oRDR_FUSION_DET_069_072_oPCAN_RADAR_59a1a6b7_Rx: ComBitPosition=408, ComBitSize=8, ComSignalType=UINT8, ComHandleId=1512, ComSystemTemplateSystemSignalRef=DET_ELEVATION_072_Rx
          DET_PROB_1STAZHYPO_070_Rx_oRDR_FUSION_DET_069_072_oPCAN_RADAR_661de2c4_Rx: ComBitPosition=215, ComBitSize=1, ComSignalType=BOOLEAN, ComHandleId=1537, ComSystemTemplateSystemSignalRef=DET_PROB_1STAZHYPO_070_Rx
          DET_CONFD_AZIMUTH_069_Rx_oRDR_FUSION_DET_069_072_oPCAN_RADAR_e10b6b1f_Rx: ComBitPosition=118, ComBitSize=2, ComSignalType=UINT8, ComHandleId=1501, ComSystemTemplateSystemSignalRef=DET_CONFD_AZIMUTH_069_Rx
          DET_CONFD_ELEVATION_070_Rx_oRDR_FUSION_DET_069_072_oPCAN_RADAR_d60a6b81_Rx: ComBitPosition=213, ComBitSize=2, ComSignalType=UINT8, ComHandleId=1506, ComSystemTemplateSystemSignalRef=DET_CONFD_ELEVATION_070_Rx
          DET_EXISTENCE_PROB_069_Rx_oRDR_FUSION_DET_069_072_oPCAN_RADAR_c4d85d2b_Rx: ComBitPosition=112, ComBitSize=6, ComSignalType=UINT8, ComHandleId=1517, ComSystemTemplateSystemSignalRef=DET_EXISTENCE_PROB_069_Rx
          DET_MTD_069_Rx_oRDR_FUSION_DET_069_072_oPCAN_RADAR_91447f5c_Rx: ComBitPosition=47, ComBitSize=1, ComSignalType=BOOLEAN, ComHandleId=1532, ComSystemTemplateSystemSignalRef=DET_MTD_069_Rx
          DET_RANGE_070_Rx_oRDR_FUSION_DET_069_072_oPCAN_RADAR_3da00ad3_Rx: ComBitPosition=136, ComBitSize=15, ComSignalType=UINT16, ComHandleId=1541, ComSystemTemplateSystemSignalRef=DET_RANGE_070_Rx
          DET_RANGE_VELOCITY_ERR_069_Rx_oRDR_FUSION_DET_069_072_oPCAN_RADAR_44117af6_Rx: ComBitPosition=64, ComBitSize=8, ComSignalType=UINT8, ComHandleId=1552, ComSystemTemplateSystemSignalRef=DET_RANGE_VELOCITY_ERR_069_Rx
          DET_CONFD_ELEVATION_069_Rx_oRDR_FUSION_DET_069_072_oPCAN_RADAR_eb2ae898_Rx: ComBitPosition=101, ComBitSize=2, ComSignalType=UINT8, ComHandleId=1505, ComSystemTemplateSystemSignalRef=DET_CONFD_ELEVATION_069_Rx
          DET_BI_STATIC_FLAG_070_Rx_oRDR_FUSION_DET_069_072_oPCAN_RADAR_3f420252_Rx: ComBitPosition=216, ComBitSize=1, ComSignalType=BOOLEAN, ComHandleId=1498, ComSystemTemplateSystemSignalRef=DET_BI_STATIC_FLAG_070_Rx
          DET_RANGE_VELOCITY_072_Rx_oRDR_FUSION_DET_069_072_oPCAN_RADAR_65adabe2_Rx: ComBitPosition=384, ComBitSize=15, ComSignalType=UINT16, ComHandleId=1551, ComSystemTemplateSystemSignalRef=DET_RANGE_VELOCITY_072_Rx
          DET_CONFD_AZIMUTH_070_Rx_oRDR_FUSION_DET_069_072_oPCAN_RADAR_dc2be806_Rx: ComBitPosition=230, ComBitSize=2, ComSignalType=UINT8, ComHandleId=1502, ComSystemTemplateSystemSignalRef=DET_CONFD_AZIMUTH_070_Rx
          DET_MH_SCAN_INDEX_4LSB_069_072_Rx_oRDR_FUSION_DET_069_072_oPCAN_RADAR_6ef503b6_Rx: ComBitPosition=476, ComBitSize=4, ComSignalType=UINT8, ComHandleId=1531, ComSystemTemplateSystemSignalRef=DET_MH_SCAN_INDEX_4LSB_069_072_Rx
          DET_RCS_071_Rx_oRDR_FUSION_DET_069_072_oPCAN_RADAR_82da8971_Rx: ComBitPosition=352, ComBitSize=8, ComSignalType=UINT8, ComHandleId=1558, ComSystemTemplateSystemSignalRef=DET_RCS_071_Rx
          DET_ELEVATION_070_Rx_oRDR_FUSION_DET_069_072_oPCAN_RADAR_dc598478_Rx: ComBitPosition=184, ComBitSize=8, ComSignalType=UINT8, ComHandleId=1510, ComSystemTemplateSystemSignalRef=DET_ELEVATION_070_Rx
          DET_ELEVATION_ERR_069_Rx_oRDR_FUSION_DET_069_072_oPCAN_RADAR_33c025be_Rx: ComBitPosition=80, ComBitSize=6, ComSignalType=UINT8, ComHandleId=1513, ComSystemTemplateSystemSignalRef=DET_ELEVATION_ERR_069_Rx
      RDR_FUSION_DET_089_092_oPCAN_RADAR_2c6c6cba_Rx (ComIPdu):
        ComIPduDirection = RECEIVE
        ComIPduType = NORMAL
        ComIPduCancellationSupport = false
        ComIPduHandleId = 44
        ComIPduSignalProcessing = DEFERRED
        ComIPduChannelRef = CN_PCAN_RADAR_458ff0f1
        ComIPduGroupRef = RDR01_oPCAN_RADAR_Rx_e0e717e1 if post-build-variant-condition{matching-criterion=RDR_POS, value=0}
        ComIPduSignalGroupRef = SG_Fusion_Detections_089_092_oRDR_FUSION_DET_089_092_oPCAN_RADAR_1f429d9f_Rx
        ComPduIdRef = RDR_FUSION_DET_089_092_oPCAN_RADAR_2c6c6cba_Rx
        ComIPduMainFunctionRef = ComMainFunctionRx
        ComIPduGroupRef = RDR02_oPCAN_RADAR_Rx_c92fa313 if post-build-variant-condition{matching-criterion=RDR_POS, value=1}
        ComIPduGroupRef = RDR03_oPCAN_RADAR_Rx_67473282 if post-build-variant-condition{matching-criterion=RDR_POS, value=2}
        ComIPduGroupRef = RDR04_oPCAN_RADAR_Rx_9abecaf7 if post-build-variant-condition{matching-criterion=RDR_POS, value=3}
        ComIPduGroupRef = RDR05_oPCAN_RADAR_Rx_34d65b66 if post-build-variant-condition{matching-criterion=RDR_POS, value=4}
        ComIPduGroupRef = RDR06_oPCAN_RADAR_Rx_1d1eef94 if post-build-variant-condition{matching-criterion=RDR_POS, value=5}
        ComIPduGroupRef = RDR07_oPCAN_RADAR_Rx_b3767e05 if post-build-variant-condition{matching-criterion=RDR_POS, value=6}
        ComIPduGroupRef = RDR08_oPCAN_RADAR_Rx_3d9c193f if post-build-variant-condition{matching-criterion=RDR_POS, value=7}
      SG_Fusion_Detections_033_036_oRDR_FUSION_DET_033_036_oPCAN_RADAR_cce3d4c2_Rx (ComSignalGroup):
        ComTimeout = 0
        ComTransferProperty = PENDING
        ComSignalGroupAccess = ACCESS_NEEDED_BY_SWC_OR_COM
        ComHandleId = 16
        ComSignalGroupArrayAccess = true
        ComSystemTemplateSignalGroupRef = SG_Fusion_Detections_033_036
        83 x ComGroupSignal, all with ComSignalEndianness=LITTLE_ENDIAN, ComSignalInitValue=0, ComSignalAccess=ACCESS_NEEDED_BY_SWC_OR_COM:
          DET_ELEVATION_035_Rx_oRDR_FUSION_DET_033_036_oPCAN_RADAR_bae340d5_Rx: ComBitPosition=296, ComBitSize=8, ComSignalType=UINT8, ComHandleId=764, ComSystemTemplateSystemSignalRef=DET_ELEVATION_035_Rx
          DET_EXISTENCE_PROB_033_Rx_oRDR_FUSION_DET_033_036_oPCAN_RADAR_ca3b7b8f_Rx: ComBitPosition=112, ComBitSize=6, ComSignalType=UINT8, ComHandleId=770, ComSystemTemplateSystemSignalRef=DET_EXISTENCE_PROB_033_Rx
          DET_SNR_035_Rx_oRDR_FUSION_DET_033_036_oPCAN_RADAR_427eae72_Rx: ComBitPosition=344, ComBitSize=8, ComSignalType=UINT8, ComHandleId=815, ComSystemTemplateSystemSignalRef=DET_SNR_035_Rx
          DET_ELEVATION_ERR_033_Rx_oRDR_FUSION_DET_033_036_oPCAN_RADAR_3d23031a_Rx: ComBitPosition=80, ComBitSize=6, ComSignalType=UINT8, ComHandleId=766, ComSystemTemplateSystemSignalRef=DET_ELEVATION_ERR_033_Rx
          DET_EXISTENCE_PROB_036_Rx_oRDR_FUSION_DET_033_036_oPCAN_RADAR_b5feaa17_Rx: ComBitPosition=448, ComBitSize=6, ComSignalType=UINT8, ComHandleId=773, ComSystemTemplateSystemSignalRef=DET_EXISTENCE_PROB_036_Rx
          DET_MTD_036_Rx_oRDR_FUSION_DET_033_036_oPCAN_RADAR_e0628860_Rx: ComBitPosition=383, ComBitSize=1, ComSignalType=BOOLEAN, ComHandleId=788, ComSystemTemplateSystemSignalRef=DET_MTD_036_Rx
          DET_AZIMUTH_035_Rx_oRDR_FUSION_DET_033_036_oPCAN_RADAR_48dc9259_Rx: ComBitPosition=312, ComBitSize=13, ComSignalType=UINT16, ComHandleId=740, ComSystemTemplateSystemSignalRef=DET_AZIMUTH_035_Rx
          DET_CONFD_AZIMUTH_035_Rx_oRDR_FUSION_DET_033_036_oPCAN_RADAR_ba912cab_Rx: ComBitPosition=342, ComBitSize=2, ComSignalType=UINT8, ComHandleId=756, ComSystemTemplateSystemSignalRef=DET_CONFD_AZIMUTH_035_Rx
          DET_SUPER_RES_TARGET_034_Rx_oRDR_FUSION_DET_033_036_oPCAN_RADAR_26c11d35_Rx: ComBitPosition=199, ComBitSize=1, ComSignalType=BOOLEAN, ComHandleId=818, ComSystemTemplateSystemSignalRef=DET_SUPER_RES_TARGET_034_Rx
          DET_AZIMUTH_ERR_036_Rx_oRDR_FUSION_DET_033_036_oPCAN_RADAR_60098353_Rx: ComBitPosition=441, ComBitSize=7, ComSignalType=UINT8, ComHandleId=745, ComSystemTemplateSystemSignalRef=DET_AZIMUTH_ERR_036_Rx
          DET_ELEVATION_034_Rx_oRDR_FUSION_DET_033_036_oPCAN_RADAR_15a7d292_Rx: ComBitPosition=184, ComBitSize=8, ComSignalType=UINT8, ComHandleId=763, ComSystemTemplateSystemSignalRef=DET_ELEVATION_034_Rx
          DET_RANGE_033_Rx_oRDR_FUSION_DET_033_036_oPCAN_RADAR_0e63af6e_Rx: ComBitPosition=24, ComBitSize=15, ComSignalType=UINT16, ComHandleId=793, ComSystemTemplateSystemSignalRef=DET_RANGE_033_Rx
          DET_CONFD_ELEVATION_033_Rx_oRDR_FUSION_DET_033_036_oPCAN_RADAR_e5c9ce3c_Rx: ComBitPosition=101, ComBitSize=2, ComSignalType=UINT8, ComHandleId=758, ComSystemTemplateSystemSignalRef=DET_CONFD_ELEVATION_033_Rx
          DET_HVC_FLAG_035_Rx_oRDR_FUSION_DET_033_036_oPCAN_RADAR_429cf7d0_Rx: ComBitPosition=310, ComBitSize=1, ComSignalType=BOOLEAN, ComHandleId=776, ComSystemTemplateSystemSignalRef=DET_HVC_FLAG_035_Rx
          DET_ELEVATION_036_Rx_oRDR_FUSION_DET_033_036_oPCAN_RADAR_905ff05d_Rx: ComBitPosition=408, ComBitSize=8, ComSignalType=UINT8, ComHandleId=765, ComSystemTemplateSystemSignalRef=DET_ELEVATION_036_Rx
          DET_RANGE_VELOCITY_ERR_033_Rx_oRDR_FUSION_DET_033_036_oPCAN_RADAR_4af25c52_Rx: ComBitPosition=64, ComBitSize=8, ComSignalType=UINT8, ComHandleId=805, ComSystemTemplateSystemSignalRef=DET_RANGE_VELOCITY_ERR_033_Rx
          DET_BI_STATIC_FLAG_033_Rx_oRDR_FUSION_DET_033_036_oPCAN_RADAR_0c81a7ef_Rx: ComBitPosition=104, ComBitSize=1, ComSignalType=BOOLEAN, ComHandleId=750, ComSystemTemplateSystemSignalRef=DET_BI_STATIC_FLAG_033_Rx
          DET_RANGE_VELOCITY_ERR_036_Rx_oRDR_FUSION_DET_033_036_oPCAN_RADAR_35378dca_Rx: ComBitPosition=400, ComBitSize=8, ComSignalType=UINT8, ComHandleId=808, ComSystemTemplateSystemSignalRef=DET_RANGE_VELOCITY_ERR_036_Rx
          DET_AZIMUTH_033_Rx_oRDR_FUSION_DET_033_036_oPCAN_RADAR_1da5f349_Rx: ComBitPosition=88, ComBitSize=13, ComSignalType=UINT16, ComHandleId=738, ComSystemTemplateSystemSignalRef=DET_AZIMUTH_033_Rx
          DET_IDM_036_Rx_oRDR_FUSION_DET_033_036_oPCAN_RADAR_5de1be10_Rx: ComBitPosition=399, ComBitSize=1, ComSignalType=BOOLEAN, ComHandleId=781, ComSystemTemplateSystemSignalRef=DET_IDM_036_Rx
          DET_RANGE_VELOCITY_ERR_035_Rx_oRDR_FUSION_DET_033_036_oPCAN_RADAR_1f8b3d42_Rx: ComBitPosition=288, ComBitSize=8, ComSignalType=UINT8, ComHandleId=807, ComSystemTemplateSystemSignalRef=DET_RANGE_VELOCITY_ERR_035_Rx
          DET_SNR_034_Rx_oRDR_FUSION_DET_033_036_oPCAN_RADAR_ed3a3c35_Rx: ComBitPosition=232, ComBitSize=8, ComSignalType=UINT8, ComHandleId=814, ComSystemTemplateSystemSignalRef=DET_SNR_034_Rx
          DET_AZIMUTH_034_Rx_oRDR_FUSION_DET_033_036_oPCAN_RADAR_e798001e_Rx: ComBitPosition=200, ComBitSize=13, ComSignalType=UINT16, ComHandleId=739, ComSystemTemplateSystemSignalRef=DET_AZIMUTH_034_Rx
          DET_BI_STATIC_FLAG_035_Rx_oRDR_FUSION_DET_033_036_oPCAN_RADAR_59f8c6ff_Rx: ComBitPosition=328, ComBitSize=1, ComSignalType=BOOLEAN, ComHandleId=752, ComSystemTemplateSystemSignalRef=DET_BI_STATIC_FLAG_035_Rx
          DET_BELOW_RAIN_THOLD_033_Rx_oRDR_FUSION_DET_033_036_oPCAN_RADAR_7b1f0cfc_Rx: ComBitPosition=39, ComBitSize=1, ComSignalType=BOOLEAN, ComHandleId=746, ComSystemTemplateSystemSignalRef=DET_BELOW_RAIN_THOLD_033_Rx
          DET_BELOW_RAIN_THOLD_036_Rx_oRDR_FUSION_DET_033_036_oPCAN_RADAR_04dadd64_Rx: ComBitPosition=375, ComBitSize=1, ComSignalType=BOOLEAN, ComHandleId=749, ComSystemTemplateSystemSignalRef=DET_BELOW_RAIN_THOLD_036_Rx
          DET_CONFD_ELEVATION_036_Rx_oRDR_FUSION_DET_033_036_oPCAN_RADAR_9a0c1fa4_Rx: ComBitPosition=437, ComBitSize=2, ComSignalType=UINT8, ComHandleId=761, ComSystemTemplateSystemSignalRef=DET_CONFD_ELEVATION_036_Rx
          DET_MTD_035_Rx_oRDR_FUSION_DET_033_036_oPCAN_RADAR_cade38e8_Rx: ComBitPosition=271, ComBitSize=1, ComSignalType=BOOLEAN, ComHandleId=787, ComSystemTemplateSystemSignalRef=DET_MTD_035_Rx
          DET_SUPER_RES_TARGET_035_Rx_oRDR_FUSION_DET_033_036_oPCAN_RADAR_89858f72_Rx: ComBitPosition=311, ComBitSize=1, ComSignalType=BOOLEAN, ComHandleId=819, ComSystemTemplateSystemSignalRef=DET_SUPER_RES_TARGET_035_Rx
          DET_MH_SCAN_INDEX_4LSB_033_036_Rx_oRDR_FUSION_DET_033_036_oPCAN_RADAR_39366376_Rx: ComBitPosition=476, ComBitSize=4, ComSignalType=UINT8, ComHandleId=784, ComSystemTemplateSystemSignalRef=DET_MH_SCAN_INDEX_4LSB_033_036_Rx
          DET_RANGE_ERR_035_Rx_oRDR_FUSION_DET_033_036_oPCAN_RADAR_0be8429e_Rx: ComBitPosition=264, ComBitSize=7, ComSignalType=UINT8, ComHandleId=799, ComSystemTemplateSystemSignalRef=DET_RANGE_ERR_035_Rx
          DET_SNR_036_Rx_oRDR_FUSION_DET_033_036_oPCAN_RADAR_68c21efa_Rx: ComBitPosition=456, ComBitSize=8, ComSignalType=UINT8, ComHandleId=816, ComSystemTemplateSystemSignalRef=DET_SNR_036_Rx
          DET_AZIMUTH_ERR_033_Rx_oRDR_FUSION_DET_033_036_oPCAN_RADAR_1fcc52cb_Rx: ComBitPosition=105, ComBitSize=7, ComSignalType=UINT8, ComHandleId=742, ComSystemTemplateSystemSignalRef=DET_AZIMUTH_ERR_033_Rx
          DET_SUPER_RES_TARGET_036_Rx_oRDR_FUSION_DET_033_036_oPCAN_RADAR_a3393ffa_Rx: ComBitPosition=423, ComBitSize=1, ComSignalType=BOOLEAN, ComHandleId=820, ComSystemTemplateSystemSignalRef=DET_SUPER_RES_TARGET_036_Rx
          DET_ELEVATION_ERR_036_Rx_oRDR_FUSION_DET_033_036_oPCAN_RADAR_42e6d282_Rx: ComBitPosition=416, ComBitSize=6, ComSignalType=UINT8, ComHandleId=769, ComSystemTemplateSystemSignalRef=DET_ELEVATION_ERR_036_Rx
          DET_BELOW_RAIN_THOLD_035_Rx_oRDR_FUSION_DET_033_036_oPCAN_RADAR_2e666dec_Rx: ComBitPosition=263, ComBitSize=1, ComSignalType=BOOLEAN, ComHandleId=748, ComSystemTemplateSystemSignalRef=DET_BELOW_RAIN_THOLD_035_Rx
          DET_AZIMUTH_ERR_034_Rx_oRDR_FUSION_DET_033_036_oPCAN_RADAR_e5f1a19c_Rx: ComBitPosition=217, ComBitSize=7, ComSignalType=UINT8, ComHandleId=743, ComSystemTemplateSystemSignalRef=DET_AZIMUTH_ERR_034_Rx
          DET_CONFD_AZIMUTH_033_Rx_oRDR_FUSION_DET_033_036_oPCAN_RADAR_efe84dbb_Rx: ComBitPosition=118, ComBitSize=2, ComSignalType=UINT8, ComHandleId=754, ComSystemTemplateSystemSignalRef=DET_CONFD_AZIMUTH_033_Rx
          DET_RCS_034_Rx_oRDR_FUSION_DET_033_036_oPCAN_RADAR_e4604ddc_Rx: ComBitPosition=240, ComBitSize=8, ComSignalType=UINT8, ComHandleId=810, ComSystemTemplateSystemSignalRef=DET_RCS_034_Rx
          DET_CONFD_AZIMUTH_034_Rx_oRDR_FUSION_DET_033_036_oPCAN_RADAR_15d5beec_Rx: ComBitPosition=230, ComBitSize=2, ComSignalType=UINT8, ComHandleId=755, ComSystemTemplateSystemSignalRef=DET_CONFD_AZIMUTH_034_Rx
          DET_RANGE_ERR_034_Rx_oRDR_FUSION_DET_033_036_oPCAN_RADAR_a4acd0d9_Rx: ComBitPosition=152, ComBitSize=7, ComSignalType=UINT8, ComHandleId=798, ComSystemTemplateSystemSignalRef=DET_RANGE_ERR_034_Rx
          DET_EXISTENCE_PROB_034_Rx_oRDR_FUSION_DET_033_036_oPCAN_RADAR_300688d8_Rx: ComBitPosition=224, ComBitSize=6, ComSignalType=UINT8, ComHandleId=771, ComSystemTemplateSystemSignalRef=DET_EXISTENCE_PROB_034_Rx
          DET_RANGE_VELOCITY_033_Rx_oRDR_FUSION_DET_033_036_oPCAN_RADAR_d3962c90_Rx: ComBitPosition=48, ComBitSize=15, ComSignalType=UINT16, ComHandleId=801, ComSystemTemplateSystemSignalRef=DET_RANGE_VELOCITY_033_Rx
          DET_CONFD_AZIMUTH_036_Rx_oRDR_FUSION_DET_033_036_oPCAN_RADAR_902d9c23_Rx: ComBitPosition=454, ComBitSize=2, ComSignalType=UINT8, ComHandleId=757, ComSystemTemplateSystemSignalRef=DET_CONFD_AZIMUTH_036_Rx
          DET_RANGE_VELOCITY_034_Rx_oRDR_FUSION_DET_033_036_oPCAN_RADAR_29abdfc7_Rx: ComBitPosition=160, ComBitSize=15, ComSignalType=UINT16, ComHandleId=802, ComSystemTemplateSystemSignalRef=DET_RANGE_VELOCITY_034_Rx
          DET_PROB_1STAZHYPO_034_Rx_oRDR_FUSION_DET_033_036_oPCAN_RADAR_afe3b42e_Rx: ComBitPosition=215, ComBitSize=1, ComSignalType=BOOLEAN, ComHandleId=790, ComSystemTemplateSystemSignalRef=DET_PROB_1STAZHYPO_034_Rx
          DET_RCS_033_Rx_oRDR_FUSION_DET_033_036_oPCAN_RADAR_1e5dbe8b_Rx: ComBitPosition=128, ComBitSize=8, ComSignalType=UINT8, ComHandleId=809, ComSystemTemplateSystemSignalRef=DET_RCS_033_Rx
          DET_RANGE_ERR_033_Rx_oRDR_FUSION_DET_033_036_oPCAN_RADAR_5e91238e_Rx: ComBitPosition=40, ComBitSize=7, ComSignalType=UINT8, ComHandleId=797, ComSystemTemplateSystemSignalRef=DET_RANGE_ERR_033_Rx
          DET_MH_CYCLE_COUNTER_033_036_Rx_oRDR_FUSION_DET_033_036_oPCAN_RADAR_5d86ac4d_Rx: ComBitPosition=16, ComBitSize=8, ComSignalType=UINT8, ComHandleId=783, ComSystemTemplateSystemSignalRef=DET_MH_CYCLE_COUNTER_033_036_Rx
          DET_RANGE_036_Rx_oRDR_FUSION_DET_033_036_oPCAN_RADAR_71a67ef6_Rx: ComBitPosition=360, ComBitSize=15, ComSignalType=UINT16, ComHandleId=796, ComSystemTemplateSystemSignalRef=DET_RANGE_036_Rx
          DET_BI_STATIC_FLAG_034_Rx_oRDR_FUSION_DET_033_036_oPCAN_RADAR_f6bc54b8_Rx: ComBitPosition=216, ComBitSize=1, ComSignalType=BOOLEAN, ComHandleId=751, ComSystemTemplateSystemSignalRef=DET_BI_STATIC_FLAG_034_Rx
          DET_RANGE_VELOCITY_ERR_034_Rx_oRDR_FUSION_DET_033_036_oPCAN_RADAR_b0cfaf05_Rx: ComBitPosition=176, ComBitSize=8, ComSignalType=UINT8, ComHandleId=806, ComSystemTemplateSystemSignalRef=DET_RANGE_VELOCITY_ERR_034_Rx
          DET_BI_STATIC_FLAG_036_Rx_oRDR_FUSION_DET_033_036_oPCAN_RADAR_73447677_Rx: ComBitPosition=440, ComBitSize=1, ComSignalType=BOOLEAN, ComHandleId=753, ComSystemTemplateSystemSignalRef=DET_BI_STATIC_FLAG_036_Rx
          DET_PROB_1STAZHYPO_033_Rx_oRDR_FUSION_DET_033_036_oPCAN_RADAR_55de4779_Rx: ComBitPosition=103, ComBitSize=1, ComSignalType=BOOLEAN, ComHandleId=789, ComSystemTemplateSystemSignalRef=DET_PROB_1STAZHYPO_033_Rx
          DET_AZIMUTH_ERR_035_Rx_oRDR_FUSION_DET_033_036_oPCAN_RADAR_4ab533db_Rx: ComBitPosition=329, ComBitSize=7, ComSignalType=UINT8, ComHandleId=744, ComSystemTemplateSystemSignalRef=DET_AZIMUTH_ERR_035_Rx
          DET_ELEVATION_033_Rx_oRDR_FUSION_DET_033_036_oPCAN_RADAR_ef9a21c5_Rx: ComBitPosition=72, ComBitSize=8, ComSignalType=UINT8, ComHandleId=762, ComSystemTemplateSystemSignalRef=DET_ELEVATION_033_Rx
          DET_IDM_034_Rx_oRDR_FUSION_DET_033_036_oPCAN_RADAR_d8199cdf_Rx: ComBitPosition=175, ComBitSize=1, ComSignalType=BOOLEAN, ComHandleId=779, ComSystemTemplateSystemSignalRef=DET_IDM_034_Rx
          DET_EXISTENCE_PROB_035_Rx_oRDR_FUSION_DET_033_036_oPCAN_RADAR_9f421a9f_Rx: ComBitPosition=336, ComBitSize=6, ComSignalType=UINT8, ComHandleId=772, ComSystemTemplateSystemSignalRef=DET_EXISTENCE_PROB_035_Rx
          DET_IDM_033_Rx_oRDR_FUSION_DET_033_036_oPCAN_RADAR_22246f88_Rx: ComBitPosition=63, ComBitSize=1, ComSignalType=BOOLEAN, ComHandleId=778, ComSystemTemplateSystemSignalRef=DET_IDM_033_Rx
          DET_MTD_034_Rx_oRDR_FUSION_DET_033_036_oPCAN_RADAR_659aaaaf_Rx: ComBitPosition=159, ComBitSize=1, ComSignalType=BOOLEAN, ComHandleId=786, ComSystemTemplateSystemSignalRef=DET_MTD_034_Rx
          DET_CONFD_ELEVATION_034_Rx_oRDR_FUSION_DET_033_036_oPCAN_RADAR_1ff43d6b_Rx: ComBitPosition=213, ComBitSize=2, ComSignalType=UINT8, ComHandleId=759, ComSystemTemplateSystemSignalRef=DET_CONFD_ELEVATION_034_Rx
          DET_MTD_033_Rx_oRDR_FUSION_DET_033_036_oPCAN_RADAR_9fa759f8_Rx: ComBitPosition=47, ComBitSize=1, ComSignalType=BOOLEAN, ComHandleId=785, ComSystemTemplateSystemSignalRef=DET_MTD_033_Rx
          DET_SUPER_RES_TARGET_033_Rx_oRDR_FUSION_DET_033_036_oPCAN_RADAR_dcfcee62_Rx: ComBitPosition=87, ComBitSize=1, ComSignalType=BOOLEAN, ComHandleId=817, ComSystemTemplateSystemSignalRef=DET_SUPER_RES_TARGET_033_Rx
          DET_MH_CRC16_033_036_Rx_oRDR_FUSION_DET_033_036_oPCAN_RADAR_505d9188_Rx: ComBitPosition=0, ComBitSize=16, ComSignalType=UINT16, ComHandleId=782, ComSystemTemplateSystemSignalRef=DET_MH_CRC16_033_036_Rx
          DET_PROB_1STAZHYPO_035_Rx_oRDR_FUSION_DET_033_036_oPCAN_RADAR_00a72669_Rx: ComBitPosition=327, ComBitSize=1, ComSignalType=BOOLEAN, ComHandleId=791, ComSystemTemplateSystemSignalRef=DET_PROB_1STAZHYPO_035_Rx
          DET_PROB_1STAZHYPO_036_Rx_oRDR_FUSION_DET_033_036_oPCAN_RADAR_2a1b96e1_Rx: ComBitPosition=439, ComBitSize=1, ComSignalType=BOOLEAN, ComHandleId=792, ComSystemTemplateSystemSignalRef=DET_PROB_1STAZHYPO_036_Rx
          DET_AZIMUTH_036_Rx_oRDR_FUSION_DET_033_036_oPCAN_RADAR_626022d1_Rx: ComBitPosition=424, ComBitSize=13, ComSignalType=UINT16, ComHandleId=741, ComSystemTemplateSystemSignalRef=DET_AZIMUTH_036_Rx
          DET_HVC_FLAG_033_Rx_oRDR_FUSION_DET_033_036_oPCAN_RADAR_17e596c0_Rx: ComBitPosition=86, ComBitSize=1, ComSignalType=BOOLEAN, ComHandleId=774, ComSystemTemplateSystemSignalRef=DET_HVC_FLAG_033_Rx
          DET_RANGE_ERR_036_Rx_oRDR_FUSION_DET_033_036_oPCAN_RADAR_2154f216_Rx: ComBitPosition=376, ComBitSize=7, ComSignalType=UINT8, ComHandleId=800, ComSystemTemplateSystemSignalRef=DET_RANGE_ERR_036_Rx
          DET_RCS_036_Rx_oRDR_FUSION_DET_033_036_oPCAN_RADAR_61986f13_Rx: ComBitPosition=464, ComBitSize=8, ComSignalType=UINT8, ComHandleId=812, ComSystemTemplateSystemSignalRef=DET_RCS_036_Rx
          DET_RANGE_035_Rx_oRDR_FUSION_DET_033_036_oPCAN_RADAR_5b1ace7e_Rx: ComBitPosition=248, ComBitSize=15, ComSignalType=UINT16, ComHandleId=795, ComSystemTemplateSystemSignalRef=DET_RANGE_035_Rx
          DET_BELOW_RAIN_THOLD_034_Rx_oRDR_FUSION_DET_033_036_oPCAN_RADAR_8122ffab_Rx: ComBitPosition=151, ComBitSize=1, ComSignalType=BOOLEAN, ComHandleId=747, ComSystemTemplateSystemSignalRef=DET_BELOW_RAIN_THOLD_034_Rx
          DET_RCS_035_Rx_oRDR_FUSION_DET_033_036_oPCAN_RADAR_4b24df9b_Rx: ComBitPosition=352, ComBitSize=8, ComSignalType=UINT8, ComHandleId=811, ComSystemTemplateSystemSignalRef=DET_RCS_035_Rx
          DET_CONFD_ELEVATION_035_Rx_oRDR_FUSION_DET_033_036_oPCAN_RADAR_b0b0af2c_Rx: ComBitPosition=325, ComBitSize=2, ComSignalType=UINT8, ComHandleId=760, ComSystemTemplateSystemSignalRef=DET_CONFD_ELEVATION_035_Rx
          DET_RANGE_034_Rx_oRDR_FUSION_DET_033_036_oPCAN_RADAR_f45e5c39_Rx: ComBitPosition=136, ComBitSize=15, ComSignalType=UINT16, ComHandleId=794, ComSystemTemplateSystemSignalRef=DET_RANGE_034_Rx
          DET_HVC_FLAG_034_Rx_oRDR_FUSION_DET_033_036_oPCAN_RADAR_edd86597_Rx: ComBitPosition=198, ComBitSize=1, ComSignalType=BOOLEAN, ComHandleId=775, ComSystemTemplateSystemSignalRef=DET_HVC_FLAG_034_Rx
          DET_ELEVATION_ERR_035_Rx_oRDR_FUSION_DET_033_036_oPCAN_RADAR_685a620a_Rx: ComBitPosition=304, ComBitSize=6, ComSignalType=UINT8, ComHandleId=768, ComSystemTemplateSystemSignalRef=DET_ELEVATION_ERR_035_Rx
          DET_RANGE_VELOCITY_035_Rx_oRDR_FUSION_DET_033_036_oPCAN_RADAR_86ef4d80_Rx: ComBitPosition=272, ComBitSize=15, ComSignalType=UINT16, ComHandleId=803, ComSystemTemplateSystemSignalRef=DET_RANGE_VELOCITY_035_Rx
          DET_SNR_033_Rx_oRDR_FUSION_DET_033_036_oPCAN_RADAR_1707cf62_Rx: ComBitPosition=120, ComBitSize=8, ComSignalType=UINT8, ComHandleId=813, ComSystemTemplateSystemSignalRef=DET_SNR_033_Rx
          DET_ELEVATION_ERR_034_Rx_oRDR_FUSION_DET_033_036_oPCAN_RADAR_c71ef04d_Rx: ComBitPosition=192, ComBitSize=6, ComSignalType=UINT8, ComHandleId=767, ComSystemTemplateSystemSignalRef=DET_ELEVATION_ERR_034_Rx
          DET_HVC_FLAG_036_Rx_oRDR_FUSION_DET_033_036_oPCAN_RADAR_68204758_Rx: ComBitPosition=422, ComBitSize=1, ComSignalType=BOOLEAN, ComHandleId=777, ComSystemTemplateSystemSignalRef=DET_HVC_FLAG_036_Rx
          DET_RANGE_VELOCITY_036_Rx_oRDR_FUSION_DET_033_036_oPCAN_RADAR_ac53fd08_Rx: ComBitPosition=384, ComBitSize=15, ComSignalType=UINT16, ComHandleId=804, ComSystemTemplateSystemSignalRef=DET_RANGE_VELOCITY_036_Rx
          DET_IDM_035_Rx_oRDR_FUSION_DET_033_036_oPCAN_RADAR_775d0e98_Rx: ComBitPosition=287, ComBitSize=1, ComSignalType=BOOLEAN, ComHandleId=780, ComSystemTemplateSystemSignalRef=DET_IDM_035_Rx
      RDR_FUSION_DET_001_004_oPCAN_RADAR_d39eadb5_Rx (ComIPdu):
        ComIPduDirection = RECEIVE
        ComIPduType = NORMAL
        ComIPduCancellationSupport = false
        ComIPduHandleId = 22
        ComIPduSignalProcessing = DEFERRED
        ComIPduChannelRef = CN_PCAN_RADAR_458ff0f1
        ComIPduGroupRef = RDR01_oPCAN_RADAR_Rx_e0e717e1 if post-build-variant-condition{matching-criterion=RDR_POS, value=0}
        ComIPduSignalGroupRef = SG_Fusion_Detections_001_004_oRDR_FUSION_DET_001_004_oPCAN_RADAR_4a788d9f_Rx
        ComPduIdRef = RDR_FUSION_DET_001_004_oPCAN_RADAR_d39eadb5_Rx
        ComIPduMainFunctionRef = ComMainFunctionRx
        ComIPduGroupRef = RDR02_oPCAN_RADAR_Rx_c92fa313 if post-build-variant-condition{matching-criterion=RDR_POS, value=1}
        ComIPduGroupRef = RDR03_oPCAN_RADAR_Rx_67473282 if post-build-variant-condition{matching-criterion=RDR_POS, value=2}
        ComIPduGroupRef = RDR04_oPCAN_RADAR_Rx_9abecaf7 if post-build-variant-condition{matching-criterion=RDR_POS, value=3}
        ComIPduGroupRef = RDR05_oPCAN_RADAR_Rx_34d65b66 if post-build-variant-condition{matching-criterion=RDR_POS, value=4}
        ComIPduGroupRef = RDR06_oPCAN_RADAR_Rx_1d1eef94 if post-build-variant-condition{matching-criterion=RDR_POS, value=5}
        ComIPduGroupRef = RDR07_oPCAN_RADAR_Rx_b3767e05 if post-build-variant-condition{matching-criterion=RDR_POS, value=6}
        ComIPduGroupRef = RDR08_oPCAN_RADAR_Rx_3d9c193f if post-build-variant-condition{matching-criterion=RDR_POS, value=7}
      4 x ComSignalGroup, all with ComTimeout=0, ComTransferProperty=PENDING, ComSignalGroupAccess=ACCESS_NEEDED_BY_SWC_OR_COM, ComSignalGroupArrayAccess=true:
        SG_Fusion_Detections_041_044_oRDR_FUSION_DET_041_044_oPCAN_RADAR_eab931b2_Rx: ComHandleId=18, ComSystemTemplateSignalGroupRef=SG_Fusion_Detections_041_044
          83 x ComGroupSignal, all with ComSignalEndianness=LITTLE_ENDIAN, ComSignalInitValue=0, ComSignalAccess=ACCESS_NEEDED_BY_SWC_OR_COM:
            DET_HVC_FLAG_041_Rx_oRDR_FUSION_DET_041_044_oPCAN_RADAR_576bc883_Rx: ComBitPosition=86, ComBitSize=1, ComSignalType=BOOLEAN, ComHandleId=940, ComSystemTemplateSystemSignalRef=DET_HVC_FLAG_041_Rx
            DET_RANGE_VELOCITY_043_Rx_oRDR_FUSION_DET_041_044_oPCAN_RADAR_16e0501c_Rx: ComBitPosition=272, ComBitSize=15, ComSignalType=UINT16, ComHandleId=969, ComSystemTemplateSystemSignalRef=DET_RANGE_VELOCITY_043_Rx
            DET_AZIMUTH_041_Rx_oRDR_FUSION_DET_041_044_oPCAN_RADAR_5d2bad0a_Rx: ComBitPosition=88, ComBitSize=13, ComSignalType=UINT16, ComHandleId=904, ComSystemTemplateSystemSignalRef=DET_AZIMUTH_041_Rx
            DET_CONFD_AZIMUTH_044_Rx_oRDR_FUSION_DET_041_044_oPCAN_RADAR_d0a3c260_Rx: ComBitPosition=454, ComBitSize=2, ComSignalType=UINT8, ComHandleId=923, ComSystemTemplateSystemSignalRef=DET_CONFD_AZIMUTH_044_Rx
            DET_SNR_044_Rx_oRDR_FUSION_DET_041_044_oPCAN_RADAR_284c40b9_Rx: ComBitPosition=456, ComBitSize=8, ComSignalType=UINT8, ComHandleId=982, ComSystemTemplateSystemSignalRef=DET_SNR_044_Rx
            DET_BI_STATIC_FLAG_042_Rx_oRDR_FUSION_DET_041_044_oPCAN_RADAR_66b34924_Rx: ComBitPosition=216, ComBitSize=1, ComSignalType=BOOLEAN, ComHandleId=917, ComSystemTemplateSystemSignalRef=DET_BI_STATIC_FLAG_042_Rx
            DET_MTD_041_Rx_oRDR_FUSION_DET_041_044_oPCAN_RADAR_df2907bb_Rx: ComBitPosition=47, ComBitSize=1, ComSignalType=BOOLEAN, ComHandleId=951, ComSystemTemplateSystemSignalRef=DET_MTD_041_Rx
            DET_EXISTENCE_PROB_044_Rx_oRDR_FUSION_DET_041_044_oPCAN_RADAR_f570f454_Rx: ComBitPosition=448, ComBitSize=6, ComSignalType=UINT8, ComHandleId=939, ComSystemTemplateSystemSignalRef=DET_EXISTENCE_PROB_044_Rx
            DET_AZIMUTH_042_Rx_oRDR_FUSION_DET_041_044_oPCAN_RADAR_77971d82_Rx: ComBitPosition=200, ComBitSize=13, ComSignalType=UINT16, ComHandleId=905, ComSystemTemplateSystemSignalRef=DET_AZIMUTH_042_Rx
            DET_RCS_042_Rx_oRDR_FUSION_DET_041_044_oPCAN_RADAR_746f5040_Rx: ComBitPosition=240, ComBitSize=8, ComSignalType=UINT8, ComHandleId=976, ComSystemTemplateSystemSignalRef=DET_RCS_042_Rx
            DET_ELEVATION_043_Rx_oRDR_FUSION_DET_041_044_oPCAN_RADAR_2aec5d49_Rx: ComBitPosition=296, ComBitSize=8, ComSignalType=UINT8, ComHandleId=930, ComSystemTemplateSystemSignalRef=DET_ELEVATION_043_Rx
            DET_MTD_043_Rx_oRDR_FUSION_DET_041_044_oPCAN_RADAR_5ad12574_Rx: ComBitPosition=271, ComBitSize=1, ComSignalType=BOOLEAN, ComHandleId=953, ComSystemTemplateSystemSignalRef=DET_MTD_043_Rx
            DET_MH_CRC16_041_044_Rx_oRDR_FUSION_DET_041_044_oPCAN_RADAR_98836a69_Rx: ComBitPosition=0, ComBitSize=16, ComSignalType=UINT16, ComHandleId=948, ComSystemTemplateSystemSignalRef=DET_MH_CRC16_041_044_Rx
            DET_ELEVATION_ERR_044_Rx_oRDR_FUSION_DET_041_044_oPCAN_RADAR_02688cc1_Rx: ComBitPosition=416, ComBitSize=6, ComSignalType=UINT8, ComHandleId=935, ComSystemTemplateSystemSignalRef=DET_ELEVATION_ERR_044_Rx
            DET_AZIMUTH_043_Rx_oRDR_FUSION_DET_041_044_oPCAN_RADAR_d8d38fc5_Rx: ComBitPosition=312, ComBitSize=13, ComSignalType=UINT16, ComHandleId=906, ComSystemTemplateSystemSignalRef=DET_AZIMUTH_043_Rx
            DET_BELOW_RAIN_THOLD_042_Rx_oRDR_FUSION_DET_041_044_oPCAN_RADAR_112de237_Rx: ComBitPosition=151, ComBitSize=1, ComSignalType=BOOLEAN, ComHandleId=913, ComSystemTemplateSystemSignalRef=DET_BELOW_RAIN_THOLD_042_Rx
            DET_ELEVATION_041_Rx_oRDR_FUSION_DET_041_044_oPCAN_RADAR_af147f86_Rx: ComBitPosition=72, ComBitSize=8, ComSignalType=UINT8, ComHandleId=928, ComSystemTemplateSystemSignalRef=DET_ELEVATION_041_Rx
            DET_AZIMUTH_ERR_043_Rx_oRDR_FUSION_DET_041_044_oPCAN_RADAR_daba2e47_Rx: ComBitPosition=329, ComBitSize=7, ComSignalType=UINT8, ComHandleId=910, ComSystemTemplateSystemSignalRef=DET_AZIMUTH_ERR_043_Rx
            DET_ELEVATION_042_Rx_oRDR_FUSION_DET_041_044_oPCAN_RADAR_85a8cf0e_Rx: ComBitPosition=184, ComBitSize=8, ComSignalType=UINT8, ComHandleId=929, ComSystemTemplateSystemSignalRef=DET_ELEVATION_042_Rx
            DET_AZIMUTH_ERR_044_Rx_oRDR_FUSION_DET_041_044_oPCAN_RADAR_2087dd10_Rx: ComBitPosition=441, ComBitSize=7, ComSignalType=UINT8, ComHandleId=911, ComSystemTemplateSystemSignalRef=DET_AZIMUTH_ERR_044_Rx
            DET_RANGE_ERR_041_Rx_oRDR_FUSION_DET_041_044_oPCAN_RADAR_1e1f7dcd_Rx: ComBitPosition=40, ComBitSize=7, ComSignalType=UINT8, ComHandleId=963, ComSystemTemplateSystemSignalRef=DET_RANGE_ERR_041_Rx
            DET_RCS_041_Rx_oRDR_FUSION_DET_041_044_oPCAN_RADAR_5ed3e0c8_Rx: ComBitPosition=128, ComBitSize=8, ComSignalType=UINT8, ComHandleId=975, ComSystemTemplateSystemSignalRef=DET_RCS_041_Rx
            DET_RANGE_VELOCITY_ERR_043_Rx_oRDR_FUSION_DET_041_044_oPCAN_RADAR_8f8420de_Rx: ComBitPosition=288, ComBitSize=8, ComSignalType=UINT8, ComHandleId=973, ComSystemTemplateSystemSignalRef=DET_RANGE_VELOCITY_ERR_043_Rx
            DET_SUPER_RES_TARGET_041_Rx_oRDR_FUSION_DET_041_044_oPCAN_RADAR_9c72b021_Rx: ComBitPosition=87, ComBitSize=1, ComSignalType=BOOLEAN, ComHandleId=983, ComSystemTemplateSystemSignalRef=DET_SUPER_RES_TARGET_041_Rx
            DET_PROB_1STAZHYPO_044_Rx_oRDR_FUSION_DET_041_044_oPCAN_RADAR_6a95c8a2_Rx: ComBitPosition=439, ComBitSize=1, ComSignalType=BOOLEAN, ComHandleId=958, ComSystemTemplateSystemSignalRef=DET_PROB_1STAZHYPO_044_Rx
            DET_IDM_042_Rx_oRDR_FUSION_DET_041_044_oPCAN_RADAR_48168143_Rx: ComBitPosition=175, ComBitSize=1, ComSignalType=BOOLEAN, ComHandleId=945, ComSystemTemplateSystemSignalRef=DET_IDM_042_Rx
            DET_RANGE_043_Rx_oRDR_FUSION_DET_041_044_oPCAN_RADAR_cb15d3e2_Rx: ComBitPosition=248, ComBitSize=15, ComSignalType=UINT16, ComHandleId=961, ComSystemTemplateSystemSignalRef=DET_RANGE_043_Rx
            DET_RANGE_VELOCITY_041_Rx_oRDR_FUSION_DET_041_044_oPCAN_RADAR_931872d3_Rx: ComBitPosition=48, ComBitSize=15, ComSignalType=UINT16, ComHandleId=967, ComSystemTemplateSystemSignalRef=DET_RANGE_VELOCITY_041_Rx
            DET_BI_STATIC_FLAG_044_Rx_oRDR_FUSION_DET_041_044_oPCAN_RADAR_33ca2834_Rx: ComBitPosition=440, ComBitSize=1, ComSignalType=BOOLEAN, ComHandleId=919, ComSystemTemplateSystemSignalRef=DET_BI_STATIC_FLAG_044_Rx
            DET_SNR_043_Rx_oRDR_FUSION_DET_041_044_oPCAN_RADAR_d271b3ee_Rx: ComBitPosition=344, ComBitSize=8, ComSignalType=UINT8, ComHandleId=981, ComSystemTemplateSystemSignalRef=DET_SNR_043_Rx
            DET_BELOW_RAIN_THOLD_041_Rx_oRDR_FUSION_DET_041_044_oPCAN_RADAR_3b9152bf_Rx: ComBitPosition=39, ComBitSize=1, ComSignalType=BOOLEAN, ComHandleId=912, ComSystemTemplateSystemSignalRef=DET_BELOW_RAIN_THOLD_041_Rx
            DET_ELEVATION_ERR_043_Rx_oRDR_FUSION_DET_041_044_oPCAN_RADAR_f8557f96_Rx: ComBitPosition=304, ComBitSize=6, ComSignalType=UINT8, ComHandleId=934, ComSystemTemplateSystemSignalRef=DET_ELEVATION_ERR_043_Rx
            DET_RANGE_ERR_044_Rx_oRDR_FUSION_DET_041_044_oPCAN_RADAR_61daac55_Rx: ComBitPosition=376, ComBitSize=7, ComSignalType=UINT8, ComHandleId=966, ComSystemTemplateSystemSignalRef=DET_RANGE_ERR_044_Rx
            DET_ELEVATION_044_Rx_oRDR_FUSION_DET_041_044_oPCAN_RADAR_d0d1ae1e_Rx: ComBitPosition=408, ComBitSize=8, ComSignalType=UINT8, ComHandleId=931, ComSystemTemplateSystemSignalRef=DET_ELEVATION_044_Rx
            DET_RANGE_VELOCITY_044_Rx_oRDR_FUSION_DET_041_044_oPCAN_RADAR_ecdda34b_Rx: ComBitPosition=384, ComBitSize=15, ComSignalType=UINT16, ComHandleId=970, ComSystemTemplateSystemSignalRef=DET_RANGE_VELOCITY_044_Rx
            DET_RANGE_VELOCITY_ERR_044_Rx_oRDR_FUSION_DET_041_044_oPCAN_RADAR_75b9d389_Rx: ComBitPosition=400, ComBitSize=8, ComSignalType=UINT8, ComHandleId=974, ComSystemTemplateSystemSignalRef=DET_RANGE_VELOCITY_ERR_044_Rx
            DET_BI_STATIC_FLAG_041_Rx_oRDR_FUSION_DET_041_044_oPCAN_RADAR_4c0ff9ac_Rx: ComBitPosition=104, ComBitSize=1, ComSignalType=BOOLEAN, ComHandleId=916, ComSystemTemplateSystemSignalRef=DET_BI_STATIC_FLAG_041_Rx
            DET_RANGE_044_Rx_oRDR_FUSION_DET_041_044_oPCAN_RADAR_312820b5_Rx: ComBitPosition=360, ComBitSize=15, ComSignalType=UINT16, ComHandleId=962, ComSystemTemplateSystemSignalRef=DET_RANGE_044_Rx
            DET_CONFD_AZIMUTH_042_Rx_oRDR_FUSION_DET_041_044_oPCAN_RADAR_85daa370_Rx: ComBitPosition=230, ComBitSize=2, ComSignalType=UINT8, ComHandleId=921, ComSystemTemplateSystemSignalRef=DET_CONFD_AZIMUTH_042_Rx
            DET_CONFD_AZIMUTH_043_Rx_oRDR_FUSION_DET_041_044_oPCAN_RADAR_2a9e3137_Rx: ComBitPosition=342, ComBitSize=2, ComSignalType=UINT8, ComHandleId=922, ComSystemTemplateSystemSignalRef=DET_CONFD_AZIMUTH_043_Rx
            DET_EXISTENCE_PROB_043_Rx_oRDR_FUSION_DET_041_044_oPCAN_RADAR_0f4d0703_Rx: ComBitPosition=336, ComBitSize=6, ComSignalType=UINT8, ComHandleId=938, ComSystemTemplateSystemSignalRef=DET_EXISTENCE_PROB_043_Rx
            DET_PROB_1STAZHYPO_041_Rx_oRDR_FUSION_DET_041_044_oPCAN_RADAR_1550193a_Rx: ComBitPosition=103, ComBitSize=1, ComSignalType=BOOLEAN, ComHandleId=955, ComSystemTemplateSystemSignalRef=DET_PROB_1STAZHYPO_041_Rx
            DET_SUPER_RES_TARGET_043_Rx_oRDR_FUSION_DET_041_044_oPCAN_RADAR_198a92ee_Rx: ComBitPosition=311, ComBitSize=1, ComSignalType=BOOLEAN, ComHandleId=985, ComSystemTemplateSystemSignalRef=DET_SUPER_RES_TARGET_043_Rx
            DET_IDM_044_Rx_oRDR_FUSION_DET_041_044_oPCAN_RADAR_1d6fe053_Rx: ComBitPosition=399, ComBitSize=1, ComSignalType=BOOLEAN, ComHandleId=947, ComSystemTemplateSystemSignalRef=DET_IDM_044_Rx
            DET_MH_CYCLE_COUNTER_041_044_Rx_oRDR_FUSION_DET_041_044_oPCAN_RADAR_955857ac_Rx: ComBitPosition=16, ComBitSize=8, ComSignalType=UINT8, ComHandleId=949, ComSystemTemplateSystemSignalRef=DET_MH_CYCLE_COUNTER_041_044_Rx
            DET_RANGE_042_Rx_oRDR_FUSION_DET_041_044_oPCAN_RADAR_645141a5_Rx: ComBitPosition=136, ComBitSize=15, ComSignalType=UINT16, ComHandleId=960, ComSystemTemplateSystemSignalRef=DET_RANGE_042_Rx
            DET_IDM_041_Rx_oRDR_FUSION_DET_041_044_oPCAN_RADAR_62aa31cb_Rx: ComBitPosition=63, ComBitSize=1, ComSignalType=BOOLEAN, ComHandleId=944, ComSystemTemplateSystemSignalRef=DET_IDM_041_Rx
            DET_RANGE_VELOCITY_042_Rx_oRDR_FUSION_DET_041_044_oPCAN_RADAR_b9a4c25b_Rx: ComBitPosition=160, ComBitSize=15, ComSignalType=UINT16, ComHandleId=968, ComSystemTemplateSystemSignalRef=DET_RANGE_VELOCITY_042_Rx
            DET_RANGE_ERR_042_Rx_oRDR_FUSION_DET_041_044_oPCAN_RADAR_34a3cd45_Rx: ComBitPosition=152, ComBitSize=7, ComSignalType=UINT8, ComHandleId=964, ComSystemTemplateSystemSignalRef=DET_RANGE_ERR_042_Rx
            DET_RANGE_VELOCITY_ERR_041_Rx_oRDR_FUSION_DET_041_044_oPCAN_RADAR_0a7c0211_Rx: ComBitPosition=64, ComBitSize=8, ComSignalType=UINT8, ComHandleId=971, ComSystemTemplateSystemSignalRef=DET_RANGE_VELOCITY_ERR_041_Rx
            DET_SNR_041_Rx_oRDR_FUSION_DET_041_044_oPCAN_RADAR_57899121_Rx: ComBitPosition=120, ComBitSize=8, ComSignalType=UINT8, ComHandleId=979, ComSystemTemplateSystemSignalRef=DET_SNR_041_Rx
            DET_HVC_FLAG_042_Rx_oRDR_FUSION_DET_041_044_oPCAN_RADAR_7dd7780b_Rx: ComBitPosition=198, ComBitSize=1, ComSignalType=BOOLEAN, ComHandleId=941, ComSystemTemplateSystemSignalRef=DET_HVC_FLAG_042_Rx
            DET_EXISTENCE_PROB_042_Rx_oRDR_FUSION_DET_041_044_oPCAN_RADAR_a0099544_Rx: ComBitPosition=224, ComBitSize=6, ComSignalType=UINT8, ComHandleId=937, ComSystemTemplateSystemSignalRef=DET_EXISTENCE_PROB_042_Rx
            DET_MTD_044_Rx_oRDR_FUSION_DET_041_044_oPCAN_RADAR_a0ecd623_Rx: ComBitPosition=383, ComBitSize=1, ComSignalType=BOOLEAN, ComHandleId=954, ComSystemTemplateSystemSignalRef=DET_MTD_044_Rx
            DET_CONFD_ELEVATION_042_Rx_oRDR_FUSION_DET_041_044_oPCAN_RADAR_8ffb20f7_Rx: ComBitPosition=213, ComBitSize=2, ComSignalType=UINT8, ComHandleId=925, ComSystemTemplateSystemSignalRef=DET_CONFD_ELEVATION_042_Rx
            DET_AZIMUTH_044_Rx_oRDR_FUSION_DET_041_044_oPCAN_RADAR_22ee7c92_Rx: ComBitPosition=424, ComBitSize=13, ComSignalType=UINT16, ComHandleId=907, ComSystemTemplateSystemSignalRef=DET_AZIMUTH_044_Rx
            DET_MTD_042_Rx_oRDR_FUSION_DET_041_044_oPCAN_RADAR_f595b733_Rx: ComBitPosition=159, ComBitSize=1, ComSignalType=BOOLEAN, ComHandleId=952, ComSystemTemplateSystemSignalRef=DET_MTD_042_Rx
            DET_RANGE_041_Rx_oRDR_FUSION_DET_041_044_oPCAN_RADAR_4eedf12d_Rx: ComBitPosition=24, ComBitSize=15, ComSignalType=UINT16, ComHandleId=959, ComSystemTemplateSystemSignalRef=DET_RANGE_041_Rx
            DET_EXISTENCE_PROB_041_Rx_oRDR_FUSION_DET_041_044_oPCAN_RADAR_8ab525cc_Rx: ComBitPosition=112, ComBitSize=6, ComSignalType=UINT8, ComHandleId=936, ComSystemTemplateSystemSignalRef=DET_EXISTENCE_PROB_041_Rx
            DET_SUPER_RES_TARGET_044_Rx_oRDR_FUSION_DET_041_044_oPCAN_RADAR_e3b761b9_Rx: ComBitPosition=423, ComBitSize=1, ComSignalType=BOOLEAN, ComHandleId=986, ComSystemTemplateSystemSignalRef=DET_SUPER_RES_TARGET_044_Rx
            DET_HVC_FLAG_044_Rx_oRDR_FUSION_DET_041_044_oPCAN_RADAR_28ae191b_Rx: ComBitPosition=422, ComBitSize=1, ComSignalType=BOOLEAN, ComHandleId=943, ComSystemTemplateSystemSignalRef=DET_HVC_FLAG_044_Rx
            DET_CONFD_ELEVATION_044_Rx_oRDR_FUSION_DET_041_044_oPCAN_RADAR_da8241e7_Rx: ComBitPosition=437, ComBitSize=2, ComSignalType=UINT8, ComHandleId=927, ComSystemTemplateSystemSignalRef=DET_CONFD_ELEVATION_044_Rx
            DET_BELOW_RAIN_THOLD_044_Rx_oRDR_FUSION_DET_041_044_oPCAN_RADAR_44548327_Rx: ComBitPosition=375, ComBitSize=1, ComSignalType=BOOLEAN, ComHandleId=915, ComSystemTemplateSystemSignalRef=DET_BELOW_RAIN_THOLD_044_Rx
            DET_CONFD_AZIMUTH_041_Rx_oRDR_FUSION_DET_041_044_oPCAN_RADAR_af6613f8_Rx: ComBitPosition=118, ComBitSize=2, ComSignalType=UINT8, ComHandleId=920, ComSystemTemplateSystemSignalRef=DET_CONFD_AZIMUTH_041_Rx
            DET_AZIMUTH_ERR_041_Rx_oRDR_FUSION_DET_041_044_oPCAN_RADAR_5f420c88_Rx: ComBitPosition=105, ComBitSize=7, ComSignalType=UINT8, ComHandleId=908, ComSystemTemplateSystemSignalRef=DET_AZIMUTH_ERR_041_Rx
            DET_ELEVATION_ERR_042_Rx_oRDR_FUSION_DET_041_044_oPCAN_RADAR_5711edd1_Rx: ComBitPosition=192, ComBitSize=6, ComSignalType=UINT8, ComHandleId=933, ComSystemTemplateSystemSignalRef=DET_ELEVATION_ERR_042_Rx
            DET_MH_SCAN_INDEX_4LSB_041_044_Rx_oRDR_FUSION_DET_041_044_oPCAN_RADAR_f1e89897_Rx: ComBitPosition=476, ComBitSize=4, ComSignalType=UINT8, ComHandleId=950, ComSystemTemplateSystemSignalRef=DET_MH_SCAN_INDEX_4LSB_041_044_Rx
            DET_CONFD_ELEVATION_041_Rx_oRDR_FUSION_DET_041_044_oPCAN_RADAR_a547907f_Rx: ComBitPosition=101, ComBitSize=2, ComSignalType=UINT8, ComHandleId=924, ComSystemTemplateSystemSignalRef=DET_CONFD_ELEVATION_041_Rx
            DET_IDM_043_Rx_oRDR_FUSION_DET_041_044_oPCAN_RADAR_e7521304_Rx: ComBitPosition=287, ComBitSize=1, ComSignalType=BOOLEAN, ComHandleId=946, ComSystemTemplateSystemSignalRef=DET_IDM_043_Rx
            DET_SNR_042_Rx_oRDR_FUSION_DET_041_044_oPCAN_RADAR_7d3521a9_Rx: ComBitPosition=232, ComBitSize=8, ComSignalType=UINT8, ComHandleId=980, ComSystemTemplateSystemSignalRef=DET_SNR_042_Rx
            DET_PROB_1STAZHYPO_042_Rx_oRDR_FUSION_DET_041_044_oPCAN_RADAR_3feca9b2_Rx: ComBitPosition=215, ComBitSize=1, ComSignalType=BOOLEAN, ComHandleId=956, ComSystemTemplateSystemSignalRef=DET_PROB_1STAZHYPO_042_Rx
            DET_BELOW_RAIN_THOLD_043_Rx_oRDR_FUSION_DET_041_044_oPCAN_RADAR_be697070_Rx: ComBitPosition=263, ComBitSize=1, ComSignalType=BOOLEAN, ComHandleId=914, ComSystemTemplateSystemSignalRef=DET_BELOW_RAIN_THOLD_043_Rx
            DET_RCS_043_Rx_oRDR_FUSION_DET_041_044_oPCAN_RADAR_db2bc207_Rx: ComBitPosition=352, ComBitSize=8, ComSignalType=UINT8, ComHandleId=977, ComSystemTemplateSystemSignalRef=DET_RCS_043_Rx
            DET_RCS_044_Rx_oRDR_FUSION_DET_041_044_oPCAN_RADAR_21163150_Rx: ComBitPosition=464, ComBitSize=8, ComSignalType=UINT8, ComHandleId=978, ComSystemTemplateSystemSignalRef=DET_RCS_044_Rx
            DET_AZIMUTH_ERR_042_Rx_oRDR_FUSION_DET_041_044_oPCAN_RADAR_75febc00_Rx: ComBitPosition=217, ComBitSize=7, ComSignalType=UINT8, ComHandleId=909, ComSystemTemplateSystemSignalRef=DET_AZIMUTH_ERR_042_Rx
            DET_HVC_FLAG_043_Rx_oRDR_FUSION_DET_041_044_oPCAN_RADAR_d293ea4c_Rx: ComBitPosition=310, ComBitSize=1, ComSignalType=BOOLEAN, ComHandleId=942, ComSystemTemplateSystemSignalRef=DET_HVC_FLAG_043_Rx
            DET_SUPER_RES_TARGET_042_Rx_oRDR_FUSION_DET_041_044_oPCAN_RADAR_b6ce00a9_Rx: ComBitPosition=199, ComBitSize=1, ComSignalType=BOOLEAN, ComHandleId=984, ComSystemTemplateSystemSignalRef=DET_SUPER_RES_TARGET_042_Rx
            DET_RANGE_ERR_043_Rx_oRDR_FUSION_DET_041_044_oPCAN_RADAR_9be75f02_Rx: ComBitPosition=264, ComBitSize=7, ComSignalType=UINT8, ComHandleId=965, ComSystemTemplateSystemSignalRef=DET_RANGE_ERR_043_Rx
            DET_ELEVATION_ERR_041_Rx_oRDR_FUSION_DET_041_044_oPCAN_RADAR_7dad5d59_Rx: ComBitPosition=80, ComBitSize=6, ComSignalType=UINT8, ComHandleId=932, ComSystemTemplateSystemSignalRef=DET_ELEVATION_ERR_041_Rx
            DET_PROB_1STAZHYPO_043_Rx_oRDR_FUSION_DET_041_044_oPCAN_RADAR_90a83bf5_Rx: ComBitPosition=327, ComBitSize=1, ComSignalType=BOOLEAN, ComHandleId=957, ComSystemTemplateSystemSignalRef=DET_PROB_1STAZHYPO_043_Rx
            DET_BI_STATIC_FLAG_043_Rx_oRDR_FUSION_DET_041_044_oPCAN_RADAR_c9f7db63_Rx: ComBitPosition=328, ComBitSize=1, ComSignalType=BOOLEAN, ComHandleId=918, ComSystemTemplateSystemSignalRef=DET_BI_STATIC_FLAG_043_Rx
            DET_RANGE_VELOCITY_ERR_042_Rx_oRDR_FUSION_DET_041_044_oPCAN_RADAR_20c0b299_Rx: ComBitPosition=176, ComBitSize=8, ComSignalType=UINT8, ComHandleId=972, ComSystemTemplateSystemSignalRef=DET_RANGE_VELOCITY_ERR_042_Rx
            DET_CONFD_ELEVATION_043_Rx_oRDR_FUSION_DET_041_044_oPCAN_RADAR_20bfb2b0_Rx: ComBitPosition=325, ComBitSize=2, ComSignalType=UINT8, ComHandleId=926, ComSystemTemplateSystemSignalRef=DET_CONFD_ELEVATION_043_Rx
        SG_Fusion_Detections_045_048_oRDR_FUSION_DET_045_048_oPCAN_RADAR_a7421a41_Rx: ComHandleId=19, ComSystemTemplateSignalGroupRef=SG_Fusion_Detections_045_048
          83 x ComGroupSignal, all with ComSignalEndianness=LITTLE_ENDIAN, ComSignalInitValue=0, ComSignalAccess=ACCESS_NEEDED_BY_SWC_OR_COM:
            DET_EXISTENCE_PROB_046_Rx_oRDR_FUSION_DET_045_048_oPCAN_RADAR_993a48af_Rx: ComBitPosition=224, ComBitSize=6, ComSignalType=UINT8, ComHandleId=1020, ComSystemTemplateSystemSignalRef=DET_EXISTENCE_PROB_046_Rx
            DET_CONFD_ELEVATION_046_Rx_oRDR_FUSION_DET_045_048_oPCAN_RADAR_b6c8fd1c_Rx: ComBitPosition=213, ComBitSize=2, ComSignalType=UINT8, ComHandleId=1008, ComSystemTemplateSystemSignalRef=DET_CONFD_ELEVATION_046_Rx
            DET_ELEVATION_ERR_047_Rx_oRDR_FUSION_DET_045_048_oPCAN_RADAR_c166a27d_Rx: ComBitPosition=304, ComBitSize=6, ComSignalType=UINT8, ComHandleId=1017, ComSystemTemplateSystemSignalRef=DET_ELEVATION_ERR_047_Rx
            DET_AZIMUTH_047_Rx_oRDR_FUSION_DET_045_048_oPCAN_RADAR_e1e0522e_Rx: ComBitPosition=312, ComBitSize=13, ComSignalType=UINT16, ComHandleId=989, ComSystemTemplateSystemSignalRef=DET_AZIMUTH_047_Rx
            DET_SUPER_RES_TARGET_045_Rx_oRDR_FUSION_DET_045_048_oPCAN_RADAR_a5416dca_Rx: ComBitPosition=87, ComBitSize=1, ComSignalType=BOOLEAN, ComHandleId=1066, ComSystemTemplateSystemSignalRef=DET_SUPER_RES_TARGET_045_Rx
            DET_RANGE_ERR_048_Rx_oRDR_FUSION_DET_045_048_oPCAN_RADAR_229af041_Rx: ComBitPosition=376, ComBitSize=7, ComSignalType=UINT8, ComHandleId=1049, ComSystemTemplateSystemSignalRef=DET_RANGE_ERR_048_Rx
            DET_AZIMUTH_ERR_046_Rx_oRDR_FUSION_DET_045_048_oPCAN_RADAR_4ccd61eb_Rx: ComBitPosition=217, ComBitSize=7, ComSignalType=UINT8, ComHandleId=992, ComSystemTemplateSystemSignalRef=DET_AZIMUTH_ERR_046_Rx
            DET_RANGE_VELOCITY_ERR_048_Rx_oRDR_FUSION_DET_045_048_oPCAN_RADAR_36f98f9d_Rx: ComBitPosition=400, ComBitSize=8, ComSignalType=UINT8, ComHandleId=1057, ComSystemTemplateSystemSignalRef=DET_RANGE_VELOCITY_ERR_048_Rx
            DET_HVC_FLAG_045_Rx_oRDR_FUSION_DET_045_048_oPCAN_RADAR_6e581568_Rx: ComBitPosition=86, ComBitSize=1, ComSignalType=BOOLEAN, ComHandleId=1023, ComSystemTemplateSystemSignalRef=DET_HVC_FLAG_045_Rx
            DET_AZIMUTH_ERR_045_Rx_oRDR_FUSION_DET_045_048_oPCAN_RADAR_6671d163_Rx: ComBitPosition=105, ComBitSize=7, ComSignalType=UINT8, ComHandleId=991, ComSystemTemplateSystemSignalRef=DET_AZIMUTH_ERR_045_Rx
            DET_IDM_045_Rx_oRDR_FUSION_DET_045_048_oPCAN_RADAR_5b99ec20_Rx: ComBitPosition=63, ComBitSize=1, ComSignalType=BOOLEAN, ComHandleId=1027, ComSystemTemplateSystemSignalRef=DET_IDM_045_Rx
            DET_RANGE_ERR_046_Rx_oRDR_FUSION_DET_045_048_oPCAN_RADAR_0d9010ae_Rx: ComBitPosition=152, ComBitSize=7, ComSignalType=UINT8, ComHandleId=1047, ComSystemTemplateSystemSignalRef=DET_RANGE_ERR_046_Rx
            DET_ELEVATION_048_Rx_oRDR_FUSION_DET_045_048_oPCAN_RADAR_9391f20a_Rx: ComBitPosition=408, ComBitSize=8, ComSignalType=UINT8, ComHandleId=1014, ComSystemTemplateSystemSignalRef=DET_ELEVATION_048_Rx
            DET_RANGE_ERR_047_Rx_oRDR_FUSION_DET_045_048_oPCAN_RADAR_a2d482e9_Rx: ComBitPosition=264, ComBitSize=7, ComSignalType=UINT8, ComHandleId=1048, ComSystemTemplateSystemSignalRef=DET_RANGE_ERR_047_Rx
            DET_PROB_1STAZHYPO_047_Rx_oRDR_FUSION_DET_045_048_oPCAN_RADAR_a99be61e_Rx: ComBitPosition=327, ComBitSize=1, ComSignalType=BOOLEAN, ComHandleId=1040, ComSystemTemplateSystemSignalRef=DET_PROB_1STAZHYPO_047_Rx
            DET_RANGE_ERR_045_Rx_oRDR_FUSION_DET_045_048_oPCAN_RADAR_272ca026_Rx: ComBitPosition=40, ComBitSize=7, ComSignalType=UINT8, ComHandleId=1046, ComSystemTemplateSystemSignalRef=DET_RANGE_ERR_045_Rx
            DET_RANGE_048_Rx_oRDR_FUSION_DET_045_048_oPCAN_RADAR_72687ca1_Rx: ComBitPosition=360, ComBitSize=15, ComSignalType=UINT16, ComHandleId=1045, ComSystemTemplateSystemSignalRef=DET_RANGE_048_Rx
            DET_EXISTENCE_PROB_045_Rx_oRDR_FUSION_DET_045_048_oPCAN_RADAR_b386f827_Rx: ComBitPosition=112, ComBitSize=6, ComSignalType=UINT8, ComHandleId=1019, ComSystemTemplateSystemSignalRef=DET_EXISTENCE_PROB_045_Rx
            DET_IDM_048_Rx_oRDR_FUSION_DET_045_048_oPCAN_RADAR_5e2fbc47_Rx: ComBitPosition=399, ComBitSize=1, ComSignalType=BOOLEAN, ComHandleId=1030, ComSystemTemplateSystemSignalRef=DET_IDM_048_Rx
            DET_BI_STATIC_FLAG_045_Rx_oRDR_FUSION_DET_045_048_oPCAN_RADAR_753c2447_Rx: ComBitPosition=104, ComBitSize=1, ComSignalType=BOOLEAN, ComHandleId=999, ComSystemTemplateSystemSignalRef=DET_BI_STATIC_FLAG_045_Rx
            DET_ELEVATION_ERR_045_Rx_oRDR_FUSION_DET_045_048_oPCAN_RADAR_449e80b2_Rx: ComBitPosition=80, ComBitSize=6, ComSignalType=UINT8, ComHandleId=1015, ComSystemTemplateSystemSignalRef=DET_ELEVATION_ERR_045_Rx
            DET_CONFD_AZIMUTH_047_Rx_oRDR_FUSION_DET_045_048_oPCAN_RADAR_13adecdc_Rx: ComBitPosition=342, ComBitSize=2, ComSignalType=UINT8, ComHandleId=1005, ComSystemTemplateSystemSignalRef=DET_CONFD_AZIMUTH_047_Rx
            DET_RANGE_VELOCITY_ERR_045_Rx_oRDR_FUSION_DET_045_048_oPCAN_RADAR_334fdffa_Rx: ComBitPosition=64, ComBitSize=8, ComSignalType=UINT8, ComHandleId=1054, ComSystemTemplateSystemSignalRef=DET_RANGE_VELOCITY_ERR_045_Rx
            DET_MTD_045_Rx_oRDR_FUSION_DET_045_048_oPCAN_RADAR_e61ada50_Rx: ComBitPosition=47, ComBitSize=1, ComSignalType=BOOLEAN, ComHandleId=1034, ComSystemTemplateSystemSignalRef=DET_MTD_045_Rx
            DET_AZIMUTH_046_Rx_oRDR_FUSION_DET_045_048_oPCAN_RADAR_4ea4c069_Rx: ComBitPosition=200, ComBitSize=13, ComSignalType=UINT16, ComHandleId=988, ComSystemTemplateSystemSignalRef=DET_AZIMUTH_046_Rx
            DET_CONFD_ELEVATION_048_Rx_oRDR_FUSION_DET_045_048_oPCAN_RADAR_99c21df3_Rx: ComBitPosition=437, ComBitSize=2, ComSignalType=UINT8, ComHandleId=1010, ComSystemTemplateSystemSignalRef=DET_CONFD_ELEVATION_048_Rx
            DET_RANGE_VELOCITY_ERR_047_Rx_oRDR_FUSION_DET_045_048_oPCAN_RADAR_b6b7fd35_Rx: ComBitPosition=288, ComBitSize=8, ComSignalType=UINT8, ComHandleId=1056, ComSystemTemplateSystemSignalRef=DET_RANGE_VELOCITY_ERR_047_Rx
            DET_AZIMUTH_ERR_048_Rx_oRDR_FUSION_DET_045_048_oPCAN_RADAR_63c78104_Rx: ComBitPosition=441, ComBitSize=7, ComSignalType=UINT8, ComHandleId=994, ComSystemTemplateSystemSignalRef=DET_AZIMUTH_ERR_048_Rx
            DET_RANGE_VELOCITY_046_Rx_oRDR_FUSION_DET_045_048_oPCAN_RADAR_80971fb0_Rx: ComBitPosition=160, ComBitSize=15, ComSignalType=UINT16, ComHandleId=1051, ComSystemTemplateSystemSignalRef=DET_RANGE_VELOCITY_046_Rx
            DET_ELEVATION_045_Rx_oRDR_FUSION_DET_045_048_oPCAN_RADAR_9627a26d_Rx: ComBitPosition=72, ComBitSize=8, ComSignalType=UINT8, ComHandleId=1011, ComSystemTemplateSystemSignalRef=DET_ELEVATION_045_Rx
            DET_RCS_046_Rx_oRDR_FUSION_DET_045_048_oPCAN_RADAR_4d5c8dab_Rx: ComBitPosition=240, ComBitSize=8, ComSignalType=UINT8, ComHandleId=1059, ComSystemTemplateSystemSignalRef=DET_RCS_046_Rx
            DET_RCS_048_Rx_oRDR_FUSION_DET_045_048_oPCAN_RADAR_62566d44_Rx: ComBitPosition=464, ComBitSize=8, ComSignalType=UINT8, ComHandleId=1061, ComSystemTemplateSystemSignalRef=DET_RCS_048_Rx
            DET_CONFD_AZIMUTH_048_Rx_oRDR_FUSION_DET_045_048_oPCAN_RADAR_93e39e74_Rx: ComBitPosition=454, ComBitSize=2, ComSignalType=UINT8, ComHandleId=1006, ComSystemTemplateSystemSignalRef=DET_CONFD_AZIMUTH_048_Rx
            DET_PROB_1STAZHYPO_048_Rx_oRDR_FUSION_DET_045_048_oPCAN_RADAR_29d594b6_Rx: ComBitPosition=439, ComBitSize=1, ComSignalType=BOOLEAN, ComHandleId=1041, ComSystemTemplateSystemSignalRef=DET_PROB_1STAZHYPO_048_Rx
            DET_PROB_1STAZHYPO_046_Rx_oRDR_FUSION_DET_045_048_oPCAN_RADAR_06df7459_Rx: ComBitPosition=215, ComBitSize=1, ComSignalType=BOOLEAN, ComHandleId=1039, ComSystemTemplateSystemSignalRef=DET_PROB_1STAZHYPO_046_Rx
            DET_BELOW_RAIN_THOLD_046_Rx_oRDR_FUSION_DET_045_048_oPCAN_RADAR_281e3fdc_Rx: ComBitPosition=151, ComBitSize=1, ComSignalType=BOOLEAN, ComHandleId=996, ComSystemTemplateSystemSignalRef=DET_BELOW_RAIN_THOLD_046_Rx
            DET_SNR_048_Rx_oRDR_FUSION_DET_045_048_oPCAN_RADAR_6b0c1cad_Rx: ComBitPosition=456, ComBitSize=8, ComSignalType=UINT8, ComHandleId=1065, ComSystemTemplateSystemSignalRef=DET_SNR_048_Rx
            DET_SUPER_RES_TARGET_047_Rx_oRDR_FUSION_DET_045_048_oPCAN_RADAR_20b94f05_Rx: ComBitPosition=311, ComBitSize=1, ComSignalType=BOOLEAN, ComHandleId=1068, ComSystemTemplateSystemSignalRef=DET_SUPER_RES_TARGET_047_Rx
            DET_BI_STATIC_FLAG_047_Rx_oRDR_FUSION_DET_045_048_oPCAN_RADAR_f0c40688_Rx: ComBitPosition=328, ComBitSize=1, ComSignalType=BOOLEAN, ComHandleId=1001, ComSystemTemplateSystemSignalRef=DET_BI_STATIC_FLAG_047_Rx
            DET_BI_STATIC_FLAG_048_Rx_oRDR_FUSION_DET_045_048_oPCAN_RADAR_708a7420_Rx: ComBitPosition=440, ComBitSize=1, ComSignalType=BOOLEAN, ComHandleId=1002, ComSystemTemplateSystemSignalRef=DET_BI_STATIC_FLAG_048_Rx
            DET_SNR_047_Rx_oRDR_FUSION_DET_045_048_oPCAN_RADAR_eb426e05_Rx: ComBitPosition=344, ComBitSize=8, ComSignalType=UINT8, ComHandleId=1064, ComSystemTemplateSystemSignalRef=DET_SNR_047_Rx
            DET_AZIMUTH_045_Rx_oRDR_FUSION_DET_045_048_oPCAN_RADAR_641870e1_Rx: ComBitPosition=88, ComBitSize=13, ComSignalType=UINT16, ComHandleId=987, ComSystemTemplateSystemSignalRef=DET_AZIMUTH_045_Rx
            DET_ELEVATION_047_Rx_oRDR_FUSION_DET_045_048_oPCAN_RADAR_13df80a2_Rx: ComBitPosition=296, ComBitSize=8, ComSignalType=UINT8, ComHandleId=1013, ComSystemTemplateSystemSignalRef=DET_ELEVATION_047_Rx
            DET_ELEVATION_ERR_046_Rx_oRDR_FUSION_DET_045_048_oPCAN_RADAR_6e22303a_Rx: ComBitPosition=192, ComBitSize=6, ComSignalType=UINT8, ComHandleId=1016, ComSystemTemplateSystemSignalRef=DET_ELEVATION_ERR_046_Rx
            DET_MH_CRC16_045_048_Rx_oRDR_FUSION_DET_045_048_oPCAN_RADAR_7363d7f5_Rx: ComBitPosition=0, ComBitSize=16, ComSignalType=UINT16, ComHandleId=1031, ComSystemTemplateSystemSignalRef=DET_MH_CRC16_045_048_Rx
            DET_MH_SCAN_INDEX_4LSB_045_048_Rx_oRDR_FUSION_DET_045_048_oPCAN_RADAR_1a08250b_Rx: ComBitPosition=476, ComBitSize=4, ComSignalType=UINT8, ComHandleId=1033, ComSystemTemplateSystemSignalRef=DET_MH_SCAN_INDEX_4LSB_045_048_Rx
            DET_RANGE_VELOCITY_048_Rx_oRDR_FUSION_DET_045_048_oPCAN_RADAR_af9dff5f_Rx: ComBitPosition=384, ComBitSize=15, ComSignalType=UINT16, ComHandleId=1053, ComSystemTemplateSystemSignalRef=DET_RANGE_VELOCITY_048_Rx
            DET_IDM_046_Rx_oRDR_FUSION_DET_045_048_oPCAN_RADAR_71255ca8_Rx: ComBitPosition=175, ComBitSize=1, ComSignalType=BOOLEAN, ComHandleId=1028, ComSystemTemplateSystemSignalRef=DET_IDM_046_Rx
            DET_RANGE_046_Rx_oRDR_FUSION_DET_045_048_oPCAN_RADAR_5d629c4e_Rx: ComBitPosition=136, ComBitSize=15, ComSignalType=UINT16, ComHandleId=1043, ComSystemTemplateSystemSignalRef=DET_RANGE_046_Rx
            DET_MTD_047_Rx_oRDR_FUSION_DET_045_048_oPCAN_RADAR_63e2f89f_Rx: ComBitPosition=271, ComBitSize=1, ComSignalType=BOOLEAN, ComHandleId=1036, ComSystemTemplateSystemSignalRef=DET_MTD_047_Rx
            DET_AZIMUTH_ERR_047_Rx_oRDR_FUSION_DET_045_048_oPCAN_RADAR_e389f3ac_Rx: ComBitPosition=329, ComBitSize=7, ComSignalType=UINT8, ComHandleId=993, ComSystemTemplateSystemSignalRef=DET_AZIMUTH_ERR_047_Rx
            DET_IDM_047_Rx_oRDR_FUSION_DET_045_048_oPCAN_RADAR_de61ceef_Rx: ComBitPosition=287, ComBitSize=1, ComSignalType=BOOLEAN, ComHandleId=1029, ComSystemTemplateSystemSignalRef=DET_IDM_047_Rx
            DET_BELOW_RAIN_THOLD_048_Rx_oRDR_FUSION_DET_045_048_oPCAN_RADAR_0714df33_Rx: ComBitPosition=375, ComBitSize=1, ComSignalType=BOOLEAN, ComHandleId=998, ComSystemTemplateSystemSignalRef=DET_BELOW_RAIN_THOLD_048_Rx
            DET_CONFD_AZIMUTH_046_Rx_oRDR_FUSION_DET_045_048_oPCAN_RADAR_bce97e9b_Rx: ComBitPosition=230, ComBitSize=2, ComSignalType=UINT8, ComHandleId=1004, ComSystemTemplateSystemSignalRef=DET_CONFD_AZIMUTH_046_Rx
            DET_CONFD_ELEVATION_045_Rx_oRDR_FUSION_DET_045_048_oPCAN_RADAR_9c744d94_Rx: ComBitPosition=101, ComBitSize=2, ComSignalType=UINT8, ComHandleId=1007, ComSystemTemplateSystemSignalRef=DET_CONFD_ELEVATION_045_Rx
            DET_SUPER_RES_TARGET_048_Rx_oRDR_FUSION_DET_045_048_oPCAN_RADAR_a0f73dad_Rx: ComBitPosition=423, ComBitSize=1, ComSignalType=BOOLEAN, ComHandleId=1069, ComSystemTemplateSystemSignalRef=DET_SUPER_RES_TARGET_048_Rx
            DET_EXISTENCE_PROB_047_Rx_oRDR_FUSION_DET_045_048_oPCAN_RADAR_367edae8_Rx: ComBitPosition=336, ComBitSize=6, ComSignalType=UINT8, ComHandleId=1021, ComSystemTemplateSystemSignalRef=DET_EXISTENCE_PROB_047_Rx
            DET_MTD_046_Rx_oRDR_FUSION_DET_045_048_oPCAN_RADAR_cca66ad8_Rx: ComBitPosition=159, ComBitSize=1, ComSignalType=BOOLEAN, ComHandleId=1035, ComSystemTemplateSystemSignalRef=DET_MTD_046_Rx
            DET_RCS_047_Rx_oRDR_FUSION_DET_045_048_oPCAN_RADAR_e2181fec_Rx: ComBitPosition=352, ComBitSize=8, ComSignalType=UINT8, ComHandleId=1060, ComSystemTemplateSystemSignalRef=DET_RCS_047_Rx
            DET_HVC_FLAG_048_Rx_oRDR_FUSION_DET_045_048_oPCAN_RADAR_6bee450f_Rx: ComBitPosition=422, ComBitSize=1, ComSignalType=BOOLEAN, ComHandleId=1026, ComSystemTemplateSystemSignalRef=DET_HVC_FLAG_048_Rx
            DET_HVC_FLAG_047_Rx_oRDR_FUSION_DET_045_048_oPCAN_RADAR_eba037a7_Rx: ComBitPosition=310, ComBitSize=1, ComSignalType=BOOLEAN, ComHandleId=1025, ComSystemTemplateSystemSignalRef=DET_HVC_FLAG_047_Rx
            DET_RANGE_VELOCITY_ERR_046_Rx_oRDR_FUSION_DET_045_048_oPCAN_RADAR_19f36f72_Rx: ComBitPosition=176, ComBitSize=8, ComSignalType=UINT8, ComHandleId=1055, ComSystemTemplateSystemSignalRef=DET_RANGE_VELOCITY_ERR_046_Rx
            DET_BI_STATIC_FLAG_046_Rx_oRDR_FUSION_DET_045_048_oPCAN_RADAR_5f8094cf_Rx: ComBitPosition=216, ComBitSize=1, ComSignalType=BOOLEAN, ComHandleId=1000, ComSystemTemplateSystemSignalRef=DET_BI_STATIC_FLAG_046_Rx
            DET_MH_CYCLE_COUNTER_045_048_Rx_oRDR_FUSION_DET_045_048_oPCAN_RADAR_7eb8ea30_Rx: ComBitPosition=16, ComBitSize=8, ComSignalType=UINT8, ComHandleId=1032, ComSystemTemplateSystemSignalRef=DET_MH_CYCLE_COUNTER_045_048_Rx
            DET_BELOW_RAIN_THOLD_047_Rx_oRDR_FUSION_DET_045_048_oPCAN_RADAR_875aad9b_Rx: ComBitPosition=263, ComBitSize=1, ComSignalType=BOOLEAN, ComHandleId=997, ComSystemTemplateSystemSignalRef=DET_BELOW_RAIN_THOLD_047_Rx
            DET_SUPER_RES_TARGET_046_Rx_oRDR_FUSION_DET_045_048_oPCAN_RADAR_8ffddd42_Rx: ComBitPosition=199, ComBitSize=1, ComSignalType=BOOLEAN, ComHandleId=1067, ComSystemTemplateSystemSignalRef=DET_SUPER_RES_TARGET_046_Rx
            DET_AZIMUTH_048_Rx_oRDR_FUSION_DET_045_048_oPCAN_RADAR_61ae2086_Rx: ComBitPosition=424, ComBitSize=13, ComSignalType=UINT16, ComHandleId=990, ComSystemTemplateSystemSignalRef=DET_AZIMUTH_048_Rx
            DET_RANGE_045_Rx_oRDR_FUSION_DET_045_048_oPCAN_RADAR_77de2cc6_Rx: ComBitPosition=24, ComBitSize=15, ComSignalType=UINT16, ComHandleId=1042, ComSystemTemplateSystemSignalRef=DET_RANGE_045_Rx
            DET_BELOW_RAIN_THOLD_045_Rx_oRDR_FUSION_DET_045_048_oPCAN_RADAR_02a28f54_Rx: ComBitPosition=39, ComBitSize=1, ComSignalType=BOOLEAN, ComHandleId=995, ComSystemTemplateSystemSignalRef=DET_BELOW_RAIN_THOLD_045_Rx
            DET_ELEVATION_046_Rx_oRDR_FUSION_DET_045_048_oPCAN_RADAR_bc9b12e5_Rx: ComBitPosition=184, ComBitSize=8, ComSignalType=UINT8, ComHandleId=1012, ComSystemTemplateSystemSignalRef=DET_ELEVATION_046_Rx
            DET_MTD_048_Rx_oRDR_FUSION_DET_045_048_oPCAN_RADAR_e3ac8a37_Rx: ComBitPosition=383, ComBitSize=1, ComSignalType=BOOLEAN, ComHandleId=1037, ComSystemTemplateSystemSignalRef=DET_MTD_048_Rx
            DET_HVC_FLAG_046_Rx_oRDR_FUSION_DET_045_048_oPCAN_RADAR_44e4a5e0_Rx: ComBitPosition=198, ComBitSize=1, ComSignalType=BOOLEAN, ComHandleId=1024, ComSystemTemplateSystemSignalRef=DET_HVC_FLAG_046_Rx
            DET_RANGE_VELOCITY_047_Rx_oRDR_FUSION_DET_045_048_oPCAN_RADAR_2fd38df7_Rx: ComBitPosition=272, ComBitSize=15, ComSignalType=UINT16, ComHandleId=1052, ComSystemTemplateSystemSignalRef=DET_RANGE_VELOCITY_047_Rx
            DET_RCS_045_Rx_oRDR_FUSION_DET_045_048_oPCAN_RADAR_67e03d23_Rx: ComBitPosition=128, ComBitSize=8, ComSignalType=UINT8, ComHandleId=1058, ComSystemTemplateSystemSignalRef=DET_RCS_045_Rx
            DET_SNR_046_Rx_oRDR_FUSION_DET_045_048_oPCAN_RADAR_4406fc42_Rx: ComBitPosition=232, ComBitSize=8, ComSignalType=UINT8, ComHandleId=1063, ComSystemTemplateSystemSignalRef=DET_SNR_046_Rx
            DET_CONFD_ELEVATION_047_Rx_oRDR_FUSION_DET_045_048_oPCAN_RADAR_198c6f5b_Rx: ComBitPosition=325, ComBitSize=2, ComSignalType=UINT8, ComHandleId=1009, ComSystemTemplateSystemSignalRef=DET_CONFD_ELEVATION_047_Rx
            DET_EXISTENCE_PROB_048_Rx_oRDR_FUSION_DET_045_048_oPCAN_RADAR_b630a840_Rx: ComBitPosition=448, ComBitSize=6, ComSignalType=UINT8, ComHandleId=1022, ComSystemTemplateSystemSignalRef=DET_EXISTENCE_PROB_048_Rx
            DET_RANGE_VELOCITY_045_Rx_oRDR_FUSION_DET_045_048_oPCAN_RADAR_aa2baf38_Rx: ComBitPosition=48, ComBitSize=15, ComSignalType=UINT16, ComHandleId=1050, ComSystemTemplateSystemSignalRef=DET_RANGE_VELOCITY_045_Rx
            DET_SNR_045_Rx_oRDR_FUSION_DET_045_048_oPCAN_RADAR_6eba4cca_Rx: ComBitPosition=120, ComBitSize=8, ComSignalType=UINT8, ComHandleId=1062, ComSystemTemplateSystemSignalRef=DET_SNR_045_Rx
            DET_CONFD_AZIMUTH_045_Rx_oRDR_FUSION_DET_045_048_oPCAN_RADAR_9655ce13_Rx: ComBitPosition=118, ComBitSize=2, ComSignalType=UINT8, ComHandleId=1003, ComSystemTemplateSystemSignalRef=DET_CONFD_AZIMUTH_045_Rx
            DET_ELEVATION_ERR_048_Rx_oRDR_FUSION_DET_045_048_oPCAN_RADAR_4128d0d5_Rx: ComBitPosition=416, ComBitSize=6, ComSignalType=UINT8, ComHandleId=1018, ComSystemTemplateSystemSignalRef=DET_ELEVATION_ERR_048_Rx
            DET_PROB_1STAZHYPO_045_Rx_oRDR_FUSION_DET_045_048_oPCAN_RADAR_2c63c4d1_Rx: ComBitPosition=103, ComBitSize=1, ComSignalType=BOOLEAN, ComHandleId=1038, ComSystemTemplateSystemSignalRef=DET_PROB_1STAZHYPO_045_Rx
            DET_RANGE_047_Rx_oRDR_FUSION_DET_045_048_oPCAN_RADAR_f2260e09_Rx: ComBitPosition=248, ComBitSize=15, ComSignalType=UINT16, ComHandleId=1044, ComSystemTemplateSystemSignalRef=DET_RANGE_047_Rx
        SG_Fusion_Detections_049_052_oRDR_FUSION_DET_049_052_oPCAN_RADAR_25715fa9_Rx: ComHandleId=20, ComSystemTemplateSignalGroupRef=SG_Fusion_Detections_049_052
          83 x ComGroupSignal, all with ComSignalEndianness=LITTLE_ENDIAN, ComSignalInitValue=0, ComSignalAccess=ACCESS_NEEDED_BY_SWC_OR_COM:
            DET_ELEVATION_050_Rx_oRDR_FUSION_DET_049_052_oPCAN_RADAR_33bd0c55_Rx: ComBitPosition=184, ComBitSize=8, ComSignalType=UINT8, ComHandleId=1095, ComSystemTemplateSystemSignalRef=DET_ELEVATION_050_Rx
            DET_ELEVATION_049_Rx_oRDR_FUSION_DET_049_052_oPCAN_RADAR_0e9d8f4c_Rx: ComBitPosition=72, ComBitSize=8, ComSignalType=UINT8, ComHandleId=1094, ComSystemTemplateSystemSignalRef=DET_ELEVATION_049_Rx
            DET_MH_CRC16_049_052_Rx_oRDR_FUSION_DET_049_052_oPCAN_RADAR_74272fbc_Rx: ComBitPosition=0, ComBitSize=16, ComSignalType=UINT16, ComHandleId=1114, ComSystemTemplateSystemSignalRef=DET_MH_CRC16_049_052_Rx
            DET_BI_STATIC_FLAG_050_Rx_oRDR_FUSION_DET_049_052_oPCAN_RADAR_d0a68a7f_Rx: ComBitPosition=216, ComBitSize=1, ComSignalType=BOOLEAN, ComHandleId=1083, ComSystemTemplateSystemSignalRef=DET_BI_STATIC_FLAG_050_Rx
            DET_SNR_051_Rx_oRDR_FUSION_DET_049_052_oPCAN_RADAR_646470b5_Rx: ComBitPosition=344, ComBitSize=8, ComSignalType=UINT8, ComHandleId=1147, ComSystemTemplateSystemSignalRef=DET_SNR_051_Rx
            DET_AZIMUTH_049_Rx_oRDR_FUSION_DET_049_052_oPCAN_RADAR_fca25dc0_Rx: ComBitPosition=88, ComBitSize=13, ComSignalType=UINT16, ComHandleId=1070, ComSystemTemplateSystemSignalRef=DET_AZIMUTH_049_Rx
            DET_BELOW_RAIN_THOLD_051_Rx_oRDR_FUSION_DET_049_052_oPCAN_RADAR_087cb32b_Rx: ComBitPosition=263, ComBitSize=1, ComSignalType=BOOLEAN, ComHandleId=1080, ComSystemTemplateSystemSignalRef=DET_BELOW_RAIN_THOLD_051_Rx
            DET_RANGE_052_Rx_oRDR_FUSION_DET_049_052_oPCAN_RADAR_57bca031_Rx: ComBitPosition=360, ComBitSize=15, ComSignalType=UINT16, ComHandleId=1128, ComSystemTemplateSystemSignalRef=DET_RANGE_052_Rx
            DET_IDM_051_Rx_oRDR_FUSION_DET_049_052_oPCAN_RADAR_5147d05f_Rx: ComBitPosition=287, ComBitSize=1, ComSignalType=BOOLEAN, ComHandleId=1112, ComSystemTemplateSystemSignalRef=DET_IDM_051_Rx
            DET_SNR_049_Rx_oRDR_FUSION_DET_049_052_oPCAN_RADAR_f60061eb_Rx: ComBitPosition=120, ComBitSize=8, ComSignalType=UINT8, ComHandleId=1145, ComSystemTemplateSystemSignalRef=DET_SNR_049_Rx
            DET_IDM_049_Rx_oRDR_FUSION_DET_049_052_oPCAN_RADAR_c323c101_Rx: ComBitPosition=63, ComBitSize=1, ComSignalType=BOOLEAN, ComHandleId=1110, ComSystemTemplateSystemSignalRef=DET_IDM_049_Rx
            DET_RANGE_VELOCITY_ERR_052_Rx_oRDR_FUSION_DET_049_052_oPCAN_RADAR_132d530d_Rx: ComBitPosition=400, ComBitSize=8, ComSignalType=UINT8, ComHandleId=1140, ComSystemTemplateSystemSignalRef=DET_RANGE_VELOCITY_ERR_052_Rx
            DET_SUPER_RES_TARGET_050_Rx_oRDR_FUSION_DET_049_052_oPCAN_RADAR_00dbc3f2_Rx: ComBitPosition=199, ComBitSize=1, ComSignalType=BOOLEAN, ComHandleId=1150, ComSystemTemplateSystemSignalRef=DET_SUPER_RES_TARGET_050_Rx
            DET_RANGE_ERR_049_Rx_oRDR_FUSION_DET_049_052_oPCAN_RADAR_bf968d07_Rx: ComBitPosition=40, ComBitSize=7, ComSignalType=UINT8, ComHandleId=1129, ComSystemTemplateSystemSignalRef=DET_RANGE_ERR_049_Rx
            DET_EXISTENCE_PROB_049_Rx_oRDR_FUSION_DET_049_052_oPCAN_RADAR_2b3cd506_Rx: ComBitPosition=112, ComBitSize=6, ComSignalType=UINT8, ComHandleId=1102, ComSystemTemplateSystemSignalRef=DET_EXISTENCE_PROB_049_Rx
            DET_RANGE_VELOCITY_ERR_050_Rx_oRDR_FUSION_DET_049_052_oPCAN_RADAR_96d571c2_Rx: ComBitPosition=176, ComBitSize=8, ComSignalType=UINT8, ComHandleId=1138, ComSystemTemplateSystemSignalRef=DET_RANGE_VELOCITY_ERR_050_Rx
            DET_BI_STATIC_FLAG_051_Rx_oRDR_FUSION_DET_049_052_oPCAN_RADAR_7fe21838_Rx: ComBitPosition=328, ComBitSize=1, ComSignalType=BOOLEAN, ComHandleId=1084, ComSystemTemplateSystemSignalRef=DET_BI_STATIC_FLAG_051_Rx
            DET_HVC_FLAG_052_Rx_oRDR_FUSION_DET_049_052_oPCAN_RADAR_4e3a999f_Rx: ComBitPosition=422, ComBitSize=1, ComSignalType=BOOLEAN, ComHandleId=1109, ComSystemTemplateSystemSignalRef=DET_HVC_FLAG_052_Rx
            DET_PROB_1STAZHYPO_050_Rx_oRDR_FUSION_DET_049_052_oPCAN_RADAR_89f96ae9_Rx: ComBitPosition=215, ComBitSize=1, ComSignalType=BOOLEAN, ComHandleId=1122, ComSystemTemplateSystemSignalRef=DET_PROB_1STAZHYPO_050_Rx
            DET_RANGE_050_Rx_oRDR_FUSION_DET_049_052_oPCAN_RADAR_d24482fe_Rx: ComBitPosition=136, ComBitSize=15, ComSignalType=UINT16, ComHandleId=1126, ComSystemTemplateSystemSignalRef=DET_RANGE_050_Rx
            DET_EXISTENCE_PROB_050_Rx_oRDR_FUSION_DET_049_052_oPCAN_RADAR_161c561f_Rx: ComBitPosition=224, ComBitSize=6, ComSignalType=UINT8, ComHandleId=1103, ComSystemTemplateSystemSignalRef=DET_EXISTENCE_PROB_050_Rx
            DET_CONFD_AZIMUTH_050_Rx_oRDR_FUSION_DET_049_052_oPCAN_RADAR_33cf602b_Rx: ComBitPosition=230, ComBitSize=2, ComSignalType=UINT8, ComHandleId=1087, ComSystemTemplateSystemSignalRef=DET_CONFD_AZIMUTH_050_Rx
            DET_PROB_1STAZHYPO_052_Rx_oRDR_FUSION_DET_049_052_oPCAN_RADAR_0c014826_Rx: ComBitPosition=439, ComBitSize=1, ComSignalType=BOOLEAN, ComHandleId=1124, ComSystemTemplateSystemSignalRef=DET_PROB_1STAZHYPO_052_Rx
            DET_BI_STATIC_FLAG_049_Rx_oRDR_FUSION_DET_049_052_oPCAN_RADAR_ed860966_Rx: ComBitPosition=104, ComBitSize=1, ComSignalType=BOOLEAN, ComHandleId=1082, ComSystemTemplateSystemSignalRef=DET_BI_STATIC_FLAG_049_Rx
            DET_RANGE_ERR_051_Rx_oRDR_FUSION_DET_049_052_oPCAN_RADAR_2df29c59_Rx: ComBitPosition=264, ComBitSize=7, ComSignalType=UINT8, ComHandleId=1131, ComSystemTemplateSystemSignalRef=DET_RANGE_ERR_051_Rx
            DET_PROB_1STAZHYPO_051_Rx_oRDR_FUSION_DET_049_052_oPCAN_RADAR_26bdf8ae_Rx: ComBitPosition=327, ComBitSize=1, ComSignalType=BOOLEAN, ComHandleId=1123, ComSystemTemplateSystemSignalRef=DET_PROB_1STAZHYPO_051_Rx
            DET_ELEVATION_051_Rx_oRDR_FUSION_DET_049_052_oPCAN_RADAR_9cf99e12_Rx: ComBitPosition=296, ComBitSize=8, ComSignalType=UINT8, ComHandleId=1096, ComSystemTemplateSystemSignalRef=DET_ELEVATION_051_Rx
            DET_RCS_049_Rx_oRDR_FUSION_DET_049_052_oPCAN_RADAR_ff5a1002_Rx: ComBitPosition=128, ComBitSize=8, ComSignalType=UINT8, ComHandleId=1141, ComSystemTemplateSystemSignalRef=DET_RCS_049_Rx
            DET_AZIMUTH_ERR_049_Rx_oRDR_FUSION_DET_049_052_oPCAN_RADAR_fecbfc42_Rx: ComBitPosition=105, ComBitSize=7, ComSignalType=UINT8, ComHandleId=1074, ComSystemTemplateSystemSignalRef=DET_AZIMUTH_ERR_049_Rx
            DET_BI_STATIC_FLAG_052_Rx_oRDR_FUSION_DET_049_052_oPCAN_RADAR_555ea8b0_Rx: ComBitPosition=440, ComBitSize=1, ComSignalType=BOOLEAN, ComHandleId=1085, ComSystemTemplateSystemSignalRef=DET_BI_STATIC_FLAG_052_Rx
            DET_RANGE_051_Rx_oRDR_FUSION_DET_049_052_oPCAN_RADAR_7d0010b9_Rx: ComBitPosition=248, ComBitSize=15, ComSignalType=UINT16, ComHandleId=1127, ComSystemTemplateSystemSignalRef=DET_RANGE_051_Rx
            DET_HVC_FLAG_049_Rx_oRDR_FUSION_DET_049_052_oPCAN_RADAR_f6e23849_Rx: ComBitPosition=86, ComBitSize=1, ComSignalType=BOOLEAN, ComHandleId=1106, ComSystemTemplateSystemSignalRef=DET_HVC_FLAG_049_Rx
            DET_CONFD_AZIMUTH_049_Rx_oRDR_FUSION_DET_049_052_oPCAN_RADAR_0eefe332_Rx: ComBitPosition=118, ComBitSize=2, ComSignalType=UINT8, ComHandleId=1086, ComSystemTemplateSystemSignalRef=DET_CONFD_AZIMUTH_049_Rx
            DET_CONFD_ELEVATION_050_Rx_oRDR_FUSION_DET_049_052_oPCAN_RADAR_39eee3ac_Rx: ComBitPosition=213, ComBitSize=2, ComSignalType=UINT8, ComHandleId=1091, ComSystemTemplateSystemSignalRef=DET_CONFD_ELEVATION_050_Rx
            DET_RANGE_VELOCITY_050_Rx_oRDR_FUSION_DET_049_052_oPCAN_RADAR_0fb10100_Rx: ComBitPosition=160, ComBitSize=15, ComSignalType=UINT16, ComHandleId=1134, ComSystemTemplateSystemSignalRef=DET_RANGE_VELOCITY_050_Rx
            DET_BELOW_RAIN_THOLD_052_Rx_oRDR_FUSION_DET_049_052_oPCAN_RADAR_22c003a3_Rx: ComBitPosition=375, ComBitSize=1, ComSignalType=BOOLEAN, ComHandleId=1081, ComSystemTemplateSystemSignalRef=DET_BELOW_RAIN_THOLD_052_Rx
            DET_CONFD_ELEVATION_049_Rx_oRDR_FUSION_DET_049_052_oPCAN_RADAR_04ce60b5_Rx: ComBitPosition=101, ComBitSize=2, ComSignalType=UINT8, ComHandleId=1090, ComSystemTemplateSystemSignalRef=DET_CONFD_ELEVATION_049_Rx
            DET_HVC_FLAG_050_Rx_oRDR_FUSION_DET_049_052_oPCAN_RADAR_cbc2bb50_Rx: ComBitPosition=198, ComBitSize=1, ComSignalType=BOOLEAN, ComHandleId=1107, ComSystemTemplateSystemSignalRef=DET_HVC_FLAG_050_Rx
            DET_ELEVATION_ERR_050_Rx_oRDR_FUSION_DET_049_052_oPCAN_RADAR_e1042e8a_Rx: ComBitPosition=192, ComBitSize=6, ComSignalType=UINT8, ComHandleId=1099, ComSystemTemplateSystemSignalRef=DET_ELEVATION_ERR_050_Rx
            DET_IDM_050_Rx_oRDR_FUSION_DET_049_052_oPCAN_RADAR_fe034218_Rx: ComBitPosition=175, ComBitSize=1, ComSignalType=BOOLEAN, ComHandleId=1111, ComSystemTemplateSystemSignalRef=DET_IDM_050_Rx
            DET_IDM_052_Rx_oRDR_FUSION_DET_049_052_oPCAN_RADAR_7bfb60d7_Rx: ComBitPosition=399, ComBitSize=1, ComSignalType=BOOLEAN, ComHandleId=1113, ComSystemTemplateSystemSignalRef=DET_IDM_052_Rx
            DET_BELOW_RAIN_THOLD_050_Rx_oRDR_FUSION_DET_049_052_oPCAN_RADAR_a738216c_Rx: ComBitPosition=151, ComBitSize=1, ComSignalType=BOOLEAN, ComHandleId=1079, ComSystemTemplateSystemSignalRef=DET_BELOW_RAIN_THOLD_050_Rx
            DET_CONFD_ELEVATION_051_Rx_oRDR_FUSION_DET_049_052_oPCAN_RADAR_96aa71eb_Rx: ComBitPosition=325, ComBitSize=2, ComSignalType=UINT8, ComHandleId=1092, ComSystemTemplateSystemSignalRef=DET_CONFD_ELEVATION_051_Rx
            DET_RANGE_VELOCITY_ERR_049_Rx_oRDR_FUSION_DET_049_052_oPCAN_RADAR_abf5f2db_Rx: ComBitPosition=64, ComBitSize=8, ComSignalType=UINT8, ComHandleId=1137, ComSystemTemplateSystemSignalRef=DET_RANGE_VELOCITY_ERR_049_Rx
            DET_PROB_1STAZHYPO_049_Rx_oRDR_FUSION_DET_049_052_oPCAN_RADAR_b4d9e9f0_Rx: ComBitPosition=103, ComBitSize=1, ComSignalType=BOOLEAN, ComHandleId=1121, ComSystemTemplateSystemSignalRef=DET_PROB_1STAZHYPO_049_Rx
            DET_RANGE_ERR_052_Rx_oRDR_FUSION_DET_049_052_oPCAN_RADAR_074e2cd1_Rx: ComBitPosition=376, ComBitSize=7, ComSignalType=UINT8, ComHandleId=1132, ComSystemTemplateSystemSignalRef=DET_RANGE_ERR_052_Rx
            DET_RCS_052_Rx_oRDR_FUSION_DET_049_052_oPCAN_RADAR_4782b1d4_Rx: ComBitPosition=464, ComBitSize=8, ComSignalType=UINT8, ComHandleId=1144, ComSystemTemplateSystemSignalRef=DET_RCS_052_Rx
            DET_AZIMUTH_051_Rx_oRDR_FUSION_DET_049_052_oPCAN_RADAR_6ec64c9e_Rx: ComBitPosition=312, ComBitSize=13, ComSignalType=UINT16, ComHandleId=1072, ComSystemTemplateSystemSignalRef=DET_AZIMUTH_051_Rx
            DET_CONFD_AZIMUTH_051_Rx_oRDR_FUSION_DET_049_052_oPCAN_RADAR_9c8bf26c_Rx: ComBitPosition=342, ComBitSize=2, ComSignalType=UINT8, ComHandleId=1088, ComSystemTemplateSystemSignalRef=DET_CONFD_AZIMUTH_051_Rx
            DET_ELEVATION_ERR_052_Rx_oRDR_FUSION_DET_049_052_oPCAN_RADAR_64fc0c45_Rx: ComBitPosition=416, ComBitSize=6, ComSignalType=UINT8, ComHandleId=1101, ComSystemTemplateSystemSignalRef=DET_ELEVATION_ERR_052_Rx
            DET_SUPER_RES_TARGET_051_Rx_oRDR_FUSION_DET_049_052_oPCAN_RADAR_af9f51b5_Rx: ComBitPosition=311, ComBitSize=1, ComSignalType=BOOLEAN, ComHandleId=1151, ComSystemTemplateSystemSignalRef=DET_SUPER_RES_TARGET_051_Rx
            DET_SUPER_RES_TARGET_052_Rx_oRDR_FUSION_DET_049_052_oPCAN_RADAR_8523e13d_Rx: ComBitPosition=423, ComBitSize=1, ComSignalType=BOOLEAN, ComHandleId=1152, ComSystemTemplateSystemSignalRef=DET_SUPER_RES_TARGET_052_Rx
            DET_CONFD_AZIMUTH_052_Rx_oRDR_FUSION_DET_049_052_oPCAN_RADAR_b63742e4_Rx: ComBitPosition=454, ComBitSize=2, ComSignalType=UINT8, ComHandleId=1089, ComSystemTemplateSystemSignalRef=DET_CONFD_AZIMUTH_052_Rx
            DET_SUPER_RES_TARGET_049_Rx_oRDR_FUSION_DET_049_052_oPCAN_RADAR_3dfb40eb_Rx: ComBitPosition=87, ComBitSize=1, ComSignalType=BOOLEAN, ComHandleId=1149, ComSystemTemplateSystemSignalRef=DET_SUPER_RES_TARGET_049_Rx
            DET_BELOW_RAIN_THOLD_049_Rx_oRDR_FUSION_DET_049_052_oPCAN_RADAR_9a18a275_Rx: ComBitPosition=39, ComBitSize=1, ComSignalType=BOOLEAN, ComHandleId=1078, ComSystemTemplateSystemSignalRef=DET_BELOW_RAIN_THOLD_049_Rx
            DET_MTD_051_Rx_oRDR_FUSION_DET_049_052_oPCAN_RADAR_ecc4e62f_Rx: ComBitPosition=271, ComBitSize=1, ComSignalType=BOOLEAN, ComHandleId=1119, ComSystemTemplateSystemSignalRef=DET_MTD_051_Rx
            DET_ELEVATION_ERR_051_Rx_oRDR_FUSION_DET_049_052_oPCAN_RADAR_4e40bccd_Rx: ComBitPosition=304, ComBitSize=6, ComSignalType=UINT8, ComHandleId=1100, ComSystemTemplateSystemSignalRef=DET_ELEVATION_ERR_051_Rx
            DET_EXISTENCE_PROB_052_Rx_oRDR_FUSION_DET_049_052_oPCAN_RADAR_93e474d0_Rx: ComBitPosition=448, ComBitSize=6, ComSignalType=UINT8, ComHandleId=1105, ComSystemTemplateSystemSignalRef=DET_EXISTENCE_PROB_052_Rx
            DET_MTD_049_Rx_oRDR_FUSION_DET_049_052_oPCAN_RADAR_7ea0f771_Rx: ComBitPosition=47, ComBitSize=1, ComSignalType=BOOLEAN, ComHandleId=1117, ComSystemTemplateSystemSignalRef=DET_MTD_049_Rx
            DET_AZIMUTH_052_Rx_oRDR_FUSION_DET_049_052_oPCAN_RADAR_447afc16_Rx: ComBitPosition=424, ComBitSize=13, ComSignalType=UINT16, ComHandleId=1073, ComSystemTemplateSystemSignalRef=DET_AZIMUTH_052_Rx
            DET_RANGE_VELOCITY_051_Rx_oRDR_FUSION_DET_049_052_oPCAN_RADAR_a0f59347_Rx: ComBitPosition=272, ComBitSize=15, ComSignalType=UINT16, ComHandleId=1135, ComSystemTemplateSystemSignalRef=DET_RANGE_VELOCITY_051_Rx
            DET_MTD_052_Rx_oRDR_FUSION_DET_049_052_oPCAN_RADAR_c67856a7_Rx: ComBitPosition=383, ComBitSize=1, ComSignalType=BOOLEAN, ComHandleId=1120, ComSystemTemplateSystemSignalRef=DET_MTD_052_Rx
            DET_MH_CYCLE_COUNTER_049_052_Rx_oRDR_FUSION_DET_049_052_oPCAN_RADAR_79fc1279_Rx: ComBitPosition=16, ComBitSize=8, ComSignalType=UINT8, ComHandleId=1115, ComSystemTemplateSystemSignalRef=DET_MH_CYCLE_COUNTER_049_052_Rx
            DET_AZIMUTH_ERR_050_Rx_oRDR_FUSION_DET_049_052_oPCAN_RADAR_c3eb7f5b_Rx: ComBitPosition=217, ComBitSize=7, ComSignalType=UINT8, ComHandleId=1075, ComSystemTemplateSystemSignalRef=DET_AZIMUTH_ERR_050_Rx
            DET_CONFD_ELEVATION_052_Rx_oRDR_FUSION_DET_049_052_oPCAN_RADAR_bc16c163_Rx: ComBitPosition=437, ComBitSize=2, ComSignalType=UINT8, ComHandleId=1093, ComSystemTemplateSystemSignalRef=DET_CONFD_ELEVATION_052_Rx
            DET_AZIMUTH_ERR_052_Rx_oRDR_FUSION_DET_049_052_oPCAN_RADAR_46135d94_Rx: ComBitPosition=441, ComBitSize=7, ComSignalType=UINT8, ComHandleId=1077, ComSystemTemplateSystemSignalRef=DET_AZIMUTH_ERR_052_Rx
            DET_ELEVATION_ERR_049_Rx_oRDR_FUSION_DET_049_052_oPCAN_RADAR_dc24ad93_Rx: ComBitPosition=80, ComBitSize=6, ComSignalType=UINT8, ComHandleId=1098, ComSystemTemplateSystemSignalRef=DET_ELEVATION_ERR_049_Rx
            DET_AZIMUTH_050_Rx_oRDR_FUSION_DET_049_052_oPCAN_RADAR_c182ded9_Rx: ComBitPosition=200, ComBitSize=13, ComSignalType=UINT16, ComHandleId=1071, ComSystemTemplateSystemSignalRef=DET_AZIMUTH_050_Rx
            DET_RANGE_VELOCITY_ERR_051_Rx_oRDR_FUSION_DET_049_052_oPCAN_RADAR_3991e385_Rx: ComBitPosition=288, ComBitSize=8, ComSignalType=UINT8, ComHandleId=1139, ComSystemTemplateSystemSignalRef=DET_RANGE_VELOCITY_ERR_051_Rx
            DET_RANGE_VELOCITY_052_Rx_oRDR_FUSION_DET_049_052_oPCAN_RADAR_8a4923cf_Rx: ComBitPosition=384, ComBitSize=15, ComSignalType=UINT16, ComHandleId=1136, ComSystemTemplateSystemSignalRef=DET_RANGE_VELOCITY_052_Rx
            DET_RANGE_ERR_050_Rx_oRDR_FUSION_DET_049_052_oPCAN_RADAR_82b60e1e_Rx: ComBitPosition=152, ComBitSize=7, ComSignalType=UINT8, ComHandleId=1130, ComSystemTemplateSystemSignalRef=DET_RANGE_ERR_050_Rx
            DET_ELEVATION_052_Rx_oRDR_FUSION_DET_049_052_oPCAN_RADAR_b6452e9a_Rx: ComBitPosition=408, ComBitSize=8, ComSignalType=UINT8, ComHandleId=1097, ComSystemTemplateSystemSignalRef=DET_ELEVATION_052_Rx
            DET_RANGE_VELOCITY_049_Rx_oRDR_FUSION_DET_049_052_oPCAN_RADAR_32918219_Rx: ComBitPosition=48, ComBitSize=15, ComSignalType=UINT16, ComHandleId=1133, ComSystemTemplateSystemSignalRef=DET_RANGE_VELOCITY_049_Rx
            DET_EXISTENCE_PROB_051_Rx_oRDR_FUSION_DET_049_052_oPCAN_RADAR_b958c458_Rx: ComBitPosition=336, ComBitSize=6, ComSignalType=UINT8, ComHandleId=1104, ComSystemTemplateSystemSignalRef=DET_EXISTENCE_PROB_051_Rx
            DET_SNR_052_Rx_oRDR_FUSION_DET_049_052_oPCAN_RADAR_4ed8c03d_Rx: ComBitPosition=456, ComBitSize=8, ComSignalType=UINT8, ComHandleId=1148, ComSystemTemplateSystemSignalRef=DET_SNR_052_Rx
            DET_RANGE_049_Rx_oRDR_FUSION_DET_049_052_oPCAN_RADAR_ef6401e7_Rx: ComBitPosition=24, ComBitSize=15, ComSignalType=UINT16, ComHandleId=1125, ComSystemTemplateSystemSignalRef=DET_RANGE_049_Rx
            DET_AZIMUTH_ERR_051_Rx_oRDR_FUSION_DET_049_052_oPCAN_RADAR_6cafed1c_Rx: ComBitPosition=329, ComBitSize=7, ComSignalType=UINT8, ComHandleId=1076, ComSystemTemplateSystemSignalRef=DET_AZIMUTH_ERR_051_Rx
            DET_MTD_050_Rx_oRDR_FUSION_DET_049_052_oPCAN_RADAR_43807468_Rx: ComBitPosition=159, ComBitSize=1, ComSignalType=BOOLEAN, ComHandleId=1118, ComSystemTemplateSystemSignalRef=DET_MTD_050_Rx
            DET_SNR_050_Rx_oRDR_FUSION_DET_049_052_oPCAN_RADAR_cb20e2f2_Rx: ComBitPosition=232, ComBitSize=8, ComSignalType=UINT8, ComHandleId=1146, ComSystemTemplateSystemSignalRef=DET_SNR_050_Rx
            DET_MH_SCAN_INDEX_4LSB_049_052_Rx_oRDR_FUSION_DET_049_052_oPCAN_RADAR_1d4cdd42_Rx: ComBitPosition=476, ComBitSize=4, ComSignalType=UINT8, ComHandleId=1116, ComSystemTemplateSystemSignalRef=DET_MH_SCAN_INDEX_4LSB_049_052_Rx
            DET_HVC_FLAG_051_Rx_oRDR_FUSION_DET_049_052_oPCAN_RADAR_64862917_Rx: ComBitPosition=310, ComBitSize=1, ComSignalType=BOOLEAN, ComHandleId=1108, ComSystemTemplateSystemSignalRef=DET_HVC_FLAG_051_Rx
            DET_RCS_050_Rx_oRDR_FUSION_DET_049_052_oPCAN_RADAR_c27a931b_Rx: ComBitPosition=240, ComBitSize=8, ComSignalType=UINT8, ComHandleId=1142, ComSystemTemplateSystemSignalRef=DET_RCS_050_Rx
            DET_RCS_051_Rx_oRDR_FUSION_DET_049_052_oPCAN_RADAR_6d3e015c_Rx: ComBitPosition=352, ComBitSize=8, ComSignalType=UINT8, ComHandleId=1143, ComSystemTemplateSystemSignalRef=DET_RCS_051_Rx
        SG_Fusion_Detections_081_084_oRDR_FUSION_DET_081_084_oPCAN_RADAR_d08af384_Rx: ComHandleId=28, ComSystemTemplateSignalGroupRef=SG_Fusion_Detections_081_084
          83 x ComGroupSignal, all with ComSignalEndianness=LITTLE_ENDIAN, ComSignalInitValue=0, ComSignalAccess=ACCESS_NEEDED_BY_SWC_OR_COM:
            DET_BELOW_RAIN_THOLD_082_Rx_oRDR_FUSION_DET_081_084_oPCAN_RADAR_1ce5d81a_Rx: ComBitPosition=151, ComBitSize=1, ComSignalType=BOOLEAN, ComHandleId=1743, ComSystemTemplateSystemSignalRef=DET_BELOW_RAIN_THOLD_082_Rx
            DET_RANGE_VELOCITY_084_Rx_oRDR_FUSION_DET_081_084_oPCAN_RADAR_e1159966_Rx: ComBitPosition=384, ComBitSize=15, ComSignalType=UINT16, ComHandleId=1800, ComSystemTemplateSystemSignalRef=DET_RANGE_VELOCITY_084_Rx
            DET_ELEVATION_081_Rx_oRDR_FUSION_DET_081_084_oPCAN_RADAR_a2dc45ab_Rx: ComBitPosition=72, ComBitSize=8, ComSignalType=UINT8, ComHandleId=1758, ComSystemTemplateSystemSignalRef=DET_ELEVATION_081_Rx
            DET_ELEVATION_084_Rx_oRDR_FUSION_DET_081_084_oPCAN_RADAR_dd199433_Rx: ComBitPosition=408, ComBitSize=8, ComSignalType=UINT8, ComHandleId=1761, ComSystemTemplateSystemSignalRef=DET_ELEVATION_084_Rx
            DET_MH_CYCLE_COUNTER_081_084_Rx_oRDR_FUSION_DET_081_084_oPCAN_RADAR_67bd97d5_Rx: ComBitPosition=16, ComBitSize=8, ComSignalType=UINT8, ComHandleId=1779, ComSystemTemplateSystemSignalRef=DET_MH_CYCLE_COUNTER_081_084_Rx
            DET_SNR_083_Rx_oRDR_FUSION_DET_081_084_oPCAN_RADAR_dfb989c3_Rx: ComBitPosition=344, ComBitSize=8, ComSignalType=UINT8, ComHandleId=1811, ComSystemTemplateSystemSignalRef=DET_SNR_083_Rx
            DET_SNR_084_Rx_oRDR_FUSION_DET_081_084_oPCAN_RADAR_25847a94_Rx: ComBitPosition=456, ComBitSize=8, ComSignalType=UINT8, ComHandleId=1812, ComSystemTemplateSystemSignalRef=DET_SNR_084_Rx
            DET_EXISTENCE_PROB_082_Rx_oRDR_FUSION_DET_081_084_oPCAN_RADAR_adc1af69_Rx: ComBitPosition=224, ComBitSize=6, ComSignalType=UINT8, ComHandleId=1767, ComSystemTemplateSystemSignalRef=DET_EXISTENCE_PROB_082_Rx
            DET_RANGE_081_Rx_oRDR_FUSION_DET_081_084_oPCAN_RADAR_4325cb00_Rx: ComBitPosition=24, ComBitSize=15, ComSignalType=UINT16, ComHandleId=1789, ComSystemTemplateSystemSignalRef=DET_RANGE_081_Rx
            DET_BI_STATIC_FLAG_081_Rx_oRDR_FUSION_DET_081_084_oPCAN_RADAR_41c7c381_Rx: ComBitPosition=104, ComBitSize=1, ComSignalType=BOOLEAN, ComHandleId=1746, ComSystemTemplateSystemSignalRef=DET_BI_STATIC_FLAG_081_Rx
            DET_MTD_084_Rx_oRDR_FUSION_DET_081_084_oPCAN_RADAR_ad24ec0e_Rx: ComBitPosition=383, ComBitSize=1, ComSignalType=BOOLEAN, ComHandleId=1784, ComSystemTemplateSystemSignalRef=DET_MTD_084_Rx
            DET_PROB_1STAZHYPO_081_Rx_oRDR_FUSION_DET_081_084_oPCAN_RADAR_18982317_Rx: ComBitPosition=103, ComBitSize=1, ComSignalType=BOOLEAN, ComHandleId=1785, ComSystemTemplateSystemSignalRef=DET_PROB_1STAZHYPO_081_Rx
            DET_MH_CRC16_081_084_Rx_oRDR_FUSION_DET_081_084_oPCAN_RADAR_6a66aa10_Rx: ComBitPosition=0, ComBitSize=16, ComSignalType=UINT16, ComHandleId=1778, ComSystemTemplateSystemSignalRef=DET_MH_CRC16_081_084_Rx
            DET_IDM_082_Rx_oRDR_FUSION_DET_081_084_oPCAN_RADAR_45debb6e_Rx: ComBitPosition=175, ComBitSize=1, ComSignalType=BOOLEAN, ComHandleId=1775, ComSystemTemplateSystemSignalRef=DET_IDM_082_Rx
            DET_CONFD_AZIMUTH_081_Rx_oRDR_FUSION_DET_081_084_oPCAN_RADAR_a2ae29d5_Rx: ComBitPosition=118, ComBitSize=2, ComSignalType=UINT8, ComHandleId=1750, ComSystemTemplateSystemSignalRef=DET_CONFD_AZIMUTH_081_Rx
            DET_HVC_FLAG_081_Rx_oRDR_FUSION_DET_081_084_oPCAN_RADAR_5aa3f2ae_Rx: ComBitPosition=86, ComBitSize=1, ComSignalType=BOOLEAN, ComHandleId=1770, ComSystemTemplateSystemSignalRef=DET_HVC_FLAG_081_Rx
            DET_RCS_084_Rx_oRDR_FUSION_DET_081_084_oPCAN_RADAR_2cde0b7d_Rx: ComBitPosition=464, ComBitSize=8, ComSignalType=UINT8, ComHandleId=1808, ComSystemTemplateSystemSignalRef=DET_RCS_084_Rx
            DET_AZIMUTH_082_Rx_oRDR_FUSION_DET_081_084_oPCAN_RADAR_7a5f27af_Rx: ComBitPosition=200, ComBitSize=13, ComSignalType=UINT16, ComHandleId=1735, ComSystemTemplateSystemSignalRef=DET_AZIMUTH_082_Rx
            DET_AZIMUTH_ERR_083_Rx_oRDR_FUSION_DET_081_084_oPCAN_RADAR_d772146a_Rx: ComBitPosition=329, ComBitSize=7, ComSignalType=UINT8, ComHandleId=1740, ComSystemTemplateSystemSignalRef=DET_AZIMUTH_ERR_083_Rx
            DET_SNR_081_Rx_oRDR_FUSION_DET_081_084_oPCAN_RADAR_5a41ab0c_Rx: ComBitPosition=120, ComBitSize=8, ComSignalType=UINT8, ComHandleId=1809, ComSystemTemplateSystemSignalRef=DET_SNR_081_Rx
            DET_RANGE_083_Rx_oRDR_FUSION_DET_081_084_oPCAN_RADAR_c6dde9cf_Rx: ComBitPosition=248, ComBitSize=15, ComSignalType=UINT16, ComHandleId=1791, ComSystemTemplateSystemSignalRef=DET_RANGE_083_Rx
            DET_AZIMUTH_081_Rx_oRDR_FUSION_DET_081_084_oPCAN_RADAR_50e39727_Rx: ComBitPosition=88, ComBitSize=13, ComSignalType=UINT16, ComHandleId=1734, ComSystemTemplateSystemSignalRef=DET_AZIMUTH_081_Rx
            DET_BELOW_RAIN_THOLD_083_Rx_oRDR_FUSION_DET_081_084_oPCAN_RADAR_b3a14a5d_Rx: ComBitPosition=263, ComBitSize=1, ComSignalType=BOOLEAN, ComHandleId=1744, ComSystemTemplateSystemSignalRef=DET_BELOW_RAIN_THOLD_083_Rx
            DET_EXISTENCE_PROB_084_Rx_oRDR_FUSION_DET_081_084_oPCAN_RADAR_f8b8ce79_Rx: ComBitPosition=448, ComBitSize=6, ComSignalType=UINT8, ComHandleId=1769, ComSystemTemplateSystemSignalRef=DET_EXISTENCE_PROB_084_Rx
            DET_HVC_FLAG_084_Rx_oRDR_FUSION_DET_081_084_oPCAN_RADAR_25662336_Rx: ComBitPosition=422, ComBitSize=1, ComSignalType=BOOLEAN, ComHandleId=1773, ComSystemTemplateSystemSignalRef=DET_HVC_FLAG_084_Rx
            DET_RANGE_ERR_081_Rx_oRDR_FUSION_DET_081_084_oPCAN_RADAR_13d747e0_Rx: ComBitPosition=40, ComBitSize=7, ComSignalType=UINT8, ComHandleId=1793, ComSystemTemplateSystemSignalRef=DET_RANGE_ERR_081_Rx
            DET_HVC_FLAG_082_Rx_oRDR_FUSION_DET_081_084_oPCAN_RADAR_701f4226_Rx: ComBitPosition=198, ComBitSize=1, ComSignalType=BOOLEAN, ComHandleId=1771, ComSystemTemplateSystemSignalRef=DET_HVC_FLAG_082_Rx
            DET_CONFD_ELEVATION_082_Rx_oRDR_FUSION_DET_081_084_oPCAN_RADAR_82331ada_Rx: ComBitPosition=213, ComBitSize=2, ComSignalType=UINT8, ComHandleId=1755, ComSystemTemplateSystemSignalRef=DET_CONFD_ELEVATION_082_Rx
            DET_ELEVATION_082_Rx_oRDR_FUSION_DET_081_084_oPCAN_RADAR_8860f523_Rx: ComBitPosition=184, ComBitSize=8, ComSignalType=UINT8, ComHandleId=1759, ComSystemTemplateSystemSignalRef=DET_ELEVATION_082_Rx
            DET_IDM_081_Rx_oRDR_FUSION_DET_081_084_oPCAN_RADAR_6f620be6_Rx: ComBitPosition=63, ComBitSize=1, ComSignalType=BOOLEAN, ComHandleId=1774, ComSystemTemplateSystemSignalRef=DET_IDM_081_Rx
            DET_ELEVATION_ERR_083_Rx_oRDR_FUSION_DET_081_084_oPCAN_RADAR_f59d45bb_Rx: ComBitPosition=304, ComBitSize=6, ComSignalType=UINT8, ComHandleId=1764, ComSystemTemplateSystemSignalRef=DET_ELEVATION_ERR_083_Rx
            DET_CONFD_AZIMUTH_082_Rx_oRDR_FUSION_DET_081_084_oPCAN_RADAR_8812995d_Rx: ComBitPosition=230, ComBitSize=2, ComSignalType=UINT8, ComHandleId=1751, ComSystemTemplateSystemSignalRef=DET_CONFD_AZIMUTH_082_Rx
            DET_EXISTENCE_PROB_081_Rx_oRDR_FUSION_DET_081_084_oPCAN_RADAR_877d1fe1_Rx: ComBitPosition=112, ComBitSize=6, ComSignalType=UINT8, ComHandleId=1766, ComSystemTemplateSystemSignalRef=DET_EXISTENCE_PROB_081_Rx
            DET_HVC_FLAG_083_Rx_oRDR_FUSION_DET_081_084_oPCAN_RADAR_df5bd061_Rx: ComBitPosition=310, ComBitSize=1, ComSignalType=BOOLEAN, ComHandleId=1772, ComSystemTemplateSystemSignalRef=DET_HVC_FLAG_083_Rx
            DET_RANGE_VELOCITY_ERR_083_Rx_oRDR_FUSION_DET_081_084_oPCAN_RADAR_824c1af3_Rx: ComBitPosition=288, ComBitSize=8, ComSignalType=UINT8, ComHandleId=1803, ComSystemTemplateSystemSignalRef=DET_RANGE_VELOCITY_ERR_083_Rx
            DET_ELEVATION_ERR_084_Rx_oRDR_FUSION_DET_081_084_oPCAN_RADAR_0fa0b6ec_Rx: ComBitPosition=416, ComBitSize=6, ComSignalType=UINT8, ComHandleId=1765, ComSystemTemplateSystemSignalRef=DET_ELEVATION_ERR_084_Rx
            DET_ELEVATION_ERR_082_Rx_oRDR_FUSION_DET_081_084_oPCAN_RADAR_5ad9d7fc_Rx: ComBitPosition=192, ComBitSize=6, ComSignalType=UINT8, ComHandleId=1763, ComSystemTemplateSystemSignalRef=DET_ELEVATION_ERR_082_Rx
            DET_BELOW_RAIN_THOLD_084_Rx_oRDR_FUSION_DET_081_084_oPCAN_RADAR_499cb90a_Rx: ComBitPosition=375, ComBitSize=1, ComSignalType=BOOLEAN, ComHandleId=1745, ComSystemTemplateSystemSignalRef=DET_BELOW_RAIN_THOLD_084_Rx
            DET_SUPER_RES_TARGET_084_Rx_oRDR_FUSION_DET_081_084_oPCAN_RADAR_ee7f5b94_Rx: ComBitPosition=423, ComBitSize=1, ComSignalType=BOOLEAN, ComHandleId=1816, ComSystemTemplateSystemSignalRef=DET_SUPER_RES_TARGET_084_Rx
            DET_MTD_083_Rx_oRDR_FUSION_DET_081_084_oPCAN_RADAR_57191f59_Rx: ComBitPosition=271, ComBitSize=1, ComSignalType=BOOLEAN, ComHandleId=1783, ComSystemTemplateSystemSignalRef=DET_MTD_083_Rx
            DET_CONFD_ELEVATION_083_Rx_oRDR_FUSION_DET_081_084_oPCAN_RADAR_2d77889d_Rx: ComBitPosition=325, ComBitSize=2, ComSignalType=UINT8, ComHandleId=1756, ComSystemTemplateSystemSignalRef=DET_CONFD_ELEVATION_083_Rx
            DET_RCS_083_Rx_oRDR_FUSION_DET_081_084_oPCAN_RADAR_d6e3f82a_Rx: ComBitPosition=352, ComBitSize=8, ComSignalType=UINT8, ComHandleId=1807, ComSystemTemplateSystemSignalRef=DET_RCS_083_Rx
            DET_AZIMUTH_ERR_084_Rx_oRDR_FUSION_DET_081_084_oPCAN_RADAR_2d4fe73d_Rx: ComBitPosition=441, ComBitSize=7, ComSignalType=UINT8, ComHandleId=1741, ComSystemTemplateSystemSignalRef=DET_AZIMUTH_ERR_084_Rx
            DET_CONFD_ELEVATION_081_Rx_oRDR_FUSION_DET_081_084_oPCAN_RADAR_a88faa52_Rx: ComBitPosition=101, ComBitSize=2, ComSignalType=UINT8, ComHandleId=1754, ComSystemTemplateSystemSignalRef=DET_CONFD_ELEVATION_081_Rx
            DET_IDM_083_Rx_oRDR_FUSION_DET_081_084_oPCAN_RADAR_ea9a2929_Rx: ComBitPosition=287, ComBitSize=1, ComSignalType=BOOLEAN, ComHandleId=1776, ComSystemTemplateSystemSignalRef=DET_IDM_083_Rx
            DET_EXISTENCE_PROB_083_Rx_oRDR_FUSION_DET_081_084_oPCAN_RADAR_02853d2e_Rx: ComBitPosition=336, ComBitSize=6, ComSignalType=UINT8, ComHandleId=1768, ComSystemTemplateSystemSignalRef=DET_EXISTENCE_PROB_083_Rx
            DET_AZIMUTH_084_Rx_oRDR_FUSION_DET_081_084_oPCAN_RADAR_2f2646bf_Rx: ComBitPosition=424, ComBitSize=13, ComSignalType=UINT16, ComHandleId=1737, ComSystemTemplateSystemSignalRef=DET_AZIMUTH_084_Rx
            DET_RANGE_VELOCITY_081_Rx_oRDR_FUSION_DET_081_084_oPCAN_RADAR_9ed048fe_Rx: ComBitPosition=48, ComBitSize=15, ComSignalType=UINT16, ComHandleId=1797, ComSystemTemplateSystemSignalRef=DET_RANGE_VELOCITY_081_Rx
            DET_AZIMUTH_ERR_081_Rx_oRDR_FUSION_DET_081_084_oPCAN_RADAR_528a36a5_Rx: ComBitPosition=105, ComBitSize=7, ComSignalType=UINT8, ComHandleId=1738, ComSystemTemplateSystemSignalRef=DET_AZIMUTH_ERR_081_Rx
            DET_PROB_1STAZHYPO_084_Rx_oRDR_FUSION_DET_081_084_oPCAN_RADAR_675df28f_Rx: ComBitPosition=439, ComBitSize=1, ComSignalType=BOOLEAN, ComHandleId=1788, ComSystemTemplateSystemSignalRef=DET_PROB_1STAZHYPO_084_Rx
            DET_BI_STATIC_FLAG_084_Rx_oRDR_FUSION_DET_081_084_oPCAN_RADAR_3e021219_Rx: ComBitPosition=440, ComBitSize=1, ComSignalType=BOOLEAN, ComHandleId=1749, ComSystemTemplateSystemSignalRef=DET_BI_STATIC_FLAG_084_Rx
            DET_RANGE_VELOCITY_082_Rx_oRDR_FUSION_DET_081_084_oPCAN_RADAR_b46cf876_Rx: ComBitPosition=160, ComBitSize=15, ComSignalType=UINT16, ComHandleId=1798, ComSystemTemplateSystemSignalRef=DET_RANGE_VELOCITY_082_Rx
            DET_RANGE_VELOCITY_ERR_081_Rx_oRDR_FUSION_DET_081_084_oPCAN_RADAR_07b4383c_Rx: ComBitPosition=64, ComBitSize=8, ComSignalType=UINT8, ComHandleId=1801, ComSystemTemplateSystemSignalRef=DET_RANGE_VELOCITY_ERR_081_Rx
            DET_CONFD_ELEVATION_084_Rx_oRDR_FUSION_DET_081_084_oPCAN_RADAR_d74a7bca_Rx: ComBitPosition=437, ComBitSize=2, ComSignalType=UINT8, ComHandleId=1757, ComSystemTemplateSystemSignalRef=DET_CONFD_ELEVATION_084_Rx
            DET_RANGE_ERR_084_Rx_oRDR_FUSION_DET_081_084_oPCAN_RADAR_6c129678_Rx: ComBitPosition=376, ComBitSize=7, ComSignalType=UINT8, ComHandleId=1796, ComSystemTemplateSystemSignalRef=DET_RANGE_ERR_084_Rx
            DET_MTD_082_Rx_oRDR_FUSION_DET_081_084_oPCAN_RADAR_f85d8d1e_Rx: ComBitPosition=159, ComBitSize=1, ComSignalType=BOOLEAN, ComHandleId=1782, ComSystemTemplateSystemSignalRef=DET_MTD_082_Rx
            DET_RANGE_084_Rx_oRDR_FUSION_DET_081_084_oPCAN_RADAR_3ce01a98_Rx: ComBitPosition=360, ComBitSize=15, ComSignalType=UINT16, ComHandleId=1792, ComSystemTemplateSystemSignalRef=DET_RANGE_084_Rx
            DET_RANGE_ERR_083_Rx_oRDR_FUSION_DET_081_084_oPCAN_RADAR_962f652f_Rx: ComBitPosition=264, ComBitSize=7, ComSignalType=UINT8, ComHandleId=1795, ComSystemTemplateSystemSignalRef=DET_RANGE_ERR_083_Rx
            DET_SUPER_RES_TARGET_083_Rx_oRDR_FUSION_DET_081_084_oPCAN_RADAR_1442a8c3_Rx: ComBitPosition=311, ComBitSize=1, ComSignalType=BOOLEAN, ComHandleId=1815, ComSystemTemplateSystemSignalRef=DET_SUPER_RES_TARGET_083_Rx
            DET_SNR_082_Rx_oRDR_FUSION_DET_081_084_oPCAN_RADAR_70fd1b84_Rx: ComBitPosition=232, ComBitSize=8, ComSignalType=UINT8, ComHandleId=1810, ComSystemTemplateSystemSignalRef=DET_SNR_082_Rx
            DET_RCS_081_Rx_oRDR_FUSION_DET_081_084_oPCAN_RADAR_531bdae5_Rx: ComBitPosition=128, ComBitSize=8, ComSignalType=UINT8, ComHandleId=1805, ComSystemTemplateSystemSignalRef=DET_RCS_081_Rx
            DET_RANGE_VELOCITY_ERR_084_Rx_oRDR_FUSION_DET_081_084_oPCAN_RADAR_7871e9a4_Rx: ComBitPosition=400, ComBitSize=8, ComSignalType=UINT8, ComHandleId=1804, ComSystemTemplateSystemSignalRef=DET_RANGE_VELOCITY_ERR_084_Rx
            DET_PROB_1STAZHYPO_082_Rx_oRDR_FUSION_DET_081_084_oPCAN_RADAR_3224939f_Rx: ComBitPosition=215, ComBitSize=1, ComSignalType=BOOLEAN, ComHandleId=1786, ComSystemTemplateSystemSignalRef=DET_PROB_1STAZHYPO_082_Rx
            DET_SUPER_RES_TARGET_082_Rx_oRDR_FUSION_DET_081_084_oPCAN_RADAR_bb063a84_Rx: ComBitPosition=199, ComBitSize=1, ComSignalType=BOOLEAN, ComHandleId=1814, ComSystemTemplateSystemSignalRef=DET_SUPER_RES_TARGET_082_Rx
            DET_SUPER_RES_TARGET_081_Rx_oRDR_FUSION_DET_081_084_oPCAN_RADAR_91ba8a0c_Rx: ComBitPosition=87, ComBitSize=1, ComSignalType=BOOLEAN, ComHandleId=1813, ComSystemTemplateSystemSignalRef=DET_SUPER_RES_TARGET_081_Rx
            DET_CONFD_AZIMUTH_084_Rx_oRDR_FUSION_DET_081_084_oPCAN_RADAR_dd6bf84d_Rx: ComBitPosition=454, ComBitSize=2, ComSignalType=UINT8, ComHandleId=1753, ComSystemTemplateSystemSignalRef=DET_CONFD_AZIMUTH_084_Rx
            DET_MTD_081_Rx_oRDR_FUSION_DET_081_084_oPCAN_RADAR_d2e13d96_Rx: ComBitPosition=47, ComBitSize=1, ComSignalType=BOOLEAN, ComHandleId=1781, ComSystemTemplateSystemSignalRef=DET_MTD_081_Rx
            DET_ELEVATION_083_Rx_oRDR_FUSION_DET_081_084_oPCAN_RADAR_27246764_Rx: ComBitPosition=296, ComBitSize=8, ComSignalType=UINT8, ComHandleId=1760, ComSystemTemplateSystemSignalRef=DET_ELEVATION_083_Rx
            DET_RANGE_ERR_082_Rx_oRDR_FUSION_DET_081_084_oPCAN_RADAR_396bf768_Rx: ComBitPosition=152, ComBitSize=7, ComSignalType=UINT8, ComHandleId=1794, ComSystemTemplateSystemSignalRef=DET_RANGE_ERR_082_Rx
            DET_RANGE_VELOCITY_ERR_082_Rx_oRDR_FUSION_DET_081_084_oPCAN_RADAR_2d0888b4_Rx: ComBitPosition=176, ComBitSize=8, ComSignalType=UINT8, ComHandleId=1802, ComSystemTemplateSystemSignalRef=DET_RANGE_VELOCITY_ERR_082_Rx
            DET_BELOW_RAIN_THOLD_081_Rx_oRDR_FUSION_DET_081_084_oPCAN_RADAR_36596892_Rx: ComBitPosition=39, ComBitSize=1, ComSignalType=BOOLEAN, ComHandleId=1742, ComSystemTemplateSystemSignalRef=DET_BELOW_RAIN_THOLD_081_Rx
            DET_MH_SCAN_INDEX_4LSB_081_084_Rx_oRDR_FUSION_DET_081_084_oPCAN_RADAR_030d58ee_Rx: ComBitPosition=476, ComBitSize=4, ComSignalType=UINT8, ComHandleId=1780, ComSystemTemplateSystemSignalRef=DET_MH_SCAN_INDEX_4LSB_081_084_Rx
            DET_AZIMUTH_083_Rx_oRDR_FUSION_DET_081_084_oPCAN_RADAR_d51bb5e8_Rx: ComBitPosition=312, ComBitSize=13, ComSignalType=UINT16, ComHandleId=1736, ComSystemTemplateSystemSignalRef=DET_AZIMUTH_083_Rx
            DET_PROB_1STAZHYPO_083_Rx_oRDR_FUSION_DET_081_084_oPCAN_RADAR_9d6001d8_Rx: ComBitPosition=327, ComBitSize=1, ComSignalType=BOOLEAN, ComHandleId=1787, ComSystemTemplateSystemSignalRef=DET_PROB_1STAZHYPO_083_Rx
            DET_RCS_082_Rx_oRDR_FUSION_DET_081_084_oPCAN_RADAR_79a76a6d_Rx: ComBitPosition=240, ComBitSize=8, ComSignalType=UINT8, ComHandleId=1806, ComSystemTemplateSystemSignalRef=DET_RCS_082_Rx
            DET_AZIMUTH_ERR_082_Rx_oRDR_FUSION_DET_081_084_oPCAN_RADAR_7836862d_Rx: ComBitPosition=217, ComBitSize=7, ComSignalType=UINT8, ComHandleId=1739, ComSystemTemplateSystemSignalRef=DET_AZIMUTH_ERR_082_Rx
            DET_IDM_084_Rx_oRDR_FUSION_DET_081_084_oPCAN_RADAR_10a7da7e_Rx: ComBitPosition=399, ComBitSize=1, ComSignalType=BOOLEAN, ComHandleId=1777, ComSystemTemplateSystemSignalRef=DET_IDM_084_Rx
            DET_RANGE_VELOCITY_083_Rx_oRDR_FUSION_DET_081_084_oPCAN_RADAR_1b286a31_Rx: ComBitPosition=272, ComBitSize=15, ComSignalType=UINT16, ComHandleId=1799, ComSystemTemplateSystemSignalRef=DET_RANGE_VELOCITY_083_Rx
            DET_BI_STATIC_FLAG_082_Rx_oRDR_FUSION_DET_081_084_oPCAN_RADAR_6b7b7309_Rx: ComBitPosition=216, ComBitSize=1, ComSignalType=BOOLEAN, ComHandleId=1747, ComSystemTemplateSystemSignalRef=DET_BI_STATIC_FLAG_082_Rx
            DET_BI_STATIC_FLAG_083_Rx_oRDR_FUSION_DET_081_084_oPCAN_RADAR_c43fe14e_Rx: ComBitPosition=328, ComBitSize=1, ComSignalType=BOOLEAN, ComHandleId=1748, ComSystemTemplateSystemSignalRef=DET_BI_STATIC_FLAG_083_Rx
            DET_ELEVATION_ERR_081_Rx_oRDR_FUSION_DET_081_084_oPCAN_RADAR_70656774_Rx: ComBitPosition=80, ComBitSize=6, ComSignalType=UINT8, ComHandleId=1762, ComSystemTemplateSystemSignalRef=DET_ELEVATION_ERR_081_Rx
            DET_CONFD_AZIMUTH_083_Rx_oRDR_FUSION_DET_081_084_oPCAN_RADAR_27560b1a_Rx: ComBitPosition=342, ComBitSize=2, ComSignalType=UINT8, ComHandleId=1752, ComSystemTemplateSystemSignalRef=DET_CONFD_AZIMUTH_083_Rx
            DET_RANGE_082_Rx_oRDR_FUSION_DET_081_084_oPCAN_RADAR_69997b88_Rx: ComBitPosition=136, ComBitSize=15, ComSignalType=UINT16, ComHandleId=1790, ComSystemTemplateSystemSignalRef=DET_RANGE_082_Rx
      RDR_FUSION_DET_097_100_oPCAN_RADAR_f5ebb32e_Rx (ComIPdu):
        ComIPduDirection = RECEIVE
        ComIPduType = NORMAL
        ComIPduCancellationSupport = false
        ComIPduHandleId = 46
        ComIPduSignalProcessing = DEFERRED
        ComIPduChannelRef = CN_PCAN_RADAR_458ff0f1
        ComIPduGroupRef = RDR01_oPCAN_RADAR_Rx_e0e717e1 if post-build-variant-condition{matching-criterion=RDR_POS, value=0}
        ComIPduSignalGroupRef = SG_Fusion_Detections_097_100_oRDR_FUSION_DET_097_100_oPCAN_RADAR_f997174e_Rx
        ComPduIdRef = RDR_FUSION_DET_097_100_oPCAN_RADAR_f5ebb32e_Rx
        ComIPduMainFunctionRef = ComMainFunctionRx
        ComIPduGroupRef = RDR02_oPCAN_RADAR_Rx_c92fa313 if post-build-variant-condition{matching-criterion=RDR_POS, value=1}
        ComIPduGroupRef = RDR03_oPCAN_RADAR_Rx_67473282 if post-build-variant-condition{matching-criterion=RDR_POS, value=2}
        ComIPduGroupRef = RDR04_oPCAN_RADAR_Rx_9abecaf7 if post-build-variant-condition{matching-criterion=RDR_POS, value=3}
        ComIPduGroupRef = RDR05_oPCAN_RADAR_Rx_34d65b66 if post-build-variant-condition{matching-criterion=RDR_POS, value=4}
        ComIPduGroupRef = RDR06_oPCAN_RADAR_Rx_1d1eef94 if post-build-variant-condition{matching-criterion=RDR_POS, value=5}
        ComIPduGroupRef = RDR07_oPCAN_RADAR_Rx_b3767e05 if post-build-variant-condition{matching-criterion=RDR_POS, value=6}
        ComIPduGroupRef = RDR08_oPCAN_RADAR_Rx_3d9c193f if post-build-variant-condition{matching-criterion=RDR_POS, value=7}
      5 x ComSignalGroup, all with ComTransferProperty=PENDING, ComSignalGroupAccess=ACCESS_NEEDED_BY_SWC_OR_COM:
        SG_Fusion_Detections_001_004_oRDR_FUSION_DET_001_004_oPCAN_RADAR_4a788d9f_Rx: ComTimeout=0, ComHandleId=8, ComSystemTemplateSignalGroupRef=SG_Fusion_Detections_001_004
          83 x ComGroupSignal, all with ComSignalEndianness=LITTLE_ENDIAN, ComSignalInitValue=0, ComSignalAccess=ACCESS_NEEDED_BY_SWC_OR_COM:
            DET_RCS_003_Rx_oRDR_FUSION_DET_001_004_oPCAN_RADAR_df93d41c_Rx: ComBitPosition=352, ComBitSize=8, ComSignalType=UINT8, ComHandleId=147, ComSystemTemplateSystemSignalRef=DET_RCS_003_Rx
            DET_BELOW_RAIN_THOLD_002_Rx_oRDR_FUSION_DET_001_004_oPCAN_RADAR_1595f42c_Rx: ComBitPosition=151, ComBitSize=1, ComSignalType=BOOLEAN, ComHandleId=83, ComSystemTemplateSystemSignalRef=DET_BELOW_RAIN_THOLD_002_Rx
            DET_AZIMUTH_001_Rx_oRDR_FUSION_DET_001_004_oPCAN_RADAR_5993bb11_Rx: ComBitPosition=88, ComBitSize=13, ComSignalType=UINT16, ComHandleId=74, ComSystemTemplateSystemSignalRef=DET_AZIMUTH_001_Rx
            DET_SNR_004_Rx_oRDR_FUSION_DET_001_004_oPCAN_RADAR_2cf456a2_Rx: ComBitPosition=456, ComBitSize=8, ComSignalType=UINT8, ComHandleId=152, ComSystemTemplateSystemSignalRef=DET_SNR_004_Rx
            DET_ELEVATION_ERR_003_Rx_oRDR_FUSION_DET_001_004_oPCAN_RADAR_fced698d_Rx: ComBitPosition=304, ComBitSize=6, ComSignalType=UINT8, ComHandleId=104, ComSystemTemplateSystemSignalRef=DET_ELEVATION_ERR_003_Rx
            DET_PROB_1STAZHYPO_003_Rx_oRDR_FUSION_DET_001_004_oPCAN_RADAR_94102dee_Rx: ComBitPosition=327, ComBitSize=1, ComSignalType=BOOLEAN, ComHandleId=127, ComSystemTemplateSystemSignalRef=DET_PROB_1STAZHYPO_003_Rx
            DET_CONFD_ELEVATION_004_Rx_oRDR_FUSION_DET_001_004_oPCAN_RADAR_de3a57fc_Rx: ComBitPosition=437, ComBitSize=2, ComSignalType=UINT8, ComHandleId=97, ComSystemTemplateSystemSignalRef=DET_CONFD_ELEVATION_004_Rx
            DET_PROB_1STAZHYPO_002_Rx_oRDR_FUSION_DET_001_004_oPCAN_RADAR_3b54bfa9_Rx: ComBitPosition=215, ComBitSize=1, ComSignalType=BOOLEAN, ComHandleId=126, ComSystemTemplateSystemSignalRef=DET_PROB_1STAZHYPO_002_Rx
            DET_AZIMUTH_002_Rx_oRDR_FUSION_DET_001_004_oPCAN_RADAR_732f0b99_Rx: ComBitPosition=200, ComBitSize=13, ComSignalType=UINT16, ComHandleId=75, ComSystemTemplateSystemSignalRef=DET_AZIMUTH_002_Rx
            DET_MTD_002_Rx_oRDR_FUSION_DET_001_004_oPCAN_RADAR_f12da128_Rx: ComBitPosition=159, ComBitSize=1, ComSignalType=BOOLEAN, ComHandleId=122, ComSystemTemplateSystemSignalRef=DET_MTD_002_Rx
            DET_ELEVATION_ERR_002_Rx_oRDR_FUSION_DET_001_004_oPCAN_RADAR_53a9fbca_Rx: ComBitPosition=192, ComBitSize=6, ComSignalType=UINT8, ComHandleId=103, ComSystemTemplateSystemSignalRef=DET_ELEVATION_ERR_002_Rx
            DET_BI_STATIC_FLAG_004_Rx_oRDR_FUSION_DET_001_004_oPCAN_RADAR_37723e2f_Rx: ComBitPosition=440, ComBitSize=1, ComSignalType=BOOLEAN, ComHandleId=89, ComSystemTemplateSystemSignalRef=DET_BI_STATIC_FLAG_004_Rx
            DET_AZIMUTH_004_Rx_oRDR_FUSION_DET_001_004_oPCAN_RADAR_26566a89_Rx: ComBitPosition=424, ComBitSize=13, ComSignalType=UINT16, ComHandleId=77, ComSystemTemplateSystemSignalRef=DET_AZIMUTH_004_Rx
            DET_SNR_001_Rx_oRDR_FUSION_DET_001_004_oPCAN_RADAR_5331873a_Rx: ComBitPosition=120, ComBitSize=8, ComSignalType=UINT8, ComHandleId=149, ComSystemTemplateSystemSignalRef=DET_SNR_001_Rx
            DET_AZIMUTH_003_Rx_oRDR_FUSION_DET_001_004_oPCAN_RADAR_dc6b99de_Rx: ComBitPosition=312, ComBitSize=13, ComSignalType=UINT16, ComHandleId=76, ComSystemTemplateSystemSignalRef=DET_AZIMUTH_003_Rx
            DET_CONFD_ELEVATION_002_Rx_oRDR_FUSION_DET_001_004_oPCAN_RADAR_8b4336ec_Rx: ComBitPosition=213, ComBitSize=2, ComSignalType=UINT8, ComHandleId=95, ComSystemTemplateSystemSignalRef=DET_CONFD_ELEVATION_002_Rx
            DET_AZIMUTH_ERR_001_Rx_oRDR_FUSION_DET_001_004_oPCAN_RADAR_5bfa1a93_Rx: ComBitPosition=105, ComBitSize=7, ComSignalType=UINT8, ComHandleId=78, ComSystemTemplateSystemSignalRef=DET_AZIMUTH_ERR_001_Rx
            DET_CONFD_ELEVATION_003_Rx_oRDR_FUSION_DET_001_004_oPCAN_RADAR_2407a4ab_Rx: ComBitPosition=325, ComBitSize=2, ComSignalType=UINT8, ComHandleId=96, ComSystemTemplateSystemSignalRef=DET_CONFD_ELEVATION_003_Rx
            DET_ELEVATION_001_Rx_oRDR_FUSION_DET_001_004_oPCAN_RADAR_abac699d_Rx: ComBitPosition=72, ComBitSize=8, ComSignalType=UINT8, ComHandleId=98, ComSystemTemplateSystemSignalRef=DET_ELEVATION_001_Rx
            DET_BI_STATIC_FLAG_002_Rx_oRDR_FUSION_DET_001_004_oPCAN_RADAR_620b5f3f_Rx: ComBitPosition=216, ComBitSize=1, ComSignalType=BOOLEAN, ComHandleId=87, ComSystemTemplateSystemSignalRef=DET_BI_STATIC_FLAG_002_Rx
            DET_EXISTENCE_PROB_001_Rx_oRDR_FUSION_DET_001_004_oPCAN_RADAR_8e0d33d7_Rx: ComBitPosition=112, ComBitSize=6, ComSignalType=UINT8, ComHandleId=106, ComSystemTemplateSystemSignalRef=DET_EXISTENCE_PROB_001_Rx
            DET_RCS_001_Rx_oRDR_FUSION_DET_001_004_oPCAN_RADAR_5a6bf6d3_Rx: ComBitPosition=128, ComBitSize=8, ComSignalType=UINT8, ComHandleId=145, ComSystemTemplateSystemSignalRef=DET_RCS_001_Rx
            DET_PROB_1STAZHYPO_001_Rx_oRDR_FUSION_DET_001_004_oPCAN_RADAR_11e80f21_Rx: ComBitPosition=103, ComBitSize=1, ComSignalType=BOOLEAN, ComHandleId=125, ComSystemTemplateSystemSignalRef=DET_PROB_1STAZHYPO_001_Rx
            DET_MH_CYCLE_COUNTER_001_004_Rx_oRDR_FUSION_DET_001_004_oPCAN_RADAR_722bea44_Rx: ComBitPosition=16, ComBitSize=8, ComSignalType=UINT8, ComHandleId=119, ComSystemTemplateSystemSignalRef=DET_MH_CYCLE_COUNTER_001_004_Rx
            DET_RANGE_ERR_001_Rx_oRDR_FUSION_DET_001_004_oPCAN_RADAR_1aa76bd6_Rx: ComBitPosition=40, ComBitSize=7, ComSignalType=UINT8, ComHandleId=133, ComSystemTemplateSystemSignalRef=DET_RANGE_ERR_001_Rx
            DET_MTD_001_Rx_oRDR_FUSION_DET_001_004_oPCAN_RADAR_db9111a0_Rx: ComBitPosition=47, ComBitSize=1, ComSignalType=BOOLEAN, ComHandleId=121, ComSystemTemplateSystemSignalRef=DET_MTD_001_Rx
            DET_RANGE_VELOCITY_002_Rx_oRDR_FUSION_DET_001_004_oPCAN_RADAR_bd1cd440_Rx: ComBitPosition=160, ComBitSize=15, ComSignalType=UINT16, ComHandleId=138, ComSystemTemplateSystemSignalRef=DET_RANGE_VELOCITY_002_Rx
            DET_SUPER_RES_TARGET_001_Rx_oRDR_FUSION_DET_001_004_oPCAN_RADAR_98caa63a_Rx: ComBitPosition=87, ComBitSize=1, ComSignalType=BOOLEAN, ComHandleId=153, ComSystemTemplateSystemSignalRef=DET_SUPER_RES_TARGET_001_Rx
            DET_BELOW_RAIN_THOLD_004_Rx_oRDR_FUSION_DET_001_004_oPCAN_RADAR_40ec953c_Rx: ComBitPosition=375, ComBitSize=1, ComSignalType=BOOLEAN, ComHandleId=85, ComSystemTemplateSystemSignalRef=DET_BELOW_RAIN_THOLD_004_Rx
            DET_RANGE_001_Rx_oRDR_FUSION_DET_001_004_oPCAN_RADAR_4a55e736_Rx: ComBitPosition=24, ComBitSize=15, ComSignalType=UINT16, ComHandleId=129, ComSystemTemplateSystemSignalRef=DET_RANGE_001_Rx
            DET_BI_STATIC_FLAG_003_Rx_oRDR_FUSION_DET_001_004_oPCAN_RADAR_cd4fcd78_Rx: ComBitPosition=328, ComBitSize=1, ComSignalType=BOOLEAN, ComHandleId=88, ComSystemTemplateSystemSignalRef=DET_BI_STATIC_FLAG_003_Rx
            DET_SUPER_RES_TARGET_002_Rx_oRDR_FUSION_DET_001_004_oPCAN_RADAR_b27616b2_Rx: ComBitPosition=199, ComBitSize=1, ComSignalType=BOOLEAN, ComHandleId=154, ComSystemTemplateSystemSignalRef=DET_SUPER_RES_TARGET_002_Rx
            DET_ELEVATION_002_Rx_oRDR_FUSION_DET_001_004_oPCAN_RADAR_8110d915_Rx: ComBitPosition=184, ComBitSize=8, ComSignalType=UINT8, ComHandleId=99, ComSystemTemplateSystemSignalRef=DET_ELEVATION_002_Rx
            DET_MTD_003_Rx_oRDR_FUSION_DET_001_004_oPCAN_RADAR_5e69336f_Rx: ComBitPosition=271, ComBitSize=1, ComSignalType=BOOLEAN, ComHandleId=123, ComSystemTemplateSystemSignalRef=DET_MTD_003_Rx
            DET_RANGE_ERR_003_Rx_oRDR_FUSION_DET_001_004_oPCAN_RADAR_9f5f4919_Rx: ComBitPosition=264, ComBitSize=7, ComSignalType=UINT8, ComHandleId=135, ComSystemTemplateSystemSignalRef=DET_RANGE_ERR_003_Rx
            DET_MH_CRC16_001_004_Rx_oRDR_FUSION_DET_001_004_oPCAN_RADAR_7ff0d781_Rx: ComBitPosition=0, ComBitSize=16, ComSignalType=UINT16, ComHandleId=118, ComSystemTemplateSystemSignalRef=DET_MH_CRC16_001_004_Rx
            DET_ELEVATION_ERR_001_Rx_oRDR_FUSION_DET_001_004_oPCAN_RADAR_79154b42_Rx: ComBitPosition=80, ComBitSize=6, ComSignalType=UINT8, ComHandleId=102, ComSystemTemplateSystemSignalRef=DET_ELEVATION_ERR_001_Rx
            DET_EXISTENCE_PROB_003_Rx_oRDR_FUSION_DET_001_004_oPCAN_RADAR_0bf51118_Rx: ComBitPosition=336, ComBitSize=6, ComSignalType=UINT8, ComHandleId=108, ComSystemTemplateSystemSignalRef=DET_EXISTENCE_PROB_003_Rx
            DET_BELOW_RAIN_THOLD_001_Rx_oRDR_FUSION_DET_001_004_oPCAN_RADAR_3f2944a4_Rx: ComBitPosition=39, ComBitSize=1, ComSignalType=BOOLEAN, ComHandleId=82, ComSystemTemplateSystemSignalRef=DET_BELOW_RAIN_THOLD_001_Rx
            DET_BI_STATIC_FLAG_001_Rx_oRDR_FUSION_DET_001_004_oPCAN_RADAR_48b7efb7_Rx: ComBitPosition=104, ComBitSize=1, ComSignalType=BOOLEAN, ComHandleId=86, ComSystemTemplateSystemSignalRef=DET_BI_STATIC_FLAG_001_Rx
            DET_CONFD_ELEVATION_001_Rx_oRDR_FUSION_DET_001_004_oPCAN_RADAR_a1ff8664_Rx: ComBitPosition=101, ComBitSize=2, ComSignalType=UINT8, ComHandleId=94, ComSystemTemplateSystemSignalRef=DET_CONFD_ELEVATION_001_Rx
            DET_SUPER_RES_TARGET_003_Rx_oRDR_FUSION_DET_001_004_oPCAN_RADAR_1d3284f5_Rx: ComBitPosition=311, ComBitSize=1, ComSignalType=BOOLEAN, ComHandleId=155, ComSystemTemplateSystemSignalRef=DET_SUPER_RES_TARGET_003_Rx
            DET_RANGE_004_Rx_oRDR_FUSION_DET_001_004_oPCAN_RADAR_359036ae_Rx: ComBitPosition=360, ComBitSize=15, ComSignalType=UINT16, ComHandleId=132, ComSystemTemplateSystemSignalRef=DET_RANGE_004_Rx
            DET_AZIMUTH_ERR_004_Rx_oRDR_FUSION_DET_001_004_oPCAN_RADAR_243fcb0b_Rx: ComBitPosition=441, ComBitSize=7, ComSignalType=UINT8, ComHandleId=81, ComSystemTemplateSystemSignalRef=DET_AZIMUTH_ERR_004_Rx
            DET_BELOW_RAIN_THOLD_003_Rx_oRDR_FUSION_DET_001_004_oPCAN_RADAR_bad1666b_Rx: ComBitPosition=263, ComBitSize=1, ComSignalType=BOOLEAN, ComHandleId=84, ComSystemTemplateSystemSignalRef=DET_BELOW_RAIN_THOLD_003_Rx
            DET_HVC_FLAG_004_Rx_oRDR_FUSION_DET_001_004_oPCAN_RADAR_2c160f00_Rx: ComBitPosition=422, ComBitSize=1, ComSignalType=BOOLEAN, ComHandleId=113, ComSystemTemplateSystemSignalRef=DET_HVC_FLAG_004_Rx
            DET_IDM_001_Rx_oRDR_FUSION_DET_001_004_oPCAN_RADAR_661227d0_Rx: ComBitPosition=63, ComBitSize=1, ComSignalType=BOOLEAN, ComHandleId=114, ComSystemTemplateSystemSignalRef=DET_IDM_001_Rx
            DET_IDM_004_Rx_oRDR_FUSION_DET_001_004_oPCAN_RADAR_19d7f648_Rx: ComBitPosition=399, ComBitSize=1, ComSignalType=BOOLEAN, ComHandleId=117, ComSystemTemplateSystemSignalRef=DET_IDM_004_Rx
            DET_SNR_002_Rx_oRDR_FUSION_DET_001_004_oPCAN_RADAR_798d37b2_Rx: ComBitPosition=232, ComBitSize=8, ComSignalType=UINT8, ComHandleId=150, ComSystemTemplateSystemSignalRef=DET_SNR_002_Rx
            DET_CONFD_AZIMUTH_001_Rx_oRDR_FUSION_DET_001_004_oPCAN_RADAR_abde05e3_Rx: ComBitPosition=118, ComBitSize=2, ComSignalType=UINT8, ComHandleId=90, ComSystemTemplateSystemSignalRef=DET_CONFD_AZIMUTH_001_Rx
            DET_HVC_FLAG_003_Rx_oRDR_FUSION_DET_001_004_oPCAN_RADAR_d62bfc57_Rx: ComBitPosition=310, ComBitSize=1, ComSignalType=BOOLEAN, ComHandleId=112, ComSystemTemplateSystemSignalRef=DET_HVC_FLAG_003_Rx
            DET_MH_SCAN_INDEX_4LSB_001_004_Rx_oRDR_FUSION_DET_001_004_oPCAN_RADAR_169b257f_Rx: ComBitPosition=476, ComBitSize=4, ComSignalType=UINT8, ComHandleId=120, ComSystemTemplateSystemSignalRef=DET_MH_SCAN_INDEX_4LSB_001_004_Rx
            DET_HVC_FLAG_001_Rx_oRDR_FUSION_DET_001_004_oPCAN_RADAR_53d3de98_Rx: ComBitPosition=86, ComBitSize=1, ComSignalType=BOOLEAN, ComHandleId=110, ComSystemTemplateSystemSignalRef=DET_HVC_FLAG_001_Rx
            DET_RANGE_VELOCITY_ERR_003_Rx_oRDR_FUSION_DET_001_004_oPCAN_RADAR_8b3c36c5_Rx: ComBitPosition=288, ComBitSize=8, ComSignalType=UINT8, ComHandleId=143, ComSystemTemplateSystemSignalRef=DET_RANGE_VELOCITY_ERR_003_Rx
            DET_AZIMUTH_ERR_002_Rx_oRDR_FUSION_DET_001_004_oPCAN_RADAR_7146aa1b_Rx: ComBitPosition=217, ComBitSize=7, ComSignalType=UINT8, ComHandleId=79, ComSystemTemplateSystemSignalRef=DET_AZIMUTH_ERR_002_Rx
            DET_CONFD_AZIMUTH_004_Rx_oRDR_FUSION_DET_001_004_oPCAN_RADAR_d41bd47b_Rx: ComBitPosition=454, ComBitSize=2, ComSignalType=UINT8, ComHandleId=93, ComSystemTemplateSystemSignalRef=DET_CONFD_AZIMUTH_004_Rx
            DET_PROB_1STAZHYPO_004_Rx_oRDR_FUSION_DET_001_004_oPCAN_RADAR_6e2ddeb9_Rx: ComBitPosition=439, ComBitSize=1, ComSignalType=BOOLEAN, ComHandleId=128, ComSystemTemplateSystemSignalRef=DET_PROB_1STAZHYPO_004_Rx
            DET_RANGE_VELOCITY_004_Rx_oRDR_FUSION_DET_001_004_oPCAN_RADAR_e865b550_Rx: ComBitPosition=384, ComBitSize=15, ComSignalType=UINT16, ComHandleId=140, ComSystemTemplateSystemSignalRef=DET_RANGE_VELOCITY_004_Rx
            DET_RANGE_003_Rx_oRDR_FUSION_DET_001_004_oPCAN_RADAR_cfadc5f9_Rx: ComBitPosition=248, ComBitSize=15, ComSignalType=UINT16, ComHandleId=131, ComSystemTemplateSystemSignalRef=DET_RANGE_003_Rx
            DET_EXISTENCE_PROB_002_Rx_oRDR_FUSION_DET_001_004_oPCAN_RADAR_a4b1835f_Rx: ComBitPosition=224, ComBitSize=6, ComSignalType=UINT8, ComHandleId=107, ComSystemTemplateSystemSignalRef=DET_EXISTENCE_PROB_002_Rx
            DET_RANGE_VELOCITY_003_Rx_oRDR_FUSION_DET_001_004_oPCAN_RADAR_12584607_Rx: ComBitPosition=272, ComBitSize=15, ComSignalType=UINT16, ComHandleId=139, ComSystemTemplateSystemSignalRef=DET_RANGE_VELOCITY_003_Rx
            DET_RANGE_VELOCITY_001_Rx_oRDR_FUSION_DET_001_004_oPCAN_RADAR_97a064c8_Rx: ComBitPosition=48, ComBitSize=15, ComSignalType=UINT16, ComHandleId=137, ComSystemTemplateSystemSignalRef=DET_RANGE_VELOCITY_001_Rx
            DET_RANGE_ERR_002_Rx_oRDR_FUSION_DET_001_004_oPCAN_RADAR_301bdb5e_Rx: ComBitPosition=152, ComBitSize=7, ComSignalType=UINT8, ComHandleId=134, ComSystemTemplateSystemSignalRef=DET_RANGE_ERR_002_Rx
            DET_ELEVATION_003_Rx_oRDR_FUSION_DET_001_004_oPCAN_RADAR_2e544b52_Rx: ComBitPosition=296, ComBitSize=8, ComSignalType=UINT8, ComHandleId=100, ComSystemTemplateSystemSignalRef=DET_ELEVATION_003_Rx
            DET_ELEVATION_004_Rx_oRDR_FUSION_DET_001_004_oPCAN_RADAR_d469b805_Rx: ComBitPosition=408, ComBitSize=8, ComSignalType=UINT8, ComHandleId=101, ComSystemTemplateSystemSignalRef=DET_ELEVATION_004_Rx
            DET_RCS_004_Rx_oRDR_FUSION_DET_001_004_oPCAN_RADAR_25ae274b_Rx: ComBitPosition=464, ComBitSize=8, ComSignalType=UINT8, ComHandleId=148, ComSystemTemplateSystemSignalRef=DET_RCS_004_Rx
            DET_IDM_002_Rx_oRDR_FUSION_DET_001_004_oPCAN_RADAR_4cae9758_Rx: ComBitPosition=175, ComBitSize=1, ComSignalType=BOOLEAN, ComHandleId=115, ComSystemTemplateSystemSignalRef=DET_IDM_002_Rx
            DET_RANGE_002_Rx_oRDR_FUSION_DET_001_004_oPCAN_RADAR_60e957be_Rx: ComBitPosition=136, ComBitSize=15, ComSignalType=UINT16, ComHandleId=130, ComSystemTemplateSystemSignalRef=DET_RANGE_002_Rx
            DET_RANGE_VELOCITY_ERR_001_Rx_oRDR_FUSION_DET_001_004_oPCAN_RADAR_0ec4140a_Rx: ComBitPosition=64, ComBitSize=8, ComSignalType=UINT8, ComHandleId=141, ComSystemTemplateSystemSignalRef=DET_RANGE_VELOCITY_ERR_001_Rx
            DET_IDM_003_Rx_oRDR_FUSION_DET_001_004_oPCAN_RADAR_e3ea051f_Rx: ComBitPosition=287, ComBitSize=1, ComSignalType=BOOLEAN, ComHandleId=116, ComSystemTemplateSystemSignalRef=DET_IDM_003_Rx
            DET_RANGE_ERR_004_Rx_oRDR_FUSION_DET_001_004_oPCAN_RADAR_6562ba4e_Rx: ComBitPosition=376, ComBitSize=7, ComSignalType=UINT8, ComHandleId=136, ComSystemTemplateSystemSignalRef=DET_RANGE_ERR_004_Rx
            DET_MTD_004_Rx_oRDR_FUSION_DET_001_004_oPCAN_RADAR_a454c038_Rx: ComBitPosition=383, ComBitSize=1, ComSignalType=BOOLEAN, ComHandleId=124, ComSystemTemplateSystemSignalRef=DET_MTD_004_Rx
            DET_CONFD_AZIMUTH_002_Rx_oRDR_FUSION_DET_001_004_oPCAN_RADAR_8162b56b_Rx: ComBitPosition=230, ComBitSize=2, ComSignalType=UINT8, ComHandleId=91, ComSystemTemplateSystemSignalRef=DET_CONFD_AZIMUTH_002_Rx
            DET_EXISTENCE_PROB_004_Rx_oRDR_FUSION_DET_001_004_oPCAN_RADAR_f1c8e24f_Rx: ComBitPosition=448, ComBitSize=6, ComSignalType=UINT8, ComHandleId=109, ComSystemTemplateSystemSignalRef=DET_EXISTENCE_PROB_004_Rx
            DET_HVC_FLAG_002_Rx_oRDR_FUSION_DET_001_004_oPCAN_RADAR_796f6e10_Rx: ComBitPosition=198, ComBitSize=1, ComSignalType=BOOLEAN, ComHandleId=111, ComSystemTemplateSystemSignalRef=DET_HVC_FLAG_002_Rx
            DET_RCS_002_Rx_oRDR_FUSION_DET_001_004_oPCAN_RADAR_70d7465b_Rx: ComBitPosition=240, ComBitSize=8, ComSignalType=UINT8, ComHandleId=146, ComSystemTemplateSystemSignalRef=DET_RCS_002_Rx
            DET_AZIMUTH_ERR_003_Rx_oRDR_FUSION_DET_001_004_oPCAN_RADAR_de02385c_Rx: ComBitPosition=329, ComBitSize=7, ComSignalType=UINT8, ComHandleId=80, ComSystemTemplateSystemSignalRef=DET_AZIMUTH_ERR_003_Rx
            DET_SUPER_RES_TARGET_004_Rx_oRDR_FUSION_DET_001_004_oPCAN_RADAR_e70f77a2_Rx: ComBitPosition=423, ComBitSize=1, ComSignalType=BOOLEAN, ComHandleId=156, ComSystemTemplateSystemSignalRef=DET_SUPER_RES_TARGET_004_Rx
            DET_CONFD_AZIMUTH_003_Rx_oRDR_FUSION_DET_001_004_oPCAN_RADAR_2e26272c_Rx: ComBitPosition=342, ComBitSize=2, ComSignalType=UINT8, ComHandleId=92, ComSystemTemplateSystemSignalRef=DET_CONFD_AZIMUTH_003_Rx
            DET_ELEVATION_ERR_004_Rx_oRDR_FUSION_DET_001_004_oPCAN_RADAR_06d09ada_Rx: ComBitPosition=416, ComBitSize=6, ComSignalType=UINT8, ComHandleId=105, ComSystemTemplateSystemSignalRef=DET_ELEVATION_ERR_004_Rx
            DET_RANGE_VELOCITY_ERR_002_Rx_oRDR_FUSION_DET_001_004_oPCAN_RADAR_2478a482_Rx: ComBitPosition=176, ComBitSize=8, ComSignalType=UINT8, ComHandleId=142, ComSystemTemplateSystemSignalRef=DET_RANGE_VELOCITY_ERR_002_Rx
            DET_RANGE_VELOCITY_ERR_004_Rx_oRDR_FUSION_DET_001_004_oPCAN_RADAR_7101c592_Rx: ComBitPosition=400, ComBitSize=8, ComSignalType=UINT8, ComHandleId=144, ComSystemTemplateSystemSignalRef=DET_RANGE_VELOCITY_ERR_004_Rx
            DET_SNR_003_Rx_oRDR_FUSION_DET_001_004_oPCAN_RADAR_d6c9a5f5_Rx: ComBitPosition=344, ComBitSize=8, ComSignalType=UINT8, ComHandleId=151, ComSystemTemplateSystemSignalRef=DET_SNR_003_Rx
        SG_Fusion_RadarHeader_oRDR_FUSION_HEADER_001_oPCAN_RADAR_cad756d0_Rx: ComSignalGroupArrayAccess=true, ComTimeout=0.05, ComHandleId=41, ComFirstTimeout=0.5, ComTimeoutNotification=ComTimeoutNotification_SG_Fusion_RadarHeader_oRDR_FUSION_HEADER_001_oPCAN_RADAR_cad756d0_Rx, ComNotification=ComNotification_SG_Fusion_RadarHeader_oRDR_FUSION_HEADER_001_oPCAN_RADAR_cad756d0_Rx, ComSystemTemplateSignalGroupRef=SG_Fusion_RadarHeader
          36 x ComGroupSignal, all with ComSignalAccess=ACCESS_NEEDED_BY_SWC_OR_COM:
            HED_SENSOR_TIME_STAMP_SEC_Rx_oRDR_FUSION_HEADER_001_oPCAN_RADAR_282ee70b_Rx: ComBitPosition=256, ComBitSize=32, ComSignalEndianness=LITTLE_ENDIAN, ComSignalInitValue=0, ComSignalType=UINT32, ComHandleId=2791, ComSystemTemplateSystemSignalRef=HED_SENSOR_TIME_STAMP_SEC_Rx
            HED_DET_SPEED_RANGE_MAX_Rx_oRDR_FUSION_HEADER_001_oPCAN_RADAR_b7cc12b5_Rx: ComBitPosition=96, ComBitSize=16, ComSignalEndianness=LITTLE_ENDIAN, ComSignalInitValue=0, ComSignalType=UINT16, ComHandleId=2770, ComSystemTemplateSystemSignalRef=HED_DET_SPEED_RANGE_MAX_Rx
            HED_OPERATION_MODE_Rx_oRDR_FUSION_HEADER_001_oPCAN_RADAR_de864358_Rx: ComBitPosition=315, ComBitSize=3, ComSignalEndianness=LITTLE_ENDIAN, ComSignalInitValue=0, ComSignalType=UINT8, ComHandleId=2783, ComSystemTemplateSystemSignalRef=HED_OPERATION_MODE_Rx
            HED_MAX_NUM_OF_DETECTIONS_Rx_oRDR_FUSION_HEADER_001_oPCAN_RADAR_084cd53e_Rx: ComBitPosition=352, ComBitSize=9, ComSignalEndianness=LITTLE_ENDIAN, ComSignalInitValue=0, ComSignalType=UINT16, ComHandleId=2778, ComSystemTemplateSystemSignalRef=HED_MAX_NUM_OF_DETECTIONS_Rx
            HED_LOOK_INDEX_Rx_oRDR_FUSION_HEADER_001_oPCAN_RADAR_2bf2972b_Rx: ComBitPosition=208, ComBitSize=16, ComSignalEndianness=LITTLE_ENDIAN, ComSignalInitValue=0, ComSignalType=UINT16, ComHandleId=2777, ComSystemTemplateSystemSignalRef=HED_LOOK_INDEX_Rx
            HED_DET_BI_STATIC_COUNT_Rx_oRDR_FUSION_HEADER_001_oPCAN_RADAR_29976834_Rx: ComBitPosition=288, ComBitSize=8, ComSignalEndianness=LITTLE_ENDIAN, ComSignalInitValue=0, ComSignalType=UINT8, ComHandleId=2765, ComSystemTemplateSystemSignalRef=HED_DET_BI_STATIC_COUNT_Rx
            HED_FOV_HOR_MAX_Rx_oRDR_FUSION_HEADER_001_oPCAN_RADAR_4b891441_Rx: ComBitPosition=136, ComBitSize=8, ComSignalEndianness=LITTLE_ENDIAN, ComSignalInitValue=0, ComSignalType=UINT8, ComHandleId=2772, ComSystemTemplateSystemSignalRef=HED_FOV_HOR_MAX_Rx
            HED_SCAN_INDEX_Rx_oRDR_FUSION_HEADER_001_oPCAN_RADAR_906dc02d_Rx: ComBitPosition=48, ComBitSize=16, ComSignalEndianness=LITTLE_ENDIAN, ComSignalInitValue=0, ComSignalType=UINT16, ComHandleId=2789, ComSystemTemplateSystemSignalRef=HED_SCAN_INDEX_Rx
            HED_V_WRAPPING_Rx_oRDR_FUSION_HEADER_001_oPCAN_RADAR_854af1a6_Rx: ComBitPosition=197, ComBitSize=11, ComSignalEndianness=LITTLE_ENDIAN, ComSignalInitValue=0, ComSignalType=UINT16, ComHandleId=2796, ComSystemTemplateSystemSignalRef=HED_V_WRAPPING_Rx
            HED_RDR_HEADER_FV_Rx_oRDR_FUSION_HEADER_001_oPCAN_RADAR_b8f721a0_Rx: ComBitPosition=416, ComSignalEndianness=opaque, ComSignalInitValue=0 0 0 0 0 0 0, ComSignalLength=7, ComSignalType=UINT8_N, ComHandleId=2786, ComSystemTemplateSystemSignalRef=HED_RDR_HEADER_FV_Rx
            HED_TRIGGER_TIME_Rx_oRDR_FUSION_HEADER_001_oPCAN_RADAR_554e6103_Rx: ComBitPosition=320, ComBitSize=32, ComSignalEndianness=LITTLE_ENDIAN, ComSignalInitValue=0, ComSignalType=UINT32, ComHandleId=2795, ComSystemTemplateSystemSignalRef=HED_TRIGGER_TIME_Rx
            HED_DET_NUM_OF_1PASS_Rx_oRDR_FUSION_HEADER_001_oPCAN_RADAR_5e84b070_Rx: ComBitPosition=296, ComBitSize=10, ComSignalEndianness=LITTLE_ENDIAN, ComSignalInitValue=0, ComSignalType=UINT16, ComHandleId=2766, ComSystemTemplateSystemSignalRef=HED_DET_NUM_OF_1PASS_Rx
            HED_PROCESSED_RANGE_Rx_oRDR_FUSION_HEADER_001_oPCAN_RADAR_2cda03f8_Rx: ComBitPosition=160, ComBitSize=9, ComSignalEndianness=LITTLE_ENDIAN, ComSignalInitValue=0, ComSignalType=UINT16, ComHandleId=2784, ComSystemTemplateSystemSignalRef=HED_PROCESSED_RANGE_Rx
            HED_TIME_SYNC_SRC_MASTER_Rx_oRDR_FUSION_HEADER_001_oPCAN_RADAR_aeef5352_Rx: ComBitPosition=169, ComBitSize=1, ComSignalEndianness=LITTLE_ENDIAN, ComSignalInitValue=0, ComSignalType=BOOLEAN, ComHandleId=2793, ComSystemTemplateSystemSignalRef=HED_TIME_SYNC_SRC_MASTER_Rx
            HED_LOOK_ID_Rx_oRDR_FUSION_HEADER_001_oPCAN_RADAR_1e55b53b_Rx: ComBitPosition=42, ComBitSize=2, ComSignalEndianness=LITTLE_ENDIAN, ComSignalInitValue=0, ComSignalType=UINT8, ComHandleId=2776, ComSystemTemplateSystemSignalRef=HED_LOOK_ID_Rx
            HED_NUM_OF_RESTBINS_USED_Rx_oRDR_FUSION_HEADER_001_oPCAN_RADAR_627cc09c_Rx: ComBitPosition=24, ComBitSize=9, ComSignalEndianness=LITTLE_ENDIAN, ComSignalInitValue=0, ComSignalType=UINT16, ComHandleId=2781, ComSystemTemplateSystemSignalRef=HED_NUM_OF_RESTBINS_USED_Rx
            HED_FOV_HOR_MIN_Rx_oRDR_FUSION_HEADER_001_oPCAN_RADAR_7e0b051f_Rx: ComBitPosition=128, ComBitSize=8, ComSignalEndianness=LITTLE_ENDIAN, ComSignalInitValue=0, ComSignalType=UINT8, ComHandleId=2773, ComSystemTemplateSystemSignalRef=HED_FOV_HOR_MIN_Rx
            HED_SENSOR_TIME_STAMP_NS_Rx_oRDR_FUSION_HEADER_001_oPCAN_RADAR_6308a4c2_Rx: ComBitPosition=224, ComBitSize=32, ComSignalEndianness=LITTLE_ENDIAN, ComSignalInitValue=0, ComSignalType=UINT32, ComHandleId=2790, ComSystemTemplateSystemSignalRef=HED_SENSOR_TIME_STAMP_NS_Rx
            HED_FOV_VER_MIN_Rx_oRDR_FUSION_HEADER_001_oPCAN_RADAR_fad7bf49_Rx: ComBitPosition=144, ComBitSize=8, ComSignalEndianness=LITTLE_ENDIAN, ComSignalInitValue=0, ComSignalType=UINT8, ComHandleId=2775, ComSystemTemplateSystemSignalRef=HED_FOV_VER_MIN_Rx
            HED_DET_NUM_OF_2PASS_Rx_oRDR_FUSION_HEADER_001_oPCAN_RADAR_97b0ab7d_Rx: ComBitPosition=306, ComBitSize=9, ComSignalEndianness=LITTLE_ENDIAN, ComSignalInitValue=0, ComSignalType=UINT16, ComHandleId=2767, ComSystemTemplateSystemSignalRef=HED_DET_NUM_OF_2PASS_Rx
            HED_NUM_OF_VALID_DETECTIONS_Rx_oRDR_FUSION_HEADER_001_oPCAN_RADAR_460781da_Rx: ComBitPosition=33, ComBitSize=9, ComSignalEndianness=LITTLE_ENDIAN, ComSignalInitValue=0, ComSignalType=UINT16, ComHandleId=2782, ComSystemTemplateSystemSignalRef=HED_NUM_OF_VALID_DETECTIONS_Rx
            HED_Auth_CRC32_Rx_oRDR_FUSION_HEADER_001_oPCAN_RADAR_70da9fad_Rx: ComBitPosition=376, ComBitSize=32, ComSignalEndianness=LITTLE_ENDIAN, ComSignalInitValue=0, ComSignalType=UINT32, ComHandleId=2763, ComSystemTemplateSystemSignalRef=HED_Auth_CRC32_Rx
            HED_DET_RANGE_MIN_Rx_oRDR_FUSION_HEADER_001_oPCAN_RADAR_437a84f8_Rx: ComBitPosition=80, ComBitSize=16, ComSignalEndianness=LITTLE_ENDIAN, ComSignalInitValue=0, ComSignalType=UINT16, ComHandleId=2769, ComSystemTemplateSystemSignalRef=HED_DET_RANGE_MIN_Rx
            HED_FOV_VER_MAX_Rx_oRDR_FUSION_HEADER_001_oPCAN_RADAR_cf55ae17_Rx: ComBitPosition=152, ComBitSize=8, ComSignalEndianness=LITTLE_ENDIAN, ComSignalInitValue=0, ComSignalType=UINT8, ComHandleId=2774, ComSystemTemplateSystemSignalRef=HED_FOV_VER_MAX_Rx
            HED_ALIGN_HOR_REF_Rx_oRDR_FUSION_HEADER_001_oPCAN_RADAR_147e49df_Rx: ComBitPosition=184, ComBitSize=13, ComSignalEndianness=LITTLE_ENDIAN, ComSignalInitValue=0, ComSignalType=UINT16, ComHandleId=2761, ComSystemTemplateSystemSignalRef=HED_ALIGN_HOR_REF_Rx
            HED_RDR_HEADER_CMAC_Rx_oRDR_FUSION_HEADER_001_oPCAN_RADAR_64fe3bc9_Rx: ComBitPosition=472, ComSignalEndianness=opaque, ComSignalInitValue=0 0 0 0 0, ComSignalLength=5, ComSignalType=UINT8_N, ComHandleId=2785, ComSystemTemplateSystemSignalRef=HED_RDR_HEADER_CMAC_Rx
            HED_SLOPE_CORR_EXECUTIONFLAG_Rx_oRDR_FUSION_HEADER_001_oPCAN_RADAR_848519d1_Rx: ComBitPosition=172, ComBitSize=2, ComSignalEndianness=LITTLE_ENDIAN, ComSignalInitValue=0, ComSignalType=UINT8, ComHandleId=2792, ComSystemTemplateSystemSignalRef=HED_SLOPE_CORR_EXECUTIONFLAG_Rx
            HED_MH_CRC16_Rx_oRDR_FUSION_HEADER_001_oPCAN_RADAR_73943b50_Rx: ComBitPosition=0, ComBitSize=16, ComSignalEndianness=LITTLE_ENDIAN, ComSignalInitValue=0, ComSignalType=UINT16, ComHandleId=2779, ComSystemTemplateSystemSignalRef=HED_MH_CRC16_Rx
            HED_DATA_QUALIFIER_Rx_oRDR_FUSION_HEADER_001_oPCAN_RADAR_5117e37a_Rx: ComBitPosition=44, ComBitSize=3, ComSignalEndianness=LITTLE_ENDIAN, ComSignalInitValue=0, ComSignalType=UINT8, ComHandleId=2764, ComSystemTemplateSystemSignalRef=HED_DATA_QUALIFIER_Rx
            HED_DET_SPEED_RANGE_MIN_Rx_oRDR_FUSION_HEADER_001_oPCAN_RADAR_824e03eb_Rx: ComBitPosition=112, ComBitSize=16, ComSignalEndianness=LITTLE_ENDIAN, ComSignalInitValue=0, ComSignalType=UINT16, ComHandleId=2771, ComSystemTemplateSystemSignalRef=HED_DET_SPEED_RANGE_MIN_Rx
            HED_R_WRAPPING_Rx_oRDR_FUSION_HEADER_001_oPCAN_RADAR_738d42d6_Rx: ComBitPosition=368, ComBitSize=8, ComSignalEndianness=LITTLE_ENDIAN, ComSignalInitValue=0, ComSignalType=UINT8, ComHandleId=2787, ComSystemTemplateSystemSignalRef=HED_R_WRAPPING_Rx
            HED_ALIGN_VER_REF_Rx_oRDR_FUSION_HEADER_001_oPCAN_RADAR_90a2f389_Rx: ComBitPosition=174, ComBitSize=10, ComSignalEndianness=LITTLE_ENDIAN, ComSignalInitValue=0, ComSignalType=UINT16, ComHandleId=2762, ComSystemTemplateSystemSignalRef=HED_ALIGN_VER_REF_Rx
            HED_MH_CYCLE_COUNTER_Rx_oRDR_FUSION_HEADER_001_oPCAN_RADAR_ea0b66ed_Rx: ComBitPosition=16, ComBitSize=8, ComSignalEndianness=LITTLE_ENDIAN, ComSignalInitValue=0, ComSignalType=UINT8, ComHandleId=2780, ComSystemTemplateSystemSignalRef=HED_MH_CYCLE_COUNTER_Rx
            HED_Rain_Level_Rx_oRDR_FUSION_HEADER_001_oPCAN_RADAR_0b0549b9_Rx: ComBitPosition=318, ComBitSize=2, ComSignalEndianness=LITTLE_ENDIAN, ComSignalInitValue=0, ComSignalType=UINT8, ComHandleId=2788, ComSystemTemplateSystemSignalRef=HED_Rain_Level_Rx
            HED_DET_RANGE_MAX_Rx_oRDR_FUSION_HEADER_001_oPCAN_RADAR_76f895a6_Rx: ComBitPosition=64, ComBitSize=16, ComSignalEndianness=LITTLE_ENDIAN, ComSignalInitValue=0, ComSignalType=UINT16, ComHandleId=2768, ComSystemTemplateSystemSignalRef=HED_DET_RANGE_MAX_Rx
            HED_TIME_SYNC_VALIDITY_FLAG_Rx_oRDR_FUSION_HEADER_001_oPCAN_RADAR_cf6ff64d_Rx: ComBitPosition=170, ComBitSize=2, ComSignalEndianness=LITTLE_ENDIAN, ComSignalInitValue=0, ComSignalType=UINT8, ComHandleId=2794, ComSystemTemplateSystemSignalRef=HED_TIME_SYNC_VALIDITY_FLAG_Rx
        SG_Fusion_Detections_021_024_oRDR_FUSION_DET_021_024_oPCAN_RADAR_f7a0d0a9_Rx: ComTimeout=0, ComHandleId=13, ComSignalGroupArrayAccess=true, ComSystemTemplateSignalGroupRef=SG_Fusion_Detections_021_024
          83 x ComGroupSignal, all with ComSignalEndianness=LITTLE_ENDIAN, ComSignalInitValue=0, ComSignalAccess=ACCESS_NEEDED_BY_SWC_OR_COM:
            DET_PROB_1STAZHYPO_023_Rx_oRDR_FUSION_DET_021_024_oPCAN_RADAR_7bf4a5c3_Rx: ComBitPosition=327, ComBitSize=1, ComSignalType=BOOLEAN, ComHandleId=542, ComSystemTemplateSystemSignalRef=DET_PROB_1STAZHYPO_023_Rx
            DET_MH_CRC16_021_024_Rx_oRDR_FUSION_DET_021_024_oPCAN_RADAR_0c490975_Rx: ComBitPosition=0, ComBitSize=16, ComSignalType=UINT16, ComHandleId=533, ComSystemTemplateSystemSignalRef=DET_MH_CRC16_021_024_Rx
            DET_PROB_1STAZHYPO_022_Rx_oRDR_FUSION_DET_021_024_oPCAN_RADAR_d4b03784_Rx: ComBitPosition=215, ComBitSize=1, ComSignalType=BOOLEAN, ComHandleId=541, ComSystemTemplateSystemSignalRef=DET_PROB_1STAZHYPO_022_Rx
            DET_IDM_023_Rx_oRDR_FUSION_DET_021_024_oPCAN_RADAR_0c0e8d32_Rx: ComBitPosition=287, ComBitSize=1, ComSignalType=BOOLEAN, ComHandleId=531, ComSystemTemplateSystemSignalRef=DET_IDM_023_Rx
            DET_CONFD_AZIMUTH_023_Rx_oRDR_FUSION_DET_021_024_oPCAN_RADAR_c1c2af01_Rx: ComBitPosition=342, ComBitSize=2, ComSignalType=UINT8, ComHandleId=507, ComSystemTemplateSystemSignalRef=DET_CONFD_AZIMUTH_023_Rx
            DET_CONFD_AZIMUTH_021_Rx_oRDR_FUSION_DET_021_024_oPCAN_RADAR_443a8dce_Rx: ComBitPosition=118, ComBitSize=2, ComSignalType=UINT8, ComHandleId=505, ComSystemTemplateSystemSignalRef=DET_CONFD_AZIMUTH_021_Rx
            DET_MH_CYCLE_COUNTER_021_024_Rx_oRDR_FUSION_DET_021_024_oPCAN_RADAR_019234b0_Rx: ComBitPosition=16, ComBitSize=8, ComSignalType=UINT8, ComHandleId=534, ComSystemTemplateSystemSignalRef=DET_MH_CYCLE_COUNTER_021_024_Rx
            DET_EXISTENCE_PROB_023_Rx_oRDR_FUSION_DET_021_024_oPCAN_RADAR_e4119935_Rx: ComBitPosition=336, ComBitSize=6, ComSignalType=UINT8, ComHandleId=523, ComSystemTemplateSystemSignalRef=DET_EXISTENCE_PROB_023_Rx
            DET_SUPER_RES_TARGET_022_Rx_oRDR_FUSION_DET_021_024_oPCAN_RADAR_5d929e9f_Rx: ComBitPosition=199, ComBitSize=1, ComSignalType=BOOLEAN, ComHandleId=569, ComSystemTemplateSystemSignalRef=DET_SUPER_RES_TARGET_022_Rx
            DET_PROB_1STAZHYPO_024_Rx_oRDR_FUSION_DET_021_024_oPCAN_RADAR_81c95694_Rx: ComBitPosition=439, ComBitSize=1, ComSignalType=BOOLEAN, ComHandleId=543, ComSystemTemplateSystemSignalRef=DET_PROB_1STAZHYPO_024_Rx
            DET_RANGE_VELOCITY_022_Rx_oRDR_FUSION_DET_021_024_oPCAN_RADAR_52f85c6d_Rx: ComBitPosition=160, ComBitSize=15, ComSignalType=UINT16, ComHandleId=553, ComSystemTemplateSystemSignalRef=DET_RANGE_VELOCITY_022_Rx
            DET_RCS_023_Rx_oRDR_FUSION_DET_021_024_oPCAN_RADAR_30775c31_Rx: ComBitPosition=352, ComBitSize=8, ComSignalType=UINT8, ComHandleId=562, ComSystemTemplateSystemSignalRef=DET_RCS_023_Rx
            DET_CONFD_ELEVATION_021_Rx_oRDR_FUSION_DET_021_024_oPCAN_RADAR_4e1b0e49_Rx: ComBitPosition=101, ComBitSize=2, ComSignalType=UINT8, ComHandleId=509, ComSystemTemplateSystemSignalRef=DET_CONFD_ELEVATION_021_Rx
            DET_ELEVATION_023_Rx_oRDR_FUSION_DET_021_024_oPCAN_RADAR_c1b0c37f_Rx: ComBitPosition=296, ComBitSize=8, ComSignalType=UINT8, ComHandleId=515, ComSystemTemplateSystemSignalRef=DET_ELEVATION_023_Rx
            DET_ELEVATION_024_Rx_oRDR_FUSION_DET_021_024_oPCAN_RADAR_3b8d3028_Rx: ComBitPosition=408, ComBitSize=8, ComSignalType=UINT8, ComHandleId=516, ComSystemTemplateSystemSignalRef=DET_ELEVATION_024_Rx
            DET_RANGE_VELOCITY_ERR_024_Rx_oRDR_FUSION_DET_021_024_oPCAN_RADAR_9ee54dbf_Rx: ComBitPosition=400, ComBitSize=8, ComSignalType=UINT8, ComHandleId=559, ComSystemTemplateSystemSignalRef=DET_RANGE_VELOCITY_ERR_024_Rx
            DET_SUPER_RES_TARGET_021_Rx_oRDR_FUSION_DET_021_024_oPCAN_RADAR_772e2e17_Rx: ComBitPosition=87, ComBitSize=1, ComSignalType=BOOLEAN, ComHandleId=568, ComSystemTemplateSystemSignalRef=DET_SUPER_RES_TARGET_021_Rx
            DET_BI_STATIC_FLAG_021_Rx_oRDR_FUSION_DET_021_024_oPCAN_RADAR_a753679a_Rx: ComBitPosition=104, ComBitSize=1, ComSignalType=BOOLEAN, ComHandleId=501, ComSystemTemplateSystemSignalRef=DET_BI_STATIC_FLAG_021_Rx
            DET_IDM_024_Rx_oRDR_FUSION_DET_021_024_oPCAN_RADAR_f6337e65_Rx: ComBitPosition=399, ComBitSize=1, ComSignalType=BOOLEAN, ComHandleId=532, ComSystemTemplateSystemSignalRef=DET_IDM_024_Rx
            DET_MTD_023_Rx_oRDR_FUSION_DET_021_024_oPCAN_RADAR_b18dbb42_Rx: ComBitPosition=271, ComBitSize=1, ComSignalType=BOOLEAN, ComHandleId=538, ComSystemTemplateSystemSignalRef=DET_MTD_023_Rx
            DET_SUPER_RES_TARGET_023_Rx_oRDR_FUSION_DET_021_024_oPCAN_RADAR_f2d60cd8_Rx: ComBitPosition=311, ComBitSize=1, ComSignalType=BOOLEAN, ComHandleId=570, ComSystemTemplateSystemSignalRef=DET_SUPER_RES_TARGET_023_Rx
            DET_AZIMUTH_021_Rx_oRDR_FUSION_DET_021_024_oPCAN_RADAR_b677333c_Rx: ComBitPosition=88, ComBitSize=13, ComSignalType=UINT16, ComHandleId=489, ComSystemTemplateSystemSignalRef=DET_AZIMUTH_021_Rx
            DET_EXISTENCE_PROB_021_Rx_oRDR_FUSION_DET_021_024_oPCAN_RADAR_61e9bbfa_Rx: ComBitPosition=112, ComBitSize=6, ComSignalType=UINT8, ComHandleId=521, ComSystemTemplateSystemSignalRef=DET_EXISTENCE_PROB_021_Rx
            DET_CONFD_AZIMUTH_022_Rx_oRDR_FUSION_DET_021_024_oPCAN_RADAR_6e863d46_Rx: ComBitPosition=230, ComBitSize=2, ComSignalType=UINT8, ComHandleId=506, ComSystemTemplateSystemSignalRef=DET_CONFD_AZIMUTH_022_Rx
            DET_ELEVATION_ERR_022_Rx_oRDR_FUSION_DET_021_024_oPCAN_RADAR_bc4d73e7_Rx: ComBitPosition=192, ComBitSize=6, ComSignalType=UINT8, ComHandleId=518, ComSystemTemplateSystemSignalRef=DET_ELEVATION_ERR_022_Rx
            DET_AZIMUTH_024_Rx_oRDR_FUSION_DET_021_024_oPCAN_RADAR_c9b2e2a4_Rx: ComBitPosition=424, ComBitSize=13, ComSignalType=UINT16, ComHandleId=492, ComSystemTemplateSystemSignalRef=DET_AZIMUTH_024_Rx
            DET_BELOW_RAIN_THOLD_022_Rx_oRDR_FUSION_DET_021_024_oPCAN_RADAR_fa717c01_Rx: ComBitPosition=151, ComBitSize=1, ComSignalType=BOOLEAN, ComHandleId=498, ComSystemTemplateSystemSignalRef=DET_BELOW_RAIN_THOLD_022_Rx
            DET_RANGE_VELOCITY_ERR_022_Rx_oRDR_FUSION_DET_021_024_oPCAN_RADAR_cb9c2caf_Rx: ComBitPosition=176, ComBitSize=8, ComSignalType=UINT8, ComHandleId=557, ComSystemTemplateSystemSignalRef=DET_RANGE_VELOCITY_ERR_022_Rx
            DET_SNR_023_Rx_oRDR_FUSION_DET_021_024_oPCAN_RADAR_392d2dd8_Rx: ComBitPosition=344, ComBitSize=8, ComSignalType=UINT8, ComHandleId=566, ComSystemTemplateSystemSignalRef=DET_SNR_023_Rx
            DET_RCS_021_Rx_oRDR_FUSION_DET_021_024_oPCAN_RADAR_b58f7efe_Rx: ComBitPosition=128, ComBitSize=8, ComSignalType=UINT8, ComHandleId=560, ComSystemTemplateSystemSignalRef=DET_RCS_021_Rx
            DET_HVC_FLAG_021_Rx_oRDR_FUSION_DET_021_024_oPCAN_RADAR_bc3756b5_Rx: ComBitPosition=86, ComBitSize=1, ComSignalType=BOOLEAN, ComHandleId=525, ComSystemTemplateSystemSignalRef=DET_HVC_FLAG_021_Rx
            DET_IDM_021_Rx_oRDR_FUSION_DET_021_024_oPCAN_RADAR_89f6affd_Rx: ComBitPosition=63, ComBitSize=1, ComSignalType=BOOLEAN, ComHandleId=529, ComSystemTemplateSystemSignalRef=DET_IDM_021_Rx
            DET_AZIMUTH_ERR_022_Rx_oRDR_FUSION_DET_021_024_oPCAN_RADAR_9ea22236_Rx: ComBitPosition=217, ComBitSize=7, ComSignalType=UINT8, ComHandleId=494, ComSystemTemplateSystemSignalRef=DET_AZIMUTH_ERR_022_Rx
            DET_RCS_022_Rx_oRDR_FUSION_DET_021_024_oPCAN_RADAR_9f33ce76_Rx: ComBitPosition=240, ComBitSize=8, ComSignalType=UINT8, ComHandleId=561, ComSystemTemplateSystemSignalRef=DET_RCS_022_Rx
            DET_AZIMUTH_023_Rx_oRDR_FUSION_DET_021_024_oPCAN_RADAR_338f11f3_Rx: ComBitPosition=312, ComBitSize=13, ComSignalType=UINT16, ComHandleId=491, ComSystemTemplateSystemSignalRef=DET_AZIMUTH_023_Rx
            DET_EXISTENCE_PROB_024_Rx_oRDR_FUSION_DET_021_024_oPCAN_RADAR_1e2c6a62_Rx: ComBitPosition=448, ComBitSize=6, ComSignalType=UINT8, ComHandleId=524, ComSystemTemplateSystemSignalRef=DET_EXISTENCE_PROB_024_Rx
            DET_EXISTENCE_PROB_022_Rx_oRDR_FUSION_DET_021_024_oPCAN_RADAR_4b550b72_Rx: ComBitPosition=224, ComBitSize=6, ComSignalType=UINT8, ComHandleId=522, ComSystemTemplateSystemSignalRef=DET_EXISTENCE_PROB_022_Rx
            DET_SNR_024_Rx_oRDR_FUSION_DET_021_024_oPCAN_RADAR_c310de8f_Rx: ComBitPosition=456, ComBitSize=8, ComSignalType=UINT8, ComHandleId=567, ComSystemTemplateSystemSignalRef=DET_SNR_024_Rx
            DET_BI_STATIC_FLAG_022_Rx_oRDR_FUSION_DET_021_024_oPCAN_RADAR_8defd712_Rx: ComBitPosition=216, ComBitSize=1, ComSignalType=BOOLEAN, ComHandleId=502, ComSystemTemplateSystemSignalRef=DET_BI_STATIC_FLAG_022_Rx
            DET_AZIMUTH_ERR_021_Rx_oRDR_FUSION_DET_021_024_oPCAN_RADAR_b41e92be_Rx: ComBitPosition=105, ComBitSize=7, ComSignalType=UINT8, ComHandleId=493, ComSystemTemplateSystemSignalRef=DET_AZIMUTH_ERR_021_Rx
            DET_BELOW_RAIN_THOLD_024_Rx_oRDR_FUSION_DET_021_024_oPCAN_RADAR_af081d11_Rx: ComBitPosition=375, ComBitSize=1, ComSignalType=BOOLEAN, ComHandleId=500, ComSystemTemplateSystemSignalRef=DET_BELOW_RAIN_THOLD_024_Rx
            DET_MH_SCAN_INDEX_4LSB_021_024_Rx_oRDR_FUSION_DET_021_024_oPCAN_RADAR_6522fb8b_Rx: ComBitPosition=476, ComBitSize=4, ComSignalType=UINT8, ComHandleId=535, ComSystemTemplateSystemSignalRef=DET_MH_SCAN_INDEX_4LSB_021_024_Rx
            DET_ELEVATION_ERR_023_Rx_oRDR_FUSION_DET_021_024_oPCAN_RADAR_1309e1a0_Rx: ComBitPosition=304, ComBitSize=6, ComSignalType=UINT8, ComHandleId=519, ComSystemTemplateSystemSignalRef=DET_ELEVATION_ERR_023_Rx
            DET_BELOW_RAIN_THOLD_023_Rx_oRDR_FUSION_DET_021_024_oPCAN_RADAR_5535ee46_Rx: ComBitPosition=263, ComBitSize=1, ComSignalType=BOOLEAN, ComHandleId=499, ComSystemTemplateSystemSignalRef=DET_BELOW_RAIN_THOLD_023_Rx
            DET_BI_STATIC_FLAG_023_Rx_oRDR_FUSION_DET_021_024_oPCAN_RADAR_22ab4555_Rx: ComBitPosition=328, ComBitSize=1, ComSignalType=BOOLEAN, ComHandleId=503, ComSystemTemplateSystemSignalRef=DET_BI_STATIC_FLAG_023_Rx
            DET_RANGE_ERR_021_Rx_oRDR_FUSION_DET_021_024_oPCAN_RADAR_f543e3fb_Rx: ComBitPosition=40, ComBitSize=7, ComSignalType=UINT8, ComHandleId=548, ComSystemTemplateSystemSignalRef=DET_RANGE_ERR_021_Rx
            DET_RANGE_ERR_023_Rx_oRDR_FUSION_DET_021_024_oPCAN_RADAR_70bbc134_Rx: ComBitPosition=264, ComBitSize=7, ComSignalType=UINT8, ComHandleId=550, ComSystemTemplateSystemSignalRef=DET_RANGE_ERR_023_Rx
            DET_RANGE_VELOCITY_024_Rx_oRDR_FUSION_DET_021_024_oPCAN_RADAR_07813d7d_Rx: ComBitPosition=384, ComBitSize=15, ComSignalType=UINT16, ComHandleId=555, ComSystemTemplateSystemSignalRef=DET_RANGE_VELOCITY_024_Rx
            DET_RANGE_VELOCITY_021_Rx_oRDR_FUSION_DET_021_024_oPCAN_RADAR_7844ece5_Rx: ComBitPosition=48, ComBitSize=15, ComSignalType=UINT16, ComHandleId=552, ComSystemTemplateSystemSignalRef=DET_RANGE_VELOCITY_021_Rx
            DET_ELEVATION_021_Rx_oRDR_FUSION_DET_021_024_oPCAN_RADAR_4448e1b0_Rx: ComBitPosition=72, ComBitSize=8, ComSignalType=UINT8, ComHandleId=513, ComSystemTemplateSystemSignalRef=DET_ELEVATION_021_Rx
            DET_CONFD_ELEVATION_023_Rx_oRDR_FUSION_DET_021_024_oPCAN_RADAR_cbe32c86_Rx: ComBitPosition=325, ComBitSize=2, ComSignalType=UINT8, ComHandleId=511, ComSystemTemplateSystemSignalRef=DET_CONFD_ELEVATION_023_Rx
            DET_BELOW_RAIN_THOLD_021_Rx_oRDR_FUSION_DET_021_024_oPCAN_RADAR_d0cdcc89_Rx: ComBitPosition=39, ComBitSize=1, ComSignalType=BOOLEAN, ComHandleId=497, ComSystemTemplateSystemSignalRef=DET_BELOW_RAIN_THOLD_021_Rx
            DET_RANGE_ERR_022_Rx_oRDR_FUSION_DET_021_024_oPCAN_RADAR_dfff5373_Rx: ComBitPosition=152, ComBitSize=7, ComSignalType=UINT8, ComHandleId=549, ComSystemTemplateSystemSignalRef=DET_RANGE_ERR_022_Rx
            DET_RANGE_023_Rx_oRDR_FUSION_DET_021_024_oPCAN_RADAR_20494dd4_Rx: ComBitPosition=248, ComBitSize=15, ComSignalType=UINT16, ComHandleId=546, ComSystemTemplateSystemSignalRef=DET_RANGE_023_Rx
            DET_AZIMUTH_ERR_024_Rx_oRDR_FUSION_DET_021_024_oPCAN_RADAR_cbdb4326_Rx: ComBitPosition=441, ComBitSize=7, ComSignalType=UINT8, ComHandleId=496, ComSystemTemplateSystemSignalRef=DET_AZIMUTH_ERR_024_Rx
            DET_MTD_021_Rx_oRDR_FUSION_DET_021_024_oPCAN_RADAR_3475998d_Rx: ComBitPosition=47, ComBitSize=1, ComSignalType=BOOLEAN, ComHandleId=536, ComSystemTemplateSystemSignalRef=DET_MTD_021_Rx
            DET_HVC_FLAG_022_Rx_oRDR_FUSION_DET_021_024_oPCAN_RADAR_968be63d_Rx: ComBitPosition=198, ComBitSize=1, ComSignalType=BOOLEAN, ComHandleId=526, ComSystemTemplateSystemSignalRef=DET_HVC_FLAG_022_Rx
            DET_IDM_022_Rx_oRDR_FUSION_DET_021_024_oPCAN_RADAR_a34a1f75_Rx: ComBitPosition=175, ComBitSize=1, ComSignalType=BOOLEAN, ComHandleId=530, ComSystemTemplateSystemSignalRef=DET_IDM_022_Rx
            DET_CONFD_ELEVATION_024_Rx_oRDR_FUSION_DET_021_024_oPCAN_RADAR_31dedfd1_Rx: ComBitPosition=437, ComBitSize=2, ComSignalType=UINT8, ComHandleId=512, ComSystemTemplateSystemSignalRef=DET_CONFD_ELEVATION_024_Rx
            DET_RCS_024_Rx_oRDR_FUSION_DET_021_024_oPCAN_RADAR_ca4aaf66_Rx: ComBitPosition=464, ComBitSize=8, ComSignalType=UINT8, ComHandleId=563, ComSystemTemplateSystemSignalRef=DET_RCS_024_Rx
            DET_RANGE_VELOCITY_ERR_023_Rx_oRDR_FUSION_DET_021_024_oPCAN_RADAR_64d8bee8_Rx: ComBitPosition=288, ComBitSize=8, ComSignalType=UINT8, ComHandleId=558, ComSystemTemplateSystemSignalRef=DET_RANGE_VELOCITY_ERR_023_Rx
            DET_RANGE_ERR_024_Rx_oRDR_FUSION_DET_021_024_oPCAN_RADAR_8a863263_Rx: ComBitPosition=376, ComBitSize=7, ComSignalType=UINT8, ComHandleId=551, ComSystemTemplateSystemSignalRef=DET_RANGE_ERR_024_Rx
            DET_MTD_024_Rx_oRDR_FUSION_DET_021_024_oPCAN_RADAR_4bb04815_Rx: ComBitPosition=383, ComBitSize=1, ComSignalType=BOOLEAN, ComHandleId=539, ComSystemTemplateSystemSignalRef=DET_MTD_024_Rx
            DET_CONFD_ELEVATION_022_Rx_oRDR_FUSION_DET_021_024_oPCAN_RADAR_64a7bec1_Rx: ComBitPosition=213, ComBitSize=2, ComSignalType=UINT8, ComHandleId=510, ComSystemTemplateSystemSignalRef=DET_CONFD_ELEVATION_022_Rx
            DET_RANGE_022_Rx_oRDR_FUSION_DET_021_024_oPCAN_RADAR_8f0ddf93_Rx: ComBitPosition=136, ComBitSize=15, ComSignalType=UINT16, ComHandleId=545, ComSystemTemplateSystemSignalRef=DET_RANGE_022_Rx
            DET_HVC_FLAG_024_Rx_oRDR_FUSION_DET_021_024_oPCAN_RADAR_c3f2872d_Rx: ComBitPosition=422, ComBitSize=1, ComSignalType=BOOLEAN, ComHandleId=528, ComSystemTemplateSystemSignalRef=DET_HVC_FLAG_024_Rx
            DET_RANGE_024_Rx_oRDR_FUSION_DET_021_024_oPCAN_RADAR_da74be83_Rx: ComBitPosition=360, ComBitSize=15, ComSignalType=UINT16, ComHandleId=547, ComSystemTemplateSystemSignalRef=DET_RANGE_024_Rx
            DET_MTD_022_Rx_oRDR_FUSION_DET_021_024_oPCAN_RADAR_1ec92905_Rx: ComBitPosition=159, ComBitSize=1, ComSignalType=BOOLEAN, ComHandleId=537, ComSystemTemplateSystemSignalRef=DET_MTD_022_Rx
            DET_ELEVATION_ERR_024_Rx_oRDR_FUSION_DET_021_024_oPCAN_RADAR_e93412f7_Rx: ComBitPosition=416, ComBitSize=6, ComSignalType=UINT8, ComHandleId=520, ComSystemTemplateSystemSignalRef=DET_ELEVATION_ERR_024_Rx
            DET_PROB_1STAZHYPO_021_Rx_oRDR_FUSION_DET_021_024_oPCAN_RADAR_fe0c870c_Rx: ComBitPosition=103, ComBitSize=1, ComSignalType=BOOLEAN, ComHandleId=540, ComSystemTemplateSystemSignalRef=DET_PROB_1STAZHYPO_021_Rx
            DET_AZIMUTH_ERR_023_Rx_oRDR_FUSION_DET_021_024_oPCAN_RADAR_31e6b071_Rx: ComBitPosition=329, ComBitSize=7, ComSignalType=UINT8, ComHandleId=495, ComSystemTemplateSystemSignalRef=DET_AZIMUTH_ERR_023_Rx
            DET_SNR_021_Rx_oRDR_FUSION_DET_021_024_oPCAN_RADAR_bcd50f17_Rx: ComBitPosition=120, ComBitSize=8, ComSignalType=UINT8, ComHandleId=564, ComSystemTemplateSystemSignalRef=DET_SNR_021_Rx
            DET_SNR_022_Rx_oRDR_FUSION_DET_021_024_oPCAN_RADAR_9669bf9f_Rx: ComBitPosition=232, ComBitSize=8, ComSignalType=UINT8, ComHandleId=565, ComSystemTemplateSystemSignalRef=DET_SNR_022_Rx
            DET_BI_STATIC_FLAG_024_Rx_oRDR_FUSION_DET_021_024_oPCAN_RADAR_d896b602_Rx: ComBitPosition=440, ComBitSize=1, ComSignalType=BOOLEAN, ComHandleId=504, ComSystemTemplateSystemSignalRef=DET_BI_STATIC_FLAG_024_Rx
            DET_ELEVATION_ERR_021_Rx_oRDR_FUSION_DET_021_024_oPCAN_RADAR_96f1c36f_Rx: ComBitPosition=80, ComBitSize=6, ComSignalType=UINT8, ComHandleId=517, ComSystemTemplateSystemSignalRef=DET_ELEVATION_ERR_021_Rx
            DET_SUPER_RES_TARGET_024_Rx_oRDR_FUSION_DET_021_024_oPCAN_RADAR_08ebff8f_Rx: ComBitPosition=423, ComBitSize=1, ComSignalType=BOOLEAN, ComHandleId=571, ComSystemTemplateSystemSignalRef=DET_SUPER_RES_TARGET_024_Rx
            DET_CONFD_AZIMUTH_024_Rx_oRDR_FUSION_DET_021_024_oPCAN_RADAR_3bff5c56_Rx: ComBitPosition=454, ComBitSize=2, ComSignalType=UINT8, ComHandleId=508, ComSystemTemplateSystemSignalRef=DET_CONFD_AZIMUTH_024_Rx
            DET_RANGE_021_Rx_oRDR_FUSION_DET_021_024_oPCAN_RADAR_a5b16f1b_Rx: ComBitPosition=24, ComBitSize=15, ComSignalType=UINT16, ComHandleId=544, ComSystemTemplateSystemSignalRef=DET_RANGE_021_Rx
            DET_AZIMUTH_022_Rx_oRDR_FUSION_DET_021_024_oPCAN_RADAR_9ccb83b4_Rx: ComBitPosition=200, ComBitSize=13, ComSignalType=UINT16, ComHandleId=490, ComSystemTemplateSystemSignalRef=DET_AZIMUTH_022_Rx
            DET_RANGE_VELOCITY_023_Rx_oRDR_FUSION_DET_021_024_oPCAN_RADAR_fdbcce2a_Rx: ComBitPosition=272, ComBitSize=15, ComSignalType=UINT16, ComHandleId=554, ComSystemTemplateSystemSignalRef=DET_RANGE_VELOCITY_023_Rx
            DET_ELEVATION_022_Rx_oRDR_FUSION_DET_021_024_oPCAN_RADAR_6ef45138_Rx: ComBitPosition=184, ComBitSize=8, ComSignalType=UINT8, ComHandleId=514, ComSystemTemplateSystemSignalRef=DET_ELEVATION_022_Rx
            DET_HVC_FLAG_023_Rx_oRDR_FUSION_DET_021_024_oPCAN_RADAR_39cf747a_Rx: ComBitPosition=310, ComBitSize=1, ComSignalType=BOOLEAN, ComHandleId=527, ComSystemTemplateSystemSignalRef=DET_HVC_FLAG_023_Rx
            DET_RANGE_VELOCITY_ERR_021_Rx_oRDR_FUSION_DET_021_024_oPCAN_RADAR_e1209c27_Rx: ComBitPosition=64, ComBitSize=8, ComSignalType=UINT8, ComHandleId=556, ComSystemTemplateSystemSignalRef=DET_RANGE_VELOCITY_ERR_021_Rx
        SG_Fusion_RadarStatus_oRDR_FUSION_STATUS_001_oPCAN_RADAR_00ff53b8_Rx: ComSignalGroupArrayAccess=true, ComTimeout=1, ComHandleId=43, ComFirstTimeout=0.5, ComTimeoutNotification=ComTimeoutNotification_SG_Fusion_RadarStatus_oRDR_FUSION_STATUS_001_oPCAN_RADAR_00ff53b8_Rx, ComNotification=ComNotification_SG_Fusion_RadarStatus_oRDR_FUSION_STATUS_001_oPCAN_RADAR_00ff53b8_Rx, ComSystemTemplateSignalGroupRef=SG_Fusion_RadarStatus
          46 x ComGroupSignal, all with ComSignalEndianness=LITTLE_ENDIAN, ComSignalInitValue=0, ComSignalAccess=ACCESS_NEEDED_BY_SWC_OR_COM:
            STS_USC_CAL_VER_MAJOR_Rx_oRDR_FUSION_STATUS_001_oPCAN_RADAR_0f3b2084_Rx: ComBitPosition=24, ComBitSize=16, ComSignalType=UINT16, ComHandleId=2877, ComSystemTemplateSystemSignalRef=STS_USC_CAL_VER_MAJOR_Rx
            STS_SENSOR_MOUNT_ORNT_PITCH_Rx_oRDR_FUSION_STATUS_001_oPCAN_RADAR_5d2c301f_Rx: ComBitPosition=264, ComBitSize=14, ComSignalType=SINT16, ComHandleId=2855, ComSystemTemplateSystemSignalRef=STS_SENSOR_MOUNT_ORNT_PITCH_Rx
            STS_SW_VERSION_FIELD2_Rx_oRDR_FUSION_STATUS_001_oPCAN_RADAR_5b075ad9_Rx: ComBitPosition=176, ComBitSize=8, ComSignalType=UINT8, ComHandleId=2873, ComSystemTemplateSystemSignalRef=STS_SW_VERSION_FIELD2_Rx
            STS_MAIN_CORE_TIME_PEAK_Rx_oRDR_FUSION_STATUS_001_oPCAN_RADAR_0d8c1d8e_Rx: ComBitPosition=448, ComBitSize=8, ComSignalType=UINT8, ComHandleId=2842, ComSystemTemplateSystemSignalRef=STS_MAIN_CORE_TIME_PEAK_Rx
            STS_SERIAL_NUM_JULIAN_YEAR_Rx_oRDR_FUSION_STATUS_001_oPCAN_RADAR_901b4493_Rx: ComBitPosition=145, ComBitSize=3, ComSignalType=UINT8, ComHandleId=2865, ComSystemTemplateSystemSignalRef=STS_SERIAL_NUM_JULIAN_YEAR_Rx
            STS_SMC_SECTION_COMPTBLITY_Rx_oRDR_FUSION_STATUS_001_oPCAN_RADAR_09850e5f_Rx: ComBitPosition=488, ComBitSize=16, ComSignalType=UINT16, ComHandleId=2869, ComSystemTemplateSystemSignalRef=STS_SMC_SECTION_COMPTBLITY_Rx
            STS_SENSOR_HEIGHT_Rx_oRDR_FUSION_STATUS_001_oPCAN_RADAR_afb05744_Rx: ComBitPosition=344, ComBitSize=32, ComSignalType=UINT32, ComHandleId=2854, ComSystemTemplateSystemSignalRef=STS_SENSOR_HEIGHT_Rx
            STS_SMC_PLATFROM_VERSION_Rx_oRDR_FUSION_STATUS_001_oPCAN_RADAR_22874c18_Rx: ComBitPosition=104, ComBitSize=8, ComSignalType=UINT8, ComHandleId=2868, ComSystemTemplateSystemSignalRef=STS_SMC_PLATFROM_VERSION_Rx
            STS_VIN_Status_Rx_oRDR_FUSION_STATUS_001_oPCAN_RADAR_5e829ab0_Rx: ComBitPosition=118, ComBitSize=2, ComSignalType=UINT8, ComHandleId=2880, ComSystemTemplateSystemSignalRef=STS_VIN_Status_Rx
            STS_SENSOR_MOUNT_ORNT_YAW_Rx_oRDR_FUSION_STATUS_001_oPCAN_RADAR_0ebbf3ee_Rx: ComBitPosition=232, ComBitSize=14, ComSignalType=SINT16, ComHandleId=2857, ComSystemTemplateSystemSignalRef=STS_SENSOR_MOUNT_ORNT_YAW_Rx
            STS_MH_001_CRC16_Rx_oRDR_FUSION_STATUS_001_oPCAN_RADAR_f7533949_Rx: ComBitPosition=0, ComBitSize=16, ComSignalType=UINT16, ComHandleId=2843, ComSystemTemplateSystemSignalRef=STS_MH_001_CRC16_Rx
            STS_PBL_VERSION_FIELD2_Rx_oRDR_FUSION_STATUS_001_oPCAN_RADAR_fc766282_Rx: ComBitPosition=208, ComBitSize=8, ComSignalType=UINT8, ComHandleId=2846, ComSystemTemplateSystemSignalRef=STS_PBL_VERSION_FIELD2_Rx
            STS_SP_CORE_TIME_PEAK_Rx_oRDR_FUSION_STATUS_001_oPCAN_RADAR_f2f3c0e9_Rx: ComBitPosition=472, ComBitSize=8, ComSignalType=UINT8, ComHandleId=2871, ComSystemTemplateSystemSignalRef=STS_SP_CORE_TIME_PEAK_Rx
            STS_SW_VERSION_FIELD3_Rx_oRDR_FUSION_STATUS_001_oPCAN_RADAR_158e5170_Rx: ComBitPosition=184, ComBitSize=8, ComSignalType=UINT8, ComHandleId=2874, ComSystemTemplateSystemSignalRef=STS_SW_VERSION_FIELD3_Rx
            STS_DIST_FRNT_BMPR_TO_RR_AXL_Rx_oRDR_FUSION_STATUS_001_oPCAN_RADAR_d3356ae9_Rx: ComBitPosition=248, ComBitSize=13, ComSignalType=UINT16, ComHandleId=2839, ComSystemTemplateSystemSignalRef=STS_DIST_FRNT_BMPR_TO_RR_AXL_Rx
            STS_SENSOR_MOUNT_POS_Y_Rx_oRDR_FUSION_STATUS_001_oPCAN_RADAR_efb2aa76_Rx: ComBitPosition=312, ComBitSize=16, ComSignalType=UINT16, ComHandleId=2859, ComSystemTemplateSystemSignalRef=STS_SENSOR_MOUNT_POS_Y_Rx
            STS_PBL_VERSION_FIELD4_Rx_oRDR_FUSION_STATUS_001_oPCAN_RADAR_80315d35_Rx: ComBitPosition=224, ComBitSize=8, ComSignalType=UINT8, ComHandleId=2848, ComSystemTemplateSystemSignalRef=STS_PBL_VERSION_FIELD4_Rx
            STS_PBL_VERSION_FIELD1_Rx_oRDR_FUSION_STATUS_001_oPCAN_RADAR_2fed7e79_Rx: ComBitPosition=200, ComBitSize=8, ComSignalType=UINT8, ComHandleId=2845, ComSystemTemplateSystemSignalRef=STS_PBL_VERSION_FIELD1_Rx
            STS_DET_DBC_BASE_VER_MAJOR_Rx_oRDR_FUSION_STATUS_001_oPCAN_RADAR_da72d0b4_Rx: ComBitPosition=376, ComBitSize=8, ComSignalType=UINT8, ComHandleId=2837, ComSystemTemplateSystemSignalRef=STS_DET_DBC_BASE_VER_MAJOR_Rx
            STS_PLATFORM_VARIANT_Rx_oRDR_FUSION_STATUS_001_oPCAN_RADAR_1ab3f6e1_Rx: ComBitPosition=162, ComBitSize=5, ComSignalType=UINT8, ComHandleId=2851, ComSystemTemplateSystemSignalRef=STS_PLATFORM_VARIANT_Rx
            STS_SERIAL_NUM_JULIAN_DAY_Rx_oRDR_FUSION_STATUS_001_oPCAN_RADAR_5edc9e7f_Rx: ComBitPosition=136, ComBitSize=9, ComSignalType=UINT16, ComHandleId=2864, ComSystemTemplateSystemSignalRef=STS_SERIAL_NUM_JULIAN_DAY_Rx
            STS_USC_CAL_VER_MINOR_Rx_oRDR_FUSION_STATUS_001_oPCAN_RADAR_101c5a35_Rx: ComBitPosition=40, ComBitSize=16, ComSignalType=UINT16, ComHandleId=2878, ComSystemTemplateSystemSignalRef=STS_USC_CAL_VER_MINOR_Rx
            STS_AF_TIME_PEAK_Rx_oRDR_FUSION_STATUS_001_oPCAN_RADAR_fbf318d6_Rx: ComBitPosition=432, ComBitSize=8, ComSignalType=UINT8, ComHandleId=2836, ComSystemTemplateSystemSignalRef=STS_AF_TIME_PEAK_Rx
            STS_MAIN_CORE_TIME_INST_Rx_oRDR_FUSION_STATUS_001_oPCAN_RADAR_119502a5_Rx: ComBitPosition=440, ComBitSize=8, ComSignalType=UINT8, ComHandleId=2841, ComSystemTemplateSystemSignalRef=STS_MAIN_CORE_TIME_INST_Rx
            STS_PCAN_PROTOCOL_VER_MINOR_Rx_oRDR_FUSION_STATUS_001_oPCAN_RADAR_d5701223_Rx: ComBitPosition=128, ComBitSize=8, ComSignalType=UINT8, ComHandleId=2850, ComSystemTemplateSystemSignalRef=STS_PCAN_PROTOCOL_VER_MINOR_Rx
            STS_SENSOR_MOUNT_POS_Z_Rx_oRDR_FUSION_STATUS_001_oPCAN_RADAR_3c29b68d_Rx: ComBitPosition=328, ComBitSize=16, ComSignalType=UINT16, ComHandleId=2860, ComSystemTemplateSystemSignalRef=STS_SENSOR_MOUNT_POS_Z_Rx
            STS_RDD_CORE_TIME_PEAK_Rx_oRDR_FUSION_STATUS_001_oPCAN_RADAR_abf464ce_Rx: ComBitPosition=464, ComBitSize=8, ComSignalType=UINT8, ComHandleId=2853, ComSystemTemplateSystemSignalRef=STS_RDD_CORE_TIME_PEAK_Rx
            STS_SMC_CAL_VER_MAJOR_Rx_oRDR_FUSION_STATUS_001_oPCAN_RADAR_d198a980_Rx: ComBitPosition=72, ComBitSize=16, ComSignalType=UINT16, ComHandleId=2866, ComSystemTemplateSystemSignalRef=STS_SMC_CAL_VER_MAJOR_Rx
            STS_SW_VERSION_FIELD1_Rx_oRDR_FUSION_STATUS_001_oPCAN_RADAR_889c4622_Rx: ComBitPosition=168, ComBitSize=8, ComSignalType=UINT8, ComHandleId=2872, ComSystemTemplateSystemSignalRef=STS_SW_VERSION_FIELD1_Rx
            STS_PCAN_PROTOCOL_VER_MAJOR_Rx_oRDR_FUSION_STATUS_001_oPCAN_RADAR_ca576892_Rx: ComBitPosition=120, ComBitSize=8, ComSignalType=UINT8, ComHandleId=2849, ComSystemTemplateSystemSignalRef=STS_PCAN_PROTOCOL_VER_MAJOR_Rx
            STS_AF_TIME_INST_Rx_oRDR_FUSION_STATUS_001_oPCAN_RADAR_e7ea07fd_Rx: ComBitPosition=424, ComBitSize=8, ComSignalType=UINT8, ComHandleId=2835, ComSystemTemplateSystemSignalRef=STS_AF_TIME_INST_Rx
            STS_TIME_SINCE_POWER_ON_Rx_oRDR_FUSION_STATUS_001_oPCAN_RADAR_fe979836_Rx: ComBitPosition=392, ComBitSize=32, ComSignalType=UINT32, ComHandleId=2876, ComSystemTemplateSystemSignalRef=STS_TIME_SINCE_POWER_ON_Rx
            STS_SP_CORE_TIME_INST_Rx_oRDR_FUSION_STATUS_001_oPCAN_RADAR_eeeadfc2_Rx: ComBitPosition=480, ComBitSize=8, ComSignalType=UINT8, ComHandleId=2870, ComSystemTemplateSystemSignalRef=STS_SP_CORE_TIME_INST_Rx
            STS_SMC_CAL_VER_MINOR_Rx_oRDR_FUSION_STATUS_001_oPCAN_RADAR_cebfd331_Rx: ComBitPosition=88, ComBitSize=16, ComSignalType=UINT16, ComHandleId=2867, ComSystemTemplateSystemSignalRef=STS_SMC_CAL_VER_MINOR_Rx
            STS_SENSOR_MOUNT_ORNT_ROLL_Rx_oRDR_FUSION_STATUS_001_oPCAN_RADAR_2eb23309_Rx: ComBitPosition=280, ComBitSize=14, ComSignalType=UINT16, ComHandleId=2856, ComSystemTemplateSystemSignalRef=STS_SENSOR_MOUNT_ORNT_ROLL_Rx
            STS_USC_SECTION_COMPTBLITY_Rx_oRDR_FUSION_STATUS_001_oPCAN_RADAR_a8d15a86_Rx: ComBitPosition=56, ComBitSize=16, ComSignalType=UINT16, ComHandleId=2879, ComSystemTemplateSystemSignalRef=STS_USC_SECTION_COMPTBLITY_Rx
            STS_SENSOR_POLARITY_Rx_oRDR_FUSION_STATUS_001_oPCAN_RADAR_cb038873_Rx: ComBitPosition=246, ComBitSize=1, ComSignalType=BOOLEAN, ComHandleId=2861, ComSystemTemplateSystemSignalRef=STS_SENSOR_POLARITY_Rx
            STS_HARDWARE_VERSION_Rx_oRDR_FUSION_STATUS_001_oPCAN_RADAR_eb5d2e7e_Rx: ComBitPosition=112, ComBitSize=3, ComSignalType=UINT8, ComHandleId=2840, ComSystemTemplateSystemSignalRef=STS_HARDWARE_VERSION_Rx
            STS_SW_VERSION_FIELD4_Rx_oRDR_FUSION_STATUS_001_oPCAN_RADAR_2740656e_Rx: ComBitPosition=192, ComBitSize=8, ComSignalType=UINT8, ComHandleId=2875, ComSystemTemplateSystemSignalRef=STS_SW_VERSION_FIELD4_Rx
            STS_RDD_CORE_TIME_INST_Rx_oRDR_FUSION_STATUS_001_oPCAN_RADAR_b7ed7be5_Rx: ComBitPosition=456, ComBitSize=8, ComSignalType=UINT8, ComHandleId=2852, ComSystemTemplateSystemSignalRef=STS_RDD_CORE_TIME_INST_Rx
            STS_MH_001_CYCLE_COUNTER_Rx_oRDR_FUSION_STATUS_001_oPCAN_RADAR_a907aaa1_Rx: ComBitPosition=16, ComBitSize=8, ComSignalType=UINT8, ComHandleId=2844, ComSystemTemplateSystemSignalRef=STS_MH_001_CYCLE_COUNTER_Rx
            STS_PBL_VERSION_FIELD3_Rx_oRDR_FUSION_STATUS_001_oPCAN_RADAR_b2ff692b_Rx: ComBitPosition=216, ComBitSize=8, ComSignalType=UINT8, ComHandleId=2847, ComSystemTemplateSystemSignalRef=STS_PBL_VERSION_FIELD3_Rx
            STS_SENSOR_POSITION_Rx_oRDR_FUSION_STATUS_001_oPCAN_RADAR_d8d06a93_Rx: ComBitPosition=115, ComBitSize=3, ComSignalType=UINT8, ComHandleId=2862, ComSystemTemplateSystemSignalRef=STS_SENSOR_POSITION_Rx
            STS_SERIAL_NUMBER_SEQUENCE_Rx_oRDR_FUSION_STATUS_001_oPCAN_RADAR_18d84c3c_Rx: ComBitPosition=148, ComBitSize=14, ComSignalType=UINT16, ComHandleId=2863, ComSystemTemplateSystemSignalRef=STS_SERIAL_NUMBER_SEQUENCE_Rx
            STS_SENSOR_MOUNT_POS_X_Rx_oRDR_FUSION_STATUS_001_oPCAN_RADAR_a13ba1df_Rx: ComBitPosition=296, ComBitSize=14, ComSignalType=UINT16, ComHandleId=2858, ComSystemTemplateSystemSignalRef=STS_SENSOR_MOUNT_POS_X_Rx
            STS_DET_DBC_BASE_VER_MINOR_Rx_oRDR_FUSION_STATUS_001_oPCAN_RADAR_c555aa05_Rx: ComBitPosition=384, ComBitSize=8, ComSignalType=UINT8, ComHandleId=2838, ComSystemTemplateSystemSignalRef=STS_DET_DBC_BASE_VER_MINOR_Rx
        SG_Fusion_Detections_053_056_oRDR_FUSION_DET_053_056_oPCAN_RADAR_d1fa35d9_Rx: ComTimeout=0, ComHandleId=21, ComSignalGroupArrayAccess=true, ComSystemTemplateSignalGroupRef=SG_Fusion_Detections_053_056
          83 x ComGroupSignal, all with ComSignalEndianness=LITTLE_ENDIAN, ComSignalInitValue=0, ComSignalAccess=ACCESS_NEEDED_BY_SWC_OR_COM:
            DET_PROB_1STAZHYPO_056_Rx_oRDR_FUSION_DET_053_056_oPCAN_RADAR_c14708d7_Rx: ComBitPosition=439, ComBitSize=1, ComSignalType=BOOLEAN, ComHandleId=1207, ComSystemTemplateSystemSignalRef=DET_PROB_1STAZHYPO_056_Rx
            DET_BI_STATIC_FLAG_056_Rx_oRDR_FUSION_DET_053_056_oPCAN_RADAR_9818e841_Rx: ComBitPosition=440, ComBitSize=1, ComSignalType=BOOLEAN, ComHandleId=1168, ComSystemTemplateSystemSignalRef=DET_BI_STATIC_FLAG_056_Rx
            DET_HVC_FLAG_055_Rx_oRDR_FUSION_DET_053_056_oPCAN_RADAR_a9c069e6_Rx: ComBitPosition=310, ComBitSize=1, ComSignalType=BOOLEAN, ComHandleId=1191, ComSystemTemplateSystemSignalRef=DET_HVC_FLAG_055_Rx
            DET_PROB_1STAZHYPO_055_Rx_oRDR_FUSION_DET_053_056_oPCAN_RADAR_ebfbb85f_Rx: ComBitPosition=327, ComBitSize=1, ComSignalType=BOOLEAN, ComHandleId=1206, ComSystemTemplateSystemSignalRef=DET_PROB_1STAZHYPO_055_Rx
            DET_ELEVATION_056_Rx_oRDR_FUSION_DET_053_056_oPCAN_RADAR_7b036e6b_Rx: ComBitPosition=408, ComBitSize=8, ComSignalType=UINT8, ComHandleId=1180, ComSystemTemplateSystemSignalRef=DET_ELEVATION_056_Rx
            DET_IDM_053_Rx_oRDR_FUSION_DET_053_056_oPCAN_RADAR_c978f1be_Rx: ComBitPosition=63, ComBitSize=1, ComSignalType=BOOLEAN, ComHandleId=1193, ComSystemTemplateSystemSignalRef=DET_IDM_053_Rx
            DET_MH_CYCLE_COUNTER_053_056_Rx_oRDR_FUSION_DET_053_056_oPCAN_RADAR_c94ccf51_Rx: ComBitPosition=16, ComBitSize=8, ComSignalType=UINT8, ComHandleId=1198, ComSystemTemplateSystemSignalRef=DET_MH_CYCLE_COUNTER_053_056_Rx
            DET_SNR_055_Rx_oRDR_FUSION_DET_053_056_oPCAN_RADAR_a9223044_Rx: ComBitPosition=344, ComBitSize=8, ComSignalType=UINT8, ComHandleId=1230, ComSystemTemplateSystemSignalRef=DET_SNR_055_Rx
            DET_BI_STATIC_FLAG_054_Rx_oRDR_FUSION_DET_053_056_oPCAN_RADAR_1de0ca8e_Rx: ComBitPosition=216, ComBitSize=1, ComSignalType=BOOLEAN, ComHandleId=1166, ComSystemTemplateSystemSignalRef=DET_BI_STATIC_FLAG_054_Rx
            DET_RANGE_ERR_055_Rx_oRDR_FUSION_DET_053_056_oPCAN_RADAR_e0b4dca8_Rx: ComBitPosition=264, ComBitSize=7, ComSignalType=UINT8, ComHandleId=1214, ComSystemTemplateSystemSignalRef=DET_RANGE_ERR_055_Rx
            DET_BELOW_RAIN_THOLD_053_Rx_oRDR_FUSION_DET_053_056_oPCAN_RADAR_904392ca_Rx: ComBitPosition=39, ComBitSize=1, ComSignalType=BOOLEAN, ComHandleId=1161, ComSystemTemplateSystemSignalRef=DET_BELOW_RAIN_THOLD_053_Rx
            DET_RANGE_ERR_053_Rx_oRDR_FUSION_DET_053_056_oPCAN_RADAR_b5cdbdb8_Rx: ComBitPosition=40, ComBitSize=7, ComSignalType=UINT8, ComHandleId=1212, ComSystemTemplateSystemSignalRef=DET_RANGE_ERR_053_Rx
            DET_BELOW_RAIN_THOLD_055_Rx_oRDR_FUSION_DET_053_056_oPCAN_RADAR_c53af3da_Rx: ComBitPosition=263, ComBitSize=1, ComSignalType=BOOLEAN, ComHandleId=1163, ComSystemTemplateSystemSignalRef=DET_BELOW_RAIN_THOLD_055_Rx
            DET_MH_SCAN_INDEX_4LSB_053_056_Rx_oRDR_FUSION_DET_053_056_oPCAN_RADAR_adfc006a_Rx: ComBitPosition=476, ComBitSize=4, ComSignalType=UINT8, ComHandleId=1199, ComSystemTemplateSystemSignalRef=DET_MH_SCAN_INDEX_4LSB_053_056_Rx
            DET_RANGE_ERR_056_Rx_oRDR_FUSION_DET_053_056_oPCAN_RADAR_ca086c20_Rx: ComBitPosition=376, ComBitSize=7, ComSignalType=UINT8, ComHandleId=1215, ComSystemTemplateSystemSignalRef=DET_RANGE_ERR_056_Rx
            DET_CONFD_ELEVATION_056_Rx_oRDR_FUSION_DET_053_056_oPCAN_RADAR_71508192_Rx: ComBitPosition=437, ComBitSize=2, ComSignalType=UINT8, ComHandleId=1176, ComSystemTemplateSystemSignalRef=DET_CONFD_ELEVATION_056_Rx
            DET_BELOW_RAIN_THOLD_054_Rx_oRDR_FUSION_DET_053_056_oPCAN_RADAR_6a7e619d_Rx: ComBitPosition=151, ComBitSize=1, ComSignalType=BOOLEAN, ComHandleId=1162, ComSystemTemplateSystemSignalRef=DET_BELOW_RAIN_THOLD_054_Rx
            DET_AZIMUTH_ERR_055_Rx_oRDR_FUSION_DET_053_056_oPCAN_RADAR_a1e9aded_Rx: ComBitPosition=329, ComBitSize=7, ComSignalType=UINT8, ComHandleId=1159, ComSystemTemplateSystemSignalRef=DET_AZIMUTH_ERR_055_Rx
            DET_IDM_054_Rx_oRDR_FUSION_DET_053_056_oPCAN_RADAR_334502e9_Rx: ComBitPosition=175, ComBitSize=1, ComSignalType=BOOLEAN, ComHandleId=1194, ComSystemTemplateSystemSignalRef=DET_IDM_054_Rx
            DET_RANGE_ERR_054_Rx_oRDR_FUSION_DET_053_056_oPCAN_RADAR_4ff04eef_Rx: ComBitPosition=152, ComBitSize=7, ComSignalType=UINT8, ComHandleId=1213, ComSystemTemplateSystemSignalRef=DET_RANGE_ERR_054_Rx
            DET_RANGE_VELOCITY_ERR_055_Rx_oRDR_FUSION_DET_053_056_oPCAN_RADAR_f4d7a374_Rx: ComBitPosition=288, ComBitSize=8, ComSignalType=UINT8, ComHandleId=1222, ComSystemTemplateSystemSignalRef=DET_RANGE_VELOCITY_ERR_055_Rx
            DET_SNR_056_Rx_oRDR_FUSION_DET_053_056_oPCAN_RADAR_839e80cc_Rx: ComBitPosition=456, ComBitSize=8, ComSignalType=UINT8, ComHandleId=1231, ComSystemTemplateSystemSignalRef=DET_SNR_056_Rx
            DET_SNR_054_Rx_oRDR_FUSION_DET_053_056_oPCAN_RADAR_0666a203_Rx: ComBitPosition=232, ComBitSize=8, ComSignalType=UINT8, ComHandleId=1229, ComSystemTemplateSystemSignalRef=DET_SNR_054_Rx
            DET_SNR_053_Rx_oRDR_FUSION_DET_053_056_oPCAN_RADAR_fc5b5154_Rx: ComBitPosition=120, ComBitSize=8, ComSignalType=UINT8, ComHandleId=1228, ComSystemTemplateSystemSignalRef=DET_SNR_053_Rx
            DET_SUPER_RES_TARGET_056_Rx_oRDR_FUSION_DET_053_056_oPCAN_RADAR_4865a1cc_Rx: ComBitPosition=423, ComBitSize=1, ComSignalType=BOOLEAN, ComHandleId=1235, ComSystemTemplateSystemSignalRef=DET_SUPER_RES_TARGET_056_Rx
            DET_RANGE_053_Rx_oRDR_FUSION_DET_053_056_oPCAN_RADAR_e53f3158_Rx: ComBitPosition=24, ComBitSize=15, ComSignalType=UINT16, ComHandleId=1208, ComSystemTemplateSystemSignalRef=DET_RANGE_053_Rx
            DET_EXISTENCE_PROB_054_Rx_oRDR_FUSION_DET_053_056_oPCAN_RADAR_db5a16ee_Rx: ComBitPosition=224, ComBitSize=6, ComSignalType=UINT8, ComHandleId=1186, ComSystemTemplateSystemSignalRef=DET_EXISTENCE_PROB_054_Rx
            DET_CONFD_ELEVATION_055_Rx_oRDR_FUSION_DET_053_056_oPCAN_RADAR_5bec311a_Rx: ComBitPosition=325, ComBitSize=2, ComSignalType=UINT8, ComHandleId=1175, ComSystemTemplateSystemSignalRef=DET_CONFD_ELEVATION_055_Rx
            DET_CONFD_AZIMUTH_053_Rx_oRDR_FUSION_DET_053_056_oPCAN_RADAR_04b4d38d_Rx: ComBitPosition=118, ComBitSize=2, ComSignalType=UINT8, ComHandleId=1169, ComSystemTemplateSystemSignalRef=DET_CONFD_AZIMUTH_053_Rx
            DET_CONFD_ELEVATION_053_Rx_oRDR_FUSION_DET_053_056_oPCAN_RADAR_0e95500a_Rx: ComBitPosition=101, ComBitSize=2, ComSignalType=UINT8, ComHandleId=1173, ComSystemTemplateSystemSignalRef=DET_CONFD_ELEVATION_053_Rx
            DET_AZIMUTH_056_Rx_oRDR_FUSION_DET_053_056_oPCAN_RADAR_893cbce7_Rx: ComBitPosition=424, ComBitSize=13, ComSignalType=UINT16, ComHandleId=1156, ComSystemTemplateSystemSignalRef=DET_AZIMUTH_056_Rx
            DET_AZIMUTH_054_Rx_oRDR_FUSION_DET_053_056_oPCAN_RADAR_0cc49e28_Rx: ComBitPosition=200, ComBitSize=13, ComSignalType=UINT16, ComHandleId=1154, ComSystemTemplateSystemSignalRef=DET_AZIMUTH_054_Rx
            DET_HVC_FLAG_056_Rx_oRDR_FUSION_DET_053_056_oPCAN_RADAR_837cd96e_Rx: ComBitPosition=422, ComBitSize=1, ComSignalType=BOOLEAN, ComHandleId=1192, ComSystemTemplateSystemSignalRef=DET_HVC_FLAG_056_Rx
            DET_HVC_FLAG_054_Rx_oRDR_FUSION_DET_053_056_oPCAN_RADAR_0684fba1_Rx: ComBitPosition=198, ComBitSize=1, ComSignalType=BOOLEAN, ComHandleId=1190, ComSystemTemplateSystemSignalRef=DET_HVC_FLAG_054_Rx
            DET_MTD_055_Rx_oRDR_FUSION_DET_053_056_oPCAN_RADAR_2182a6de_Rx: ComBitPosition=271, ComBitSize=1, ComSignalType=BOOLEAN, ComHandleId=1202, ComSystemTemplateSystemSignalRef=DET_MTD_055_Rx
            DET_SUPER_RES_TARGET_054_Rx_oRDR_FUSION_DET_053_056_oPCAN_RADAR_cd9d8303_Rx: ComBitPosition=199, ComBitSize=1, ComSignalType=BOOLEAN, ComHandleId=1233, ComSystemTemplateSystemSignalRef=DET_SUPER_RES_TARGET_054_Rx
            DET_BI_STATIC_FLAG_053_Rx_oRDR_FUSION_DET_053_056_oPCAN_RADAR_e7dd39d9_Rx: ComBitPosition=104, ComBitSize=1, ComSignalType=BOOLEAN, ComHandleId=1165, ComSystemTemplateSystemSignalRef=DET_BI_STATIC_FLAG_053_Rx
            DET_SUPER_RES_TARGET_055_Rx_oRDR_FUSION_DET_053_056_oPCAN_RADAR_62d91144_Rx: ComBitPosition=311, ComBitSize=1, ComSignalType=BOOLEAN, ComHandleId=1234, ComSystemTemplateSystemSignalRef=DET_SUPER_RES_TARGET_055_Rx
            DET_IDM_055_Rx_oRDR_FUSION_DET_053_056_oPCAN_RADAR_9c0190ae_Rx: ComBitPosition=287, ComBitSize=1, ComSignalType=BOOLEAN, ComHandleId=1195, ComSystemTemplateSystemSignalRef=DET_IDM_055_Rx
            DET_BI_STATIC_FLAG_055_Rx_oRDR_FUSION_DET_053_056_oPCAN_RADAR_b2a458c9_Rx: ComBitPosition=328, ComBitSize=1, ComSignalType=BOOLEAN, ComHandleId=1167, ComSystemTemplateSystemSignalRef=DET_BI_STATIC_FLAG_055_Rx
            DET_MTD_053_Rx_oRDR_FUSION_DET_053_056_oPCAN_RADAR_74fbc7ce_Rx: ComBitPosition=47, ComBitSize=1, ComSignalType=BOOLEAN, ComHandleId=1200, ComSystemTemplateSystemSignalRef=DET_MTD_053_Rx
            DET_EXISTENCE_PROB_053_Rx_oRDR_FUSION_DET_053_056_oPCAN_RADAR_2167e5b9_Rx: ComBitPosition=112, ComBitSize=6, ComSignalType=UINT8, ComHandleId=1185, ComSystemTemplateSystemSignalRef=DET_EXISTENCE_PROB_053_Rx
            DET_RANGE_VELOCITY_056_Rx_oRDR_FUSION_DET_053_056_oPCAN_RADAR_470f633e_Rx: ComBitPosition=384, ComBitSize=15, ComSignalType=UINT16, ComHandleId=1219, ComSystemTemplateSystemSignalRef=DET_RANGE_VELOCITY_056_Rx
            DET_SUPER_RES_TARGET_053_Rx_oRDR_FUSION_DET_053_056_oPCAN_RADAR_37a07054_Rx: ComBitPosition=87, ComBitSize=1, ComSignalType=BOOLEAN, ComHandleId=1232, ComSystemTemplateSystemSignalRef=DET_SUPER_RES_TARGET_053_Rx
            DET_RANGE_VELOCITY_ERR_053_Rx_oRDR_FUSION_DET_053_056_oPCAN_RADAR_a1aec264_Rx: ComBitPosition=64, ComBitSize=8, ComSignalType=UINT8, ComHandleId=1220, ComSystemTemplateSystemSignalRef=DET_RANGE_VELOCITY_ERR_053_Rx
            DET_CONFD_AZIMUTH_054_Rx_oRDR_FUSION_DET_053_056_oPCAN_RADAR_fe8920da_Rx: ComBitPosition=230, ComBitSize=2, ComSignalType=UINT8, ComHandleId=1170, ComSystemTemplateSystemSignalRef=DET_CONFD_AZIMUTH_054_Rx
            DET_RANGE_VELOCITY_053_Rx_oRDR_FUSION_DET_053_056_oPCAN_RADAR_38cab2a6_Rx: ComBitPosition=48, ComBitSize=15, ComSignalType=UINT16, ComHandleId=1216, ComSystemTemplateSystemSignalRef=DET_RANGE_VELOCITY_053_Rx
            DET_ELEVATION_055_Rx_oRDR_FUSION_DET_053_056_oPCAN_RADAR_51bfdee3_Rx: ComBitPosition=296, ComBitSize=8, ComSignalType=UINT8, ComHandleId=1179, ComSystemTemplateSystemSignalRef=DET_ELEVATION_055_Rx
            DET_AZIMUTH_055_Rx_oRDR_FUSION_DET_053_056_oPCAN_RADAR_a3800c6f_Rx: ComBitPosition=312, ComBitSize=13, ComSignalType=UINT16, ComHandleId=1155, ComSystemTemplateSystemSignalRef=DET_AZIMUTH_055_Rx
            DET_ELEVATION_053_Rx_oRDR_FUSION_DET_053_056_oPCAN_RADAR_04c6bff3_Rx: ComBitPosition=72, ComBitSize=8, ComSignalType=UINT8, ComHandleId=1177, ComSystemTemplateSystemSignalRef=DET_ELEVATION_053_Rx
            DET_EXISTENCE_PROB_055_Rx_oRDR_FUSION_DET_053_056_oPCAN_RADAR_741e84a9_Rx: ComBitPosition=336, ComBitSize=6, ComSignalType=UINT8, ComHandleId=1187, ComSystemTemplateSystemSignalRef=DET_EXISTENCE_PROB_055_Rx
            DET_MH_CRC16_053_056_Rx_oRDR_FUSION_DET_053_056_oPCAN_RADAR_c497f294_Rx: ComBitPosition=0, ComBitSize=16, ComSignalType=UINT16, ComHandleId=1197, ComSystemTemplateSystemSignalRef=DET_MH_CRC16_053_056_Rx
            DET_RANGE_VELOCITY_ERR_056_Rx_oRDR_FUSION_DET_053_056_oPCAN_RADAR_de6b13fc_Rx: ComBitPosition=400, ComBitSize=8, ComSignalType=UINT8, ComHandleId=1223, ComSystemTemplateSystemSignalRef=DET_RANGE_VELOCITY_ERR_056_Rx
            DET_ELEVATION_ERR_054_Rx_oRDR_FUSION_DET_053_056_oPCAN_RADAR_2c426e7b_Rx: ComBitPosition=192, ComBitSize=6, ComSignalType=UINT8, ComHandleId=1182, ComSystemTemplateSystemSignalRef=DET_ELEVATION_ERR_054_Rx
            DET_RANGE_054_Rx_oRDR_FUSION_DET_053_056_oPCAN_RADAR_1f02c20f_Rx: ComBitPosition=136, ComBitSize=15, ComSignalType=UINT16, ComHandleId=1209, ComSystemTemplateSystemSignalRef=DET_RANGE_054_Rx
            DET_AZIMUTH_ERR_056_Rx_oRDR_FUSION_DET_053_056_oPCAN_RADAR_8b551d65_Rx: ComBitPosition=441, ComBitSize=7, ComSignalType=UINT8, ComHandleId=1160, ComSystemTemplateSystemSignalRef=DET_AZIMUTH_ERR_056_Rx
            DET_CONFD_ELEVATION_054_Rx_oRDR_FUSION_DET_053_056_oPCAN_RADAR_f4a8a35d_Rx: ComBitPosition=213, ComBitSize=2, ComSignalType=UINT8, ComHandleId=1174, ComSystemTemplateSystemSignalRef=DET_CONFD_ELEVATION_054_Rx
            DET_MTD_054_Rx_oRDR_FUSION_DET_053_056_oPCAN_RADAR_8ec63499_Rx: ComBitPosition=159, ComBitSize=1, ComSignalType=BOOLEAN, ComHandleId=1201, ComSystemTemplateSystemSignalRef=DET_MTD_054_Rx
            DET_RCS_053_Rx_oRDR_FUSION_DET_053_056_oPCAN_RADAR_f50120bd_Rx: ComBitPosition=128, ComBitSize=8, ComSignalType=UINT8, ComHandleId=1224, ComSystemTemplateSystemSignalRef=DET_RCS_053_Rx
            DET_CONFD_AZIMUTH_056_Rx_oRDR_FUSION_DET_053_056_oPCAN_RADAR_7b710215_Rx: ComBitPosition=454, ComBitSize=2, ComSignalType=UINT8, ComHandleId=1172, ComSystemTemplateSystemSignalRef=DET_CONFD_AZIMUTH_056_Rx
            DET_RANGE_VELOCITY_055_Rx_oRDR_FUSION_DET_053_056_oPCAN_RADAR_6db3d3b6_Rx: ComBitPosition=272, ComBitSize=15, ComSignalType=UINT16, ComHandleId=1218, ComSystemTemplateSystemSignalRef=DET_RANGE_VELOCITY_055_Rx
            DET_RANGE_056_Rx_oRDR_FUSION_DET_053_056_oPCAN_RADAR_9afae0c0_Rx: ComBitPosition=360, ComBitSize=15, ComSignalType=UINT16, ComHandleId=1211, ComSystemTemplateSystemSignalRef=DET_RANGE_056_Rx
            DET_RANGE_VELOCITY_054_Rx_oRDR_FUSION_DET_053_056_oPCAN_RADAR_c2f741f1_Rx: ComBitPosition=160, ComBitSize=15, ComSignalType=UINT16, ComHandleId=1217, ComSystemTemplateSystemSignalRef=DET_RANGE_VELOCITY_054_Rx
            DET_AZIMUTH_053_Rx_oRDR_FUSION_DET_053_056_oPCAN_RADAR_f6f96d7f_Rx: ComBitPosition=88, ComBitSize=13, ComSignalType=UINT16, ComHandleId=1153, ComSystemTemplateSystemSignalRef=DET_AZIMUTH_053_Rx
            DET_IDM_056_Rx_oRDR_FUSION_DET_053_056_oPCAN_RADAR_b6bd2026_Rx: ComBitPosition=399, ComBitSize=1, ComSignalType=BOOLEAN, ComHandleId=1196, ComSystemTemplateSystemSignalRef=DET_IDM_056_Rx
            DET_AZIMUTH_ERR_054_Rx_oRDR_FUSION_DET_053_056_oPCAN_RADAR_0ead3faa_Rx: ComBitPosition=217, ComBitSize=7, ComSignalType=UINT8, ComHandleId=1158, ComSystemTemplateSystemSignalRef=DET_AZIMUTH_ERR_054_Rx
            DET_RCS_056_Rx_oRDR_FUSION_DET_053_056_oPCAN_RADAR_8ac4f125_Rx: ComBitPosition=464, ComBitSize=8, ComSignalType=UINT8, ComHandleId=1227, ComSystemTemplateSystemSignalRef=DET_RCS_056_Rx
            DET_ELEVATION_ERR_055_Rx_oRDR_FUSION_DET_053_056_oPCAN_RADAR_8306fc3c_Rx: ComBitPosition=304, ComBitSize=6, ComSignalType=UINT8, ComHandleId=1183, ComSystemTemplateSystemSignalRef=DET_ELEVATION_ERR_055_Rx
            DET_RCS_054_Rx_oRDR_FUSION_DET_053_056_oPCAN_RADAR_0f3cd3ea_Rx: ComBitPosition=240, ComBitSize=8, ComSignalType=UINT8, ComHandleId=1225, ComSystemTemplateSystemSignalRef=DET_RCS_054_Rx
            DET_HVC_FLAG_053_Rx_oRDR_FUSION_DET_053_056_oPCAN_RADAR_fcb908f6_Rx: ComBitPosition=86, ComBitSize=1, ComSignalType=BOOLEAN, ComHandleId=1189, ComSystemTemplateSystemSignalRef=DET_HVC_FLAG_053_Rx
            DET_ELEVATION_ERR_056_Rx_oRDR_FUSION_DET_053_056_oPCAN_RADAR_a9ba4cb4_Rx: ComBitPosition=416, ComBitSize=6, ComSignalType=UINT8, ComHandleId=1184, ComSystemTemplateSystemSignalRef=DET_ELEVATION_ERR_056_Rx
            DET_PROB_1STAZHYPO_053_Rx_oRDR_FUSION_DET_053_056_oPCAN_RADAR_be82d94f_Rx: ComBitPosition=103, ComBitSize=1, ComSignalType=BOOLEAN, ComHandleId=1204, ComSystemTemplateSystemSignalRef=DET_PROB_1STAZHYPO_053_Rx
            DET_RANGE_055_Rx_oRDR_FUSION_DET_053_056_oPCAN_RADAR_b0465048_Rx: ComBitPosition=248, ComBitSize=15, ComSignalType=UINT16, ComHandleId=1210, ComSystemTemplateSystemSignalRef=DET_RANGE_055_Rx
            DET_EXISTENCE_PROB_056_Rx_oRDR_FUSION_DET_053_056_oPCAN_RADAR_5ea23421_Rx: ComBitPosition=448, ComBitSize=6, ComSignalType=UINT8, ComHandleId=1188, ComSystemTemplateSystemSignalRef=DET_EXISTENCE_PROB_056_Rx
            DET_PROB_1STAZHYPO_054_Rx_oRDR_FUSION_DET_053_056_oPCAN_RADAR_44bf2a18_Rx: ComBitPosition=215, ComBitSize=1, ComSignalType=BOOLEAN, ComHandleId=1205, ComSystemTemplateSystemSignalRef=DET_PROB_1STAZHYPO_054_Rx
            DET_CONFD_AZIMUTH_055_Rx_oRDR_FUSION_DET_053_056_oPCAN_RADAR_51cdb29d_Rx: ComBitPosition=342, ComBitSize=2, ComSignalType=UINT8, ComHandleId=1171, ComSystemTemplateSystemSignalRef=DET_CONFD_AZIMUTH_055_Rx
            DET_BELOW_RAIN_THOLD_056_Rx_oRDR_FUSION_DET_053_056_oPCAN_RADAR_ef864352_Rx: ComBitPosition=375, ComBitSize=1, ComSignalType=BOOLEAN, ComHandleId=1164, ComSystemTemplateSystemSignalRef=DET_BELOW_RAIN_THOLD_056_Rx
            DET_RCS_055_Rx_oRDR_FUSION_DET_053_056_oPCAN_RADAR_a07841ad_Rx: ComBitPosition=352, ComBitSize=8, ComSignalType=UINT8, ComHandleId=1226, ComSystemTemplateSystemSignalRef=DET_RCS_055_Rx
            DET_ELEVATION_ERR_053_Rx_oRDR_FUSION_DET_053_056_oPCAN_RADAR_d67f9d2c_Rx: ComBitPosition=80, ComBitSize=6, ComSignalType=UINT8, ComHandleId=1181, ComSystemTemplateSystemSignalRef=DET_ELEVATION_ERR_053_Rx
            DET_MTD_056_Rx_oRDR_FUSION_DET_053_056_oPCAN_RADAR_0b3e1656_Rx: ComBitPosition=383, ComBitSize=1, ComSignalType=BOOLEAN, ComHandleId=1203, ComSystemTemplateSystemSignalRef=DET_MTD_056_Rx
            DET_AZIMUTH_ERR_053_Rx_oRDR_FUSION_DET_053_056_oPCAN_RADAR_f490ccfd_Rx: ComBitPosition=105, ComBitSize=7, ComSignalType=UINT8, ComHandleId=1157, ComSystemTemplateSystemSignalRef=DET_AZIMUTH_ERR_053_Rx
            DET_ELEVATION_054_Rx_oRDR_FUSION_DET_053_056_oPCAN_RADAR_fefb4ca4_Rx: ComBitPosition=184, ComBitSize=8, ComSignalType=UINT8, ComHandleId=1178, ComSystemTemplateSystemSignalRef=DET_ELEVATION_054_Rx
            DET_RANGE_VELOCITY_ERR_054_Rx_oRDR_FUSION_DET_053_056_oPCAN_RADAR_5b933133_Rx: ComBitPosition=176, ComBitSize=8, ComSignalType=UINT8, ComHandleId=1221, ComSystemTemplateSystemSignalRef=DET_RANGE_VELOCITY_ERR_054_Rx
