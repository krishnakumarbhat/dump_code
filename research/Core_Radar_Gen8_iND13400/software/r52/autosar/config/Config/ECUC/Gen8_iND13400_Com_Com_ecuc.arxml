[part 13 of 20: package /ActiveEcuC]
AUTOSAR XML (schema 00053)
package /ActiveEcuC  (continued)
  module config Com: implementation-config-variant=VARIANT-PRE-COMPILE, module-description=Com_Impl  (continued)
    ComConfig: ComConfigurationId=0, ComRxImmediateNotificationCacheSize=0, ComRxDeferredNotificationCacheSize=1  (continued)
      109 x ComSignalGroup, all with ComSignalGroupAccess=ACCESS_NEEDED_BY_SWC_OR_COM, ComSignalGroupArrayAccess=true:  (continued)
        SG_Detections_233_236_oRDR_DETECTION_233_236_oPCAN_RADAR_b5df088e_Tx: ComTransferProperty=TRIGGERED, ComHandleId=60, ComSystemTemplateSignalGroupRef=SG_Detections_233_236
          83 x ComGroupSignal, all with ComSignalEndianness=LITTLE_ENDIAN, ComTransferProperty=PENDING, ComSignalAccess=ACCESS_NEEDED_BY_SWC_OR_COM:
            DET_SUPER_RES_TARGET_234_oRDR_DETECTION_233_236_oPCAN_RADAR_03831b56_Tx: ComBitPosition=199, ComBitSize=1, ComSignalInitValue=0, ComSignalType=BOOLEAN, ComHandleId=4955, ComSystemTemplateSystemSignalRef=DET_SUPER_RES_TARGET_234
            DET_AZIMUTH_234_oRDR_DETECTION_233_236_oPCAN_RADAR_0d09e1f5_Tx: ComBitPosition=200, ComBitSize=13, ComSignalInitValue=0, ComSignalType=UINT16, ComHandleId=4876, ComSystemTemplateSystemSignalRef=DET_AZIMUTH_234
            DET_RANGE_VELOCITY_235_oRDR_DETECTION_233_236_oPCAN_RADAR_fd4484fe_Tx: ComBitPosition=272, ComBitSize=15, ComSignalInitValue=16384, ComSignalType=UINT16, ComHandleId=4940, ComSystemTemplateSystemSignalRef=DET_RANGE_VELOCITY_235
            DET_CONFD_ELEVATION_233_oRDR_DETECTION_233_236_oPCAN_RADAR_51cac9ac_Tx: ComBitPosition=101, ComBitSize=2, ComSignalInitValue=0, ComSignalType=UINT8, ComHandleId=4895, ComSystemTemplateSystemSignalRef=DET_CONFD_ELEVATION_233
            DET_SUPER_RES_TARGET_236_oRDR_DETECTION_233_236_oPCAN_RADAR_f213b43d_Tx: ComBitPosition=423, ComBitSize=1, ComSignalInitValue=0, ComSignalType=BOOLEAN, ComHandleId=4957, ComSystemTemplateSystemSignalRef=DET_SUPER_RES_TARGET_236
            DET_CONFD_ELEVATION_236_oRDR_DETECTION_233_236_oPCAN_RADAR_fcea45ae_Tx: ComBitPosition=437, ComBitSize=2, ComSignalInitValue=0, ComSignalType=UINT8, ComHandleId=4898, ComSystemTemplateSystemSignalRef=DET_CONFD_ELEVATION_236
            DET_ELEVATION_234_oRDR_DETECTION_233_236_oPCAN_RADAR_dcba3ef9_Tx: ComBitPosition=184, ComBitSize=8, ComSignalInitValue=0, ComSignalType=UINT8, ComHandleId=4900, ComSystemTemplateSystemSignalRef=DET_ELEVATION_234
            DET_RANGE_VELOCITY_233_oRDR_DETECTION_233_236_oPCAN_RADAR_34847302_Tx: ComBitPosition=48, ComBitSize=15, ComSignalInitValue=16384, ComSignalType=UINT16, ComHandleId=4938, ComSystemTemplateSystemSignalRef=DET_RANGE_VELOCITY_233
            DET_RANGE_VELOCITY_ERR_236_oRDR_DETECTION_233_236_oPCAN_RADAR_961f04b2_Tx: ComBitPosition=400, ComBitSize=8, ComSignalInitValue=0, ComSignalType=UINT8, ComHandleId=4945, ComSystemTemplateSystemSignalRef=DET_RANGE_VELOCITY_ERR_236
            DET_SNR_236_oRDR_DETECTION_233_236_oPCAN_RADAR_c38a9c58_Tx: ComBitPosition=456, ComBitSize=8, ComSignalInitValue=0, ComSignalType=UINT8, ComHandleId=4953, ComSystemTemplateSystemSignalRef=DET_SNR_236
            DET_BI_STATIC_FLAG_235_oRDR_DETECTION_233_236_oPCAN_RADAR_ce5575e5_Tx: ComBitPosition=328, ComBitSize=1, ComSignalInitValue=0, ComSignalType=BOOLEAN, ComHandleId=4889, ComSystemTemplateSystemSignalRef=DET_BI_STATIC_FLAG_235
            DET_ELEVATION_233_oRDR_DETECTION_233_236_oPCAN_RADAR_800a1d90_Tx: ComBitPosition=72, ComBitSize=8, ComSignalInitValue=0, ComSignalType=UINT8, ComHandleId=4899, ComSystemTemplateSystemSignalRef=DET_ELEVATION_233
            DET_ELEVATION_ERR_234_oRDR_DETECTION_233_236_oPCAN_RADAR_5b83a68c_Tx: ComBitPosition=192, ComBitSize=6, ComSignalInitValue=0, ComSignalType=UINT8, ComHandleId=4904, ComSystemTemplateSystemSignalRef=DET_ELEVATION_ERR_234
            DET_SNR_235_oRDR_DETECTION_233_236_oPCAN_RADAR_a76ae7a6_Tx: ComBitPosition=344, ComBitSize=8, ComSignalInitValue=0, ComSignalType=UINT8, ComHandleId=4952, ComSystemTemplateSystemSignalRef=DET_SNR_235
            DET_RANGE_VELOCITY_ERR_233_oRDR_DETECTION_233_236_oPCAN_RADAR_3b3f88b0_Tx: ComBitPosition=64, ComBitSize=8, ComSignalInitValue=0, ComSignalType=UINT8, ComHandleId=4942, ComSystemTemplateSystemSignalRef=DET_RANGE_VELOCITY_ERR_233
            DET_RANGE_VELOCITY_ERR_235_oRDR_DETECTION_233_236_oPCAN_RADAR_f2ff7f4c_Tx: ComBitPosition=288, ComBitSize=8, ComSignalInitValue=0, ComSignalType=UINT8, ComHandleId=4944, ComSystemTemplateSystemSignalRef=DET_RANGE_VELOCITY_ERR_235
            DET_BI_STATIC_FLAG_234_oRDR_DETECTION_233_236_oPCAN_RADAR_5b25a170_Tx: ComBitPosition=216, ComBitSize=1, ComSignalInitValue=0, ComSignalType=BOOLEAN, ComHandleId=4888, ComSystemTemplateSystemSignalRef=DET_BI_STATIC_FLAG_234
            DET_RCS_235_oRDR_DETECTION_233_236_oPCAN_RADAR_7ac4b3a4_Tx: ComBitPosition=352, ComBitSize=8, ComSignalInitValue=128, ComSignalType=UINT8, ComHandleId=4948, ComSystemTemplateSystemSignalRef=DET_RCS_235
            DET_BI_STATIC_FLAG_236_oRDR_DETECTION_233_236_oPCAN_RADAR_aab50e1b_Tx: ComBitPosition=440, ComBitSize=1, ComSignalInitValue=0, ComSignalType=BOOLEAN, ComHandleId=4890, ComSystemTemplateSystemSignalRef=DET_BI_STATIC_FLAG_236
            DET_AZIMUTH_233_oRDR_DETECTION_233_236_oPCAN_RADAR_51b9c29c_Tx: ComBitPosition=88, ComBitSize=13, ComSignalInitValue=0, ComSignalType=UINT16, ComHandleId=4875, ComSystemTemplateSystemSignalRef=DET_AZIMUTH_233
            DET_RANGE_ERR_234_oRDR_DETECTION_233_236_oPCAN_RADAR_ba7a2827_Tx: ComBitPosition=152, ComBitSize=7, ComSignalInitValue=0, ComSignalType=UINT8, ComHandleId=4935, ComSystemTemplateSystemSignalRef=DET_RANGE_ERR_234
            DET_SNR_233_oRDR_DETECTION_233_236_oPCAN_RADAR_6eaa105a_Tx: ComBitPosition=120, ComBitSize=8, ComSignalInitValue=0, ComSignalType=UINT8, ComHandleId=4950, ComSystemTemplateSystemSignalRef=DET_SNR_233
            DET_RANGE_VELOCITY_236_oRDR_DETECTION_233_236_oPCAN_RADAR_99a4ff00_Tx: ComBitPosition=384, ComBitSize=15, ComSignalInitValue=16384, ComSignalType=UINT16, ComHandleId=4941, ComSystemTemplateSystemSignalRef=DET_RANGE_VELOCITY_236
            DET_RCS_233_oRDR_DETECTION_233_236_oPCAN_RADAR_b3044458_Tx: ComBitPosition=128, ComBitSize=8, ComSignalInitValue=128, ComSignalType=UINT8, ComHandleId=4946, ComSystemTemplateSystemSignalRef=DET_RCS_233
            DET_ELEVATION_ERR_236_oRDR_DETECTION_233_236_oPCAN_RADAR_aa1309e7_Tx: ComBitPosition=416, ComBitSize=6, ComSignalInitValue=0, ComSignalType=UINT8, ComHandleId=4906, ComSystemTemplateSystemSignalRef=DET_ELEVATION_ERR_236
            DET_CONFD_AZIMUTH_234_oRDR_DETECTION_233_236_oPCAN_RADAR_0fefeb3f_Tx: ComBitPosition=230, ComBitSize=2, ComSignalInitValue=0, ComSignalType=UINT8, ComHandleId=4892, ComSystemTemplateSystemSignalRef=DET_CONFD_AZIMUTH_234
            DET_EXISTENCE_PROB_234_oRDR_DETECTION_233_236_oPCAN_RADAR_891cd3ec_Tx: ComBitPosition=224, ComBitSize=6, ComSignalInitValue=0, ComSignalType=UINT8, ComHandleId=4908, ComSystemTemplateSystemSignalRef=DET_EXISTENCE_PROB_234
            DET_CONFD_AZIMUTH_235_oRDR_DETECTION_233_236_oPCAN_RADAR_9a9f3faa_Tx: ComBitPosition=342, ComBitSize=2, ComSignalInitValue=0, ComSignalType=UINT8, ComHandleId=4893, ComSystemTemplateSystemSignalRef=DET_CONFD_AZIMUTH_235
            DET_ELEVATION_236_oRDR_DETECTION_233_236_oPCAN_RADAR_2d2a9192_Tx: ComBitPosition=408, ComBitSize=8, ComSignalInitValue=0, ComSignalType=UINT8, ComHandleId=4902, ComSystemTemplateSystemSignalRef=DET_ELEVATION_236
            DET_RANGE_235_oRDR_DETECTION_233_236_oPCAN_RADAR_88e246db_Tx: ComBitPosition=248, ComBitSize=15, ComSignalInitValue=0, ComSignalType=UINT16, ComHandleId=4932, ComSystemTemplateSystemSignalRef=DET_RANGE_235
            DET_RANGE_VELOCITY_ERR_234_oRDR_DETECTION_233_236_oPCAN_RADAR_678fabd9_Tx: ComBitPosition=176, ComBitSize=8, ComSignalInitValue=0, ComSignalType=UINT8, ComHandleId=4943, ComSystemTemplateSystemSignalRef=DET_RANGE_VELOCITY_ERR_234
            DET_CONFD_ELEVATION_235_oRDR_DETECTION_233_236_oPCAN_RADAR_980a3e50_Tx: ComBitPosition=325, ComBitSize=2, ComSignalInitValue=0, ComSignalType=UINT8, ComHandleId=4897, ComSystemTemplateSystemSignalRef=DET_CONFD_ELEVATION_235
            DET_CONFD_AZIMUTH_233_oRDR_DETECTION_233_236_oPCAN_RADAR_535fc856_Tx: ComBitPosition=118, ComBitSize=2, ComSignalInitValue=0, ComSignalType=UINT8, ComHandleId=4891, ComSystemTemplateSystemSignalRef=DET_CONFD_AZIMUTH_233
            DET_SNR_234_oRDR_DETECTION_233_236_oPCAN_RADAR_321a3333_Tx: ComBitPosition=232, ComBitSize=8, ComSignalInitValue=0, ComSignalType=UINT8, ComHandleId=4951, ComSystemTemplateSystemSignalRef=DET_SNR_234
            DET_HVC_FLAG_234_oRDR_DETECTION_233_236_oPCAN_RADAR_68689093_Tx: ComBitPosition=198, ComBitSize=1, ComSignalInitValue=0, ComSignalType=BOOLEAN, ComHandleId=4912, ComSystemTemplateSystemSignalRef=DET_HVC_FLAG_234
            DET_MH_SCAN_INDEX_4LSB_233_236_oRDR_DETECTION_233_236_oPCAN_RADAR_79085e3e_Tx: ComBitPosition=476, ComBitSize=4, ComSignalInitValue=0, ComSignalType=UINT8, ComHandleId=4921, ComSystemTemplateSystemSignalRef=DET_MH_SCAN_INDEX_4LSB_233_236
            DET_AZIMUTH_ERR_234_oRDR_DETECTION_233_236_oPCAN_RADAR_a9bc7400_Tx: ComBitPosition=217, ComBitSize=7, ComSignalInitValue=0, ComSignalType=UINT8, ComHandleId=4880, ComSystemTemplateSystemSignalRef=DET_AZIMUTH_ERR_234
            DET_HVC_FLAG_235_oRDR_DETECTION_233_236_oPCAN_RADAR_fd184406_Tx: ComBitPosition=310, ComBitSize=1, ComSignalInitValue=0, ComSignalType=BOOLEAN, ComHandleId=4913, ComSystemTemplateSystemSignalRef=DET_HVC_FLAG_235
            DET_ELEVATION_235_oRDR_DETECTION_233_236_oPCAN_RADAR_49caea6c_Tx: ComBitPosition=296, ComBitSize=8, ComSignalInitValue=0, ComSignalType=UINT8, ComHandleId=4901, ComSystemTemplateSystemSignalRef=DET_ELEVATION_235
            DET_RCS_236_oRDR_DETECTION_233_236_oPCAN_RADAR_1e24c85a_Tx: ComBitPosition=464, ComBitSize=8, ComSignalInitValue=128, ComSignalType=UINT8, ComHandleId=4949, ComSystemTemplateSystemSignalRef=DET_RCS_236
            DET_EXISTENCE_PROB_236_oRDR_DETECTION_233_236_oPCAN_RADAR_788c7c87_Tx: ComBitPosition=448, ComBitSize=6, ComSignalInitValue=0, ComSignalType=UINT8, ComHandleId=4910, ComSystemTemplateSystemSignalRef=DET_EXISTENCE_PROB_236
            DET_HVC_FLAG_236_oRDR_DETECTION_233_236_oPCAN_RADAR_99f83ff8_Tx: ComBitPosition=422, ComBitSize=1, ComSignalInitValue=0, ComSignalType=BOOLEAN, ComHandleId=4914, ComSystemTemplateSystemSignalRef=DET_HVC_FLAG_236
            DET_RCS_234_oRDR_DETECTION_233_236_oPCAN_RADAR_efb46731_Tx: ComBitPosition=240, ComBitSize=8, ComSignalInitValue=128, ComSignalType=UINT8, ComHandleId=4947, ComSystemTemplateSystemSignalRef=DET_RCS_234
            DET_ELEVATION_ERR_235_oRDR_DETECTION_233_236_oPCAN_RADAR_cef37219_Tx: ComBitPosition=304, ComBitSize=6, ComSignalInitValue=0, ComSignalType=UINT8, ComHandleId=4905, ComSystemTemplateSystemSignalRef=DET_ELEVATION_ERR_235
            DET_RANGE_ERR_233_oRDR_DETECTION_233_236_oPCAN_RADAR_e6ca0b4e_Tx: ComBitPosition=40, ComBitSize=7, ComSignalInitValue=0, ComSignalType=UINT8, ComHandleId=4934, ComSystemTemplateSystemSignalRef=DET_RANGE_ERR_233
            DET_CONFD_AZIMUTH_236_oRDR_DETECTION_233_236_oPCAN_RADAR_fe7f4454_Tx: ComBitPosition=454, ComBitSize=2, ComSignalInitValue=0, ComSignalType=UINT8, ComHandleId=4894, ComSystemTemplateSystemSignalRef=DET_CONFD_AZIMUTH_236
            DET_AZIMUTH_ERR_236_oRDR_DETECTION_233_236_oPCAN_RADAR_582cdb6b_Tx: ComBitPosition=441, ComBitSize=7, ComSignalInitValue=0, ComSignalType=UINT8, ComHandleId=4882, ComSystemTemplateSystemSignalRef=DET_AZIMUTH_ERR_236
            DET_HVC_FLAG_233_oRDR_DETECTION_233_236_oPCAN_RADAR_34d8b3fa_Tx: ComBitPosition=86, ComBitSize=1, ComSignalInitValue=0, ComSignalType=BOOLEAN, ComHandleId=4911, ComSystemTemplateSystemSignalRef=DET_HVC_FLAG_233
            DET_RANGE_236_oRDR_DETECTION_233_236_oPCAN_RADAR_ec023d25_Tx: ComBitPosition=360, ComBitSize=15, ComSignalInitValue=0, ComSignalType=UINT16, ComHandleId=4933, ComSystemTemplateSystemSignalRef=DET_RANGE_236
            DET_RANGE_233_oRDR_DETECTION_233_236_oPCAN_RADAR_4122b127_Tx: ComBitPosition=24, ComBitSize=15, ComSignalInitValue=0, ComSignalType=UINT16, ComHandleId=4930, ComSystemTemplateSystemSignalRef=DET_RANGE_233
            DET_RANGE_VELOCITY_234_oRDR_DETECTION_233_236_oPCAN_RADAR_6834506b_Tx: ComBitPosition=160, ComBitSize=15, ComSignalInitValue=16384, ComSignalType=UINT16, ComHandleId=4939, ComSystemTemplateSystemSignalRef=DET_RANGE_VELOCITY_234
            DET_BI_STATIC_FLAG_233_oRDR_DETECTION_233_236_oPCAN_RADAR_07958219_Tx: ComBitPosition=104, ComBitSize=1, ComSignalInitValue=0, ComSignalType=BOOLEAN, ComHandleId=4887, ComSystemTemplateSystemSignalRef=DET_BI_STATIC_FLAG_233
            DET_EXISTENCE_PROB_235_oRDR_DETECTION_233_236_oPCAN_RADAR_1c6c0779_Tx: ComBitPosition=336, ComBitSize=6, ComSignalInitValue=0, ComSignalType=UINT8, ComHandleId=4909, ComSystemTemplateSystemSignalRef=DET_EXISTENCE_PROB_235
            DET_AZIMUTH_235_oRDR_DETECTION_233_236_oPCAN_RADAR_98793560_Tx: ComBitPosition=312, ComBitSize=13, ComSignalInitValue=0, ComSignalType=UINT16, ComHandleId=4877, ComSystemTemplateSystemSignalRef=DET_AZIMUTH_235
            DET_SUPER_RES_TARGET_233_oRDR_DETECTION_233_236_oPCAN_RADAR_5f33383f_Tx: ComBitPosition=87, ComBitSize=1, ComSignalInitValue=0, ComSignalType=BOOLEAN, ComHandleId=4954, ComSystemTemplateSystemSignalRef=DET_SUPER_RES_TARGET_233
            DET_RANGE_ERR_235_oRDR_DETECTION_233_236_oPCAN_RADAR_2f0afcb2_Tx: ComBitPosition=264, ComBitSize=7, ComSignalInitValue=0, ComSignalType=UINT8, ComHandleId=4936, ComSystemTemplateSystemSignalRef=DET_RANGE_ERR_235
            DET_RANGE_234_oRDR_DETECTION_233_236_oPCAN_RADAR_1d92924e_Tx: ComBitPosition=136, ComBitSize=15, ComSignalInitValue=0, ComSignalType=UINT16, ComHandleId=4931, ComSystemTemplateSystemSignalRef=DET_RANGE_234
            DET_AZIMUTH_236_oRDR_DETECTION_233_236_oPCAN_RADAR_fc994e9e_Tx: ComBitPosition=424, ComBitSize=13, ComSignalInitValue=0, ComSignalType=UINT16, ComHandleId=4878, ComSystemTemplateSystemSignalRef=DET_AZIMUTH_236
            DET_AZIMUTH_ERR_235_oRDR_DETECTION_233_236_oPCAN_RADAR_3ccca095_Tx: ComBitPosition=329, ComBitSize=7, ComSignalInitValue=0, ComSignalType=UINT8, ComHandleId=4881, ComSystemTemplateSystemSignalRef=DET_AZIMUTH_ERR_235
            DET_ELEVATION_ERR_233_oRDR_DETECTION_233_236_oPCAN_RADAR_073385e5_Tx: ComBitPosition=80, ComBitSize=6, ComSignalInitValue=0, ComSignalType=UINT8, ComHandleId=4903, ComSystemTemplateSystemSignalRef=DET_ELEVATION_ERR_233
            DET_CONFD_ELEVATION_234_oRDR_DETECTION_233_236_oPCAN_RADAR_0d7aeac5_Tx: ComBitPosition=213, ComBitSize=2, ComSignalInitValue=0, ComSignalType=UINT8, ComHandleId=4896, ComSystemTemplateSystemSignalRef=DET_CONFD_ELEVATION_234
            DET_RANGE_ERR_236_oRDR_DETECTION_233_236_oPCAN_RADAR_4bea874c_Tx: ComBitPosition=376, ComBitSize=7, ComSignalInitValue=0, ComSignalType=UINT8, ComHandleId=4937, ComSystemTemplateSystemSignalRef=DET_RANGE_ERR_236
            DET_EXISTENCE_PROB_233_oRDR_DETECTION_233_236_oPCAN_RADAR_d5acf085_Tx: ComBitPosition=112, ComBitSize=6, ComSignalInitValue=0, ComSignalType=UINT8, ComHandleId=4907, ComSystemTemplateSystemSignalRef=DET_EXISTENCE_PROB_233
            DET_MH_CRC16_233_236_oRDR_DETECTION_233_236_oPCAN_RADAR_3157da85_Tx: ComBitPosition=0, ComBitSize=16, ComSignalInitValue=0, ComSignalType=UINT16, ComHandleId=4919, ComSystemTemplateSystemSignalRef=DET_MH_CRC16_233_236
            DET_AZIMUTH_ERR_233_oRDR_DETECTION_233_236_oPCAN_RADAR_f50c5769_Tx: ComBitPosition=105, ComBitSize=7, ComSignalInitValue=0, ComSignalType=UINT8, ComHandleId=4879, ComSystemTemplateSystemSignalRef=DET_AZIMUTH_ERR_233
            DET_MH_CYCLE_COUNTER_233_236_oRDR_DETECTION_233_236_oPCAN_RADAR_b5227bb2_Tx: ComBitPosition=16, ComBitSize=8, ComSignalInitValue=0, ComSignalType=UINT8, ComHandleId=4920, ComSystemTemplateSystemSignalRef=DET_MH_CYCLE_COUNTER_233_236
            DET_SUPER_RES_TARGET_235_oRDR_DETECTION_233_236_oPCAN_RADAR_96f3cfc3_Tx: ComBitPosition=311, ComBitSize=1, ComSignalInitValue=0, ComSignalType=BOOLEAN, ComHandleId=4956, ComSystemTemplateSystemSignalRef=DET_SUPER_RES_TARGET_235
            DET_MTD_236_oRDR_DETECTION_233_236_oPCAN_RADAR_7419369e_Tx: ComBitPosition=383, ComBitSize=1, ComSignalInitValue=0, ComSignalType=UINT8, ComHandleId=4925, ComSystemTemplateSystemSignalRef=DET_MTD_236
            DET_MTD_234_oRDR_DETECTION_233_236_oPCAN_RADAR_858999f5_Tx: ComBitPosition=159, ComBitSize=1, ComSignalInitValue=0, ComSignalType=UINT8, ComHandleId=4923, ComSystemTemplateSystemSignalRef=DET_MTD_234
            DET_IDM_234_oRDR_DETECTION_233_236_oPCAN_RADAR_e33aab2e_Tx: ComBitPosition=175, ComBitSize=1, ComSignalInitValue=0, ComSignalType=UINT8, ComHandleId=4916, ComSystemTemplateSystemSignalRef=DET_IDM_234
            DET_IDM_233_oRDR_DETECTION_233_236_oPCAN_RADAR_bf8a8847_Tx: ComBitPosition=63, ComBitSize=1, ComSignalInitValue=0, ComSignalType=UINT8, ComHandleId=4915, ComSystemTemplateSystemSignalRef=DET_IDM_233
            DET_MTD_235_oRDR_DETECTION_233_236_oPCAN_RADAR_10f94d60_Tx: ComBitPosition=271, ComBitSize=1, ComSignalInitValue=0, ComSignalType=UINT8, ComHandleId=4924, ComSystemTemplateSystemSignalRef=DET_MTD_235
            DET_IDM_235_oRDR_DETECTION_233_236_oPCAN_RADAR_764a7fbb_Tx: ComBitPosition=287, ComBitSize=1, ComSignalInitValue=0, ComSignalType=UINT8, ComHandleId=4917, ComSystemTemplateSystemSignalRef=DET_IDM_235
            DET_MTD_233_oRDR_DETECTION_233_236_oPCAN_RADAR_d939ba9c_Tx: ComBitPosition=47, ComBitSize=1, ComSignalInitValue=0, ComSignalType=UINT8, ComHandleId=4922, ComSystemTemplateSystemSignalRef=DET_MTD_233
            DET_BELOW_RAIN_THOLD_233_oRDR_DETECTION_233_236_oPCAN_RADAR_84b8515c_Tx: ComBitPosition=39, ComBitSize=1, ComSignalInitValue=0, ComSignalType=UINT8, ComHandleId=4883, ComSystemTemplateSystemSignalRef=DET_BELOW_RAIN_THOLD_233
            DET_PROB_1STAZHYPO_233_oRDR_DETECTION_233_236_oPCAN_RADAR_4a8d5251_Tx: ComBitPosition=103, ComBitSize=1, ComSignalInitValue=0, ComSignalType=BOOLEAN, ComHandleId=4926, ComSystemTemplateSystemSignalRef=DET_PROB_1STAZHYPO_233
            DET_IDM_236_oRDR_DETECTION_233_236_oPCAN_RADAR_12aa0445_Tx: ComBitPosition=399, ComBitSize=1, ComSignalInitValue=0, ComSignalType=UINT8, ComHandleId=4918, ComSystemTemplateSystemSignalRef=DET_IDM_236
            DET_PROB_1STAZHYPO_235_oRDR_DETECTION_233_236_oPCAN_RADAR_834da5ad_Tx: ComBitPosition=327, ComBitSize=1, ComSignalInitValue=0, ComSignalType=BOOLEAN, ComHandleId=4928, ComSystemTemplateSystemSignalRef=DET_PROB_1STAZHYPO_235
            DET_BELOW_RAIN_THOLD_235_oRDR_DETECTION_233_236_oPCAN_RADAR_4d78a6a0_Tx: ComBitPosition=263, ComBitSize=1, ComSignalInitValue=0, ComSignalType=UINT8, ComHandleId=4885, ComSystemTemplateSystemSignalRef=DET_BELOW_RAIN_THOLD_235
            DET_BELOW_RAIN_THOLD_234_oRDR_DETECTION_233_236_oPCAN_RADAR_d8087235_Tx: ComBitPosition=151, ComBitSize=1, ComSignalInitValue=0, ComSignalType=UINT8, ComHandleId=4884, ComSystemTemplateSystemSignalRef=DET_BELOW_RAIN_THOLD_234
            DET_PROB_1STAZHYPO_236_oRDR_DETECTION_233_236_oPCAN_RADAR_e7adde53_Tx: ComBitPosition=439, ComBitSize=1, ComSignalInitValue=0, ComSignalType=BOOLEAN, ComHandleId=4929, ComSystemTemplateSystemSignalRef=DET_PROB_1STAZHYPO_236
            DET_BELOW_RAIN_THOLD_236_oRDR_DETECTION_233_236_oPCAN_RADAR_2998dd5e_Tx: ComBitPosition=375, ComBitSize=1, ComSignalInitValue=0, ComSignalType=UINT8, ComHandleId=4886, ComSystemTemplateSystemSignalRef=DET_BELOW_RAIN_THOLD_236
            DET_PROB_1STAZHYPO_234_oRDR_DETECTION_233_236_oPCAN_RADAR_163d7138_Tx: ComBitPosition=215, ComBitSize=1, ComSignalInitValue=0, ComSignalType=BOOLEAN, ComHandleId=4927, ComSystemTemplateSystemSignalRef=DET_PROB_1STAZHYPO_234
        SG_Detections_173_176_oRDR_DETECTION_173_176_oPCAN_RADAR_18cc2fee_Tx: ComTransferProperty=TRIGGERED, ComHandleId=45, ComSystemTemplateSignalGroupRef=SG_Detections_173_176
          83 x ComGroupSignal, all with ComSignalEndianness=LITTLE_ENDIAN, ComTransferProperty=PENDING, ComSignalAccess=ACCESS_NEEDED_BY_SWC_OR_COM:
            DET_AZIMUTH_175_oRDR_DETECTION_173_176_oPCAN_RADAR_1bedd775_Tx: ComBitPosition=312, ComBitSize=13, ComSignalInitValue=0, ComSignalType=UINT16, ComHandleId=3632, ComSystemTemplateSystemSignalRef=DET_AZIMUTH_175
            DET_BI_STATIC_FLAG_174_oRDR_DETECTION_173_176_oPCAN_RADAR_d8b14365_Tx: ComBitPosition=216, ComBitSize=1, ComSignalInitValue=0, ComSignalType=BOOLEAN, ComHandleId=3643, ComSystemTemplateSystemSignalRef=DET_BI_STATIC_FLAG_174
            DET_ELEVATION_176_oRDR_DETECTION_173_176_oPCAN_RADAR_aebe7387_Tx: ComBitPosition=408, ComBitSize=8, ComSignalInitValue=0, ComSignalType=UINT8, ComHandleId=3657, ComSystemTemplateSystemSignalRef=DET_ELEVATION_176
            DET_RANGE_VELOCITY_ERR_176_oRDR_DETECTION_173_176_oPCAN_RADAR_158be6a7_Tx: ComBitPosition=400, ComBitSize=8, ComSignalInitValue=0, ComSignalType=UINT8, ComHandleId=3700, ComSystemTemplateSystemSignalRef=DET_RANGE_VELOCITY_ERR_176
            DET_ELEVATION_175_oRDR_DETECTION_173_176_oPCAN_RADAR_ca5e0879_Tx: ComBitPosition=296, ComBitSize=8, ComSignalInitValue=0, ComSignalType=UINT8, ComHandleId=3656, ComSystemTemplateSystemSignalRef=DET_ELEVATION_175
            DET_RANGE_ERR_174_oRDR_DETECTION_173_176_oPCAN_RADAR_39eeca32_Tx: ComBitPosition=152, ComBitSize=7, ComSignalInitValue=0, ComSignalType=UINT8, ComHandleId=3690, ComSystemTemplateSystemSignalRef=DET_RANGE_ERR_174
            DET_CONFD_ELEVATION_173_oRDR_DETECTION_173_176_oPCAN_RADAR_d25e2bb9_Tx: ComBitPosition=101, ComBitSize=2, ComSignalInitValue=0, ComSignalType=UINT8, ComHandleId=3650, ComSystemTemplateSystemSignalRef=DET_CONFD_ELEVATION_173
            DET_RCS_173_oRDR_DETECTION_173_176_oPCAN_RADAR_3090a64d_Tx: ComBitPosition=128, ComBitSize=8, ComSignalInitValue=128, ComSignalType=UINT8, ComHandleId=3701, ComSystemTemplateSystemSignalRef=DET_RCS_173
            DET_BI_STATIC_FLAG_176_oRDR_DETECTION_173_176_oPCAN_RADAR_2921ec0e_Tx: ComBitPosition=440, ComBitSize=1, ComSignalInitValue=0, ComSignalType=BOOLEAN, ComHandleId=3645, ComSystemTemplateSystemSignalRef=DET_BI_STATIC_FLAG_176
            DET_ELEVATION_ERR_174_oRDR_DETECTION_173_176_oPCAN_RADAR_d8174499_Tx: ComBitPosition=192, ComBitSize=6, ComSignalInitValue=0, ComSignalType=UINT8, ComHandleId=3659, ComSystemTemplateSystemSignalRef=DET_ELEVATION_ERR_174
            DET_HVC_FLAG_175_oRDR_DETECTION_173_176_oPCAN_RADAR_7e8ca613_Tx: ComBitPosition=310, ComBitSize=1, ComSignalInitValue=0, ComSignalType=BOOLEAN, ComHandleId=3668, ComSystemTemplateSystemSignalRef=DET_HVC_FLAG_175
            DET_RANGE_173_oRDR_DETECTION_173_176_oPCAN_RADAR_c2b65332_Tx: ComBitPosition=24, ComBitSize=15, ComSignalInitValue=0, ComSignalType=UINT16, ComHandleId=3685, ComSystemTemplateSystemSignalRef=DET_RANGE_173
            DET_RANGE_VELOCITY_173_oRDR_DETECTION_173_176_oPCAN_RADAR_b7109117_Tx: ComBitPosition=48, ComBitSize=15, ComSignalInitValue=16384, ComSignalType=UINT16, ComHandleId=3693, ComSystemTemplateSystemSignalRef=DET_RANGE_VELOCITY_173
            DET_RANGE_VELOCITY_174_oRDR_DETECTION_173_176_oPCAN_RADAR_eba0b27e_Tx: ComBitPosition=160, ComBitSize=15, ComSignalInitValue=16384, ComSignalType=UINT16, ComHandleId=3694, ComSystemTemplateSystemSignalRef=DET_RANGE_VELOCITY_174
            DET_SNR_175_oRDR_DETECTION_173_176_oPCAN_RADAR_24fe05b3_Tx: ComBitPosition=344, ComBitSize=8, ComSignalInitValue=0, ComSignalType=UINT8, ComHandleId=3707, ComSystemTemplateSystemSignalRef=DET_SNR_175
            DET_AZIMUTH_ERR_173_oRDR_DETECTION_173_176_oPCAN_RADAR_7698b57c_Tx: ComBitPosition=105, ComBitSize=7, ComSignalInitValue=0, ComSignalType=UINT8, ComHandleId=3634, ComSystemTemplateSystemSignalRef=DET_AZIMUTH_ERR_173
            DET_SUPER_RES_TARGET_175_oRDR_DETECTION_173_176_oPCAN_RADAR_15672dd6_Tx: ComBitPosition=311, ComBitSize=1, ComSignalInitValue=0, ComSignalType=BOOLEAN, ComHandleId=3711, ComSystemTemplateSystemSignalRef=DET_SUPER_RES_TARGET_175
            DET_RANGE_ERR_176_oRDR_DETECTION_173_176_oPCAN_RADAR_c87e6559_Tx: ComBitPosition=376, ComBitSize=7, ComSignalInitValue=0, ComSignalType=UINT8, ComHandleId=3692, ComSystemTemplateSystemSignalRef=DET_RANGE_ERR_176
            DET_RANGE_174_oRDR_DETECTION_173_176_oPCAN_RADAR_9e06705b_Tx: ComBitPosition=136, ComBitSize=15, ComSignalInitValue=0, ComSignalType=UINT16, ComHandleId=3686, ComSystemTemplateSystemSignalRef=DET_RANGE_174
            DET_CONFD_AZIMUTH_173_oRDR_DETECTION_173_176_oPCAN_RADAR_d0cb2a43_Tx: ComBitPosition=118, ComBitSize=2, ComSignalInitValue=0, ComSignalType=UINT8, ComHandleId=3646, ComSystemTemplateSystemSignalRef=DET_CONFD_AZIMUTH_173
            DET_AZIMUTH_173_oRDR_DETECTION_173_176_oPCAN_RADAR_d22d2089_Tx: ComBitPosition=88, ComBitSize=13, ComSignalInitValue=0, ComSignalType=UINT16, ComHandleId=3630, ComSystemTemplateSystemSignalRef=DET_AZIMUTH_173
            DET_BI_STATIC_FLAG_175_oRDR_DETECTION_173_176_oPCAN_RADAR_4dc197f0_Tx: ComBitPosition=328, ComBitSize=1, ComSignalInitValue=0, ComSignalType=BOOLEAN, ComHandleId=3644, ComSystemTemplateSystemSignalRef=DET_BI_STATIC_FLAG_175
            DET_CONFD_AZIMUTH_176_oRDR_DETECTION_173_176_oPCAN_RADAR_7deba641_Tx: ComBitPosition=454, ComBitSize=2, ComSignalInitValue=0, ComSignalType=UINT8, ComHandleId=3649, ComSystemTemplateSystemSignalRef=DET_CONFD_AZIMUTH_176
            DET_RANGE_ERR_173_oRDR_DETECTION_173_176_oPCAN_RADAR_655ee95b_Tx: ComBitPosition=40, ComBitSize=7, ComSignalInitValue=0, ComSignalType=UINT8, ComHandleId=3689, ComSystemTemplateSystemSignalRef=DET_RANGE_ERR_173
            DET_ELEVATION_ERR_173_oRDR_DETECTION_173_176_oPCAN_RADAR_84a767f0_Tx: ComBitPosition=80, ComBitSize=6, ComSignalInitValue=0, ComSignalType=UINT8, ComHandleId=3658, ComSystemTemplateSystemSignalRef=DET_ELEVATION_ERR_173
            DET_RANGE_175_oRDR_DETECTION_173_176_oPCAN_RADAR_0b76a4ce_Tx: ComBitPosition=248, ComBitSize=15, ComSignalInitValue=0, ComSignalType=UINT16, ComHandleId=3687, ComSystemTemplateSystemSignalRef=DET_RANGE_175
            DET_RANGE_VELOCITY_ERR_173_oRDR_DETECTION_173_176_oPCAN_RADAR_b8ab6aa5_Tx: ComBitPosition=64, ComBitSize=8, ComSignalInitValue=0, ComSignalType=UINT8, ComHandleId=3697, ComSystemTemplateSystemSignalRef=DET_RANGE_VELOCITY_ERR_173
            DET_EXISTENCE_PROB_173_oRDR_DETECTION_173_176_oPCAN_RADAR_56381290_Tx: ComBitPosition=112, ComBitSize=6, ComSignalInitValue=0, ComSignalType=UINT8, ComHandleId=3662, ComSystemTemplateSystemSignalRef=DET_EXISTENCE_PROB_173
            DET_RANGE_VELOCITY_176_oRDR_DETECTION_173_176_oPCAN_RADAR_1a301d15_Tx: ComBitPosition=384, ComBitSize=15, ComSignalInitValue=16384, ComSignalType=UINT16, ComHandleId=3696, ComSystemTemplateSystemSignalRef=DET_RANGE_VELOCITY_176
            DET_SUPER_RES_TARGET_176_oRDR_DETECTION_173_176_oPCAN_RADAR_71875628_Tx: ComBitPosition=423, ComBitSize=1, ComSignalInitValue=0, ComSignalType=BOOLEAN, ComHandleId=3712, ComSystemTemplateSystemSignalRef=DET_SUPER_RES_TARGET_176
            DET_ELEVATION_ERR_176_oRDR_DETECTION_173_176_oPCAN_RADAR_2987ebf2_Tx: ComBitPosition=416, ComBitSize=6, ComSignalInitValue=0, ComSignalType=UINT8, ComHandleId=3661, ComSystemTemplateSystemSignalRef=DET_ELEVATION_ERR_176
            DET_SNR_174_oRDR_DETECTION_173_176_oPCAN_RADAR_b18ed126_Tx: ComBitPosition=232, ComBitSize=8, ComSignalInitValue=0, ComSignalType=UINT8, ComHandleId=3706, ComSystemTemplateSystemSignalRef=DET_SNR_174
            DET_RANGE_176_oRDR_DETECTION_173_176_oPCAN_RADAR_6f96df30_Tx: ComBitPosition=360, ComBitSize=15, ComSignalInitValue=0, ComSignalType=UINT16, ComHandleId=3688, ComSystemTemplateSystemSignalRef=DET_RANGE_176
            DET_BI_STATIC_FLAG_173_oRDR_DETECTION_173_176_oPCAN_RADAR_8401600c_Tx: ComBitPosition=104, ComBitSize=1, ComSignalInitValue=0, ComSignalType=BOOLEAN, ComHandleId=3642, ComSystemTemplateSystemSignalRef=DET_BI_STATIC_FLAG_173
            DET_HVC_FLAG_174_oRDR_DETECTION_173_176_oPCAN_RADAR_ebfc7286_Tx: ComBitPosition=198, ComBitSize=1, ComSignalInitValue=0, ComSignalType=BOOLEAN, ComHandleId=3667, ComSystemTemplateSystemSignalRef=DET_HVC_FLAG_174
            DET_ELEVATION_174_oRDR_DETECTION_173_176_oPCAN_RADAR_5f2edcec_Tx: ComBitPosition=184, ComBitSize=8, ComSignalInitValue=0, ComSignalType=UINT8, ComHandleId=3655, ComSystemTemplateSystemSignalRef=DET_ELEVATION_174
            DET_RANGE_VELOCITY_ERR_175_oRDR_DETECTION_173_176_oPCAN_RADAR_716b9d59_Tx: ComBitPosition=288, ComBitSize=8, ComSignalInitValue=0, ComSignalType=UINT8, ComHandleId=3699, ComSystemTemplateSystemSignalRef=DET_RANGE_VELOCITY_ERR_175
            DET_AZIMUTH_174_oRDR_DETECTION_173_176_oPCAN_RADAR_8e9d03e0_Tx: ComBitPosition=200, ComBitSize=13, ComSignalInitValue=0, ComSignalType=UINT16, ComHandleId=3631, ComSystemTemplateSystemSignalRef=DET_AZIMUTH_174
            DET_AZIMUTH_ERR_174_oRDR_DETECTION_173_176_oPCAN_RADAR_2a289615_Tx: ComBitPosition=217, ComBitSize=7, ComSignalInitValue=0, ComSignalType=UINT8, ComHandleId=3635, ComSystemTemplateSystemSignalRef=DET_AZIMUTH_ERR_174
            DET_ELEVATION_173_oRDR_DETECTION_173_176_oPCAN_RADAR_039eff85_Tx: ComBitPosition=72, ComBitSize=8, ComSignalInitValue=0, ComSignalType=UINT8, ComHandleId=3654, ComSystemTemplateSystemSignalRef=DET_ELEVATION_173
            DET_HVC_FLAG_176_oRDR_DETECTION_173_176_oPCAN_RADAR_1a6cdded_Tx: ComBitPosition=422, ComBitSize=1, ComSignalInitValue=0, ComSignalType=BOOLEAN, ComHandleId=3669, ComSystemTemplateSystemSignalRef=DET_HVC_FLAG_176
            DET_MH_CRC16_173_176_oRDR_DETECTION_173_176_oPCAN_RADAR_9c44fde5_Tx: ComBitPosition=0, ComBitSize=16, ComSignalInitValue=0, ComSignalType=UINT16, ComHandleId=3674, ComSystemTemplateSystemSignalRef=DET_MH_CRC16_173_176
            DET_CONFD_ELEVATION_176_oRDR_DETECTION_173_176_oPCAN_RADAR_7f7ea7bb_Tx: ComBitPosition=437, ComBitSize=2, ComSignalInitValue=0, ComSignalType=UINT8, ComHandleId=3653, ComSystemTemplateSystemSignalRef=DET_CONFD_ELEVATION_176
            DET_RANGE_ERR_175_oRDR_DETECTION_173_176_oPCAN_RADAR_ac9e1ea7_Tx: ComBitPosition=264, ComBitSize=7, ComSignalInitValue=0, ComSignalType=UINT8, ComHandleId=3691, ComSystemTemplateSystemSignalRef=DET_RANGE_ERR_175
            DET_CONFD_ELEVATION_175_oRDR_DETECTION_173_176_oPCAN_RADAR_1b9edc45_Tx: ComBitPosition=325, ComBitSize=2, ComSignalInitValue=0, ComSignalType=UINT8, ComHandleId=3652, ComSystemTemplateSystemSignalRef=DET_CONFD_ELEVATION_175
            DET_CONFD_AZIMUTH_175_oRDR_DETECTION_173_176_oPCAN_RADAR_190bddbf_Tx: ComBitPosition=342, ComBitSize=2, ComSignalInitValue=0, ComSignalType=UINT8, ComHandleId=3648, ComSystemTemplateSystemSignalRef=DET_CONFD_AZIMUTH_175
            DET_RCS_175_oRDR_DETECTION_173_176_oPCAN_RADAR_f95051b1_Tx: ComBitPosition=352, ComBitSize=8, ComSignalInitValue=128, ComSignalType=UINT8, ComHandleId=3703, ComSystemTemplateSystemSignalRef=DET_RCS_175
            DET_EXISTENCE_PROB_175_oRDR_DETECTION_173_176_oPCAN_RADAR_9ff8e56c_Tx: ComBitPosition=336, ComBitSize=6, ComSignalInitValue=0, ComSignalType=UINT8, ComHandleId=3664, ComSystemTemplateSystemSignalRef=DET_EXISTENCE_PROB_175
            DET_SNR_176_oRDR_DETECTION_173_176_oPCAN_RADAR_401e7e4d_Tx: ComBitPosition=456, ComBitSize=8, ComSignalInitValue=0, ComSignalType=UINT8, ComHandleId=3708, ComSystemTemplateSystemSignalRef=DET_SNR_176
            DET_SNR_173_oRDR_DETECTION_173_176_oPCAN_RADAR_ed3ef24f_Tx: ComBitPosition=120, ComBitSize=8, ComSignalInitValue=0, ComSignalType=UINT8, ComHandleId=3705, ComSystemTemplateSystemSignalRef=DET_SNR_173
            DET_ELEVATION_ERR_175_oRDR_DETECTION_173_176_oPCAN_RADAR_4d67900c_Tx: ComBitPosition=304, ComBitSize=6, ComSignalInitValue=0, ComSignalType=UINT8, ComHandleId=3660, ComSystemTemplateSystemSignalRef=DET_ELEVATION_ERR_175
            DET_HVC_FLAG_173_oRDR_DETECTION_173_176_oPCAN_RADAR_b74c51ef_Tx: ComBitPosition=86, ComBitSize=1, ComSignalInitValue=0, ComSignalType=BOOLEAN, ComHandleId=3666, ComSystemTemplateSystemSignalRef=DET_HVC_FLAG_173
            DET_RANGE_VELOCITY_ERR_174_oRDR_DETECTION_173_176_oPCAN_RADAR_e41b49cc_Tx: ComBitPosition=176, ComBitSize=8, ComSignalInitValue=0, ComSignalType=UINT8, ComHandleId=3698, ComSystemTemplateSystemSignalRef=DET_RANGE_VELOCITY_ERR_174
            DET_AZIMUTH_ERR_175_oRDR_DETECTION_173_176_oPCAN_RADAR_bf584280_Tx: ComBitPosition=329, ComBitSize=7, ComSignalInitValue=0, ComSignalType=UINT8, ComHandleId=3636, ComSystemTemplateSystemSignalRef=DET_AZIMUTH_ERR_175
            DET_AZIMUTH_ERR_176_oRDR_DETECTION_173_176_oPCAN_RADAR_dbb8397e_Tx: ComBitPosition=441, ComBitSize=7, ComSignalInitValue=0, ComSignalType=UINT8, ComHandleId=3637, ComSystemTemplateSystemSignalRef=DET_AZIMUTH_ERR_176
            DET_MH_CYCLE_COUNTER_173_176_oRDR_DETECTION_173_176_oPCAN_RADAR_18315cd2_Tx: ComBitPosition=16, ComBitSize=8, ComSignalInitValue=0, ComSignalType=UINT8, ComHandleId=3675, ComSystemTemplateSystemSignalRef=DET_MH_CYCLE_COUNTER_173_176
            DET_SUPER_RES_TARGET_174_oRDR_DETECTION_173_176_oPCAN_RADAR_8017f943_Tx: ComBitPosition=199, ComBitSize=1, ComSignalInitValue=0, ComSignalType=BOOLEAN, ComHandleId=3710, ComSystemTemplateSystemSignalRef=DET_SUPER_RES_TARGET_174
            DET_RCS_176_oRDR_DETECTION_173_176_oPCAN_RADAR_9db02a4f_Tx: ComBitPosition=464, ComBitSize=8, ComSignalInitValue=128, ComSignalType=UINT8, ComHandleId=3704, ComSystemTemplateSystemSignalRef=DET_RCS_176
            DET_EXISTENCE_PROB_174_oRDR_DETECTION_173_176_oPCAN_RADAR_0a8831f9_Tx: ComBitPosition=224, ComBitSize=6, ComSignalInitValue=0, ComSignalType=UINT8, ComHandleId=3663, ComSystemTemplateSystemSignalRef=DET_EXISTENCE_PROB_174
            DET_MH_SCAN_INDEX_4LSB_173_176_oRDR_DETECTION_173_176_oPCAN_RADAR_d41b795e_Tx: ComBitPosition=476, ComBitSize=4, ComSignalInitValue=0, ComSignalType=UINT8, ComHandleId=3676, ComSystemTemplateSystemSignalRef=DET_MH_SCAN_INDEX_4LSB_173_176
            DET_AZIMUTH_176_oRDR_DETECTION_173_176_oPCAN_RADAR_7f0dac8b_Tx: ComBitPosition=424, ComBitSize=13, ComSignalInitValue=0, ComSignalType=UINT16, ComHandleId=3633, ComSystemTemplateSystemSignalRef=DET_AZIMUTH_176
            DET_EXISTENCE_PROB_176_oRDR_DETECTION_173_176_oPCAN_RADAR_fb189e92_Tx: ComBitPosition=448, ComBitSize=6, ComSignalInitValue=0, ComSignalType=UINT8, ComHandleId=3665, ComSystemTemplateSystemSignalRef=DET_EXISTENCE_PROB_176
            DET_RANGE_VELOCITY_175_oRDR_DETECTION_173_176_oPCAN_RADAR_7ed066eb_Tx: ComBitPosition=272, ComBitSize=15, ComSignalInitValue=16384, ComSignalType=UINT16, ComHandleId=3695, ComSystemTemplateSystemSignalRef=DET_RANGE_VELOCITY_175
            DET_CONFD_AZIMUTH_174_oRDR_DETECTION_173_176_oPCAN_RADAR_8c7b092a_Tx: ComBitPosition=230, ComBitSize=2, ComSignalInitValue=0, ComSignalType=UINT8, ComHandleId=3647, ComSystemTemplateSystemSignalRef=DET_CONFD_AZIMUTH_174
            DET_RCS_174_oRDR_DETECTION_173_176_oPCAN_RADAR_6c208524_Tx: ComBitPosition=240, ComBitSize=8, ComSignalInitValue=128, ComSignalType=UINT8, ComHandleId=3702, ComSystemTemplateSystemSignalRef=DET_RCS_174
            DET_SUPER_RES_TARGET_173_oRDR_DETECTION_173_176_oPCAN_RADAR_dca7da2a_Tx: ComBitPosition=87, ComBitSize=1, ComSignalInitValue=0, ComSignalType=BOOLEAN, ComHandleId=3709, ComSystemTemplateSystemSignalRef=DET_SUPER_RES_TARGET_173
            DET_CONFD_ELEVATION_174_oRDR_DETECTION_173_176_oPCAN_RADAR_8eee08d0_Tx: ComBitPosition=213, ComBitSize=2, ComSignalInitValue=0, ComSignalType=UINT8, ComHandleId=3651, ComSystemTemplateSystemSignalRef=DET_CONFD_ELEVATION_174
            DET_MTD_174_oRDR_DETECTION_173_176_oPCAN_RADAR_061d7be0_Tx: ComBitPosition=159, ComBitSize=1, ComSignalInitValue=0, ComSignalType=UINT8, ComHandleId=3678, ComSystemTemplateSystemSignalRef=DET_MTD_174
            DET_BELOW_RAIN_THOLD_175_oRDR_DETECTION_173_176_oPCAN_RADAR_ceec44b5_Tx: ComBitPosition=263, ComBitSize=1, ComSignalInitValue=0, ComSignalType=UINT8, ComHandleId=3640, ComSystemTemplateSystemSignalRef=DET_BELOW_RAIN_THOLD_175
            DET_PROB_1STAZHYPO_173_oRDR_DETECTION_173_176_oPCAN_RADAR_c919b044_Tx: ComBitPosition=103, ComBitSize=1, ComSignalInitValue=0, ComSignalType=BOOLEAN, ComHandleId=3681, ComSystemTemplateSystemSignalRef=DET_PROB_1STAZHYPO_173
            DET_PROB_1STAZHYPO_176_oRDR_DETECTION_173_176_oPCAN_RADAR_64393c46_Tx: ComBitPosition=439, ComBitSize=1, ComSignalInitValue=0, ComSignalType=BOOLEAN, ComHandleId=3684, ComSystemTemplateSystemSignalRef=DET_PROB_1STAZHYPO_176
            DET_IDM_175_oRDR_DETECTION_173_176_oPCAN_RADAR_f5de9dae_Tx: ComBitPosition=287, ComBitSize=1, ComSignalInitValue=0, ComSignalType=UINT8, ComHandleId=3672, ComSystemTemplateSystemSignalRef=DET_IDM_175
            DET_IDM_176_oRDR_DETECTION_173_176_oPCAN_RADAR_913ee650_Tx: ComBitPosition=399, ComBitSize=1, ComSignalInitValue=0, ComSignalType=UINT8, ComHandleId=3673, ComSystemTemplateSystemSignalRef=DET_IDM_176
            DET_BELOW_RAIN_THOLD_174_oRDR_DETECTION_173_176_oPCAN_RADAR_5b9c9020_Tx: ComBitPosition=151, ComBitSize=1, ComSignalInitValue=0, ComSignalType=UINT8, ComHandleId=3639, ComSystemTemplateSystemSignalRef=DET_BELOW_RAIN_THOLD_174
            DET_BELOW_RAIN_THOLD_176_oRDR_DETECTION_173_176_oPCAN_RADAR_aa0c3f4b_Tx: ComBitPosition=375, ComBitSize=1, ComSignalInitValue=0, ComSignalType=UINT8, ComHandleId=3641, ComSystemTemplateSystemSignalRef=DET_BELOW_RAIN_THOLD_176
            DET_MTD_176_oRDR_DETECTION_173_176_oPCAN_RADAR_f78dd48b_Tx: ComBitPosition=383, ComBitSize=1, ComSignalInitValue=0, ComSignalType=UINT8, ComHandleId=3680, ComSystemTemplateSystemSignalRef=DET_MTD_176
            DET_MTD_175_oRDR_DETECTION_173_176_oPCAN_RADAR_936daf75_Tx: ComBitPosition=271, ComBitSize=1, ComSignalInitValue=0, ComSignalType=UINT8, ComHandleId=3679, ComSystemTemplateSystemSignalRef=DET_MTD_175
            DET_IDM_173_oRDR_DETECTION_173_176_oPCAN_RADAR_3c1e6a52_Tx: ComBitPosition=63, ComBitSize=1, ComSignalInitValue=0, ComSignalType=UINT8, ComHandleId=3670, ComSystemTemplateSystemSignalRef=DET_IDM_173
            DET_BELOW_RAIN_THOLD_173_oRDR_DETECTION_173_176_oPCAN_RADAR_072cb349_Tx: ComBitPosition=39, ComBitSize=1, ComSignalInitValue=0, ComSignalType=UINT8, ComHandleId=3638, ComSystemTemplateSystemSignalRef=DET_BELOW_RAIN_THOLD_173
            DET_PROB_1STAZHYPO_175_oRDR_DETECTION_173_176_oPCAN_RADAR_00d947b8_Tx: ComBitPosition=327, ComBitSize=1, ComSignalInitValue=0, ComSignalType=BOOLEAN, ComHandleId=3683, ComSystemTemplateSystemSignalRef=DET_PROB_1STAZHYPO_175
            DET_MTD_173_oRDR_DETECTION_173_176_oPCAN_RADAR_5aad5889_Tx: ComBitPosition=47, ComBitSize=1, ComSignalInitValue=0, ComSignalType=UINT8, ComHandleId=3677, ComSystemTemplateSystemSignalRef=DET_MTD_173
            DET_IDM_174_oRDR_DETECTION_173_176_oPCAN_RADAR_60ae493b_Tx: ComBitPosition=175, ComBitSize=1, ComSignalInitValue=0, ComSignalType=UINT8, ComHandleId=3671, ComSystemTemplateSystemSignalRef=DET_IDM_174
            DET_PROB_1STAZHYPO_174_oRDR_DETECTION_173_176_oPCAN_RADAR_95a9932d_Tx: ComBitPosition=215, ComBitSize=1, ComSignalInitValue=0, ComSignalType=BOOLEAN, ComHandleId=3682, ComSystemTemplateSystemSignalRef=DET_PROB_1STAZHYPO_174
        SG_Detections_389_392_oRDR_DETECTION_389_392_oPCAN_RADAR_25df6300_Tx: ComTransferProperty=TRIGGERED, ComHandleId=99, ComSystemTemplateSignalGroupRef=SG_Detections_389_392
          83 x ComGroupSignal, all with ComSignalEndianness=LITTLE_ENDIAN, ComTransferProperty=PENDING, ComSignalAccess=ACCESS_NEEDED_BY_SWC_OR_COM:
            DET_SNR_392_oRDR_DETECTION_389_392_oPCAN_RADAR_c309fba6_Tx: ComBitPosition=456, ComBitSize=8, ComSignalInitValue=0, ComSignalType=UINT8, ComHandleId=8190, ComSystemTemplateSystemSignalRef=DET_SNR_392
            DET_SNR_391_oRDR_DETECTION_389_392_oPCAN_RADAR_a7e98058_Tx: ComBitPosition=344, ComBitSize=8, ComSignalInitValue=0, ComSignalType=UINT8, ComHandleId=8189, ComSystemTemplateSystemSignalRef=DET_SNR_391
            DET_AZIMUTH_392_oRDR_DETECTION_389_392_oPCAN_RADAR_fc1a2960_Tx: ComBitPosition=424, ComBitSize=13, ComSignalInitValue=0, ComSignalType=UINT16, ComHandleId=8115, ComSystemTemplateSystemSignalRef=DET_AZIMUTH_392
            DET_RANGE_VELOCITY_392_oRDR_DETECTION_389_392_oPCAN_RADAR_992798fe_Tx: ComBitPosition=384, ComBitSize=15, ComSignalInitValue=16384, ComSignalType=UINT16, ComHandleId=8178, ComSystemTemplateSystemSignalRef=DET_RANGE_VELOCITY_392
            DET_ELEVATION_ERR_391_oRDR_DETECTION_389_392_oPCAN_RADAR_ce7015e7_Tx: ComBitPosition=304, ComBitSize=6, ComSignalInitValue=0, ComSignalType=UINT8, ComHandleId=8142, ComSystemTemplateSystemSignalRef=DET_ELEVATION_ERR_391
            DET_RANGE_391_oRDR_DETECTION_389_392_oPCAN_RADAR_88612125_Tx: ComBitPosition=248, ComBitSize=15, ComSignalInitValue=0, ComSignalType=UINT16, ComHandleId=8169, ComSystemTemplateSystemSignalRef=DET_RANGE_391
            DET_RCS_390_oRDR_DETECTION_389_392_oPCAN_RADAR_ef3700cf_Tx: ComBitPosition=240, ComBitSize=8, ComSignalInitValue=128, ComSignalType=UINT8, ComHandleId=8184, ComSystemTemplateSystemSignalRef=DET_RCS_390
            DET_RANGE_ERR_391_oRDR_DETECTION_389_392_oPCAN_RADAR_2f899b4c_Tx: ComBitPosition=264, ComBitSize=7, ComSignalInitValue=0, ComSignalType=UINT8, ComHandleId=8173, ComSystemTemplateSystemSignalRef=DET_RANGE_ERR_391
            DET_BI_STATIC_FLAG_391_oRDR_DETECTION_389_392_oPCAN_RADAR_ced6121b_Tx: ComBitPosition=328, ComBitSize=1, ComSignalInitValue=0, ComSignalType=BOOLEAN, ComHandleId=8126, ComSystemTemplateSystemSignalRef=DET_BI_STATIC_FLAG_391
            DET_AZIMUTH_ERR_391_oRDR_DETECTION_389_392_oPCAN_RADAR_3c4fc76b_Tx: ComBitPosition=329, ComBitSize=7, ComSignalInitValue=0, ComSignalType=UINT8, ComHandleId=8118, ComSystemTemplateSystemSignalRef=DET_AZIMUTH_ERR_391
            DET_RCS_392_oRDR_DETECTION_389_392_oPCAN_RADAR_1ea7afa4_Tx: ComBitPosition=464, ComBitSize=8, ComSignalInitValue=128, ComSignalType=UINT8, ComHandleId=8186, ComSystemTemplateSystemSignalRef=DET_RCS_392
            DET_AZIMUTH_390_oRDR_DETECTION_389_392_oPCAN_RADAR_0d8a860b_Tx: ComBitPosition=200, ComBitSize=13, ComSignalInitValue=0, ComSignalType=UINT16, ComHandleId=8113, ComSystemTemplateSystemSignalRef=DET_AZIMUTH_390
            DET_CONFD_ELEVATION_392_oRDR_DETECTION_389_392_oPCAN_RADAR_fc692250_Tx: ComBitPosition=437, ComBitSize=2, ComSignalInitValue=0, ComSignalType=UINT8, ComHandleId=8135, ComSystemTemplateSystemSignalRef=DET_CONFD_ELEVATION_392
            DET_CONFD_ELEVATION_390_oRDR_DETECTION_389_392_oPCAN_RADAR_0df98d3b_Tx: ComBitPosition=213, ComBitSize=2, ComSignalInitValue=0, ComSignalType=UINT8, ComHandleId=8133, ComSystemTemplateSystemSignalRef=DET_CONFD_ELEVATION_390
            DET_CONFD_AZIMUTH_392_oRDR_DETECTION_389_392_oPCAN_RADAR_fefc23aa_Tx: ComBitPosition=454, ComBitSize=2, ComSignalInitValue=0, ComSignalType=UINT8, ComHandleId=8131, ComSystemTemplateSystemSignalRef=DET_CONFD_AZIMUTH_392
            DET_ELEVATION_ERR_392_oRDR_DETECTION_389_392_oPCAN_RADAR_aa906e19_Tx: ComBitPosition=416, ComBitSize=6, ComSignalInitValue=0, ComSignalType=UINT8, ComHandleId=8143, ComSystemTemplateSystemSignalRef=DET_ELEVATION_ERR_392
            DET_AZIMUTH_389_oRDR_DETECTION_389_392_oPCAN_RADAR_68aaf4af_Tx: ComBitPosition=88, ComBitSize=13, ComSignalInitValue=0, ComSignalType=UINT16, ComHandleId=8112, ComSystemTemplateSystemSignalRef=DET_AZIMUTH_389
            DET_MH_CYCLE_COUNTER_389_392_oRDR_DETECTION_389_392_oPCAN_RADAR_2522103c_Tx: ComBitPosition=16, ComBitSize=8, ComSignalInitValue=0, ComSignalType=UINT8, ComHandleId=8157, ComSystemTemplateSystemSignalRef=DET_MH_CYCLE_COUNTER_389_392
            DET_RANGE_390_oRDR_DETECTION_389_392_oPCAN_RADAR_1d11f5b0_Tx: ComBitPosition=136, ComBitSize=15, ComSignalInitValue=0, ComSignalType=UINT16, ComHandleId=8168, ComSystemTemplateSystemSignalRef=DET_RANGE_390
            DET_SUPER_RES_TARGET_392_oRDR_DETECTION_389_392_oPCAN_RADAR_f290d3c3_Tx: ComBitPosition=423, ComBitSize=1, ComSignalInitValue=0, ComSignalType=BOOLEAN, ComHandleId=8194, ComSystemTemplateSystemSignalRef=DET_SUPER_RES_TARGET_392
            DET_ELEVATION_392_oRDR_DETECTION_389_392_oPCAN_RADAR_2da9f66c_Tx: ComBitPosition=408, ComBitSize=8, ComSignalInitValue=0, ComSignalType=UINT8, ComHandleId=8139, ComSystemTemplateSystemSignalRef=DET_ELEVATION_392
            DET_RANGE_ERR_390_oRDR_DETECTION_389_392_oPCAN_RADAR_baf94fd9_Tx: ComBitPosition=152, ComBitSize=7, ComSignalInitValue=0, ComSignalType=UINT8, ComHandleId=8172, ComSystemTemplateSystemSignalRef=DET_RANGE_ERR_390
            DET_MH_SCAN_INDEX_4LSB_389_392_oRDR_DETECTION_389_392_oPCAN_RADAR_e90835b0_Tx: ComBitPosition=476, ComBitSize=4, ComSignalInitValue=0, ComSignalType=UINT8, ComHandleId=8158, ComSystemTemplateSystemSignalRef=DET_MH_SCAN_INDEX_4LSB_389_392
            DET_BI_STATIC_FLAG_390_oRDR_DETECTION_389_392_oPCAN_RADAR_5ba6c68e_Tx: ComBitPosition=216, ComBitSize=1, ComSignalInitValue=0, ComSignalType=BOOLEAN, ComHandleId=8125, ComSystemTemplateSystemSignalRef=DET_BI_STATIC_FLAG_390
            DET_CONFD_AZIMUTH_391_oRDR_DETECTION_389_392_oPCAN_RADAR_9a1c5854_Tx: ComBitPosition=342, ComBitSize=2, ComSignalInitValue=0, ComSignalType=UINT8, ComHandleId=8130, ComSystemTemplateSystemSignalRef=DET_CONFD_AZIMUTH_391
            DET_CONFD_ELEVATION_391_oRDR_DETECTION_389_392_oPCAN_RADAR_988959ae_Tx: ComBitPosition=325, ComBitSize=2, ComSignalInitValue=0, ComSignalType=UINT8, ComHandleId=8134, ComSystemTemplateSystemSignalRef=DET_CONFD_ELEVATION_391
            DET_RANGE_VELOCITY_ERR_389_oRDR_DETECTION_389_392_oPCAN_RADAR_022cbe83_Tx: ComBitPosition=64, ComBitSize=8, ComSignalInitValue=0, ComSignalType=UINT8, ComHandleId=8179, ComSystemTemplateSystemSignalRef=DET_RANGE_VELOCITY_ERR_389
            DET_BI_STATIC_FLAG_389_oRDR_DETECTION_389_392_oPCAN_RADAR_3e86b42a_Tx: ComBitPosition=104, ComBitSize=1, ComSignalInitValue=0, ComSignalType=BOOLEAN, ComHandleId=8124, ComSystemTemplateSystemSignalRef=DET_BI_STATIC_FLAG_389
            DET_HVC_FLAG_391_oRDR_DETECTION_389_392_oPCAN_RADAR_fd9b23f8_Tx: ComBitPosition=310, ComBitSize=1, ComSignalInitValue=0, ComSignalType=BOOLEAN, ComHandleId=8150, ComSystemTemplateSystemSignalRef=DET_HVC_FLAG_391
            DET_MH_CRC16_389_392_oRDR_DETECTION_389_392_oPCAN_RADAR_a157b10b_Tx: ComBitPosition=0, ComBitSize=16, ComSignalInitValue=0, ComSignalType=UINT16, ComHandleId=8156, ComSystemTemplateSystemSignalRef=DET_MH_CRC16_389_392
            DET_RANGE_ERR_392_oRDR_DETECTION_389_392_oPCAN_RADAR_4b69e0b2_Tx: ComBitPosition=376, ComBitSize=7, ComSignalInitValue=0, ComSignalType=UINT8, ComHandleId=8174, ComSystemTemplateSystemSignalRef=DET_RANGE_ERR_392
            DET_SUPER_RES_TARGET_389_oRDR_DETECTION_389_392_oPCAN_RADAR_66200e0c_Tx: ComBitPosition=87, ComBitSize=1, ComSignalInitValue=0, ComSignalType=BOOLEAN, ComHandleId=8191, ComSystemTemplateSystemSignalRef=DET_SUPER_RES_TARGET_389
            DET_CONFD_ELEVATION_389_oRDR_DETECTION_389_392_oPCAN_RADAR_68d9ff9f_Tx: ComBitPosition=101, ComBitSize=2, ComSignalInitValue=0, ComSignalType=UINT8, ComHandleId=8132, ComSystemTemplateSystemSignalRef=DET_CONFD_ELEVATION_389
            DET_HVC_FLAG_389_oRDR_DETECTION_389_392_oPCAN_RADAR_0dcb85c9_Tx: ComBitPosition=86, ComBitSize=1, ComSignalInitValue=0, ComSignalType=BOOLEAN, ComHandleId=8148, ComSystemTemplateSystemSignalRef=DET_HVC_FLAG_389
            DET_RANGE_VELOCITY_391_oRDR_DETECTION_389_392_oPCAN_RADAR_fdc7e300_Tx: ComBitPosition=272, ComBitSize=15, ComSignalInitValue=16384, ComSignalType=UINT16, ComHandleId=8177, ComSystemTemplateSystemSignalRef=DET_RANGE_VELOCITY_391
            DET_RANGE_VELOCITY_ERR_390_oRDR_DETECTION_389_392_oPCAN_RADAR_670ccc27_Tx: ComBitPosition=176, ComBitSize=8, ComSignalInitValue=0, ComSignalType=UINT8, ComHandleId=8180, ComSystemTemplateSystemSignalRef=DET_RANGE_VELOCITY_ERR_390
            DET_EXISTENCE_PROB_392_oRDR_DETECTION_389_392_oPCAN_RADAR_780f1b79_Tx: ComBitPosition=448, ComBitSize=6, ComSignalInitValue=0, ComSignalType=UINT8, ComHandleId=8147, ComSystemTemplateSystemSignalRef=DET_EXISTENCE_PROB_392
            DET_SNR_390_oRDR_DETECTION_389_392_oPCAN_RADAR_329954cd_Tx: ComBitPosition=232, ComBitSize=8, ComSignalInitValue=0, ComSignalType=UINT8, ComHandleId=8188, ComSystemTemplateSystemSignalRef=DET_SNR_390
            DET_ELEVATION_ERR_390_oRDR_DETECTION_389_392_oPCAN_RADAR_5b00c172_Tx: ComBitPosition=192, ComBitSize=6, ComSignalInitValue=0, ComSignalType=UINT8, ComHandleId=8141, ComSystemTemplateSystemSignalRef=DET_ELEVATION_ERR_390
            DET_HVC_FLAG_392_oRDR_DETECTION_389_392_oPCAN_RADAR_997b5806_Tx: ComBitPosition=422, ComBitSize=1, ComSignalInitValue=0, ComSignalType=BOOLEAN, ComHandleId=8151, ComSystemTemplateSystemSignalRef=DET_HVC_FLAG_392
            DET_EXISTENCE_PROB_391_oRDR_DETECTION_389_392_oPCAN_RADAR_1cef6087_Tx: ComBitPosition=336, ComBitSize=6, ComSignalInitValue=0, ComSignalType=UINT8, ComHandleId=8146, ComSystemTemplateSystemSignalRef=DET_EXISTENCE_PROB_391
            DET_RANGE_VELOCITY_390_oRDR_DETECTION_389_392_oPCAN_RADAR_68b73795_Tx: ComBitPosition=160, ComBitSize=15, ComSignalInitValue=16384, ComSignalType=UINT16, ComHandleId=8176, ComSystemTemplateSystemSignalRef=DET_RANGE_VELOCITY_390
            DET_CONFD_AZIMUTH_389_oRDR_DETECTION_389_392_oPCAN_RADAR_6a4cfe65_Tx: ComBitPosition=118, ComBitSize=2, ComSignalInitValue=0, ComSignalType=UINT8, ComHandleId=8128, ComSystemTemplateSystemSignalRef=DET_CONFD_AZIMUTH_389
            DET_CONFD_AZIMUTH_390_oRDR_DETECTION_389_392_oPCAN_RADAR_0f6c8cc1_Tx: ComBitPosition=230, ComBitSize=2, ComSignalInitValue=0, ComSignalType=UINT8, ComHandleId=8129, ComSystemTemplateSystemSignalRef=DET_CONFD_AZIMUTH_390
            DET_AZIMUTH_ERR_392_oRDR_DETECTION_389_392_oPCAN_RADAR_58afbc95_Tx: ComBitPosition=441, ComBitSize=7, ComSignalInitValue=0, ComSignalType=UINT8, ComHandleId=8119, ComSystemTemplateSystemSignalRef=DET_AZIMUTH_ERR_392
            DET_RANGE_VELOCITY_389_oRDR_DETECTION_389_392_oPCAN_RADAR_0d974531_Tx: ComBitPosition=48, ComBitSize=15, ComSignalInitValue=16384, ComSignalType=UINT16, ComHandleId=8175, ComSystemTemplateSystemSignalRef=DET_RANGE_VELOCITY_389
            DET_RANGE_VELOCITY_ERR_391_oRDR_DETECTION_389_392_oPCAN_RADAR_f27c18b2_Tx: ComBitPosition=288, ComBitSize=8, ComSignalInitValue=0, ComSignalType=UINT8, ComHandleId=8181, ComSystemTemplateSystemSignalRef=DET_RANGE_VELOCITY_ERR_391
            DET_ELEVATION_389_oRDR_DETECTION_389_392_oPCAN_RADAR_b9192ba3_Tx: ComBitPosition=72, ComBitSize=8, ComSignalInitValue=0, ComSignalType=UINT8, ComHandleId=8136, ComSystemTemplateSystemSignalRef=DET_ELEVATION_389
            DET_HVC_FLAG_390_oRDR_DETECTION_389_392_oPCAN_RADAR_68ebf76d_Tx: ComBitPosition=198, ComBitSize=1, ComSignalInitValue=0, ComSignalType=BOOLEAN, ComHandleId=8149, ComSystemTemplateSystemSignalRef=DET_HVC_FLAG_390
            DET_SUPER_RES_TARGET_391_oRDR_DETECTION_389_392_oPCAN_RADAR_9670a83d_Tx: ComBitPosition=311, ComBitSize=1, ComSignalInitValue=0, ComSignalType=BOOLEAN, ComHandleId=8193, ComSystemTemplateSystemSignalRef=DET_SUPER_RES_TARGET_391
            DET_BI_STATIC_FLAG_392_oRDR_DETECTION_389_392_oPCAN_RADAR_aa3669e5_Tx: ComBitPosition=440, ComBitSize=1, ComSignalInitValue=0, ComSignalType=BOOLEAN, ComHandleId=8127, ComSystemTemplateSystemSignalRef=DET_BI_STATIC_FLAG_392
            DET_RANGE_392_oRDR_DETECTION_389_392_oPCAN_RADAR_ec815adb_Tx: ComBitPosition=360, ComBitSize=15, ComSignalInitValue=0, ComSignalType=UINT16, ComHandleId=8170, ComSystemTemplateSystemSignalRef=DET_RANGE_392
            DET_SUPER_RES_TARGET_390_oRDR_DETECTION_389_392_oPCAN_RADAR_03007ca8_Tx: ComBitPosition=199, ComBitSize=1, ComSignalInitValue=0, ComSignalType=BOOLEAN, ComHandleId=8192, ComSystemTemplateSystemSignalRef=DET_SUPER_RES_TARGET_390
            DET_AZIMUTH_ERR_389_oRDR_DETECTION_389_392_oPCAN_RADAR_cc1f615a_Tx: ComBitPosition=105, ComBitSize=7, ComSignalInitValue=0, ComSignalType=UINT8, ComHandleId=8116, ComSystemTemplateSystemSignalRef=DET_AZIMUTH_ERR_389
            DET_ELEVATION_ERR_389_oRDR_DETECTION_389_392_oPCAN_RADAR_3e20b3d6_Tx: ComBitPosition=80, ComBitSize=6, ComSignalInitValue=0, ComSignalType=UINT8, ComHandleId=8140, ComSystemTemplateSystemSignalRef=DET_ELEVATION_ERR_389
            DET_RANGE_389_oRDR_DETECTION_389_392_oPCAN_RADAR_78318714_Tx: ComBitPosition=24, ComBitSize=15, ComSignalInitValue=0, ComSignalType=UINT16, ComHandleId=8167, ComSystemTemplateSystemSignalRef=DET_RANGE_389
            DET_ELEVATION_390_oRDR_DETECTION_389_392_oPCAN_RADAR_dc395907_Tx: ComBitPosition=184, ComBitSize=8, ComSignalInitValue=0, ComSignalType=UINT8, ComHandleId=8137, ComSystemTemplateSystemSignalRef=DET_ELEVATION_390
            DET_EXISTENCE_PROB_389_oRDR_DETECTION_389_392_oPCAN_RADAR_ecbfc6b6_Tx: ComBitPosition=112, ComBitSize=6, ComSignalInitValue=0, ComSignalType=UINT8, ComHandleId=8144, ComSystemTemplateSystemSignalRef=DET_EXISTENCE_PROB_389
            DET_AZIMUTH_ERR_390_oRDR_DETECTION_389_392_oPCAN_RADAR_a93f13fe_Tx: ComBitPosition=217, ComBitSize=7, ComSignalInitValue=0, ComSignalType=UINT8, ComHandleId=8117, ComSystemTemplateSystemSignalRef=DET_AZIMUTH_ERR_390
            DET_RCS_389_oRDR_DETECTION_389_392_oPCAN_RADAR_8a17726b_Tx: ComBitPosition=128, ComBitSize=8, ComSignalInitValue=128, ComSignalType=UINT8, ComHandleId=8183, ComSystemTemplateSystemSignalRef=DET_RCS_389
            DET_RANGE_ERR_389_oRDR_DETECTION_389_392_oPCAN_RADAR_dfd93d7d_Tx: ComBitPosition=40, ComBitSize=7, ComSignalInitValue=0, ComSignalType=UINT8, ComHandleId=8171, ComSystemTemplateSystemSignalRef=DET_RANGE_ERR_389
            DET_SNR_389_oRDR_DETECTION_389_392_oPCAN_RADAR_57b92669_Tx: ComBitPosition=120, ComBitSize=8, ComSignalInitValue=0, ComSignalType=UINT8, ComHandleId=8187, ComSystemTemplateSystemSignalRef=DET_SNR_389
            DET_EXISTENCE_PROB_390_oRDR_DETECTION_389_392_oPCAN_RADAR_899fb412_Tx: ComBitPosition=224, ComBitSize=6, ComSignalInitValue=0, ComSignalType=UINT8, ComHandleId=8145, ComSystemTemplateSystemSignalRef=DET_EXISTENCE_PROB_390
            DET_RANGE_VELOCITY_ERR_392_oRDR_DETECTION_389_392_oPCAN_RADAR_969c634c_Tx: ComBitPosition=400, ComBitSize=8, ComSignalInitValue=0, ComSignalType=UINT8, ComHandleId=8182, ComSystemTemplateSystemSignalRef=DET_RANGE_VELOCITY_ERR_392
            DET_ELEVATION_391_oRDR_DETECTION_389_392_oPCAN_RADAR_49498d92_Tx: ComBitPosition=296, ComBitSize=8, ComSignalInitValue=0, ComSignalType=UINT8, ComHandleId=8138, ComSystemTemplateSystemSignalRef=DET_ELEVATION_391
            DET_AZIMUTH_391_oRDR_DETECTION_389_392_oPCAN_RADAR_98fa529e_Tx: ComBitPosition=312, ComBitSize=13, ComSignalInitValue=0, ComSignalType=UINT16, ComHandleId=8114, ComSystemTemplateSystemSignalRef=DET_AZIMUTH_391
            DET_RCS_391_oRDR_DETECTION_389_392_oPCAN_RADAR_7a47d45a_Tx: ComBitPosition=352, ComBitSize=8, ComSignalInitValue=128, ComSignalType=UINT8, ComHandleId=8185, ComSystemTemplateSystemSignalRef=DET_RCS_391
            DET_MTD_389_oRDR_DETECTION_389_392_oPCAN_RADAR_e02a8caf_Tx: ComBitPosition=47, ComBitSize=1, ComSignalInitValue=0, ComSignalType=UINT8, ComHandleId=8159, ComSystemTemplateSystemSignalRef=DET_MTD_389
            DET_BELOW_RAIN_THOLD_391_oRDR_DETECTION_389_392_oPCAN_RADAR_4dfbc15e_Tx: ComBitPosition=263, ComBitSize=1, ComSignalInitValue=0, ComSignalType=UINT8, ComHandleId=8122, ComSystemTemplateSystemSignalRef=DET_BELOW_RAIN_THOLD_391
            DET_MTD_391_oRDR_DETECTION_389_392_oPCAN_RADAR_107a2a9e_Tx: ComBitPosition=271, ComBitSize=1, ComSignalInitValue=0, ComSignalType=UINT8, ComHandleId=8161, ComSystemTemplateSystemSignalRef=DET_MTD_391
            DET_IDM_389_oRDR_DETECTION_389_392_oPCAN_RADAR_8699be74_Tx: ComBitPosition=63, ComBitSize=1, ComSignalInitValue=0, ComSignalType=UINT8, ComHandleId=8152, ComSystemTemplateSystemSignalRef=DET_IDM_389
            DET_PROB_1STAZHYPO_391_oRDR_DETECTION_389_392_oPCAN_RADAR_83cec253_Tx: ComBitPosition=327, ComBitSize=1, ComSignalInitValue=0, ComSignalType=BOOLEAN, ComHandleId=8165, ComSystemTemplateSystemSignalRef=DET_PROB_1STAZHYPO_391
            DET_BELOW_RAIN_THOLD_390_oRDR_DETECTION_389_392_oPCAN_RADAR_d88b15cb_Tx: ComBitPosition=151, ComBitSize=1, ComSignalInitValue=0, ComSignalType=UINT8, ComHandleId=8121, ComSystemTemplateSystemSignalRef=DET_BELOW_RAIN_THOLD_390
            DET_PROB_1STAZHYPO_392_oRDR_DETECTION_389_392_oPCAN_RADAR_e72eb9ad_Tx: ComBitPosition=439, ComBitSize=1, ComSignalInitValue=0, ComSignalType=BOOLEAN, ComHandleId=8166, ComSystemTemplateSystemSignalRef=DET_PROB_1STAZHYPO_392
            DET_BELOW_RAIN_THOLD_389_oRDR_DETECTION_389_392_oPCAN_RADAR_bdab676f_Tx: ComBitPosition=39, ComBitSize=1, ComSignalInitValue=0, ComSignalType=UINT8, ComHandleId=8120, ComSystemTemplateSystemSignalRef=DET_BELOW_RAIN_THOLD_389
            DET_MTD_392_oRDR_DETECTION_389_392_oPCAN_RADAR_749a5160_Tx: ComBitPosition=383, ComBitSize=1, ComSignalInitValue=0, ComSignalType=UINT8, ComHandleId=8162, ComSystemTemplateSystemSignalRef=DET_MTD_392
            DET_PROB_1STAZHYPO_389_oRDR_DETECTION_389_392_oPCAN_RADAR_739e6462_Tx: ComBitPosition=103, ComBitSize=1, ComSignalInitValue=0, ComSignalType=BOOLEAN, ComHandleId=8163, ComSystemTemplateSystemSignalRef=DET_PROB_1STAZHYPO_389
            DET_PROB_1STAZHYPO_390_oRDR_DETECTION_389_392_oPCAN_RADAR_16be16c6_Tx: ComBitPosition=215, ComBitSize=1, ComSignalInitValue=0, ComSignalType=BOOLEAN, ComHandleId=8164, ComSystemTemplateSystemSignalRef=DET_PROB_1STAZHYPO_390
            DET_IDM_392_oRDR_DETECTION_389_392_oPCAN_RADAR_122963bb_Tx: ComBitPosition=399, ComBitSize=1, ComSignalInitValue=0, ComSignalType=UINT8, ComHandleId=8155, ComSystemTemplateSystemSignalRef=DET_IDM_392
            DET_IDM_391_oRDR_DETECTION_389_392_oPCAN_RADAR_76c91845_Tx: ComBitPosition=287, ComBitSize=1, ComSignalInitValue=0, ComSignalType=UINT8, ComHandleId=8154, ComSystemTemplateSystemSignalRef=DET_IDM_391
            DET_MTD_390_oRDR_DETECTION_389_392_oPCAN_RADAR_850afe0b_Tx: ComBitPosition=159, ComBitSize=1, ComSignalInitValue=0, ComSignalType=UINT8, ComHandleId=8160, ComSystemTemplateSystemSignalRef=DET_MTD_390
            DET_IDM_390_oRDR_DETECTION_389_392_oPCAN_RADAR_e3b9ccd0_Tx: ComBitPosition=175, ComBitSize=1, ComSignalInitValue=0, ComSignalType=UINT8, ComHandleId=8153, ComSystemTemplateSystemSignalRef=DET_IDM_390
            DET_BELOW_RAIN_THOLD_392_oRDR_DETECTION_389_392_oPCAN_RADAR_291bbaa0_Tx: ComBitPosition=375, ComBitSize=1, ComSignalInitValue=0, ComSignalType=UINT8, ComHandleId=8123, ComSystemTemplateSystemSignalRef=DET_BELOW_RAIN_THOLD_392
        SG_Detections_001_004_oRDR_DETECTION_001_004_oPCAN_RADAR_df4895a5_Tx: ComTransferProperty=TRIGGERED, ComHandleId=2, ComSystemTemplateSignalGroupRef=SG_Detections_001_004
          83 x ComGroupSignal, all with ComSignalEndianness=LITTLE_ENDIAN, ComTransferProperty=PENDING, ComSignalAccess=ACCESS_NEEDED_BY_SWC_OR_COM:
            DET_RANGE_VELOCITY_ERR_004_oRDR_DETECTION_001_004_oPCAN_RADAR_033b0369_Tx: ComBitPosition=400, ComBitSize=8, ComSignalInitValue=0, ComSignalType=UINT8, ComHandleId=131, ComSystemTemplateSystemSignalRef=DET_RANGE_VELOCITY_ERR_004
            DET_EXISTENCE_PROB_003_oRDR_DETECTION_001_004_oPCAN_RADAR_b1185835_Tx: ComBitPosition=336, ComBitSize=6, ComSignalInitValue=0, ComSignalType=UINT8, ComHandleId=95, ComSystemTemplateSystemSignalRef=DET_EXISTENCE_PROB_003
            DET_AZIMUTH_ERR_001_oRDR_DETECTION_001_004_oPCAN_RADAR_602850b2_Tx: ComBitPosition=105, ComBitSize=7, ComSignalInitValue=0, ComSignalType=UINT8, ComHandleId=65, ComSystemTemplateSystemSignalRef=DET_AZIMUTH_ERR_001
            DET_CONFD_AZIMUTH_001_oRDR_DETECTION_001_004_oPCAN_RADAR_c67bcf8d_Tx: ComBitPosition=118, ComBitSize=2, ComSignalInitValue=0, ComSignalType=UINT8, ComHandleId=77, ComSystemTemplateSystemSignalRef=DET_CONFD_AZIMUTH_001
            DET_EXISTENCE_PROB_002_oRDR_DETECTION_001_004_oPCAN_RADAR_24688ca0_Tx: ComBitPosition=224, ComBitSize=6, ComSignalInitValue=0, ComSignalType=UINT8, ComHandleId=94, ComSystemTemplateSystemSignalRef=DET_EXISTENCE_PROB_002
            DET_RANGE_VELOCITY_001_oRDR_DETECTION_001_004_oPCAN_RADAR_a1a074d9_Tx: ComBitPosition=48, ComBitSize=15, ComSignalInitValue=16384, ComSignalType=UINT16, ComHandleId=124, ComSystemTemplateSystemSignalRef=DET_RANGE_VELOCITY_001
            DET_RANGE_VELOCITY_002_oRDR_DETECTION_001_004_oPCAN_RADAR_c5400f27_Tx: ComBitPosition=160, ComBitSize=15, ComSignalInitValue=16384, ComSignalType=UINT16, ComHandleId=125, ComSystemTemplateSystemSignalRef=DET_RANGE_VELOCITY_002
            DET_BI_STATIC_FLAG_001_oRDR_DETECTION_001_004_oPCAN_RADAR_92b185c2_Tx: ComBitPosition=104, ComBitSize=1, ComSignalInitValue=0, ComSignalType=BOOLEAN, ComHandleId=73, ComSystemTemplateSystemSignalRef=DET_BI_STATIC_FLAG_001
            DET_RANGE_VELOCITY_004_oRDR_DETECTION_001_004_oPCAN_RADAR_0c80f8db_Tx: ComBitPosition=384, ComBitSize=15, ComSignalInitValue=16384, ComSignalType=UINT16, ComHandleId=127, ComSystemTemplateSystemSignalRef=DET_RANGE_VELOCITY_004
            DET_CONFD_ELEVATION_001_oRDR_DETECTION_001_004_oPCAN_RADAR_c4eece77_Tx: ComBitPosition=101, ComBitSize=2, ComSignalInitValue=0, ComSignalType=UINT8, ComHandleId=81, ComSystemTemplateSystemSignalRef=DET_CONFD_ELEVATION_001
            DET_SNR_001_oRDR_DETECTION_001_004_oPCAN_RADAR_fb8e1781_Tx: ComBitPosition=120, ComBitSize=8, ComSignalInitValue=0, ComSignalType=UINT8, ComHandleId=136, ComSystemTemplateSystemSignalRef=DET_SNR_001
            DET_SNR_004_oRDR_DETECTION_001_004_oPCAN_RADAR_56ae9b83_Tx: ComBitPosition=456, ComBitSize=8, ComSignalInitValue=0, ComSignalType=UINT8, ComHandleId=139, ComSystemTemplateSystemSignalRef=DET_SNR_004
            DET_CONFD_AZIMUTH_003_oRDR_DETECTION_001_004_oPCAN_RADAR_37eb60e6_Tx: ComBitPosition=342, ComBitSize=2, ComSignalInitValue=0, ComSignalType=UINT8, ComHandleId=79, ComSystemTemplateSystemSignalRef=DET_CONFD_AZIMUTH_003
            DET_RANGE_ERR_003_oRDR_DETECTION_001_004_oPCAN_RADAR_827ea3fe_Tx: ComBitPosition=264, ComBitSize=7, ComSignalInitValue=0, ComSignalType=UINT8, ComHandleId=122, ComSystemTemplateSystemSignalRef=DET_RANGE_ERR_003
            DET_RANGE_VELOCITY_003_oRDR_DETECTION_001_004_oPCAN_RADAR_5030dbb2_Tx: ComBitPosition=272, ComBitSize=15, ComSignalInitValue=16384, ComSignalType=UINT16, ComHandleId=126, ComSystemTemplateSystemSignalRef=DET_RANGE_VELOCITY_003
            DET_MH_SCAN_INDEX_4LSB_001_004_oRDR_DETECTION_001_004_oPCAN_RADAR_139fc315_Tx: ComBitPosition=476, ComBitSize=4, ComSignalInitValue=0, ComSignalType=UINT8, ComHandleId=107, ComSystemTemplateSystemSignalRef=DET_MH_SCAN_INDEX_4LSB_001_004
            DET_SUPER_RES_TARGET_001_oRDR_DETECTION_001_004_oPCAN_RADAR_ca173fe4_Tx: ComBitPosition=87, ComBitSize=1, ComSignalInitValue=0, ComSignalType=BOOLEAN, ComHandleId=140, ComSystemTemplateSystemSignalRef=DET_SUPER_RES_TARGET_001
            DET_RANGE_VELOCITY_ERR_002_oRDR_DETECTION_001_004_oPCAN_RADAR_cafbf495_Tx: ComBitPosition=176, ComBitSize=8, ComSignalInitValue=0, ComSignalType=UINT8, ComHandleId=129, ComSystemTemplateSystemSignalRef=DET_RANGE_VELOCITY_ERR_002
            DET_ELEVATION_ERR_002_oRDR_DETECTION_001_004_oPCAN_RADAR_f6f7f9c0_Tx: ComBitPosition=192, ComBitSize=6, ComSignalInitValue=0, ComSignalType=UINT8, ComHandleId=90, ComSystemTemplateSystemSignalRef=DET_ELEVATION_ERR_002
            DET_ELEVATION_001_oRDR_DETECTION_001_004_oPCAN_RADAR_152e1a4b_Tx: ComBitPosition=72, ComBitSize=8, ComSignalInitValue=0, ComSignalType=UINT8, ComHandleId=85, ComSystemTemplateSystemSignalRef=DET_ELEVATION_001
            DET_BI_STATIC_FLAG_004_oRDR_DETECTION_001_004_oPCAN_RADAR_3f9109c0_Tx: ComBitPosition=440, ComBitSize=1, ComSignalInitValue=0, ComSignalType=BOOLEAN, ComHandleId=76, ComSystemTemplateSystemSignalRef=DET_BI_STATIC_FLAG_004
            DET_CONFD_AZIMUTH_002_oRDR_DETECTION_001_004_oPCAN_RADAR_a29bb473_Tx: ComBitPosition=230, ComBitSize=2, ComSignalInitValue=0, ComSignalType=UINT8, ComHandleId=78, ComSystemTemplateSystemSignalRef=DET_CONFD_AZIMUTH_002
            DET_RANGE_004_oRDR_DETECTION_001_004_oPCAN_RADAR_79263afe_Tx: ComBitPosition=360, ComBitSize=15, ComSignalInitValue=0, ComSignalType=UINT16, ComHandleId=119, ComSystemTemplateSystemSignalRef=DET_RANGE_004
            DET_RANGE_VELOCITY_ERR_003_oRDR_DETECTION_001_004_oPCAN_RADAR_5f8b2000_Tx: ComBitPosition=288, ComBitSize=8, ComSignalInitValue=0, ComSignalType=UINT8, ComHandleId=130, ComSystemTemplateSystemSignalRef=DET_RANGE_VELOCITY_ERR_003
            DET_RANGE_001_oRDR_DETECTION_001_004_oPCAN_RADAR_d406b6fc_Tx: ComBitPosition=24, ComBitSize=15, ComSignalInitValue=0, ComSignalType=UINT16, ComHandleId=116, ComSystemTemplateSystemSignalRef=DET_RANGE_001
            DET_SNR_002_oRDR_DETECTION_001_004_oPCAN_RADAR_9f6e6c7f_Tx: ComBitPosition=232, ComBitSize=8, ComSignalInitValue=0, ComSignalType=UINT8, ComHandleId=137, ComSystemTemplateSystemSignalRef=DET_SNR_002
            DET_ELEVATION_ERR_003_oRDR_DETECTION_001_004_oPCAN_RADAR_63872d55_Tx: ComBitPosition=304, ComBitSize=6, ComSignalInitValue=0, ComSignalType=UINT8, ComHandleId=91, ComSystemTemplateSystemSignalRef=DET_ELEVATION_ERR_003
            DET_ELEVATION_003_oRDR_DETECTION_001_004_oPCAN_RADAR_e4beb520_Tx: ComBitPosition=296, ComBitSize=8, ComSignalInitValue=0, ComSignalType=UINT8, ComHandleId=87, ComSystemTemplateSystemSignalRef=DET_ELEVATION_003
            DET_AZIMUTH_002_oRDR_DETECTION_001_004_oPCAN_RADAR_a07dbeb9_Tx: ComBitPosition=200, ComBitSize=13, ComSignalInitValue=0, ComSignalType=UINT16, ComHandleId=62, ComSystemTemplateSystemSignalRef=DET_AZIMUTH_002
            DET_AZIMUTH_ERR_003_oRDR_DETECTION_001_004_oPCAN_RADAR_91b8ffd9_Tx: ComBitPosition=329, ComBitSize=7, ComSignalInitValue=0, ComSignalType=UINT8, ComHandleId=67, ComSystemTemplateSystemSignalRef=DET_AZIMUTH_ERR_003
            DET_RANGE_ERR_001_oRDR_DETECTION_001_004_oPCAN_RADAR_73ee0c95_Tx: ComBitPosition=40, ComBitSize=7, ComSignalInitValue=0, ComSignalType=UINT8, ComHandleId=120, ComSystemTemplateSystemSignalRef=DET_RANGE_ERR_001
            DET_SUPER_RES_TARGET_002_oRDR_DETECTION_001_004_oPCAN_RADAR_aef7441a_Tx: ComBitPosition=199, ComBitSize=1, ComSignalInitValue=0, ComSignalType=BOOLEAN, ComHandleId=141, ComSystemTemplateSystemSignalRef=DET_SUPER_RES_TARGET_002
            DET_AZIMUTH_ERR_002_oRDR_DETECTION_001_004_oPCAN_RADAR_04c82b4c_Tx: ComBitPosition=217, ComBitSize=7, ComSignalInitValue=0, ComSignalType=UINT8, ComHandleId=66, ComSystemTemplateSystemSignalRef=DET_AZIMUTH_ERR_002
            DET_SNR_003_oRDR_DETECTION_001_004_oPCAN_RADAR_0a1eb8ea_Tx: ComBitPosition=344, ComBitSize=8, ComSignalInitValue=0, ComSignalType=UINT8, ComHandleId=138, ComSystemTemplateSystemSignalRef=DET_SNR_003
            DET_EXISTENCE_PROB_001_oRDR_DETECTION_001_004_oPCAN_RADAR_4088f75e_Tx: ComBitPosition=112, ComBitSize=6, ComSignalInitValue=0, ComSignalType=UINT8, ComHandleId=93, ComSystemTemplateSystemSignalRef=DET_EXISTENCE_PROB_001
            DET_MH_CRC16_001_004_oRDR_DETECTION_001_004_oPCAN_RADAR_5bc047ae_Tx: ComBitPosition=0, ComBitSize=16, ComSignalInitValue=0, ComSignalType=UINT16, ComHandleId=105, ComSystemTemplateSystemSignalRef=DET_MH_CRC16_001_004
            DET_BI_STATIC_FLAG_002_oRDR_DETECTION_001_004_oPCAN_RADAR_f651fe3c_Tx: ComBitPosition=216, ComBitSize=1, ComSignalInitValue=0, ComSignalType=BOOLEAN, ComHandleId=74, ComSystemTemplateSystemSignalRef=DET_BI_STATIC_FLAG_002
            DET_ELEVATION_ERR_001_oRDR_DETECTION_001_004_oPCAN_RADAR_9217823e_Tx: ComBitPosition=80, ComBitSize=6, ComSignalInitValue=0, ComSignalType=UINT8, ComHandleId=89, ComSystemTemplateSystemSignalRef=DET_ELEVATION_ERR_001
            DET_ELEVATION_ERR_004_oRDR_DETECTION_001_004_oPCAN_RADAR_3f370e3c_Tx: ComBitPosition=416, ComBitSize=6, ComSignalInitValue=0, ComSignalType=UINT8, ComHandleId=92, ComSystemTemplateSystemSignalRef=DET_ELEVATION_ERR_004
            DET_ELEVATION_002_oRDR_DETECTION_001_004_oPCAN_RADAR_71ce61b5_Tx: ComBitPosition=184, ComBitSize=8, ComSignalInitValue=0, ComSignalType=UINT8, ComHandleId=86, ComSystemTemplateSystemSignalRef=DET_ELEVATION_002
            DET_AZIMUTH_003_oRDR_DETECTION_001_004_oPCAN_RADAR_350d6a2c_Tx: ComBitPosition=312, ComBitSize=13, ComSignalInitValue=0, ComSignalType=UINT16, ComHandleId=63, ComSystemTemplateSystemSignalRef=DET_AZIMUTH_003
            DET_RANGE_002_oRDR_DETECTION_001_004_oPCAN_RADAR_b0e6cd02_Tx: ComBitPosition=136, ComBitSize=15, ComSignalInitValue=0, ComSignalType=UINT16, ComHandleId=117, ComSystemTemplateSystemSignalRef=DET_RANGE_002
            DET_SUPER_RES_TARGET_003_oRDR_DETECTION_001_004_oPCAN_RADAR_3b87908f_Tx: ComBitPosition=311, ComBitSize=1, ComSignalInitValue=0, ComSignalType=BOOLEAN, ComHandleId=142, ComSystemTemplateSystemSignalRef=DET_SUPER_RES_TARGET_003
            DET_RANGE_VELOCITY_ERR_001_oRDR_DETECTION_001_004_oPCAN_RADAR_ae1b8f6b_Tx: ComBitPosition=64, ComBitSize=8, ComSignalInitValue=0, ComSignalType=UINT8, ComHandleId=128, ComSystemTemplateSystemSignalRef=DET_RANGE_VELOCITY_ERR_001
            DET_RCS_001_oRDR_DETECTION_001_004_oPCAN_RADAR_26204383_Tx: ComBitPosition=128, ComBitSize=8, ComSignalInitValue=128, ComSignalType=UINT8, ComHandleId=132, ComSystemTemplateSystemSignalRef=DET_RCS_001
            DET_AZIMUTH_004_oRDR_DETECTION_001_004_oPCAN_RADAR_69bd4945_Tx: ComBitPosition=424, ComBitSize=13, ComSignalInitValue=0, ComSignalType=UINT16, ComHandleId=64, ComSystemTemplateSystemSignalRef=DET_AZIMUTH_004
            DET_CONFD_ELEVATION_004_oRDR_DETECTION_001_004_oPCAN_RADAR_69ce4275_Tx: ComBitPosition=437, ComBitSize=2, ComSignalInitValue=0, ComSignalType=UINT8, ComHandleId=84, ComSystemTemplateSystemSignalRef=DET_CONFD_ELEVATION_004
            DET_SUPER_RES_TARGET_004_oRDR_DETECTION_001_004_oPCAN_RADAR_6737b3e6_Tx: ComBitPosition=423, ComBitSize=1, ComSignalInitValue=0, ComSignalType=BOOLEAN, ComHandleId=143, ComSystemTemplateSystemSignalRef=DET_SUPER_RES_TARGET_004
            DET_BI_STATIC_FLAG_003_oRDR_DETECTION_001_004_oPCAN_RADAR_63212aa9_Tx: ComBitPosition=328, ComBitSize=1, ComSignalInitValue=0, ComSignalType=BOOLEAN, ComHandleId=75, ComSystemTemplateSystemSignalRef=DET_BI_STATIC_FLAG_003
            DET_HVC_FLAG_001_oRDR_DETECTION_001_004_oPCAN_RADAR_a1fcb421_Tx: ComBitPosition=86, ComBitSize=1, ComSignalInitValue=0, ComSignalType=BOOLEAN, ComHandleId=97, ComSystemTemplateSystemSignalRef=DET_HVC_FLAG_001
            DET_RCS_002_oRDR_DETECTION_001_004_oPCAN_RADAR_42c0387d_Tx: ComBitPosition=240, ComBitSize=8, ComSignalInitValue=128, ComSignalType=UINT8, ComHandleId=133, ComSystemTemplateSystemSignalRef=DET_RCS_002
            DET_MH_CYCLE_COUNTER_001_004_oRDR_DETECTION_001_004_oPCAN_RADAR_dfb5e699_Tx: ComBitPosition=16, ComBitSize=8, ComSignalInitValue=0, ComSignalType=UINT8, ComHandleId=106, ComSystemTemplateSystemSignalRef=DET_MH_CYCLE_COUNTER_001_004
            DET_RANGE_ERR_004_oRDR_DETECTION_001_004_oPCAN_RADAR_dece8097_Tx: ComBitPosition=376, ComBitSize=7, ComSignalInitValue=0, ComSignalType=UINT8, ComHandleId=123, ComSystemTemplateSystemSignalRef=DET_RANGE_ERR_004
            DET_RANGE_003_oRDR_DETECTION_001_004_oPCAN_RADAR_25961997_Tx: ComBitPosition=248, ComBitSize=15, ComSignalInitValue=0, ComSignalType=UINT16, ComHandleId=118, ComSystemTemplateSystemSignalRef=DET_RANGE_003
            DET_ELEVATION_004_oRDR_DETECTION_001_004_oPCAN_RADAR_b80e9649_Tx: ComBitPosition=408, ComBitSize=8, ComSignalInitValue=0, ComSignalType=UINT8, ComHandleId=88, ComSystemTemplateSystemSignalRef=DET_ELEVATION_004
            DET_EXISTENCE_PROB_004_oRDR_DETECTION_001_004_oPCAN_RADAR_eda87b5c_Tx: ComBitPosition=448, ComBitSize=6, ComSignalInitValue=0, ComSignalType=UINT8, ComHandleId=96, ComSystemTemplateSystemSignalRef=DET_EXISTENCE_PROB_004
            DET_AZIMUTH_ERR_004_oRDR_DETECTION_001_004_oPCAN_RADAR_cd08dcb0_Tx: ComBitPosition=441, ComBitSize=7, ComSignalInitValue=0, ComSignalType=UINT8, ComHandleId=68, ComSystemTemplateSystemSignalRef=DET_AZIMUTH_ERR_004
            DET_HVC_FLAG_002_oRDR_DETECTION_001_004_oPCAN_RADAR_c51ccfdf_Tx: ComBitPosition=198, ComBitSize=1, ComSignalInitValue=0, ComSignalType=BOOLEAN, ComHandleId=98, ComSystemTemplateSystemSignalRef=DET_HVC_FLAG_002
            DET_CONFD_AZIMUTH_004_oRDR_DETECTION_001_004_oPCAN_RADAR_6b5b438f_Tx: ComBitPosition=454, ComBitSize=2, ComSignalInitValue=0, ComSignalType=UINT8, ComHandleId=80, ComSystemTemplateSystemSignalRef=DET_CONFD_AZIMUTH_004
            DET_RCS_004_oRDR_DETECTION_001_004_oPCAN_RADAR_8b00cf81_Tx: ComBitPosition=464, ComBitSize=8, ComSignalInitValue=128, ComSignalType=UINT8, ComHandleId=135, ComSystemTemplateSystemSignalRef=DET_RCS_004
            DET_RANGE_ERR_002_oRDR_DETECTION_001_004_oPCAN_RADAR_170e776b_Tx: ComBitPosition=152, ComBitSize=7, ComSignalInitValue=0, ComSignalType=UINT8, ComHandleId=121, ComSystemTemplateSystemSignalRef=DET_RANGE_ERR_002
            DET_RCS_003_oRDR_DETECTION_001_004_oPCAN_RADAR_d7b0ece8_Tx: ComBitPosition=352, ComBitSize=8, ComSignalInitValue=128, ComSignalType=UINT8, ComHandleId=134, ComSystemTemplateSystemSignalRef=DET_RCS_003
            DET_CONFD_ELEVATION_002_oRDR_DETECTION_001_004_oPCAN_RADAR_a00eb589_Tx: ComBitPosition=213, ComBitSize=2, ComSignalInitValue=0, ComSignalType=UINT8, ComHandleId=82, ComSystemTemplateSystemSignalRef=DET_CONFD_ELEVATION_002
            DET_HVC_FLAG_003_oRDR_DETECTION_001_004_oPCAN_RADAR_506c1b4a_Tx: ComBitPosition=310, ComBitSize=1, ComSignalInitValue=0, ComSignalType=BOOLEAN, ComHandleId=99, ComSystemTemplateSystemSignalRef=DET_HVC_FLAG_003
            DET_HVC_FLAG_004_oRDR_DETECTION_001_004_oPCAN_RADAR_0cdc3823_Tx: ComBitPosition=422, ComBitSize=1, ComSignalInitValue=0, ComSignalType=BOOLEAN, ComHandleId=100, ComSystemTemplateSystemSignalRef=DET_HVC_FLAG_004
            DET_AZIMUTH_001_oRDR_DETECTION_001_004_oPCAN_RADAR_c49dc547_Tx: ComBitPosition=88, ComBitSize=13, ComSignalInitValue=0, ComSignalType=UINT16, ComHandleId=61, ComSystemTemplateSystemSignalRef=DET_AZIMUTH_001
            DET_CONFD_ELEVATION_003_oRDR_DETECTION_001_004_oPCAN_RADAR_357e611c_Tx: ComBitPosition=325, ComBitSize=2, ComSignalInitValue=0, ComSignalType=UINT8, ComHandleId=83, ComSystemTemplateSystemSignalRef=DET_CONFD_ELEVATION_003
            DET_IDM_001_oRDR_DETECTION_001_004_oPCAN_RADAR_2aae8f9c_Tx: ComBitPosition=63, ComBitSize=1, ComSignalInitValue=0, ComSignalType=UINT8, ComHandleId=101, ComSystemTemplateSystemSignalRef=DET_IDM_001
            DET_BELOW_RAIN_THOLD_001_oRDR_DETECTION_001_004_oPCAN_RADAR_119c5687_Tx: ComBitPosition=39, ComBitSize=1, ComSignalInitValue=0, ComSignalType=UINT8, ComHandleId=69, ComSystemTemplateSystemSignalRef=DET_BELOW_RAIN_THOLD_001
            DET_MTD_002_oRDR_DETECTION_001_004_oPCAN_RADAR_28fdc6b9_Tx: ComBitPosition=159, ComBitSize=1, ComSignalInitValue=0, ComSignalType=UINT8, ComHandleId=109, ComSystemTemplateSystemSignalRef=DET_MTD_002
            DET_BELOW_RAIN_THOLD_004_oRDR_DETECTION_001_004_oPCAN_RADAR_bcbcda85_Tx: ComBitPosition=375, ComBitSize=1, ComSignalInitValue=0, ComSignalType=UINT8, ComHandleId=72, ComSystemTemplateSystemSignalRef=DET_BELOW_RAIN_THOLD_004
            DET_IDM_003_oRDR_DETECTION_001_004_oPCAN_RADAR_db3e20f7_Tx: ComBitPosition=287, ComBitSize=1, ComSignalInitValue=0, ComSignalType=UINT8, ComHandleId=103, ComSystemTemplateSystemSignalRef=DET_IDM_003
            DET_MTD_004_oRDR_DETECTION_001_004_oPCAN_RADAR_e13d3145_Tx: ComBitPosition=383, ComBitSize=1, ComSignalInitValue=0, ComSignalType=UINT8, ComHandleId=111, ComSystemTemplateSystemSignalRef=DET_MTD_004
            DET_BELOW_RAIN_THOLD_002_oRDR_DETECTION_001_004_oPCAN_RADAR_757c2d79_Tx: ComBitPosition=151, ComBitSize=1, ComSignalInitValue=0, ComSignalType=UINT8, ComHandleId=70, ComSystemTemplateSystemSignalRef=DET_BELOW_RAIN_THOLD_002
            DET_PROB_1STAZHYPO_004_oRDR_DETECTION_001_004_oPCAN_RADAR_7289d988_Tx: ComBitPosition=439, ComBitSize=1, ComSignalInitValue=0, ComSignalType=BOOLEAN, ComHandleId=115, ComSystemTemplateSystemSignalRef=DET_PROB_1STAZHYPO_004
            DET_IDM_004_oRDR_DETECTION_001_004_oPCAN_RADAR_878e039e_Tx: ComBitPosition=399, ComBitSize=1, ComSignalInitValue=0, ComSignalType=UINT8, ComHandleId=104, ComSystemTemplateSystemSignalRef=DET_IDM_004
            DET_MTD_003_oRDR_DETECTION_001_004_oPCAN_RADAR_bd8d122c_Tx: ComBitPosition=271, ComBitSize=1, ComSignalInitValue=0, ComSignalType=UINT8, ComHandleId=110, ComSystemTemplateSystemSignalRef=DET_MTD_003
            DET_PROB_1STAZHYPO_003_oRDR_DETECTION_001_004_oPCAN_RADAR_2e39fae1_Tx: ComBitPosition=327, ComBitSize=1, ComSignalInitValue=0, ComSignalType=BOOLEAN, ComHandleId=114, ComSystemTemplateSystemSignalRef=DET_PROB_1STAZHYPO_003
            DET_PROB_1STAZHYPO_001_oRDR_DETECTION_001_004_oPCAN_RADAR_dfa9558a_Tx: ComBitPosition=103, ComBitSize=1, ComSignalInitValue=0, ComSignalType=BOOLEAN, ComHandleId=112, ComSystemTemplateSystemSignalRef=DET_PROB_1STAZHYPO_001
            DET_PROB_1STAZHYPO_002_oRDR_DETECTION_001_004_oPCAN_RADAR_bb492e74_Tx: ComBitPosition=215, ComBitSize=1, ComSignalInitValue=0, ComSignalType=BOOLEAN, ComHandleId=113, ComSystemTemplateSystemSignalRef=DET_PROB_1STAZHYPO_002
            DET_IDM_002_oRDR_DETECTION_001_004_oPCAN_RADAR_4e4ef462_Tx: ComBitPosition=175, ComBitSize=1, ComSignalInitValue=0, ComSignalType=UINT8, ComHandleId=102, ComSystemTemplateSystemSignalRef=DET_IDM_002
            DET_MTD_001_oRDR_DETECTION_001_004_oPCAN_RADAR_4c1dbd47_Tx: ComBitPosition=47, ComBitSize=1, ComSignalInitValue=0, ComSignalType=UINT8, ComHandleId=108, ComSystemTemplateSystemSignalRef=DET_MTD_001
            DET_BELOW_RAIN_THOLD_003_oRDR_DETECTION_001_004_oPCAN_RADAR_e00cf9ec_Tx: ComBitPosition=263, ComBitSize=1, ComSignalInitValue=0, ComSignalType=UINT8, ComHandleId=71, ComSystemTemplateSystemSignalRef=DET_BELOW_RAIN_THOLD_003
        SG_Detections_037_040_oRDR_DETECTION_037_040_oPCAN_RADAR_abdcc2d8_Tx: ComTransferProperty=TRIGGERED, ComHandleId=11, ComSystemTemplateSignalGroupRef=SG_Detections_037_040
          83 x ComGroupSignal, all with ComSignalEndianness=LITTLE_ENDIAN, ComTransferProperty=PENDING, ComSignalAccess=ACCESS_NEEDED_BY_SWC_OR_COM:
            DET_RCS_040_oRDR_DETECTION_037_040_oPCAN_RADAR_49a44e4e_Tx: ComBitPosition=464, ComBitSize=8, ComSignalInitValue=128, ComSignalType=UINT8, ComHandleId=882, ComSystemTemplateSystemSignalRef=DET_RCS_040
            DET_RANGE_ERR_038_oRDR_DETECTION_037_040_oPCAN_RADAR_58f8d9a9_Tx: ComBitPosition=152, ComBitSize=7, ComSignalInitValue=0, ComSignalType=UINT8, ComHandleId=868, ComSystemTemplateSystemSignalRef=DET_RANGE_ERR_038
            DET_HVC_FLAG_040_oRDR_DETECTION_037_040_oPCAN_RADAR_ce78b9ec_Tx: ComBitPosition=422, ComBitSize=1, ComSignalInitValue=0, ComSignalType=BOOLEAN, ComHandleId=847, ComSystemTemplateSystemSignalRef=DET_HVC_FLAG_040
            DET_RANGE_VELOCITY_ERR_038_oRDR_DETECTION_037_040_oPCAN_RADAR_850d5a57_Tx: ComBitPosition=176, ComBitSize=8, ComSignalInitValue=0, ComSignalType=UINT8, ComHandleId=876, ComSystemTemplateSystemSignalRef=DET_RANGE_VELOCITY_ERR_038
            DET_HVC_FLAG_038_oRDR_DETECTION_037_040_oPCAN_RADAR_8aea611d_Tx: ComBitPosition=198, ComBitSize=1, ComSignalInitValue=0, ComSignalType=BOOLEAN, ComHandleId=845, ComSystemTemplateSystemSignalRef=DET_HVC_FLAG_038
            DET_RANGE_VELOCITY_039_oRDR_DETECTION_037_040_oPCAN_RADAR_1fc67570_Tx: ComBitPosition=272, ComBitSize=15, ComSignalInitValue=16384, ComSignalType=UINT16, ComHandleId=873, ComSystemTemplateSystemSignalRef=DET_RANGE_VELOCITY_039
            DET_RANGE_037_oRDR_DETECTION_037_040_oPCAN_RADAR_d300f187_Tx: ComBitPosition=24, ComBitSize=15, ComSignalInitValue=0, ComSignalType=UINT16, ComHandleId=863, ComSystemTemplateSystemSignalRef=DET_RANGE_037
            DET_HVC_FLAG_037_oRDR_DETECTION_037_040_oPCAN_RADAR_a6faf35a_Tx: ComBitPosition=86, ComBitSize=1, ComSignalInitValue=0, ComSignalType=BOOLEAN, ComHandleId=844, ComSystemTemplateSystemSignalRef=DET_HVC_FLAG_037
            DET_RANGE_038_oRDR_DETECTION_037_040_oPCAN_RADAR_ff1063c0_Tx: ComBitPosition=136, ComBitSize=15, ComSignalInitValue=0, ComSignalType=UINT16, ComHandleId=864, ComSystemTemplateSystemSignalRef=DET_RANGE_038
            DET_RANGE_VELOCITY_ERR_040_oRDR_DETECTION_037_040_oPCAN_RADAR_c19f82a6_Tx: ComBitPosition=400, ComBitSize=8, ComSignalInitValue=0, ComSignalType=UINT8, ComHandleId=878, ComSystemTemplateSystemSignalRef=DET_RANGE_VELOCITY_ERR_040
            DET_MH_CRC16_037_040_oRDR_DETECTION_037_040_oPCAN_RADAR_2f5410d3_Tx: ComBitPosition=0, ComBitSize=16, ComSignalInitValue=0, ComSignalType=UINT16, ComHandleId=852, ComSystemTemplateSystemSignalRef=DET_MH_CRC16_037_040
            DET_EXISTENCE_PROB_037_oRDR_DETECTION_037_040_oPCAN_RADAR_478eb025_Tx: ComBitPosition=112, ComBitSize=6, ComSignalInitValue=0, ComSignalType=UINT8, ComHandleId=840, ComSystemTemplateSystemSignalRef=DET_EXISTENCE_PROB_037
            DET_EXISTENCE_PROB_040_oRDR_DETECTION_037_040_oPCAN_RADAR_2f0cfa93_Tx: ComBitPosition=448, ComBitSize=6, ComSignalInitValue=0, ComSignalType=UINT8, ComHandleId=843, ComSystemTemplateSystemSignalRef=DET_EXISTENCE_PROB_040
            DET_BI_STATIC_FLAG_040_oRDR_DETECTION_037_040_oPCAN_RADAR_fd35880f_Tx: ComBitPosition=440, ComBitSize=1, ComSignalInitValue=0, ComSignalType=BOOLEAN, ComHandleId=823, ComSystemTemplateSystemSignalRef=DET_BI_STATIC_FLAG_040
            DET_ELEVATION_039_oRDR_DETECTION_037_040_oPCAN_RADAR_ab481be2_Tx: ComBitPosition=296, ComBitSize=8, ComSignalInitValue=0, ComSignalType=UINT8, ComHandleId=834, ComSystemTemplateSystemSignalRef=DET_ELEVATION_039
            DET_ELEVATION_ERR_039_oRDR_DETECTION_037_040_oPCAN_RADAR_2c718397_Tx: ComBitPosition=304, ComBitSize=6, ComSignalInitValue=0, ComSignalType=UINT8, ComHandleId=838, ComSystemTemplateSystemSignalRef=DET_ELEVATION_ERR_039
            DET_RANGE_ERR_037_oRDR_DETECTION_037_040_oPCAN_RADAR_74e84bee_Tx: ComBitPosition=40, ComBitSize=7, ComSignalInitValue=0, ComSignalType=UINT8, ComHandleId=867, ComSystemTemplateSystemSignalRef=DET_RANGE_ERR_037
            DET_ELEVATION_040_oRDR_DETECTION_037_040_oPCAN_RADAR_7aaa1786_Tx: ComBitPosition=408, ComBitSize=8, ComSignalInitValue=0, ComSignalType=UINT8, ComHandleId=835, ComSystemTemplateSystemSignalRef=DET_ELEVATION_040
            DET_CONFD_ELEVATION_038_oRDR_DETECTION_037_040_oPCAN_RADAR_eff81b4b_Tx: ComBitPosition=213, ComBitSize=2, ComSignalInitValue=0, ComSignalType=UINT8, ComHandleId=829, ComSystemTemplateSystemSignalRef=DET_CONFD_ELEVATION_038
            DET_CONFD_AZIMUTH_037_oRDR_DETECTION_037_040_oPCAN_RADAR_c17d88f6_Tx: ComBitPosition=118, ComBitSize=2, ComSignalInitValue=0, ComSignalType=UINT8, ComHandleId=824, ComSystemTemplateSystemSignalRef=DET_CONFD_AZIMUTH_037
            DET_CONFD_AZIMUTH_039_oRDR_DETECTION_037_040_oPCAN_RADAR_781dce24_Tx: ComBitPosition=342, ComBitSize=2, ComSignalInitValue=0, ComSignalType=UINT8, ComHandleId=826, ComSystemTemplateSystemSignalRef=DET_CONFD_AZIMUTH_039
            DET_AZIMUTH_040_oRDR_DETECTION_037_040_oPCAN_RADAR_ab19c88a_Tx: ComBitPosition=424, ComBitSize=13, ComSignalInitValue=0, ComSignalType=UINT16, ComHandleId=811, ComSystemTemplateSystemSignalRef=DET_AZIMUTH_040
            DET_SNR_038_oRDR_DETECTION_037_040_oPCAN_RADAR_d098c2bd_Tx: ComBitPosition=232, ComBitSize=8, ComSignalInitValue=0, ComSignalType=UINT8, ComHandleId=884, ComSystemTemplateSystemSignalRef=DET_SNR_038
            DET_RCS_039_oRDR_DETECTION_037_040_oPCAN_RADAR_9846422a_Tx: ComBitPosition=352, ComBitSize=8, ComSignalInitValue=128, ComSignalType=UINT8, ComHandleId=881, ComSystemTemplateSystemSignalRef=DET_RCS_039
            DET_BI_STATIC_FLAG_038_oRDR_DETECTION_037_040_oPCAN_RADAR_b9a750fe_Tx: ComBitPosition=216, ComBitSize=1, ComSignalInitValue=0, ComSignalType=BOOLEAN, ComHandleId=821, ComSystemTemplateSystemSignalRef=DET_BI_STATIC_FLAG_038
            DET_BI_STATIC_FLAG_037_oRDR_DETECTION_037_040_oPCAN_RADAR_95b7c2b9_Tx: ComBitPosition=104, ComBitSize=1, ComSignalInitValue=0, ComSignalType=BOOLEAN, ComHandleId=820, ComSystemTemplateSystemSignalRef=DET_BI_STATIC_FLAG_037
            DET_RANGE_VELOCITY_ERR_039_oRDR_DETECTION_037_040_oPCAN_RADAR_107d8ec2_Tx: ComBitPosition=288, ComBitSize=8, ComSignalInitValue=0, ComSignalType=UINT8, ComHandleId=877, ComSystemTemplateSystemSignalRef=DET_RANGE_VELOCITY_ERR_039
            DET_MH_SCAN_INDEX_4LSB_037_040_oRDR_DETECTION_037_040_oPCAN_RADAR_670b9468_Tx: ComBitPosition=476, ComBitSize=4, ComSignalInitValue=0, ComSignalType=UINT8, ComHandleId=854, ComSystemTemplateSystemSignalRef=DET_MH_SCAN_INDEX_4LSB_037_040
            DET_RANGE_VELOCITY_ERR_037_oRDR_DETECTION_037_040_oPCAN_RADAR_a91dc810_Tx: ComBitPosition=64, ComBitSize=8, ComSignalInitValue=0, ComSignalType=UINT8, ComHandleId=875, ComSystemTemplateSystemSignalRef=DET_RANGE_VELOCITY_ERR_037
            DET_ELEVATION_038_oRDR_DETECTION_037_040_oPCAN_RADAR_3e38cf77_Tx: ComBitPosition=184, ComBitSize=8, ComSignalInitValue=0, ComSignalType=UINT8, ComHandleId=833, ComSystemTemplateSystemSignalRef=DET_ELEVATION_038
            DET_CONFD_AZIMUTH_040_oRDR_DETECTION_037_040_oPCAN_RADAR_a9ffc240_Tx: ComBitPosition=454, ComBitSize=2, ComSignalInitValue=0, ComSignalType=UINT8, ComHandleId=827, ComSystemTemplateSystemSignalRef=DET_CONFD_AZIMUTH_040
            DET_RANGE_VELOCITY_037_oRDR_DETECTION_037_040_oPCAN_RADAR_a6a633a2_Tx: ComBitPosition=48, ComBitSize=15, ComSignalInitValue=16384, ComSignalType=UINT16, ComHandleId=871, ComSystemTemplateSystemSignalRef=DET_RANGE_VELOCITY_037
            DET_SNR_039_oRDR_DETECTION_037_040_oPCAN_RADAR_45e81628_Tx: ComBitPosition=344, ComBitSize=8, ComSignalInitValue=0, ComSignalType=UINT8, ComHandleId=885, ComSystemTemplateSystemSignalRef=DET_SNR_039
            DET_RCS_038_oRDR_DETECTION_037_040_oPCAN_RADAR_0d3696bf_Tx: ComBitPosition=240, ComBitSize=8, ComSignalInitValue=128, ComSignalType=UINT8, ComHandleId=880, ComSystemTemplateSystemSignalRef=DET_RCS_038
            DET_MH_CYCLE_COUNTER_037_040_oRDR_DETECTION_037_040_oPCAN_RADAR_ab21b1e4_Tx: ComBitPosition=16, ComBitSize=8, ComSignalInitValue=0, ComSignalType=UINT8, ComHandleId=853, ComSystemTemplateSystemSignalRef=DET_MH_CYCLE_COUNTER_037_040
            DET_AZIMUTH_ERR_038_oRDR_DETECTION_037_040_oPCAN_RADAR_4b3e858e_Tx: ComBitPosition=217, ComBitSize=7, ComSignalInitValue=0, ComSignalType=UINT8, ComHandleId=813, ComSystemTemplateSystemSignalRef=DET_AZIMUTH_ERR_038
            DET_RANGE_ERR_039_oRDR_DETECTION_037_040_oPCAN_RADAR_cd880d3c_Tx: ComBitPosition=264, ComBitSize=7, ComSignalInitValue=0, ComSignalType=UINT8, ComHandleId=869, ComSystemTemplateSystemSignalRef=DET_RANGE_ERR_039
            DET_ELEVATION_ERR_040_oRDR_DETECTION_037_040_oPCAN_RADAR_fd938ff3_Tx: ComBitPosition=416, ComBitSize=6, ComSignalInitValue=0, ComSignalType=UINT8, ComHandleId=839, ComSystemTemplateSystemSignalRef=DET_ELEVATION_ERR_040
            DET_ELEVATION_ERR_038_oRDR_DETECTION_037_040_oPCAN_RADAR_b9015702_Tx: ComBitPosition=192, ComBitSize=6, ComSignalInitValue=0, ComSignalType=UINT8, ComHandleId=837, ComSystemTemplateSystemSignalRef=DET_ELEVATION_ERR_038
            DET_SNR_040_oRDR_DETECTION_037_040_oPCAN_RADAR_940a1a4c_Tx: ComBitPosition=456, ComBitSize=8, ComSignalInitValue=0, ComSignalType=UINT8, ComHandleId=886, ComSystemTemplateSystemSignalRef=DET_SNR_040
            DET_BI_STATIC_FLAG_039_oRDR_DETECTION_037_040_oPCAN_RADAR_2cd7846b_Tx: ComBitPosition=328, ComBitSize=1, ComSignalInitValue=0, ComSignalType=BOOLEAN, ComHandleId=822, ComSystemTemplateSystemSignalRef=DET_BI_STATIC_FLAG_039
            DET_SUPER_RES_TARGET_037_oRDR_DETECTION_037_040_oPCAN_RADAR_cd11789f_Tx: ComBitPosition=87, ComBitSize=1, ComSignalInitValue=0, ComSignalType=BOOLEAN, ComHandleId=887, ComSystemTemplateSystemSignalRef=DET_SUPER_RES_TARGET_037
            DET_ELEVATION_037_oRDR_DETECTION_037_040_oPCAN_RADAR_12285d30_Tx: ComBitPosition=72, ComBitSize=8, ComSignalInitValue=0, ComSignalType=UINT8, ComHandleId=832, ComSystemTemplateSystemSignalRef=DET_ELEVATION_037
            DET_RCS_037_oRDR_DETECTION_037_040_oPCAN_RADAR_212604f8_Tx: ComBitPosition=128, ComBitSize=8, ComSignalInitValue=128, ComSignalType=UINT8, ComHandleId=879, ComSystemTemplateSystemSignalRef=DET_RCS_037
            DET_RANGE_ERR_040_oRDR_DETECTION_037_040_oPCAN_RADAR_1c6a0158_Tx: ComBitPosition=376, ComBitSize=7, ComSignalInitValue=0, ComSignalType=UINT8, ComHandleId=870, ComSystemTemplateSystemSignalRef=DET_RANGE_ERR_040
            DET_SNR_037_oRDR_DETECTION_037_040_oPCAN_RADAR_fc8850fa_Tx: ComBitPosition=120, ComBitSize=8, ComSignalInitValue=0, ComSignalType=UINT8, ComHandleId=883, ComSystemTemplateSystemSignalRef=DET_SNR_037
            DET_SUPER_RES_TARGET_039_oRDR_DETECTION_037_040_oPCAN_RADAR_74713e4d_Tx: ComBitPosition=311, ComBitSize=1, ComSignalInitValue=0, ComSignalType=BOOLEAN, ComHandleId=889, ComSystemTemplateSystemSignalRef=DET_SUPER_RES_TARGET_039
            DET_EXISTENCE_PROB_038_oRDR_DETECTION_037_040_oPCAN_RADAR_6b9e2262_Tx: ComBitPosition=224, ComBitSize=6, ComSignalInitValue=0, ComSignalType=UINT8, ComHandleId=841, ComSystemTemplateSystemSignalRef=DET_EXISTENCE_PROB_038
            DET_ELEVATION_ERR_037_oRDR_DETECTION_037_040_oPCAN_RADAR_9511c545_Tx: ComBitPosition=80, ComBitSize=6, ComSignalInitValue=0, ComSignalType=UINT8, ComHandleId=836, ComSystemTemplateSystemSignalRef=DET_ELEVATION_ERR_037
            DET_AZIMUTH_037_oRDR_DETECTION_037_040_oPCAN_RADAR_c39b823c_Tx: ComBitPosition=88, ComBitSize=13, ComSignalInitValue=0, ComSignalType=UINT16, ComHandleId=808, ComSystemTemplateSystemSignalRef=DET_AZIMUTH_037
            DET_AZIMUTH_039_oRDR_DETECTION_037_040_oPCAN_RADAR_7afbc4ee_Tx: ComBitPosition=312, ComBitSize=13, ComSignalInitValue=0, ComSignalType=UINT16, ComHandleId=810, ComSystemTemplateSystemSignalRef=DET_AZIMUTH_039
            DET_CONFD_ELEVATION_040_oRDR_DETECTION_037_040_oPCAN_RADAR_ab6ac3ba_Tx: ComBitPosition=437, ComBitSize=2, ComSignalInitValue=0, ComSignalType=UINT8, ComHandleId=831, ComSystemTemplateSystemSignalRef=DET_CONFD_ELEVATION_040
            DET_RANGE_VELOCITY_040_oRDR_DETECTION_037_040_oPCAN_RADAR_ce247914_Tx: ComBitPosition=384, ComBitSize=15, ComSignalInitValue=16384, ComSignalType=UINT16, ComHandleId=874, ComSystemTemplateSystemSignalRef=DET_RANGE_VELOCITY_040
            DET_EXISTENCE_PROB_039_oRDR_DETECTION_037_040_oPCAN_RADAR_feeef6f7_Tx: ComBitPosition=336, ComBitSize=6, ComSignalInitValue=0, ComSignalType=UINT8, ComHandleId=842, ComSystemTemplateSystemSignalRef=DET_EXISTENCE_PROB_039
            DET_CONFD_ELEVATION_039_oRDR_DETECTION_037_040_oPCAN_RADAR_7a88cfde_Tx: ComBitPosition=325, ComBitSize=2, ComSignalInitValue=0, ComSignalType=UINT8, ComHandleId=830, ComSystemTemplateSystemSignalRef=DET_CONFD_ELEVATION_039
            DET_AZIMUTH_ERR_039_oRDR_DETECTION_037_040_oPCAN_RADAR_de4e511b_Tx: ComBitPosition=329, ComBitSize=7, ComSignalInitValue=0, ComSignalType=UINT8, ComHandleId=814, ComSystemTemplateSystemSignalRef=DET_AZIMUTH_ERR_039
            DET_SUPER_RES_TARGET_038_oRDR_DETECTION_037_040_oPCAN_RADAR_e101ead8_Tx: ComBitPosition=199, ComBitSize=1, ComSignalInitValue=0, ComSignalType=BOOLEAN, ComHandleId=888, ComSystemTemplateSystemSignalRef=DET_SUPER_RES_TARGET_038
            DET_CONFD_AZIMUTH_038_oRDR_DETECTION_037_040_oPCAN_RADAR_ed6d1ab1_Tx: ComBitPosition=230, ComBitSize=2, ComSignalInitValue=0, ComSignalType=UINT8, ComHandleId=825, ComSystemTemplateSystemSignalRef=DET_CONFD_AZIMUTH_038
            DET_AZIMUTH_ERR_037_oRDR_DETECTION_037_040_oPCAN_RADAR_672e17c9_Tx: ComBitPosition=105, ComBitSize=7, ComSignalInitValue=0, ComSignalType=UINT8, ComHandleId=812, ComSystemTemplateSystemSignalRef=DET_AZIMUTH_ERR_037
            DET_RANGE_VELOCITY_038_oRDR_DETECTION_037_040_oPCAN_RADAR_8ab6a1e5_Tx: ComBitPosition=160, ComBitSize=15, ComSignalInitValue=16384, ComSignalType=UINT16, ComHandleId=872, ComSystemTemplateSystemSignalRef=DET_RANGE_VELOCITY_038
            DET_HVC_FLAG_039_oRDR_DETECTION_037_040_oPCAN_RADAR_1f9ab588_Tx: ComBitPosition=310, ComBitSize=1, ComSignalInitValue=0, ComSignalType=BOOLEAN, ComHandleId=846, ComSystemTemplateSystemSignalRef=DET_HVC_FLAG_039
            DET_AZIMUTH_ERR_040_oRDR_DETECTION_037_040_oPCAN_RADAR_0fac5d7f_Tx: ComBitPosition=441, ComBitSize=7, ComSignalInitValue=0, ComSignalType=UINT8, ComHandleId=815, ComSystemTemplateSystemSignalRef=DET_AZIMUTH_ERR_040
            DET_SUPER_RES_TARGET_040_oRDR_DETECTION_037_040_oPCAN_RADAR_a5933229_Tx: ComBitPosition=423, ComBitSize=1, ComSignalInitValue=0, ComSignalType=BOOLEAN, ComHandleId=890, ComSystemTemplateSystemSignalRef=DET_SUPER_RES_TARGET_040
            DET_CONFD_ELEVATION_037_oRDR_DETECTION_037_040_oPCAN_RADAR_c3e8890c_Tx: ComBitPosition=101, ComBitSize=2, ComSignalInitValue=0, ComSignalType=UINT8, ComHandleId=828, ComSystemTemplateSystemSignalRef=DET_CONFD_ELEVATION_037
            DET_RANGE_039_oRDR_DETECTION_037_040_oPCAN_RADAR_6a60b755_Tx: ComBitPosition=248, ComBitSize=15, ComSignalInitValue=0, ComSignalType=UINT16, ComHandleId=865, ComSystemTemplateSystemSignalRef=DET_RANGE_039
            DET_AZIMUTH_038_oRDR_DETECTION_037_040_oPCAN_RADAR_ef8b107b_Tx: ComBitPosition=200, ComBitSize=13, ComSignalInitValue=0, ComSignalType=UINT16, ComHandleId=809, ComSystemTemplateSystemSignalRef=DET_AZIMUTH_038
            DET_RANGE_040_oRDR_DETECTION_037_040_oPCAN_RADAR_bb82bb31_Tx: ComBitPosition=360, ComBitSize=15, ComSignalInitValue=0, ComSignalType=UINT16, ComHandleId=866, ComSystemTemplateSystemSignalRef=DET_RANGE_040
            DET_PROB_1STAZHYPO_040_oRDR_DETECTION_037_040_oPCAN_RADAR_b02d5847_Tx: ComBitPosition=439, ComBitSize=1, ComSignalInitValue=0, ComSignalType=BOOLEAN, ComHandleId=862, ComSystemTemplateSystemSignalRef=DET_PROB_1STAZHYPO_040
            DET_PROB_1STAZHYPO_037_oRDR_DETECTION_037_040_oPCAN_RADAR_d8af12f1_Tx: ComBitPosition=103, ComBitSize=1, ComSignalInitValue=0, ComSignalType=BOOLEAN, ComHandleId=859, ComSystemTemplateSystemSignalRef=DET_PROB_1STAZHYPO_037
            DET_IDM_038_oRDR_DETECTION_037_040_oPCAN_RADAR_01b85aa0_Tx: ComBitPosition=175, ComBitSize=1, ComSignalInitValue=0, ComSignalType=UINT8, ComHandleId=849, ComSystemTemplateSystemSignalRef=DET_IDM_038
            DET_BELOW_RAIN_THOLD_040_oRDR_DETECTION_037_040_oPCAN_RADAR_7e185b4a_Tx: ComBitPosition=375, ComBitSize=1, ComSignalInitValue=0, ComSignalType=UINT8, ComHandleId=819, ComSystemTemplateSystemSignalRef=DET_BELOW_RAIN_THOLD_040
            DET_MTD_038_oRDR_DETECTION_037_040_oPCAN_RADAR_670b687b_Tx: ComBitPosition=159, ComBitSize=1, ComSignalInitValue=0, ComSignalType=UINT8, ComHandleId=856, ComSystemTemplateSystemSignalRef=DET_MTD_038
            DET_MTD_040_oRDR_DETECTION_037_040_oPCAN_RADAR_2399b08a_Tx: ComBitPosition=383, ComBitSize=1, ComSignalInitValue=0, ComSignalType=UINT8, ComHandleId=858, ComSystemTemplateSystemSignalRef=DET_MTD_040
            DET_IDM_039_oRDR_DETECTION_037_040_oPCAN_RADAR_94c88e35_Tx: ComBitPosition=287, ComBitSize=1, ComSignalInitValue=0, ComSignalType=UINT8, ComHandleId=850, ComSystemTemplateSystemSignalRef=DET_IDM_039
            DET_BELOW_RAIN_THOLD_037_oRDR_DETECTION_037_040_oPCAN_RADAR_169a11fc_Tx: ComBitPosition=39, ComBitSize=1, ComSignalInitValue=0, ComSignalType=UINT8, ComHandleId=816, ComSystemTemplateSystemSignalRef=DET_BELOW_RAIN_THOLD_037
            DET_IDM_037_oRDR_DETECTION_037_040_oPCAN_RADAR_2da8c8e7_Tx: ComBitPosition=63, ComBitSize=1, ComSignalInitValue=0, ComSignalType=UINT8, ComHandleId=848, ComSystemTemplateSystemSignalRef=DET_IDM_037
            DET_PROB_1STAZHYPO_039_oRDR_DETECTION_037_040_oPCAN_RADAR_61cf5423_Tx: ComBitPosition=327, ComBitSize=1, ComSignalInitValue=0, ComSignalType=BOOLEAN, ComHandleId=861, ComSystemTemplateSystemSignalRef=DET_PROB_1STAZHYPO_039
            DET_BELOW_RAIN_THOLD_039_oRDR_DETECTION_037_040_oPCAN_RADAR_affa572e_Tx: ComBitPosition=263, ComBitSize=1, ComSignalInitValue=0, ComSignalType=UINT8, ComHandleId=818, ComSystemTemplateSystemSignalRef=DET_BELOW_RAIN_THOLD_039
            DET_PROB_1STAZHYPO_038_oRDR_DETECTION_037_040_oPCAN_RADAR_f4bf80b6_Tx: ComBitPosition=215, ComBitSize=1, ComSignalInitValue=0, ComSignalType=BOOLEAN, ComHandleId=860, ComSystemTemplateSystemSignalRef=DET_PROB_1STAZHYPO_038
            DET_IDM_040_oRDR_DETECTION_037_040_oPCAN_RADAR_452a8251_Tx: ComBitPosition=399, ComBitSize=1, ComSignalInitValue=0, ComSignalType=UINT8, ComHandleId=851, ComSystemTemplateSystemSignalRef=DET_IDM_040
            DET_BELOW_RAIN_THOLD_038_oRDR_DETECTION_037_040_oPCAN_RADAR_3a8a83bb_Tx: ComBitPosition=151, ComBitSize=1, ComSignalInitValue=0, ComSignalType=UINT8, ComHandleId=817, ComSystemTemplateSystemSignalRef=DET_BELOW_RAIN_THOLD_038
            DET_MTD_037_oRDR_DETECTION_037_040_oPCAN_RADAR_4b1bfa3c_Tx: ComBitPosition=47, ComBitSize=1, ComSignalInitValue=0, ComSignalType=UINT8, ComHandleId=855, ComSystemTemplateSystemSignalRef=DET_MTD_037
            DET_MTD_039_oRDR_DETECTION_037_040_oPCAN_RADAR_f27bbcee_Tx: ComBitPosition=271, ComBitSize=1, ComSignalInitValue=0, ComSignalType=UINT8, ComHandleId=857, ComSystemTemplateSystemSignalRef=DET_MTD_039
        SG_Detections_205_208_oRDR_DETECTION_205_208_oPCAN_RADAR_2bdbe48f_Tx: ComTransferProperty=TRIGGERED, ComHandleId=53, ComSystemTemplateSignalGroupRef=SG_Detections_205_208
          83 x ComGroupSignal, all with ComSignalEndianness=LITTLE_ENDIAN, ComTransferProperty=PENDING, ComSignalAccess=ACCESS_NEEDED_BY_SWC_OR_COM:
            DET_HVC_FLAG_207_oRDR_DETECTION_205_208_oPCAN_RADAR_9ddc970c_Tx: ComBitPosition=310, ComBitSize=1, ComSignalInitValue=0, ComSignalType=BOOLEAN, ComHandleId=4332, ComSystemTemplateSystemSignalRef=DET_HVC_FLAG_207
            DET_ELEVATION_ERR_206_oRDR_DETECTION_205_208_oPCAN_RADAR_3b477586_Tx: ComBitPosition=192, ComBitSize=6, ComSignalInitValue=0, ComSignalType=UINT8, ComHandleId=4323, ComSystemTemplateSystemSignalRef=DET_ELEVATION_ERR_206
            DET_ELEVATION_ERR_207_oRDR_DETECTION_205_208_oPCAN_RADAR_ae37a113_Tx: ComBitPosition=304, ComBitSize=6, ComSignalInitValue=0, ComSignalType=UINT8, ComHandleId=4324, ComSystemTemplateSystemSignalRef=DET_ELEVATION_ERR_207
            DET_RCS_207_oRDR_DETECTION_205_208_oPCAN_RADAR_1a0060ae_Tx: ComBitPosition=352, ComBitSize=8, ComSignalInitValue=128, ComSignalType=UINT8, ComHandleId=4367, ComSystemTemplateSystemSignalRef=DET_RCS_207
            DET_EXISTENCE_PROB_207_oRDR_DETECTION_205_208_oPCAN_RADAR_7ca8d473_Tx: ComBitPosition=336, ComBitSize=6, ComSignalInitValue=0, ComSignalType=UINT8, ComHandleId=4328, ComSystemTemplateSystemSignalRef=DET_EXISTENCE_PROB_207
            DET_EXISTENCE_PROB_208_oRDR_DETECTION_205_208_oPCAN_RADAR_50b84634_Tx: ComBitPosition=448, ComBitSize=6, ComSignalInitValue=0, ComSignalType=UINT8, ComHandleId=4329, ComSystemTemplateSystemSignalRef=DET_EXISTENCE_PROB_208
            DET_HVC_FLAG_208_oRDR_DETECTION_205_208_oPCAN_RADAR_b1cc054b_Tx: ComBitPosition=422, ComBitSize=1, ComSignalInitValue=0, ComSignalType=BOOLEAN, ComHandleId=4333, ComSystemTemplateSystemSignalRef=DET_HVC_FLAG_208
            DET_SNR_207_oRDR_DETECTION_205_208_oPCAN_RADAR_c7ae34ac_Tx: ComBitPosition=344, ComBitSize=8, ComSignalInitValue=0, ComSignalType=UINT8, ComHandleId=4371, ComSystemTemplateSystemSignalRef=DET_SNR_207
            DET_HVC_FLAG_206_oRDR_DETECTION_205_208_oPCAN_RADAR_08ac4399_Tx: ComBitPosition=198, ComBitSize=1, ComSignalInitValue=0, ComSignalType=BOOLEAN, ComHandleId=4331, ComSystemTemplateSystemSignalRef=DET_HVC_FLAG_206
            DET_SUPER_RES_TARGET_207_oRDR_DETECTION_205_208_oPCAN_RADAR_f6371cc9_Tx: ComBitPosition=311, ComBitSize=1, ComSignalInitValue=0, ComSignalType=BOOLEAN, ComHandleId=4375, ComSystemTemplateSystemSignalRef=DET_SUPER_RES_TARGET_207
            DET_EXISTENCE_PROB_205_oRDR_DETECTION_205_208_oPCAN_RADAR_8d387b18_Tx: ComBitPosition=112, ComBitSize=6, ComSignalInitValue=0, ComSignalType=UINT8, ComHandleId=4326, ComSystemTemplateSystemSignalRef=DET_EXISTENCE_PROB_205
            DET_RANGE_VELOCITY_208_oRDR_DETECTION_205_208_oPCAN_RADAR_b190c5b3_Tx: ComBitPosition=384, ComBitSize=15, ComSignalInitValue=16384, ComSignalType=UINT16, ComHandleId=4360, ComSystemTemplateSystemSignalRef=DET_RANGE_VELOCITY_208
            DET_AZIMUTH_208_oRDR_DETECTION_205_208_oPCAN_RADAR_d4ad742d_Tx: ComBitPosition=424, ComBitSize=13, ComSignalInitValue=0, ComSignalType=UINT16, ComHandleId=4297, ComSystemTemplateSystemSignalRef=DET_AZIMUTH_208
            DET_ELEVATION_ERR_208_oRDR_DETECTION_205_208_oPCAN_RADAR_82273354_Tx: ComBitPosition=416, ComBitSize=6, ComSignalInitValue=0, ComSignalType=UINT8, ComHandleId=4325, ComSystemTemplateSystemSignalRef=DET_ELEVATION_ERR_208
            DET_SNR_206_oRDR_DETECTION_205_208_oPCAN_RADAR_52dee039_Tx: ComBitPosition=232, ComBitSize=8, ComSignalInitValue=0, ComSignalType=UINT8, ComHandleId=4370, ComSystemTemplateSystemSignalRef=DET_SNR_206
            DET_RANGE_207_oRDR_DETECTION_205_208_oPCAN_RADAR_e82695d1_Tx: ComBitPosition=248, ComBitSize=15, ComSignalInitValue=0, ComSignalType=UINT16, ComHandleId=4351, ComSystemTemplateSystemSignalRef=DET_RANGE_207
            DET_RANGE_208_oRDR_DETECTION_205_208_oPCAN_RADAR_c4360796_Tx: ComBitPosition=360, ComBitSize=15, ComSignalInitValue=0, ComSignalType=UINT16, ComHandleId=4352, ComSystemTemplateSystemSignalRef=DET_RANGE_208
            DET_CONFD_AZIMUTH_207_oRDR_DETECTION_205_208_oPCAN_RADAR_fa5beca0_Tx: ComBitPosition=342, ComBitSize=2, ComSignalInitValue=0, ComSignalType=UINT8, ComHandleId=4312, ComSystemTemplateSystemSignalRef=DET_CONFD_AZIMUTH_207
            DET_ELEVATION_205_oRDR_DETECTION_205_208_oPCAN_RADAR_d89e960d_Tx: ComBitPosition=72, ComBitSize=8, ComSignalInitValue=0, ComSignalType=UINT8, ComHandleId=4318, ComSystemTemplateSystemSignalRef=DET_ELEVATION_205
            DET_RANGE_206_oRDR_DETECTION_205_208_oPCAN_RADAR_7d564144_Tx: ComBitPosition=136, ComBitSize=15, ComSignalInitValue=0, ComSignalType=UINT16, ComHandleId=4350, ComSystemTemplateSystemSignalRef=DET_RANGE_206
            DET_CONFD_ELEVATION_208_oRDR_DETECTION_205_208_oPCAN_RADAR_d4de7f1d_Tx: ComBitPosition=437, ComBitSize=2, ComSignalInitValue=0, ComSignalType=UINT8, ComHandleId=4317, ComSystemTemplateSystemSignalRef=DET_CONFD_ELEVATION_208
            DET_RANGE_VELOCITY_ERR_207_oRDR_DETECTION_205_208_oPCAN_RADAR_923bac46_Tx: ComBitPosition=288, ComBitSize=8, ComSignalInitValue=0, ComSignalType=UINT8, ComHandleId=4363, ComSystemTemplateSystemSignalRef=DET_RANGE_VELOCITY_ERR_207
            DET_SNR_208_oRDR_DETECTION_205_208_oPCAN_RADAR_ebbea6eb_Tx: ComBitPosition=456, ComBitSize=8, ComSignalInitValue=0, ComSignalType=UINT8, ComHandleId=4372, ComSystemTemplateSystemSignalRef=DET_SNR_208
            DET_RANGE_VELOCITY_207_oRDR_DETECTION_205_208_oPCAN_RADAR_9d8057f4_Tx: ComBitPosition=272, ComBitSize=15, ComSignalInitValue=16384, ComSignalType=UINT16, ComHandleId=4359, ComSystemTemplateSystemSignalRef=DET_RANGE_VELOCITY_207
            DET_CONFD_ELEVATION_207_oRDR_DETECTION_205_208_oPCAN_RADAR_f8ceed5a_Tx: ComBitPosition=325, ComBitSize=2, ComSignalInitValue=0, ComSignalType=UINT8, ComHandleId=4316, ComSystemTemplateSystemSignalRef=DET_CONFD_ELEVATION_207
            DET_AZIMUTH_ERR_206_oRDR_DETECTION_205_208_oPCAN_RADAR_c978a70a_Tx: ComBitPosition=217, ComBitSize=7, ComSignalInitValue=0, ComSignalType=UINT8, ComHandleId=4299, ComSystemTemplateSystemSignalRef=DET_AZIMUTH_ERR_206
            DET_ELEVATION_ERR_205_oRDR_DETECTION_205_208_oPCAN_RADAR_5fa70e78_Tx: ComBitPosition=80, ComBitSize=6, ComSignalInitValue=0, ComSignalType=UINT8, ComHandleId=4322, ComSystemTemplateSystemSignalRef=DET_ELEVATION_ERR_205
            DET_RANGE_ERR_206_oRDR_DETECTION_205_208_oPCAN_RADAR_dabefb2d_Tx: ComBitPosition=152, ComBitSize=7, ComSignalInitValue=0, ComSignalType=UINT8, ComHandleId=4354, ComSystemTemplateSystemSignalRef=DET_RANGE_ERR_206
            DET_MH_SCAN_INDEX_4LSB_205_208_oRDR_DETECTION_205_208_oPCAN_RADAR_e70cb23f_Tx: ComBitPosition=476, ComBitSize=4, ComSignalInitValue=0, ComSignalType=UINT8, ComHandleId=4340, ComSystemTemplateSystemSignalRef=DET_MH_SCAN_INDEX_4LSB_205_208
            DET_SNR_205_oRDR_DETECTION_205_208_oPCAN_RADAR_363e9bc7_Tx: ComBitPosition=120, ComBitSize=8, ComSignalInitValue=0, ComSignalType=UINT8, ComHandleId=4369, ComSystemTemplateSystemSignalRef=DET_SNR_205
            DET_SUPER_RES_TARGET_206_oRDR_DETECTION_205_208_oPCAN_RADAR_6347c85c_Tx: ComBitPosition=199, ComBitSize=1, ComSignalInitValue=0, ComSignalType=BOOLEAN, ComHandleId=4374, ComSystemTemplateSystemSignalRef=DET_SUPER_RES_TARGET_206
            DET_AZIMUTH_ERR_208_oRDR_DETECTION_205_208_oPCAN_RADAR_7018e1d8_Tx: ComBitPosition=441, ComBitSize=7, ComSignalInitValue=0, ComSignalType=UINT8, ComHandleId=4301, ComSystemTemplateSystemSignalRef=DET_AZIMUTH_ERR_208
            DET_ELEVATION_206_oRDR_DETECTION_205_208_oPCAN_RADAR_bc7eedf3_Tx: ComBitPosition=184, ComBitSize=8, ComSignalInitValue=0, ComSignalType=UINT8, ComHandleId=4319, ComSystemTemplateSystemSignalRef=DET_ELEVATION_206
            DET_RANGE_VELOCITY_ERR_206_oRDR_DETECTION_205_208_oPCAN_RADAR_074b78d3_Tx: ComBitPosition=176, ComBitSize=8, ComSignalInitValue=0, ComSignalType=UINT8, ComHandleId=4362, ComSystemTemplateSystemSignalRef=DET_RANGE_VELOCITY_ERR_206
            DET_EXISTENCE_PROB_206_oRDR_DETECTION_205_208_oPCAN_RADAR_e9d800e6_Tx: ComBitPosition=224, ComBitSize=6, ComSignalInitValue=0, ComSignalType=UINT8, ComHandleId=4327, ComSystemTemplateSystemSignalRef=DET_EXISTENCE_PROB_206
            DET_CONFD_AZIMUTH_208_oRDR_DETECTION_205_208_oPCAN_RADAR_d64b7ee7_Tx: ComBitPosition=454, ComBitSize=2, ComSignalInitValue=0, ComSignalType=UINT8, ComHandleId=4313, ComSystemTemplateSystemSignalRef=DET_CONFD_AZIMUTH_208
            DET_RANGE_VELOCITY_ERR_205_oRDR_DETECTION_205_208_oPCAN_RADAR_63ab032d_Tx: ComBitPosition=64, ComBitSize=8, ComSignalInitValue=0, ComSignalType=UINT8, ComHandleId=4361, ComSystemTemplateSystemSignalRef=DET_RANGE_VELOCITY_ERR_205
            DET_CONFD_AZIMUTH_205_oRDR_DETECTION_205_208_oPCAN_RADAR_0bcb43cb_Tx: ComBitPosition=118, ComBitSize=2, ComSignalInitValue=0, ComSignalType=UINT8, ComHandleId=4310, ComSystemTemplateSystemSignalRef=DET_CONFD_AZIMUTH_205
            DET_HVC_FLAG_205_oRDR_DETECTION_205_208_oPCAN_RADAR_6c4c3867_Tx: ComBitPosition=86, ComBitSize=1, ComSignalInitValue=0, ComSignalType=BOOLEAN, ComHandleId=4330, ComSystemTemplateSystemSignalRef=DET_HVC_FLAG_205
            DET_AZIMUTH_ERR_205_oRDR_DETECTION_205_208_oPCAN_RADAR_ad98dcf4_Tx: ComBitPosition=105, ComBitSize=7, ComSignalInitValue=0, ComSignalType=UINT8, ComHandleId=4298, ComSystemTemplateSystemSignalRef=DET_AZIMUTH_ERR_205
            DET_AZIMUTH_207_oRDR_DETECTION_205_208_oPCAN_RADAR_f8bde66a_Tx: ComBitPosition=312, ComBitSize=13, ComSignalInitValue=0, ComSignalType=UINT16, ComHandleId=4296, ComSystemTemplateSystemSignalRef=DET_AZIMUTH_207
            DET_BI_STATIC_FLAG_205_oRDR_DETECTION_205_208_oPCAN_RADAR_5f010984_Tx: ComBitPosition=104, ComBitSize=1, ComSignalInitValue=0, ComSignalType=BOOLEAN, ComHandleId=4306, ComSystemTemplateSystemSignalRef=DET_BI_STATIC_FLAG_205
            DET_ELEVATION_208_oRDR_DETECTION_205_208_oPCAN_RADAR_051eab21_Tx: ComBitPosition=408, ComBitSize=8, ComSignalInitValue=0, ComSignalType=UINT8, ComHandleId=4321, ComSystemTemplateSystemSignalRef=DET_ELEVATION_208
            DET_AZIMUTH_206_oRDR_DETECTION_205_208_oPCAN_RADAR_6dcd32ff_Tx: ComBitPosition=200, ComBitSize=13, ComSignalInitValue=0, ComSignalType=UINT16, ComHandleId=4295, ComSystemTemplateSystemSignalRef=DET_AZIMUTH_206
            DET_RCS_205_oRDR_DETECTION_205_208_oPCAN_RADAR_eb90cfc5_Tx: ComBitPosition=128, ComBitSize=8, ComSignalInitValue=128, ComSignalType=UINT8, ComHandleId=4365, ComSystemTemplateSystemSignalRef=DET_RCS_205
            DET_RANGE_ERR_208_oRDR_DETECTION_205_208_oPCAN_RADAR_63debdff_Tx: ComBitPosition=376, ComBitSize=7, ComSignalInitValue=0, ComSignalType=UINT8, ComHandleId=4356, ComSystemTemplateSystemSignalRef=DET_RANGE_ERR_208
            DET_RCS_208_oRDR_DETECTION_205_208_oPCAN_RADAR_3610f2e9_Tx: ComBitPosition=464, ComBitSize=8, ComSignalInitValue=128, ComSignalType=UINT8, ComHandleId=4368, ComSystemTemplateSystemSignalRef=DET_RCS_208
            DET_CONFD_AZIMUTH_206_oRDR_DETECTION_205_208_oPCAN_RADAR_6f2b3835_Tx: ComBitPosition=230, ComBitSize=2, ComSignalInitValue=0, ComSignalType=UINT8, ComHandleId=4311, ComSystemTemplateSystemSignalRef=DET_CONFD_AZIMUTH_206
            DET_RANGE_205_oRDR_DETECTION_205_208_oPCAN_RADAR_19b63aba_Tx: ComBitPosition=24, ComBitSize=15, ComSignalInitValue=0, ComSignalType=UINT16, ComHandleId=4349, ComSystemTemplateSystemSignalRef=DET_RANGE_205
            DET_RCS_206_oRDR_DETECTION_205_208_oPCAN_RADAR_8f70b43b_Tx: ComBitPosition=240, ComBitSize=8, ComSignalInitValue=128, ComSignalType=UINT8, ComHandleId=4366, ComSystemTemplateSystemSignalRef=DET_RCS_206
            DET_RANGE_ERR_207_oRDR_DETECTION_205_208_oPCAN_RADAR_4fce2fb8_Tx: ComBitPosition=264, ComBitSize=7, ComSignalInitValue=0, ComSignalType=UINT8, ComHandleId=4355, ComSystemTemplateSystemSignalRef=DET_RANGE_ERR_207
            DET_BI_STATIC_FLAG_207_oRDR_DETECTION_205_208_oPCAN_RADAR_ae91a6ef_Tx: ComBitPosition=328, ComBitSize=1, ComSignalInitValue=0, ComSignalType=BOOLEAN, ComHandleId=4308, ComSystemTemplateSystemSignalRef=DET_BI_STATIC_FLAG_207
            DET_CONFD_ELEVATION_206_oRDR_DETECTION_205_208_oPCAN_RADAR_6dbe39cf_Tx: ComBitPosition=213, ComBitSize=2, ComSignalInitValue=0, ComSignalType=UINT8, ComHandleId=4315, ComSystemTemplateSystemSignalRef=DET_CONFD_ELEVATION_206
            DET_SUPER_RES_TARGET_208_oRDR_DETECTION_205_208_oPCAN_RADAR_da278e8e_Tx: ComBitPosition=423, ComBitSize=1, ComSignalInitValue=0, ComSignalType=BOOLEAN, ComHandleId=4376, ComSystemTemplateSystemSignalRef=DET_SUPER_RES_TARGET_208
            DET_RANGE_VELOCITY_206_oRDR_DETECTION_205_208_oPCAN_RADAR_08f08361_Tx: ComBitPosition=160, ComBitSize=15, ComSignalInitValue=16384, ComSignalType=UINT16, ComHandleId=4358, ComSystemTemplateSystemSignalRef=DET_RANGE_VELOCITY_206
            DET_AZIMUTH_ERR_207_oRDR_DETECTION_205_208_oPCAN_RADAR_5c08739f_Tx: ComBitPosition=329, ComBitSize=7, ComSignalInitValue=0, ComSignalType=UINT8, ComHandleId=4300, ComSystemTemplateSystemSignalRef=DET_AZIMUTH_ERR_207
            DET_BI_STATIC_FLAG_208_oRDR_DETECTION_205_208_oPCAN_RADAR_828134a8_Tx: ComBitPosition=440, ComBitSize=1, ComSignalInitValue=0, ComSignalType=BOOLEAN, ComHandleId=4309, ComSystemTemplateSystemSignalRef=DET_BI_STATIC_FLAG_208
            DET_CONFD_ELEVATION_205_oRDR_DETECTION_205_208_oPCAN_RADAR_095e4231_Tx: ComBitPosition=101, ComBitSize=2, ComSignalInitValue=0, ComSignalType=UINT8, ComHandleId=4314, ComSystemTemplateSystemSignalRef=DET_CONFD_ELEVATION_205
            DET_MH_CRC16_205_208_oRDR_DETECTION_205_208_oPCAN_RADAR_af533684_Tx: ComBitPosition=0, ComBitSize=16, ComSignalInitValue=0, ComSignalType=UINT16, ComHandleId=4338, ComSystemTemplateSystemSignalRef=DET_MH_CRC16_205_208
            DET_BI_STATIC_FLAG_206_oRDR_DETECTION_205_208_oPCAN_RADAR_3be1727a_Tx: ComBitPosition=216, ComBitSize=1, ComSignalInitValue=0, ComSignalType=BOOLEAN, ComHandleId=4307, ComSystemTemplateSystemSignalRef=DET_BI_STATIC_FLAG_206
            DET_RANGE_ERR_205_oRDR_DETECTION_205_208_oPCAN_RADAR_be5e80d3_Tx: ComBitPosition=40, ComBitSize=7, ComSignalInitValue=0, ComSignalType=UINT8, ComHandleId=4353, ComSystemTemplateSystemSignalRef=DET_RANGE_ERR_205
            DET_RANGE_VELOCITY_ERR_208_oRDR_DETECTION_205_208_oPCAN_RADAR_be2b3e01_Tx: ComBitPosition=400, ComBitSize=8, ComSignalInitValue=0, ComSignalType=UINT8, ComHandleId=4364, ComSystemTemplateSystemSignalRef=DET_RANGE_VELOCITY_ERR_208
            DET_RANGE_VELOCITY_205_oRDR_DETECTION_205_208_oPCAN_RADAR_6c10f89f_Tx: ComBitPosition=48, ComBitSize=15, ComSignalInitValue=16384, ComSignalType=UINT16, ComHandleId=4357, ComSystemTemplateSystemSignalRef=DET_RANGE_VELOCITY_205
            DET_MH_CYCLE_COUNTER_205_208_oRDR_DETECTION_205_208_oPCAN_RADAR_2b2697b3_Tx: ComBitPosition=16, ComBitSize=8, ComSignalInitValue=0, ComSignalType=UINT8, ComHandleId=4339, ComSystemTemplateSystemSignalRef=DET_MH_CYCLE_COUNTER_205_208
            DET_SUPER_RES_TARGET_205_oRDR_DETECTION_205_208_oPCAN_RADAR_07a7b3a2_Tx: ComBitPosition=87, ComBitSize=1, ComSignalInitValue=0, ComSignalType=BOOLEAN, ComHandleId=4373, ComSystemTemplateSystemSignalRef=DET_SUPER_RES_TARGET_205
            DET_AZIMUTH_205_oRDR_DETECTION_205_208_oPCAN_RADAR_092d4901_Tx: ComBitPosition=88, ComBitSize=13, ComSignalInitValue=0, ComSignalType=UINT16, ComHandleId=4294, ComSystemTemplateSystemSignalRef=DET_AZIMUTH_205
            DET_ELEVATION_207_oRDR_DETECTION_205_208_oPCAN_RADAR_290e3966_Tx: ComBitPosition=296, ComBitSize=8, ComSignalInitValue=0, ComSignalType=UINT8, ComHandleId=4320, ComSystemTemplateSystemSignalRef=DET_ELEVATION_207
            DET_MTD_206_oRDR_DETECTION_205_208_oPCAN_RADAR_e54d4aff_Tx: ComBitPosition=159, ComBitSize=1, ComSignalInitValue=0, ComSignalType=UINT8, ComHandleId=4342, ComSystemTemplateSystemSignalRef=DET_MTD_206
            DET_BELOW_RAIN_THOLD_208_oRDR_DETECTION_205_208_oPCAN_RADAR_01ace7ed_Tx: ComBitPosition=375, ComBitSize=1, ComSignalInitValue=0, ComSignalType=UINT8, ComHandleId=4305, ComSystemTemplateSystemSignalRef=DET_BELOW_RAIN_THOLD_208
            DET_IDM_205_oRDR_DETECTION_205_208_oPCAN_RADAR_e71e03da_Tx: ComBitPosition=63, ComBitSize=1, ComSignalInitValue=0, ComSignalType=UINT8, ComHandleId=4334, ComSystemTemplateSystemSignalRef=DET_IDM_205
            DET_MTD_208_oRDR_DETECTION_205_208_oPCAN_RADAR_5c2d0c2d_Tx: ComBitPosition=383, ComBitSize=1, ComSignalInitValue=0, ComSignalType=UINT8, ComHandleId=4344, ComSystemTemplateSystemSignalRef=DET_MTD_208
            DET_PROB_1STAZHYPO_205_oRDR_DETECTION_205_208_oPCAN_RADAR_1219d9cc_Tx: ComBitPosition=103, ComBitSize=1, ComSignalInitValue=0, ComSignalType=BOOLEAN, ComHandleId=4345, ComSystemTemplateSystemSignalRef=DET_PROB_1STAZHYPO_205
            DET_PROB_1STAZHYPO_206_oRDR_DETECTION_205_208_oPCAN_RADAR_76f9a232_Tx: ComBitPosition=215, ComBitSize=1, ComSignalInitValue=0, ComSignalType=BOOLEAN, ComHandleId=4346, ComSystemTemplateSystemSignalRef=DET_PROB_1STAZHYPO_206
            DET_PROB_1STAZHYPO_207_oRDR_DETECTION_205_208_oPCAN_RADAR_e38976a7_Tx: ComBitPosition=327, ComBitSize=1, ComSignalInitValue=0, ComSignalType=BOOLEAN, ComHandleId=4347, ComSystemTemplateSystemSignalRef=DET_PROB_1STAZHYPO_207
            DET_BELOW_RAIN_THOLD_205_oRDR_DETECTION_205_208_oPCAN_RADAR_dc2cdac1_Tx: ComBitPosition=39, ComBitSize=1, ComSignalInitValue=0, ComSignalType=UINT8, ComHandleId=4302, ComSystemTemplateSystemSignalRef=DET_BELOW_RAIN_THOLD_205
            DET_IDM_207_oRDR_DETECTION_205_208_oPCAN_RADAR_168eacb1_Tx: ComBitPosition=287, ComBitSize=1, ComSignalInitValue=0, ComSignalType=UINT8, ComHandleId=4336, ComSystemTemplateSystemSignalRef=DET_IDM_207
            DET_IDM_208_oRDR_DETECTION_205_208_oPCAN_RADAR_3a9e3ef6_Tx: ComBitPosition=399, ComBitSize=1, ComSignalInitValue=0, ComSignalType=UINT8, ComHandleId=4337, ComSystemTemplateSystemSignalRef=DET_IDM_208
            DET_MTD_207_oRDR_DETECTION_205_208_oPCAN_RADAR_703d9e6a_Tx: ComBitPosition=271, ComBitSize=1, ComSignalInitValue=0, ComSignalType=UINT8, ComHandleId=4343, ComSystemTemplateSystemSignalRef=DET_MTD_207
            DET_PROB_1STAZHYPO_208_oRDR_DETECTION_205_208_oPCAN_RADAR_cf99e4e0_Tx: ComBitPosition=439, ComBitSize=1, ComSignalInitValue=0, ComSignalType=BOOLEAN, ComHandleId=4348, ComSystemTemplateSystemSignalRef=DET_PROB_1STAZHYPO_208
            DET_IDM_206_oRDR_DETECTION_205_208_oPCAN_RADAR_83fe7824_Tx: ComBitPosition=175, ComBitSize=1, ComSignalInitValue=0, ComSignalType=UINT8, ComHandleId=4335, ComSystemTemplateSystemSignalRef=DET_IDM_206
            DET_BELOW_RAIN_THOLD_207_oRDR_DETECTION_205_208_oPCAN_RADAR_2dbc75aa_Tx: ComBitPosition=263, ComBitSize=1, ComSignalInitValue=0, ComSignalType=UINT8, ComHandleId=4304, ComSystemTemplateSystemSignalRef=DET_BELOW_RAIN_THOLD_207
            DET_BELOW_RAIN_THOLD_206_oRDR_DETECTION_205_208_oPCAN_RADAR_b8cca13f_Tx: ComBitPosition=151, ComBitSize=1, ComSignalInitValue=0, ComSignalType=UINT8, ComHandleId=4303, ComSystemTemplateSystemSignalRef=DET_BELOW_RAIN_THOLD_206
            DET_MTD_205_oRDR_DETECTION_205_208_oPCAN_RADAR_81ad3101_Tx: ComBitPosition=47, ComBitSize=1, ComSignalInitValue=0, ComSignalType=UINT8, ComHandleId=4341, ComSystemTemplateSystemSignalRef=DET_MTD_205
        SG_Detections_085_088_oRDR_DETECTION_085_088_oPCAN_RADAR_7b5d20bf_Tx: ComTransferProperty=TRIGGERED, ComHandleId=23, ComSystemTemplateSignalGroupRef=SG_Detections_085_088
          83 x ComGroupSignal, all with ComSignalEndianness=LITTLE_ENDIAN, ComTransferProperty=PENDING, ComSignalAccess=ACCESS_NEEDED_BY_SWC_OR_COM:
            DET_RANGE_VELOCITY_ERR_087_oRDR_DETECTION_085_088_oPCAN_RADAR_76c7fbe7_Tx: ComBitPosition=288, ComBitSize=8, ComSignalInitValue=0, ComSignalType=UINT8, ComHandleId=1873, ComSystemTemplateSystemSignalRef=DET_RANGE_VELOCITY_ERR_087
            DET_EXISTENCE_PROB_088_oRDR_DETECTION_085_088_oPCAN_RADAR_b4441195_Tx: ComBitPosition=448, ComBitSize=6, ComSignalInitValue=0, ComSignalType=UINT8, ComHandleId=1839, ComSystemTemplateSystemSignalRef=DET_EXISTENCE_PROB_088
            DET_CONFD_ELEVATION_086_oRDR_DETECTION_085_088_oPCAN_RADAR_89426e6e_Tx: ComBitPosition=213, ComBitSize=2, ComSignalInitValue=0, ComSignalType=UINT8, ComHandleId=1825, ComSystemTemplateSystemSignalRef=DET_CONFD_ELEVATION_086
            DET_BI_STATIC_FLAG_087_oRDR_DETECTION_085_088_oPCAN_RADAR_4a6df14e_Tx: ComBitPosition=328, ComBitSize=1, ComSignalInitValue=0, ComSignalType=BOOLEAN, ComHandleId=1818, ComSystemTemplateSystemSignalRef=DET_BI_STATIC_FLAG_087
            DET_ELEVATION_087_oRDR_DETECTION_085_088_oPCAN_RADAR_cdf26ec7_Tx: ComBitPosition=296, ComBitSize=8, ComSignalInitValue=0, ComSignalType=UINT8, ComHandleId=1830, ComSystemTemplateSystemSignalRef=DET_ELEVATION_087
            DET_ELEVATION_ERR_088_oRDR_DETECTION_085_088_oPCAN_RADAR_66db64f5_Tx: ComBitPosition=416, ComBitSize=6, ComSignalInitValue=0, ComSignalType=UINT8, ComHandleId=1835, ComSystemTemplateSystemSignalRef=DET_ELEVATION_ERR_088
            DET_ELEVATION_ERR_085_oRDR_DETECTION_085_088_oPCAN_RADAR_bb5b59d9_Tx: ComBitPosition=80, ComBitSize=6, ComSignalInitValue=0, ComSignalType=UINT8, ComHandleId=1832, ComSystemTemplateSystemSignalRef=DET_ELEVATION_ERR_085
            DET_RCS_086_oRDR_DETECTION_085_088_oPCAN_RADAR_6b8ce39a_Tx: ComBitPosition=240, ComBitSize=8, ComSignalInitValue=128, ComSignalType=UINT8, ComHandleId=1876, ComSystemTemplateSystemSignalRef=DET_RCS_086
            DET_SUPER_RES_TARGET_088_oRDR_DETECTION_085_088_oPCAN_RADAR_3edbd92f_Tx: ComBitPosition=423, ComBitSize=1, ComSignalInitValue=0, ComSignalType=BOOLEAN, ComHandleId=1886, ComSystemTemplateSystemSignalRef=DET_SUPER_RES_TARGET_088
            DET_RANGE_085_oRDR_DETECTION_085_088_oPCAN_RADAR_fd4a6d1b_Tx: ComBitPosition=24, ComBitSize=15, ComSignalInitValue=0, ComSignalType=UINT16, ComHandleId=1859, ComSystemTemplateSystemSignalRef=DET_RANGE_085
            DET_RANGE_VELOCITY_ERR_086_oRDR_DETECTION_085_088_oPCAN_RADAR_e3b72f72_Tx: ComBitPosition=176, ComBitSize=8, ComSignalInitValue=0, ComSignalType=UINT8, ComHandleId=1872, ComSystemTemplateSystemSignalRef=DET_RANGE_VELOCITY_ERR_086
            DET_RANGE_ERR_085_oRDR_DETECTION_085_088_oPCAN_RADAR_5aa2d772_Tx: ComBitPosition=40, ComBitSize=7, ComSignalInitValue=0, ComSignalType=UINT8, ComHandleId=1863, ComSystemTemplateSystemSignalRef=DET_RANGE_ERR_085
            DET_SUPER_RES_TARGET_086_oRDR_DETECTION_085_088_oPCAN_RADAR_87bb9ffd_Tx: ComBitPosition=199, ComBitSize=1, ComSignalInitValue=0, ComSignalType=BOOLEAN, ComHandleId=1884, ComSystemTemplateSystemSignalRef=DET_SUPER_RES_TARGET_086
            DET_SNR_087_oRDR_DETECTION_085_088_oPCAN_RADAR_2352630d_Tx: ComBitPosition=344, ComBitSize=8, ComSignalInitValue=0, ComSignalType=UINT8, ComHandleId=1881, ComSystemTemplateSystemSignalRef=DET_SNR_087
            DET_ELEVATION_ERR_087_oRDR_DETECTION_085_088_oPCAN_RADAR_4acbf6b2_Tx: ComBitPosition=304, ComBitSize=6, ComSignalInitValue=0, ComSignalType=UINT8, ComHandleId=1834, ComSystemTemplateSystemSignalRef=DET_ELEVATION_ERR_087
            DET_BI_STATIC_FLAG_086_oRDR_DETECTION_085_088_oPCAN_RADAR_df1d25db_Tx: ComBitPosition=216, ComBitSize=1, ComSignalInitValue=0, ComSignalType=BOOLEAN, ComHandleId=1817, ComSystemTemplateSystemSignalRef=DET_BI_STATIC_FLAG_086
            DET_RANGE_088_oRDR_DETECTION_085_088_oPCAN_RADAR_20ca5037_Tx: ComBitPosition=360, ComBitSize=15, ComSignalInitValue=0, ComSignalType=UINT16, ComHandleId=1862, ComSystemTemplateSystemSignalRef=DET_RANGE_088
            DET_HVC_FLAG_087_oRDR_DETECTION_085_088_oPCAN_RADAR_7920c0ad_Tx: ComBitPosition=310, ComBitSize=1, ComSignalInitValue=0, ComSignalType=BOOLEAN, ComHandleId=1842, ComSystemTemplateSystemSignalRef=DET_HVC_FLAG_087
            DET_ELEVATION_085_oRDR_DETECTION_085_088_oPCAN_RADAR_3c62c1ac_Tx: ComBitPosition=72, ComBitSize=8, ComSignalInitValue=0, ComSignalType=UINT8, ComHandleId=1828, ComSystemTemplateSystemSignalRef=DET_ELEVATION_085
            DET_MH_SCAN_INDEX_4LSB_085_088_oRDR_DETECTION_085_088_oPCAN_RADAR_b78a760f_Tx: ComBitPosition=476, ComBitSize=4, ComSignalInitValue=0, ComSignalType=UINT8, ComHandleId=1850, ComSystemTemplateSystemSignalRef=DET_MH_SCAN_INDEX_4LSB_085_088
            DET_EXISTENCE_PROB_085_oRDR_DETECTION_085_088_oPCAN_RADAR_69c42cb9_Tx: ComBitPosition=112, ComBitSize=6, ComSignalInitValue=0, ComSignalType=UINT8, ComHandleId=1836, ComSystemTemplateSystemSignalRef=DET_EXISTENCE_PROB_085
            DET_SUPER_RES_TARGET_085_oRDR_DETECTION_085_088_oPCAN_RADAR_e35be403_Tx: ComBitPosition=87, ComBitSize=1, ComSignalInitValue=0, ComSignalType=BOOLEAN, ComHandleId=1883, ComSystemTemplateSystemSignalRef=DET_SUPER_RES_TARGET_085
            DET_RCS_088_oRDR_DETECTION_085_088_oPCAN_RADAR_d2eca548_Tx: ComBitPosition=464, ComBitSize=8, ComSignalInitValue=128, ComSignalType=UINT8, ComHandleId=1878, ComSystemTemplateSystemSignalRef=DET_RCS_088
            DET_CONFD_AZIMUTH_085_oRDR_DETECTION_085_088_oPCAN_RADAR_ef37146a_Tx: ComBitPosition=118, ComBitSize=2, ComSignalInitValue=0, ComSignalType=UINT8, ComHandleId=1820, ComSystemTemplateSystemSignalRef=DET_CONFD_AZIMUTH_085
            DET_CONFD_AZIMUTH_087_oRDR_DETECTION_085_088_oPCAN_RADAR_1ea7bb01_Tx: ComBitPosition=342, ComBitSize=2, ComSignalInitValue=0, ComSignalType=UINT8, ComHandleId=1822, ComSystemTemplateSystemSignalRef=DET_CONFD_AZIMUTH_087
            DET_RANGE_ERR_087_oRDR_DETECTION_085_088_oPCAN_RADAR_ab327819_Tx: ComBitPosition=264, ComBitSize=7, ComSignalInitValue=0, ComSignalType=UINT8, ComHandleId=1865, ComSystemTemplateSystemSignalRef=DET_RANGE_ERR_087
            DET_RANGE_VELOCITY_086_oRDR_DETECTION_085_088_oPCAN_RADAR_ec0cd4c0_Tx: ComBitPosition=160, ComBitSize=15, ComSignalInitValue=16384, ComSignalType=UINT16, ComHandleId=1868, ComSystemTemplateSystemSignalRef=DET_RANGE_VELOCITY_086
            DET_SNR_085_oRDR_DETECTION_085_088_oPCAN_RADAR_d2c2cc66_Tx: ComBitPosition=120, ComBitSize=8, ComSignalInitValue=0, ComSignalType=UINT8, ComHandleId=1879, ComSystemTemplateSystemSignalRef=DET_SNR_085
            DET_ELEVATION_ERR_086_oRDR_DETECTION_085_088_oPCAN_RADAR_dfbb2227_Tx: ComBitPosition=192, ComBitSize=6, ComSignalInitValue=0, ComSignalType=UINT8, ComHandleId=1833, ComSystemTemplateSystemSignalRef=DET_ELEVATION_ERR_086
            DET_RANGE_VELOCITY_087_oRDR_DETECTION_085_088_oPCAN_RADAR_797c0055_Tx: ComBitPosition=272, ComBitSize=15, ComSignalInitValue=16384, ComSignalType=UINT16, ComHandleId=1869, ComSystemTemplateSystemSignalRef=DET_RANGE_VELOCITY_087
            DET_CONFD_ELEVATION_085_oRDR_DETECTION_085_088_oPCAN_RADAR_eda21590_Tx: ComBitPosition=101, ComBitSize=2, ComSignalInitValue=0, ComSignalType=UINT8, ComHandleId=1824, ComSystemTemplateSystemSignalRef=DET_CONFD_ELEVATION_085
            DET_RANGE_ERR_088_oRDR_DETECTION_085_088_oPCAN_RADAR_8722ea5e_Tx: ComBitPosition=376, ComBitSize=7, ComSignalInitValue=0, ComSignalType=UINT8, ComHandleId=1866, ComSystemTemplateSystemSignalRef=DET_RANGE_ERR_088
            DET_SUPER_RES_TARGET_087_oRDR_DETECTION_085_088_oPCAN_RADAR_12cb4b68_Tx: ComBitPosition=311, ComBitSize=1, ComSignalInitValue=0, ComSignalType=BOOLEAN, ComHandleId=1885, ComSystemTemplateSystemSignalRef=DET_SUPER_RES_TARGET_087
            DET_EXISTENCE_PROB_087_oRDR_DETECTION_085_088_oPCAN_RADAR_985483d2_Tx: ComBitPosition=336, ComBitSize=6, ComSignalInitValue=0, ComSignalType=UINT8, ComHandleId=1838, ComSystemTemplateSystemSignalRef=DET_EXISTENCE_PROB_087
            DET_RANGE_VELOCITY_085_oRDR_DETECTION_085_088_oPCAN_RADAR_88ecaf3e_Tx: ComBitPosition=48, ComBitSize=15, ComSignalInitValue=16384, ComSignalType=UINT16, ComHandleId=1867, ComSystemTemplateSystemSignalRef=DET_RANGE_VELOCITY_085
            DET_RANGE_VELOCITY_ERR_085_oRDR_DETECTION_085_088_oPCAN_RADAR_8757548c_Tx: ComBitPosition=64, ComBitSize=8, ComSignalInitValue=0, ComSignalType=UINT8, ComHandleId=1871, ComSystemTemplateSystemSignalRef=DET_RANGE_VELOCITY_ERR_085
            DET_MH_CRC16_085_088_oRDR_DETECTION_085_088_oPCAN_RADAR_ffd5f2b4_Tx: ComBitPosition=0, ComBitSize=16, ComSignalInitValue=0, ComSignalType=UINT16, ComHandleId=1848, ComSystemTemplateSystemSignalRef=DET_MH_CRC16_085_088
            DET_CONFD_ELEVATION_087_oRDR_DETECTION_085_088_oPCAN_RADAR_1c32bafb_Tx: ComBitPosition=325, ComBitSize=2, ComSignalInitValue=0, ComSignalType=UINT8, ComHandleId=1826, ComSystemTemplateSystemSignalRef=DET_CONFD_ELEVATION_087
            DET_AZIMUTH_ERR_088_oRDR_DETECTION_085_088_oPCAN_RADAR_94e4b679_Tx: ComBitPosition=441, ComBitSize=7, ComSignalInitValue=0, ComSignalType=UINT8, ComHandleId=1811, ComSystemTemplateSystemSignalRef=DET_AZIMUTH_ERR_088
            DET_RCS_085_oRDR_DETECTION_085_088_oPCAN_RADAR_0f6c9864_Tx: ComBitPosition=128, ComBitSize=8, ComSignalInitValue=128, ComSignalType=UINT8, ComHandleId=1875, ComSystemTemplateSystemSignalRef=DET_RCS_085
            DET_CONFD_ELEVATION_088_oRDR_DETECTION_085_088_oPCAN_RADAR_302228bc_Tx: ComBitPosition=437, ComBitSize=2, ComSignalInitValue=0, ComSignalType=UINT8, ComHandleId=1827, ComSystemTemplateSystemSignalRef=DET_CONFD_ELEVATION_088
            DET_MH_CYCLE_COUNTER_085_088_oRDR_DETECTION_085_088_oPCAN_RADAR_7ba05383_Tx: ComBitPosition=16, ComBitSize=8, ComSignalInitValue=0, ComSignalType=UINT8, ComHandleId=1849, ComSystemTemplateSystemSignalRef=DET_MH_CYCLE_COUNTER_085_088
            DET_SNR_086_oRDR_DETECTION_085_088_oPCAN_RADAR_b622b798_Tx: ComBitPosition=232, ComBitSize=8, ComSignalInitValue=0, ComSignalType=UINT8, ComHandleId=1880, ComSystemTemplateSystemSignalRef=DET_SNR_086
            DET_EXISTENCE_PROB_086_oRDR_DETECTION_085_088_oPCAN_RADAR_0d245747_Tx: ComBitPosition=224, ComBitSize=6, ComSignalInitValue=0, ComSignalType=UINT8, ComHandleId=1837, ComSystemTemplateSystemSignalRef=DET_EXISTENCE_PROB_086
            DET_RANGE_VELOCITY_088_oRDR_DETECTION_085_088_oPCAN_RADAR_556c9212_Tx: ComBitPosition=384, ComBitSize=15, ComSignalInitValue=16384, ComSignalType=UINT16, ComHandleId=1870, ComSystemTemplateSystemSignalRef=DET_RANGE_VELOCITY_088
            DET_HVC_FLAG_086_oRDR_DETECTION_085_088_oPCAN_RADAR_ec501438_Tx: ComBitPosition=198, ComBitSize=1, ComSignalInitValue=0, ComSignalType=BOOLEAN, ComHandleId=1841, ComSystemTemplateSystemSignalRef=DET_HVC_FLAG_086
            DET_RANGE_ERR_086_oRDR_DETECTION_085_088_oPCAN_RADAR_3e42ac8c_Tx: ComBitPosition=152, ComBitSize=7, ComSignalInitValue=0, ComSignalType=UINT8, ComHandleId=1864, ComSystemTemplateSystemSignalRef=DET_RANGE_ERR_086
            DET_RANGE_087_oRDR_DETECTION_085_088_oPCAN_RADAR_0cdac270_Tx: ComBitPosition=248, ComBitSize=15, ComSignalInitValue=0, ComSignalType=UINT16, ComHandleId=1861, ComSystemTemplateSystemSignalRef=DET_RANGE_087
            DET_ELEVATION_088_oRDR_DETECTION_085_088_oPCAN_RADAR_e1e2fc80_Tx: ComBitPosition=408, ComBitSize=8, ComSignalInitValue=0, ComSignalType=UINT8, ComHandleId=1831, ComSystemTemplateSystemSignalRef=DET_ELEVATION_088
            DET_CONFD_AZIMUTH_086_oRDR_DETECTION_085_088_oPCAN_RADAR_8bd76f94_Tx: ComBitPosition=230, ComBitSize=2, ComSignalInitValue=0, ComSignalType=UINT8, ComHandleId=1821, ComSystemTemplateSystemSignalRef=DET_CONFD_AZIMUTH_086
            DET_BI_STATIC_FLAG_088_oRDR_DETECTION_085_088_oPCAN_RADAR_667d6309_Tx: ComBitPosition=440, ComBitSize=1, ComSignalInitValue=0, ComSignalType=BOOLEAN, ComHandleId=1819, ComSystemTemplateSystemSignalRef=DET_BI_STATIC_FLAG_088
            DET_AZIMUTH_086_oRDR_DETECTION_085_088_oPCAN_RADAR_8931655e_Tx: ComBitPosition=200, ComBitSize=13, ComSignalInitValue=0, ComSignalType=UINT16, ComHandleId=1805, ComSystemTemplateSystemSignalRef=DET_AZIMUTH_086
            DET_HVC_FLAG_088_oRDR_DETECTION_085_088_oPCAN_RADAR_553052ea_Tx: ComBitPosition=422, ComBitSize=1, ComSignalInitValue=0, ComSignalType=BOOLEAN, ComHandleId=1843, ComSystemTemplateSystemSignalRef=DET_HVC_FLAG_088
            DET_BI_STATIC_FLAG_085_oRDR_DETECTION_085_088_oPCAN_RADAR_bbfd5e25_Tx: ComBitPosition=104, ComBitSize=1, ComSignalInitValue=0, ComSignalType=BOOLEAN, ComHandleId=1816, ComSystemTemplateSystemSignalRef=DET_BI_STATIC_FLAG_085
            DET_ELEVATION_086_oRDR_DETECTION_085_088_oPCAN_RADAR_5882ba52_Tx: ComBitPosition=184, ComBitSize=8, ComSignalInitValue=0, ComSignalType=UINT8, ComHandleId=1829, ComSystemTemplateSystemSignalRef=DET_ELEVATION_086
            DET_RANGE_086_oRDR_DETECTION_085_088_oPCAN_RADAR_99aa16e5_Tx: ComBitPosition=136, ComBitSize=15, ComSignalInitValue=0, ComSignalType=UINT16, ComHandleId=1860, ComSystemTemplateSystemSignalRef=DET_RANGE_086
            DET_SNR_088_oRDR_DETECTION_085_088_oPCAN_RADAR_0f42f14a_Tx: ComBitPosition=456, ComBitSize=8, ComSignalInitValue=0, ComSignalType=UINT8, ComHandleId=1882, ComSystemTemplateSystemSignalRef=DET_SNR_088
            DET_AZIMUTH_085_oRDR_DETECTION_085_088_oPCAN_RADAR_edd11ea0_Tx: ComBitPosition=88, ComBitSize=13, ComSignalInitValue=0, ComSignalType=UINT16, ComHandleId=1804, ComSystemTemplateSystemSignalRef=DET_AZIMUTH_085
            DET_AZIMUTH_ERR_087_oRDR_DETECTION_085_088_oPCAN_RADAR_b8f4243e_Tx: ComBitPosition=329, ComBitSize=7, ComSignalInitValue=0, ComSignalType=UINT8, ComHandleId=1810, ComSystemTemplateSystemSignalRef=DET_AZIMUTH_ERR_087
            DET_AZIMUTH_ERR_086_oRDR_DETECTION_085_088_oPCAN_RADAR_2d84f0ab_Tx: ComBitPosition=217, ComBitSize=7, ComSignalInitValue=0, ComSignalType=UINT8, ComHandleId=1809, ComSystemTemplateSystemSignalRef=DET_AZIMUTH_ERR_086
            DET_AZIMUTH_088_oRDR_DETECTION_085_088_oPCAN_RADAR_3051238c_Tx: ComBitPosition=424, ComBitSize=13, ComSignalInitValue=0, ComSignalType=UINT16, ComHandleId=1807, ComSystemTemplateSystemSignalRef=DET_AZIMUTH_088
            DET_RANGE_VELOCITY_ERR_088_oRDR_DETECTION_085_088_oPCAN_RADAR_5ad769a0_Tx: ComBitPosition=400, ComBitSize=8, ComSignalInitValue=0, ComSignalType=UINT8, ComHandleId=1874, ComSystemTemplateSystemSignalRef=DET_RANGE_VELOCITY_ERR_088
            DET_CONFD_AZIMUTH_088_oRDR_DETECTION_085_088_oPCAN_RADAR_32b72946_Tx: ComBitPosition=454, ComBitSize=2, ComSignalInitValue=0, ComSignalType=UINT8, ComHandleId=1823, ComSystemTemplateSystemSignalRef=DET_CONFD_AZIMUTH_088
            DET_AZIMUTH_087_oRDR_DETECTION_085_088_oPCAN_RADAR_1c41b1cb_Tx: ComBitPosition=312, ComBitSize=13, ComSignalInitValue=0, ComSignalType=UINT16, ComHandleId=1806, ComSystemTemplateSystemSignalRef=DET_AZIMUTH_087
            DET_HVC_FLAG_085_oRDR_DETECTION_085_088_oPCAN_RADAR_88b06fc6_Tx: ComBitPosition=86, ComBitSize=1, ComSignalInitValue=0, ComSignalType=BOOLEAN, ComHandleId=1840, ComSystemTemplateSystemSignalRef=DET_HVC_FLAG_085
            DET_RCS_087_oRDR_DETECTION_085_088_oPCAN_RADAR_fefc370f_Tx: ComBitPosition=352, ComBitSize=8, ComSignalInitValue=128, ComSignalType=UINT8, ComHandleId=1877, ComSystemTemplateSystemSignalRef=DET_RCS_087
            DET_AZIMUTH_ERR_085_oRDR_DETECTION_085_088_oPCAN_RADAR_49648b55_Tx: ComBitPosition=105, ComBitSize=7, ComSignalInitValue=0, ComSignalType=UINT8, ComHandleId=1808, ComSystemTemplateSystemSignalRef=DET_AZIMUTH_ERR_085
            DET_PROB_1STAZHYPO_086_oRDR_DETECTION_085_088_oPCAN_RADAR_9205f593_Tx: ComBitPosition=215, ComBitSize=1, ComSignalInitValue=0, ComSignalType=BOOLEAN, ComHandleId=1856, ComSystemTemplateSystemSignalRef=DET_PROB_1STAZHYPO_086
            DET_BELOW_RAIN_THOLD_087_oRDR_DETECTION_085_088_oPCAN_RADAR_c940220b_Tx: ComBitPosition=263, ComBitSize=1, ComSignalInitValue=0, ComSignalType=UINT8, ComHandleId=1814, ComSystemTemplateSystemSignalRef=DET_BELOW_RAIN_THOLD_087
            DET_IDM_086_oRDR_DETECTION_085_088_oPCAN_RADAR_67022f85_Tx: ComBitPosition=175, ComBitSize=1, ComSignalInitValue=0, ComSignalType=UINT8, ComHandleId=1845, ComSystemTemplateSystemSignalRef=DET_IDM_086
            DET_IDM_085_oRDR_DETECTION_085_088_oPCAN_RADAR_03e2547b_Tx: ComBitPosition=63, ComBitSize=1, ComSignalInitValue=0, ComSignalType=UINT8, ComHandleId=1844, ComSystemTemplateSystemSignalRef=DET_IDM_085
            DET_BELOW_RAIN_THOLD_085_oRDR_DETECTION_085_088_oPCAN_RADAR_38d08d60_Tx: ComBitPosition=39, ComBitSize=1, ComSignalInitValue=0, ComSignalType=UINT8, ComHandleId=1812, ComSystemTemplateSystemSignalRef=DET_BELOW_RAIN_THOLD_085
            DET_IDM_087_oRDR_DETECTION_085_088_oPCAN_RADAR_f272fb10_Tx: ComBitPosition=287, ComBitSize=1, ComSignalInitValue=0, ComSignalType=UINT8, ComHandleId=1846, ComSystemTemplateSystemSignalRef=DET_IDM_087
            DET_IDM_088_oRDR_DETECTION_085_088_oPCAN_RADAR_de626957_Tx: ComBitPosition=399, ComBitSize=1, ComSignalInitValue=0, ComSignalType=UINT8, ComHandleId=1847, ComSystemTemplateSystemSignalRef=DET_IDM_088
            DET_MTD_085_oRDR_DETECTION_085_088_oPCAN_RADAR_655166a0_Tx: ComBitPosition=47, ComBitSize=1, ComSignalInitValue=0, ComSignalType=UINT8, ComHandleId=1851, ComSystemTemplateSystemSignalRef=DET_MTD_085
            DET_MTD_087_oRDR_DETECTION_085_088_oPCAN_RADAR_94c1c9cb_Tx: ComBitPosition=271, ComBitSize=1, ComSignalInitValue=0, ComSignalType=UINT8, ComHandleId=1853, ComSystemTemplateSystemSignalRef=DET_MTD_087
            DET_MTD_088_oRDR_DETECTION_085_088_oPCAN_RADAR_b8d15b8c_Tx: ComBitPosition=383, ComBitSize=1, ComSignalInitValue=0, ComSignalType=UINT8, ComHandleId=1854, ComSystemTemplateSystemSignalRef=DET_MTD_088
            DET_PROB_1STAZHYPO_088_oRDR_DETECTION_085_088_oPCAN_RADAR_2b65b341_Tx: ComBitPosition=439, ComBitSize=1, ComSignalInitValue=0, ComSignalType=BOOLEAN, ComHandleId=1858, ComSystemTemplateSystemSignalRef=DET_PROB_1STAZHYPO_088
            DET_PROB_1STAZHYPO_087_oRDR_DETECTION_085_088_oPCAN_RADAR_07752106_Tx: ComBitPosition=327, ComBitSize=1, ComSignalInitValue=0, ComSignalType=BOOLEAN, ComHandleId=1857, ComSystemTemplateSystemSignalRef=DET_PROB_1STAZHYPO_087
            DET_BELOW_RAIN_THOLD_086_oRDR_DETECTION_085_088_oPCAN_RADAR_5c30f69e_Tx: ComBitPosition=151, ComBitSize=1, ComSignalInitValue=0, ComSignalType=UINT8, ComHandleId=1813, ComSystemTemplateSystemSignalRef=DET_BELOW_RAIN_THOLD_086
            DET_PROB_1STAZHYPO_085_oRDR_DETECTION_085_088_oPCAN_RADAR_f6e58e6d_Tx: ComBitPosition=103, ComBitSize=1, ComSignalInitValue=0, ComSignalType=BOOLEAN, ComHandleId=1855, ComSystemTemplateSystemSignalRef=DET_PROB_1STAZHYPO_085
            DET_MTD_086_oRDR_DETECTION_085_088_oPCAN_RADAR_01b11d5e_Tx: ComBitPosition=159, ComBitSize=1, ComSignalInitValue=0, ComSignalType=UINT8, ComHandleId=1852, ComSystemTemplateSystemSignalRef=DET_MTD_086
            DET_BELOW_RAIN_THOLD_088_oRDR_DETECTION_085_088_oPCAN_RADAR_e550b04c_Tx: ComBitPosition=375, ComBitSize=1, ComSignalInitValue=0, ComSignalType=UINT8, ComHandleId=1815, ComSystemTemplateSystemSignalRef=DET_BELOW_RAIN_THOLD_088
        SG_Detections_029_032_oRDR_DETECTION_029_032_oPCAN_RADAR_028425de_Tx: ComTransferProperty=TRIGGERED, ComHandleId=9, ComSystemTemplateSignalGroupRef=SG_Detections_029_032
          83 x ComGroupSignal, all with ComSignalEndianness=LITTLE_ENDIAN, ComTransferProperty=PENDING, ComSignalAccess=ACCESS_NEEDED_BY_SWC_OR_COM:
            DET_CONFD_ELEVATION_029_oRDR_DETECTION_029_032_oPCAN_RADAR_519f893d_Tx: ComBitPosition=101, ComBitSize=2, ComSignalInitValue=0, ComSignalType=UINT8, ComHandleId=662, ComSystemTemplateSystemSignalRef=DET_CONFD_ELEVATION_029
            DET_RANGE_ERR_032_oRDR_DETECTION_029_032_oPCAN_RADAR_722f9610_Tx: ComBitPosition=376, ComBitSize=7, ComSignalInitValue=0, ComSignalType=UINT8, ComHandleId=704, ComSystemTemplateSystemSignalRef=DET_RANGE_ERR_032
            DET_RCS_031_oRDR_DETECTION_029_032_oPCAN_RADAR_4301a2f8_Tx: ComBitPosition=352, ComBitSize=8, ComSignalInitValue=128, ComSignalType=UINT8, ComHandleId=715, ComSystemTemplateSystemSignalRef=DET_RCS_031
            DET_SUPER_RES_TARGET_030_oRDR_DETECTION_029_032_oPCAN_RADAR_3a460a0a_Tx: ComBitPosition=199, ComBitSize=1, ComSignalInitValue=0, ComSignalType=BOOLEAN, ComHandleId=722, ComSystemTemplateSystemSignalRef=DET_SUPER_RES_TARGET_030
            DET_EXISTENCE_PROB_029_oRDR_DETECTION_029_032_oPCAN_RADAR_d5f9b014_Tx: ComBitPosition=112, ComBitSize=6, ComSignalInitValue=0, ComSignalType=UINT8, ComHandleId=674, ComSystemTemplateSystemSignalRef=DET_EXISTENCE_PROB_029
            DET_BI_STATIC_FLAG_030_oRDR_DETECTION_029_032_oPCAN_RADAR_62e0b02c_Tx: ComBitPosition=216, ComBitSize=1, ComSignalInitValue=0, ComSignalType=BOOLEAN, ComHandleId=655, ComSystemTemplateSystemSignalRef=DET_BI_STATIC_FLAG_030
            DET_AZIMUTH_ERR_030_oRDR_DETECTION_029_032_oPCAN_RADAR_9079655c_Tx: ComBitPosition=217, ComBitSize=7, ComSignalInitValue=0, ComSignalType=UINT8, ComHandleId=647, ComSystemTemplateSystemSignalRef=DET_AZIMUTH_ERR_030
            DET_RANGE_ERR_029_oRDR_DETECTION_029_032_oPCAN_RADAR_e69f4bdf_Tx: ComBitPosition=40, ComBitSize=7, ComSignalInitValue=0, ComSignalType=UINT8, ComHandleId=701, ComSystemTemplateSystemSignalRef=DET_RANGE_ERR_029
            DET_RANGE_029_oRDR_DETECTION_029_032_oPCAN_RADAR_4177f1b6_Tx: ComBitPosition=24, ComBitSize=15, ComSignalInitValue=0, ComSignalType=UINT16, ComHandleId=697, ComSystemTemplateSystemSignalRef=DET_RANGE_029
            DET_SNR_032_oRDR_DETECTION_029_032_oPCAN_RADAR_fa4f8d04_Tx: ComBitPosition=456, ComBitSize=8, ComSignalInitValue=0, ComSignalType=UINT8, ComHandleId=720, ComSystemTemplateSystemSignalRef=DET_SNR_032
            DET_ELEVATION_032_oRDR_DETECTION_029_032_oPCAN_RADAR_14ef80ce_Tx: ComBitPosition=408, ComBitSize=8, ComSignalInitValue=0, ComSignalType=UINT8, ComHandleId=669, ComSystemTemplateSystemSignalRef=DET_ELEVATION_032
            DET_AZIMUTH_ERR_031_oRDR_DETECTION_029_032_oPCAN_RADAR_0509b1c9_Tx: ComBitPosition=329, ComBitSize=7, ComSignalInitValue=0, ComSignalType=UINT8, ComHandleId=648, ComSystemTemplateSystemSignalRef=DET_AZIMUTH_ERR_031
            DET_SUPER_RES_TARGET_029_oRDR_DETECTION_029_032_oPCAN_RADAR_5f6678ae_Tx: ComBitPosition=87, ComBitSize=1, ComSignalInitValue=0, ComSignalType=BOOLEAN, ComHandleId=721, ComSystemTemplateSystemSignalRef=DET_SUPER_RES_TARGET_029
            DET_ELEVATION_ERR_031_oRDR_DETECTION_029_032_oPCAN_RADAR_f7366345_Tx: ComBitPosition=304, ComBitSize=6, ComSignalInitValue=0, ComSignalType=UINT8, ComHandleId=672, ComSystemTemplateSystemSignalRef=DET_ELEVATION_ERR_031
            DET_SUPER_RES_TARGET_031_oRDR_DETECTION_029_032_oPCAN_RADAR_af36de9f_Tx: ComBitPosition=311, ComBitSize=1, ComSignalInitValue=0, ComSignalType=BOOLEAN, ComHandleId=723, ComSystemTemplateSystemSignalRef=DET_SUPER_RES_TARGET_031
            DET_AZIMUTH_030_oRDR_DETECTION_029_032_oPCAN_RADAR_34ccf0a9_Tx: ComBitPosition=200, ComBitSize=13, ComSignalInitValue=0, ComSignalType=UINT16, ComHandleId=643, ComSystemTemplateSystemSignalRef=DET_AZIMUTH_030
            DET_AZIMUTH_031_oRDR_DETECTION_029_032_oPCAN_RADAR_a1bc243c_Tx: ComBitPosition=312, ComBitSize=13, ComSignalInitValue=0, ComSignalType=UINT16, ComHandleId=644, ComSystemTemplateSystemSignalRef=DET_AZIMUTH_031
            DET_EXISTENCE_PROB_030_oRDR_DETECTION_029_032_oPCAN_RADAR_b0d9c2b0_Tx: ComBitPosition=224, ComBitSize=6, ComSignalInitValue=0, ComSignalType=UINT8, ComHandleId=675, ComSystemTemplateSystemSignalRef=DET_EXISTENCE_PROB_030
            DET_EXISTENCE_PROB_031_oRDR_DETECTION_029_032_oPCAN_RADAR_25a91625_Tx: ComBitPosition=336, ComBitSize=6, ComSignalInitValue=0, ComSignalType=UINT8, ComHandleId=676, ComSystemTemplateSystemSignalRef=DET_EXISTENCE_PROB_031
            DET_BI_STATIC_FLAG_032_oRDR_DETECTION_029_032_oPCAN_RADAR_93701f47_Tx: ComBitPosition=440, ComBitSize=1, ComSignalInitValue=0, ComSignalType=BOOLEAN, ComHandleId=657, ComSystemTemplateSystemSignalRef=DET_BI_STATIC_FLAG_032
            DET_RANGE_030_oRDR_DETECTION_029_032_oPCAN_RADAR_24578312_Tx: ComBitPosition=136, ComBitSize=15, ComSignalInitValue=0, ComSignalType=UINT16, ComHandleId=698, ComSystemTemplateSystemSignalRef=DET_RANGE_030
            DET_RCS_030_oRDR_DETECTION_029_032_oPCAN_RADAR_d671766d_Tx: ComBitPosition=240, ComBitSize=8, ComSignalInitValue=128, ComSignalType=UINT8, ComHandleId=714, ComSystemTemplateSystemSignalRef=DET_RCS_030
            DET_RANGE_VELOCITY_ERR_031_oRDR_DETECTION_029_032_oPCAN_RADAR_cb3a6e10_Tx: ComBitPosition=288, ComBitSize=8, ComSignalInitValue=0, ComSignalType=UINT8, ComHandleId=711, ComSystemTemplateSystemSignalRef=DET_RANGE_VELOCITY_ERR_031
            DET_AZIMUTH_ERR_032_oRDR_DETECTION_029_032_oPCAN_RADAR_61e9ca37_Tx: ComBitPosition=441, ComBitSize=7, ComSignalInitValue=0, ComSignalType=UINT8, ComHandleId=649, ComSystemTemplateSystemSignalRef=DET_AZIMUTH_ERR_032
            DET_AZIMUTH_029_oRDR_DETECTION_029_032_oPCAN_RADAR_51ec820d_Tx: ComBitPosition=88, ComBitSize=13, ComSignalInitValue=0, ComSignalType=UINT16, ComHandleId=642, ComSystemTemplateSystemSignalRef=DET_AZIMUTH_029
            DET_SNR_030_oRDR_DETECTION_029_032_oPCAN_RADAR_0bdf226f_Tx: ComBitPosition=232, ComBitSize=8, ComSignalInitValue=0, ComSignalType=UINT8, ComHandleId=718, ComSystemTemplateSystemSignalRef=DET_SNR_030
            DET_RANGE_VELOCITY_031_oRDR_DETECTION_029_032_oPCAN_RADAR_c48195a2_Tx: ComBitPosition=272, ComBitSize=15, ComSignalInitValue=16384, ComSignalType=UINT16, ComHandleId=707, ComSystemTemplateSystemSignalRef=DET_RANGE_VELOCITY_031
            DET_RANGE_VELOCITY_ERR_032_oRDR_DETECTION_029_032_oPCAN_RADAR_afda15ee_Tx: ComBitPosition=400, ComBitSize=8, ComSignalInitValue=0, ComSignalType=UINT8, ComHandleId=712, ComSystemTemplateSystemSignalRef=DET_RANGE_VELOCITY_ERR_032
            DET_CONFD_AZIMUTH_030_oRDR_DETECTION_029_032_oPCAN_RADAR_362afa63_Tx: ComBitPosition=230, ComBitSize=2, ComSignalInitValue=0, ComSignalType=UINT8, ComHandleId=659, ComSystemTemplateSystemSignalRef=DET_CONFD_AZIMUTH_030
            DET_RANGE_ERR_030_oRDR_DETECTION_029_032_oPCAN_RADAR_83bf397b_Tx: ComBitPosition=152, ComBitSize=7, ComSignalInitValue=0, ComSignalType=UINT8, ComHandleId=702, ComSystemTemplateSystemSignalRef=DET_RANGE_ERR_030
            DET_HVC_FLAG_030_oRDR_DETECTION_029_032_oPCAN_RADAR_51ad81cf_Tx: ComBitPosition=198, ComBitSize=1, ComSignalInitValue=0, ComSignalType=BOOLEAN, ComHandleId=679, ComSystemTemplateSystemSignalRef=DET_HVC_FLAG_030
            DET_RANGE_VELOCITY_029_oRDR_DETECTION_029_032_oPCAN_RADAR_34d13393_Tx: ComBitPosition=48, ComBitSize=15, ComSignalInitValue=16384, ComSignalType=UINT16, ComHandleId=705, ComSystemTemplateSystemSignalRef=DET_RANGE_VELOCITY_029
            DET_RANGE_VELOCITY_ERR_029_oRDR_DETECTION_029_032_oPCAN_RADAR_3b6ac821_Tx: ComBitPosition=64, ComBitSize=8, ComSignalInitValue=0, ComSignalType=UINT8, ComHandleId=709, ComSystemTemplateSystemSignalRef=DET_RANGE_VELOCITY_ERR_029
            DET_CONFD_ELEVATION_032_oRDR_DETECTION_029_032_oPCAN_RADAR_c52f54f2_Tx: ComBitPosition=437, ComBitSize=2, ComSignalInitValue=0, ComSignalType=UINT8, ComHandleId=665, ComSystemTemplateSystemSignalRef=DET_CONFD_ELEVATION_032
            DET_ELEVATION_ERR_032_oRDR_DETECTION_029_032_oPCAN_RADAR_93d618bb_Tx: ComBitPosition=416, ComBitSize=6, ComSignalInitValue=0, ComSignalType=UINT8, ComHandleId=673, ComSystemTemplateSystemSignalRef=DET_ELEVATION_ERR_032
            DET_SUPER_RES_TARGET_032_oRDR_DETECTION_029_032_oPCAN_RADAR_cbd6a561_Tx: ComBitPosition=423, ComBitSize=1, ComSignalInitValue=0, ComSignalType=BOOLEAN, ComHandleId=724, ComSystemTemplateSystemSignalRef=DET_SUPER_RES_TARGET_032
            DET_BI_STATIC_FLAG_031_oRDR_DETECTION_029_032_oPCAN_RADAR_f79064b9_Tx: ComBitPosition=328, ComBitSize=1, ComSignalInitValue=0, ComSignalType=BOOLEAN, ComHandleId=656, ComSystemTemplateSystemSignalRef=DET_BI_STATIC_FLAG_031
            DET_SNR_031_oRDR_DETECTION_029_032_oPCAN_RADAR_9eaff6fa_Tx: ComBitPosition=344, ComBitSize=8, ComSignalInitValue=0, ComSignalType=UINT8, ComHandleId=719, ComSystemTemplateSystemSignalRef=DET_SNR_031
            DET_ELEVATION_ERR_029_oRDR_DETECTION_029_032_oPCAN_RADAR_0766c574_Tx: ComBitPosition=80, ComBitSize=6, ComSignalInitValue=0, ComSignalType=UINT8, ComHandleId=670, ComSystemTemplateSystemSignalRef=DET_ELEVATION_ERR_029
            DET_ELEVATION_030_oRDR_DETECTION_029_032_oPCAN_RADAR_e57f2fa5_Tx: ComBitPosition=184, ComBitSize=8, ComSignalInitValue=0, ComSignalType=UINT8, ComHandleId=667, ComSystemTemplateSystemSignalRef=DET_ELEVATION_030
            DET_MH_CRC16_029_032_oRDR_DETECTION_029_032_oPCAN_RADAR_860cf7d5_Tx: ComBitPosition=0, ComBitSize=16, ComSignalInitValue=0, ComSignalType=UINT16, ComHandleId=686, ComSystemTemplateSystemSignalRef=DET_MH_CRC16_029_032
            DET_MH_CYCLE_COUNTER_029_032_oRDR_DETECTION_029_032_oPCAN_RADAR_027956e2_Tx: ComBitPosition=16, ComBitSize=8, ComSignalInitValue=0, ComSignalType=UINT8, ComHandleId=687, ComSystemTemplateSystemSignalRef=DET_MH_CYCLE_COUNTER_029_032
            DET_EXISTENCE_PROB_032_oRDR_DETECTION_029_032_oPCAN_RADAR_41496ddb_Tx: ComBitPosition=448, ComBitSize=6, ComSignalInitValue=0, ComSignalType=UINT8, ComHandleId=677, ComSystemTemplateSystemSignalRef=DET_EXISTENCE_PROB_032
            DET_HVC_FLAG_029_oRDR_DETECTION_029_032_oPCAN_RADAR_348df36b_Tx: ComBitPosition=86, ComBitSize=1, ComSignalInitValue=0, ComSignalType=BOOLEAN, ComHandleId=678, ComSystemTemplateSystemSignalRef=DET_HVC_FLAG_029
            DET_HVC_FLAG_032_oRDR_DETECTION_029_032_oPCAN_RADAR_a03d2ea4_Tx: ComBitPosition=422, ComBitSize=1, ComSignalInitValue=0, ComSignalType=BOOLEAN, ComHandleId=681, ComSystemTemplateSystemSignalRef=DET_HVC_FLAG_032
            DET_AZIMUTH_032_oRDR_DETECTION_029_032_oPCAN_RADAR_c55c5fc2_Tx: ComBitPosition=424, ComBitSize=13, ComSignalInitValue=0, ComSignalType=UINT16, ComHandleId=645, ComSystemTemplateSystemSignalRef=DET_AZIMUTH_032
            DET_CONFD_AZIMUTH_029_oRDR_DETECTION_029_032_oPCAN_RADAR_530a88c7_Tx: ComBitPosition=118, ComBitSize=2, ComSignalInitValue=0, ComSignalType=UINT8, ComHandleId=658, ComSystemTemplateSystemSignalRef=DET_CONFD_AZIMUTH_029
            DET_BI_STATIC_FLAG_029_oRDR_DETECTION_029_032_oPCAN_RADAR_07c0c288_Tx: ComBitPosition=104, ComBitSize=1, ComSignalInitValue=0, ComSignalType=BOOLEAN, ComHandleId=654, ComSystemTemplateSystemSignalRef=DET_BI_STATIC_FLAG_029
            DET_RANGE_VELOCITY_030_oRDR_DETECTION_029_032_oPCAN_RADAR_51f14137_Tx: ComBitPosition=160, ComBitSize=15, ComSignalInitValue=16384, ComSignalType=UINT16, ComHandleId=706, ComSystemTemplateSystemSignalRef=DET_RANGE_VELOCITY_030
            DET_SNR_029_oRDR_DETECTION_029_032_oPCAN_RADAR_6eff50cb_Tx: ComBitPosition=120, ComBitSize=8, ComSignalInitValue=0, ComSignalType=UINT8, ComHandleId=717, ComSystemTemplateSystemSignalRef=DET_SNR_029
            DET_MH_SCAN_INDEX_4LSB_029_032_oRDR_DETECTION_029_032_oPCAN_RADAR_ce53736e_Tx: ComBitPosition=476, ComBitSize=4, ComSignalInitValue=0, ComSignalType=UINT8, ComHandleId=688, ComSystemTemplateSystemSignalRef=DET_MH_SCAN_INDEX_4LSB_029_032
            DET_CONFD_AZIMUTH_032_oRDR_DETECTION_029_032_oPCAN_RADAR_c7ba5508_Tx: ComBitPosition=454, ComBitSize=2, ComSignalInitValue=0, ComSignalType=UINT8, ComHandleId=661, ComSystemTemplateSystemSignalRef=DET_CONFD_AZIMUTH_032
            DET_ELEVATION_031_oRDR_DETECTION_029_032_oPCAN_RADAR_700ffb30_Tx: ComBitPosition=296, ComBitSize=8, ComSignalInitValue=0, ComSignalType=UINT8, ComHandleId=668, ComSystemTemplateSystemSignalRef=DET_ELEVATION_031
            DET_ELEVATION_ERR_030_oRDR_DETECTION_029_032_oPCAN_RADAR_6246b7d0_Tx: ComBitPosition=192, ComBitSize=6, ComSignalInitValue=0, ComSignalType=UINT8, ComHandleId=671, ComSystemTemplateSystemSignalRef=DET_ELEVATION_ERR_030
            DET_ELEVATION_029_oRDR_DETECTION_029_032_oPCAN_RADAR_805f5d01_Tx: ComBitPosition=72, ComBitSize=8, ComSignalInitValue=0, ComSignalType=UINT8, ComHandleId=666, ComSystemTemplateSystemSignalRef=DET_ELEVATION_029
            DET_HVC_FLAG_031_oRDR_DETECTION_029_032_oPCAN_RADAR_c4dd555a_Tx: ComBitPosition=310, ComBitSize=1, ComSignalInitValue=0, ComSignalType=BOOLEAN, ComHandleId=680, ComSystemTemplateSystemSignalRef=DET_HVC_FLAG_031
            DET_RANGE_032_oRDR_DETECTION_029_032_oPCAN_RADAR_d5c72c79_Tx: ComBitPosition=360, ComBitSize=15, ComSignalInitValue=0, ComSignalType=UINT16, ComHandleId=700, ComSystemTemplateSystemSignalRef=DET_RANGE_032
            DET_RANGE_VELOCITY_032_oRDR_DETECTION_029_032_oPCAN_RADAR_a061ee5c_Tx: ComBitPosition=384, ComBitSize=15, ComSignalInitValue=16384, ComSignalType=UINT16, ComHandleId=708, ComSystemTemplateSystemSignalRef=DET_RANGE_VELOCITY_032
            DET_RANGE_031_oRDR_DETECTION_029_032_oPCAN_RADAR_b1275787_Tx: ComBitPosition=248, ComBitSize=15, ComSignalInitValue=0, ComSignalType=UINT16, ComHandleId=699, ComSystemTemplateSystemSignalRef=DET_RANGE_031
            DET_RANGE_VELOCITY_ERR_030_oRDR_DETECTION_029_032_oPCAN_RADAR_5e4aba85_Tx: ComBitPosition=176, ComBitSize=8, ComSignalInitValue=0, ComSignalType=UINT8, ComHandleId=710, ComSystemTemplateSystemSignalRef=DET_RANGE_VELOCITY_ERR_030
            DET_AZIMUTH_ERR_029_oRDR_DETECTION_029_032_oPCAN_RADAR_f55917f8_Tx: ComBitPosition=105, ComBitSize=7, ComSignalInitValue=0, ComSignalType=UINT8, ComHandleId=646, ComSystemTemplateSystemSignalRef=DET_AZIMUTH_ERR_029
            DET_CONFD_ELEVATION_031_oRDR_DETECTION_029_032_oPCAN_RADAR_a1cf2f0c_Tx: ComBitPosition=325, ComBitSize=2, ComSignalInitValue=0, ComSignalType=UINT8, ComHandleId=664, ComSystemTemplateSystemSignalRef=DET_CONFD_ELEVATION_031
            DET_CONFD_AZIMUTH_031_oRDR_DETECTION_029_032_oPCAN_RADAR_a35a2ef6_Tx: ComBitPosition=342, ComBitSize=2, ComSignalInitValue=0, ComSignalType=UINT8, ComHandleId=660, ComSystemTemplateSystemSignalRef=DET_CONFD_AZIMUTH_031
            DET_RCS_029_oRDR_DETECTION_029_032_oPCAN_RADAR_b35104c9_Tx: ComBitPosition=128, ComBitSize=8, ComSignalInitValue=128, ComSignalType=UINT8, ComHandleId=713, ComSystemTemplateSystemSignalRef=DET_RCS_029
            DET_RANGE_ERR_031_oRDR_DETECTION_029_032_oPCAN_RADAR_16cfedee_Tx: ComBitPosition=264, ComBitSize=7, ComSignalInitValue=0, ComSignalType=UINT8, ComHandleId=703, ComSystemTemplateSystemSignalRef=DET_RANGE_ERR_031
            DET_RCS_032_oRDR_DETECTION_029_032_oPCAN_RADAR_27e1d906_Tx: ComBitPosition=464, ComBitSize=8, ComSignalInitValue=128, ComSignalType=UINT8, ComHandleId=716, ComSystemTemplateSystemSignalRef=DET_RCS_032
            DET_CONFD_ELEVATION_030_oRDR_DETECTION_029_032_oPCAN_RADAR_34bffb99_Tx: ComBitPosition=213, ComBitSize=2, ComSignalInitValue=0, ComSignalType=UINT8, ComHandleId=663, ComSystemTemplateSystemSignalRef=DET_CONFD_ELEVATION_030
            DET_MTD_031_oRDR_DETECTION_029_032_oPCAN_RADAR_293c5c3c_Tx: ComBitPosition=271, ComBitSize=1, ComSignalInitValue=0, ComSignalType=UINT8, ComHandleId=691, ComSystemTemplateSystemSignalRef=DET_MTD_031
            DET_BELOW_RAIN_THOLD_029_oRDR_DETECTION_029_032_oPCAN_RADAR_84ed11cd_Tx: ComBitPosition=39, ComBitSize=1, ComSignalInitValue=0, ComSignalType=UINT8, ComHandleId=650, ComSystemTemplateSystemSignalRef=DET_BELOW_RAIN_THOLD_029
            DET_BELOW_RAIN_THOLD_030_oRDR_DETECTION_029_032_oPCAN_RADAR_e1cd6369_Tx: ComBitPosition=151, ComBitSize=1, ComSignalInitValue=0, ComSignalType=UINT8, ComHandleId=651, ComSystemTemplateSystemSignalRef=DET_BELOW_RAIN_THOLD_030
            DET_IDM_030_oRDR_DETECTION_029_032_oPCAN_RADAR_daffba72_Tx: ComBitPosition=175, ComBitSize=1, ComSignalInitValue=0, ComSignalType=UINT8, ComHandleId=683, ComSystemTemplateSystemSignalRef=DET_IDM_030
            DET_MTD_029_oRDR_DETECTION_029_032_oPCAN_RADAR_d96cfa0d_Tx: ComBitPosition=47, ComBitSize=1, ComSignalInitValue=0, ComSignalType=UINT8, ComHandleId=689, ComSystemTemplateSystemSignalRef=DET_MTD_029
            DET_PROB_1STAZHYPO_030_oRDR_DETECTION_029_032_oPCAN_RADAR_2ff86064_Tx: ComBitPosition=215, ComBitSize=1, ComSignalInitValue=0, ComSignalType=BOOLEAN, ComHandleId=694, ComSystemTemplateSystemSignalRef=DET_PROB_1STAZHYPO_030
            DET_PROB_1STAZHYPO_031_oRDR_DETECTION_029_032_oPCAN_RADAR_ba88b4f1_Tx: ComBitPosition=327, ComBitSize=1, ComSignalInitValue=0, ComSignalType=BOOLEAN, ComHandleId=695, ComSystemTemplateSystemSignalRef=DET_PROB_1STAZHYPO_031
            DET_IDM_031_oRDR_DETECTION_029_032_oPCAN_RADAR_4f8f6ee7_Tx: ComBitPosition=287, ComBitSize=1, ComSignalInitValue=0, ComSignalType=UINT8, ComHandleId=684, ComSystemTemplateSystemSignalRef=DET_IDM_031
            DET_MTD_032_oRDR_DETECTION_029_032_oPCAN_RADAR_4ddc27c2_Tx: ComBitPosition=383, ComBitSize=1, ComSignalInitValue=0, ComSignalType=UINT8, ComHandleId=692, ComSystemTemplateSystemSignalRef=DET_MTD_032
            DET_IDM_029_oRDR_DETECTION_029_032_oPCAN_RADAR_bfdfc8d6_Tx: ComBitPosition=63, ComBitSize=1, ComSignalInitValue=0, ComSignalType=UINT8, ComHandleId=682, ComSystemTemplateSystemSignalRef=DET_IDM_029
            DET_PROB_1STAZHYPO_029_oRDR_DETECTION_029_032_oPCAN_RADAR_4ad812c0_Tx: ComBitPosition=103, ComBitSize=1, ComSignalInitValue=0, ComSignalType=BOOLEAN, ComHandleId=693, ComSystemTemplateSystemSignalRef=DET_PROB_1STAZHYPO_029
            DET_BELOW_RAIN_THOLD_031_oRDR_DETECTION_029_032_oPCAN_RADAR_74bdb7fc_Tx: ComBitPosition=263, ComBitSize=1, ComSignalInitValue=0, ComSignalType=UINT8, ComHandleId=652, ComSystemTemplateSystemSignalRef=DET_BELOW_RAIN_THOLD_031
            DET_MTD_030_oRDR_DETECTION_029_032_oPCAN_RADAR_bc4c88a9_Tx: ComBitPosition=159, ComBitSize=1, ComSignalInitValue=0, ComSignalType=UINT8, ComHandleId=690, ComSystemTemplateSystemSignalRef=DET_MTD_030
            DET_PROB_1STAZHYPO_032_oRDR_DETECTION_029_032_oPCAN_RADAR_de68cf0f_Tx: ComBitPosition=439, ComBitSize=1, ComSignalInitValue=0, ComSignalType=BOOLEAN, ComHandleId=696, ComSystemTemplateSystemSignalRef=DET_PROB_1STAZHYPO_032
            DET_BELOW_RAIN_THOLD_032_oRDR_DETECTION_029_032_oPCAN_RADAR_105dcc02_Tx: ComBitPosition=375, ComBitSize=1, ComSignalInitValue=0, ComSignalType=UINT8, ComHandleId=653, ComSystemTemplateSystemSignalRef=DET_BELOW_RAIN_THOLD_032
            DET_IDM_032_oRDR_DETECTION_029_032_oPCAN_RADAR_2b6f1519_Tx: ComBitPosition=399, ComBitSize=1, ComSignalInitValue=0, ComSignalType=UINT8, ComHandleId=685, ComSystemTemplateSystemSignalRef=DET_IDM_032
        SG_Detections_137_140_oRDR_DETECTION_137_140_oPCAN_RADAR_e974e064_Tx: ComTransferProperty=TRIGGERED, ComHandleId=36, ComSystemTemplateSignalGroupRef=SG_Detections_137_140
          83 x ComGroupSignal, all with ComSignalEndianness=LITTLE_ENDIAN, ComTransferProperty=PENDING, ComSignalAccess=ACCESS_NEEDED_BY_SWC_OR_COM:
            DET_AZIMUTH_137_oRDR_DETECTION_137_140_oPCAN_RADAR_200a246e_Tx: ComBitPosition=88, ComBitSize=13, ComSignalInitValue=0, ComSignalType=UINT16, ComHandleId=2883, ComSystemTemplateSystemSignalRef=DET_AZIMUTH_137
            DET_EXISTENCE_PROB_138_oRDR_DETECTION_137_140_oPCAN_RADAR_880f8430_Tx: ComBitPosition=224, ComBitSize=6, ComSignalInitValue=0, ComSignalType=UINT8, ComHandleId=2916, ComSystemTemplateSystemSignalRef=DET_EXISTENCE_PROB_138
            DET_RANGE_138_oRDR_DETECTION_137_140_oPCAN_RADAR_1c81c592_Tx: ComBitPosition=136, ComBitSize=15, ComSignalInitValue=0, ComSignalType=UINT16, ComHandleId=2939, ComSystemTemplateSystemSignalRef=DET_RANGE_138
            DET_RANGE_140_oRDR_DETECTION_137_140_oPCAN_RADAR_58131d63_Tx: ComBitPosition=360, ComBitSize=15, ComSignalInitValue=0, ComSignalType=UINT16, ComHandleId=2941, ComSystemTemplateSystemSignalRef=DET_RANGE_140
            DET_MH_CRC16_137_140_oRDR_DETECTION_137_140_oPCAN_RADAR_6dfc326f_Tx: ComBitPosition=0, ComBitSize=16, ComSignalInitValue=0, ComSignalType=UINT16, ComHandleId=2927, ComSystemTemplateSystemSignalRef=DET_MH_CRC16_137_140
            DET_MH_SCAN_INDEX_4LSB_137_140_oRDR_DETECTION_137_140_oPCAN_RADAR_25a3b6d4_Tx: ComBitPosition=476, ComBitSize=4, ComSignalInitValue=0, ComSignalType=UINT8, ComHandleId=2929, ComSystemTemplateSystemSignalRef=DET_MH_SCAN_INDEX_4LSB_137_140
            DET_SNR_139_oRDR_DETECTION_137_140_oPCAN_RADAR_a679b07a_Tx: ComBitPosition=344, ComBitSize=8, ComSignalInitValue=0, ComSignalType=UINT8, ComHandleId=2960, ComSystemTemplateSystemSignalRef=DET_SNR_139
            DET_SUPER_RES_TARGET_140_oRDR_DETECTION_137_140_oPCAN_RADAR_4602947b_Tx: ComBitPosition=423, ComBitSize=1, ComSignalInitValue=0, ComSignalType=BOOLEAN, ComHandleId=2965, ComSystemTemplateSystemSignalRef=DET_SUPER_RES_TARGET_140
            DET_SNR_140_oRDR_DETECTION_137_140_oPCAN_RADAR_779bbc1e_Tx: ComBitPosition=456, ComBitSize=8, ComSignalInitValue=0, ComSignalType=UINT8, ComHandleId=2961, ComSystemTemplateSystemSignalRef=DET_SNR_140
            DET_CONFD_ELEVATION_137_oRDR_DETECTION_137_140_oPCAN_RADAR_20792f5e_Tx: ComBitPosition=101, ComBitSize=2, ComSignalInitValue=0, ComSignalType=UINT8, ComHandleId=2903, ComSystemTemplateSystemSignalRef=DET_CONFD_ELEVATION_137
            DET_HVC_FLAG_137_oRDR_DETECTION_137_140_oPCAN_RADAR_456b5508_Tx: ComBitPosition=86, ComBitSize=1, ComSignalInitValue=0, ComSignalType=BOOLEAN, ComHandleId=2919, ComSystemTemplateSystemSignalRef=DET_HVC_FLAG_137
            DET_CONFD_AZIMUTH_138_oRDR_DETECTION_137_140_oPCAN_RADAR_0efcbce3_Tx: ComBitPosition=230, ComBitSize=2, ComSignalInitValue=0, ComSignalType=UINT8, ComHandleId=2900, ComSystemTemplateSystemSignalRef=DET_CONFD_AZIMUTH_138
            DET_BI_STATIC_FLAG_138_oRDR_DETECTION_137_140_oPCAN_RADAR_5a36f6ac_Tx: ComBitPosition=216, ComBitSize=1, ComSignalInitValue=0, ComSignalType=BOOLEAN, ComHandleId=2896, ComSystemTemplateSystemSignalRef=DET_BI_STATIC_FLAG_138
            DET_RANGE_VELOCITY_ERR_139_oRDR_DETECTION_137_140_oPCAN_RADAR_f3ec2890_Tx: ComBitPosition=288, ComBitSize=8, ComSignalInitValue=0, ComSignalType=UINT8, ComHandleId=2952, ComSystemTemplateSystemSignalRef=DET_RANGE_VELOCITY_ERR_139
            DET_RANGE_VELOCITY_ERR_137_oRDR_DETECTION_137_140_oPCAN_RADAR_4a8c6e42_Tx: ComBitPosition=64, ComBitSize=8, ComSignalInitValue=0, ComSignalType=UINT8, ComHandleId=2950, ComSystemTemplateSystemSignalRef=DET_RANGE_VELOCITY_ERR_137
            DET_ELEVATION_139_oRDR_DETECTION_137_140_oPCAN_RADAR_48d9bdb0_Tx: ComBitPosition=296, ComBitSize=8, ComSignalInitValue=0, ComSignalType=UINT8, ComHandleId=2909, ComSystemTemplateSystemSignalRef=DET_ELEVATION_139
            DET_RANGE_VELOCITY_ERR_140_oRDR_DETECTION_137_140_oPCAN_RADAR_220e24f4_Tx: ComBitPosition=400, ComBitSize=8, ComSignalInitValue=0, ComSignalType=UINT8, ComHandleId=2953, ComSystemTemplateSystemSignalRef=DET_RANGE_VELOCITY_ERR_140
            DET_SUPER_RES_TARGET_137_oRDR_DETECTION_137_140_oPCAN_RADAR_2e80decd_Tx: ComBitPosition=87, ComBitSize=1, ComSignalInitValue=0, ComSignalType=BOOLEAN, ComHandleId=2962, ComSystemTemplateSystemSignalRef=DET_SUPER_RES_TARGET_137
            DET_RANGE_VELOCITY_138_oRDR_DETECTION_137_140_oPCAN_RADAR_692707b7_Tx: ComBitPosition=160, ComBitSize=15, ComSignalInitValue=16384, ComSignalType=UINT16, ComHandleId=2947, ComSystemTemplateSystemSignalRef=DET_RANGE_VELOCITY_138
            DET_RCS_140_oRDR_DETECTION_137_140_oPCAN_RADAR_aa35e81c_Tx: ComBitPosition=464, ComBitSize=8, ComSignalInitValue=128, ComSignalType=UINT8, ComHandleId=2957, ComSystemTemplateSystemSignalRef=DET_RCS_140
            DET_ELEVATION_138_oRDR_DETECTION_137_140_oPCAN_RADAR_dda96925_Tx: ComBitPosition=184, ComBitSize=8, ComSignalInitValue=0, ComSignalType=UINT8, ComHandleId=2908, ComSystemTemplateSystemSignalRef=DET_ELEVATION_138
            DET_BI_STATIC_FLAG_139_oRDR_DETECTION_137_140_oPCAN_RADAR_cf462239_Tx: ComBitPosition=328, ComBitSize=1, ComSignalInitValue=0, ComSignalType=BOOLEAN, ComHandleId=2897, ComSystemTemplateSystemSignalRef=DET_BI_STATIC_FLAG_139
            DET_AZIMUTH_ERR_137_oRDR_DETECTION_137_140_oPCAN_RADAR_84bfb19b_Tx: ComBitPosition=105, ComBitSize=7, ComSignalInitValue=0, ComSignalType=UINT8, ComHandleId=2887, ComSystemTemplateSystemSignalRef=DET_AZIMUTH_ERR_137
            DET_CONFD_ELEVATION_138_oRDR_DETECTION_137_140_oPCAN_RADAR_0c69bd19_Tx: ComBitPosition=213, ComBitSize=2, ComSignalInitValue=0, ComSignalType=UINT8, ComHandleId=2904, ComSystemTemplateSystemSignalRef=DET_CONFD_ELEVATION_138
            DET_CONFD_ELEVATION_140_oRDR_DETECTION_137_140_oPCAN_RADAR_48fb65e8_Tx: ComBitPosition=437, ComBitSize=2, ComSignalInitValue=0, ComSignalType=UINT8, ComHandleId=2906, ComSystemTemplateSystemSignalRef=DET_CONFD_ELEVATION_140
            DET_SUPER_RES_TARGET_139_oRDR_DETECTION_137_140_oPCAN_RADAR_97e0981f_Tx: ComBitPosition=311, ComBitSize=1, ComSignalInitValue=0, ComSignalType=BOOLEAN, ComHandleId=2964, ComSystemTemplateSystemSignalRef=DET_SUPER_RES_TARGET_139
            DET_ELEVATION_ERR_137_oRDR_DETECTION_137_140_oPCAN_RADAR_76806317_Tx: ComBitPosition=80, ComBitSize=6, ComSignalInitValue=0, ComSignalType=UINT8, ComHandleId=2911, ComSystemTemplateSystemSignalRef=DET_ELEVATION_ERR_137
            DET_AZIMUTH_138_oRDR_DETECTION_137_140_oPCAN_RADAR_0c1ab629_Tx: ComBitPosition=200, ComBitSize=13, ComSignalInitValue=0, ComSignalType=UINT16, ComHandleId=2884, ComSystemTemplateSystemSignalRef=DET_AZIMUTH_138
            DET_CONFD_AZIMUTH_139_oRDR_DETECTION_137_140_oPCAN_RADAR_9b8c6876_Tx: ComBitPosition=342, ComBitSize=2, ComSignalInitValue=0, ComSignalType=UINT8, ComHandleId=2901, ComSystemTemplateSystemSignalRef=DET_CONFD_AZIMUTH_139
            DET_BI_STATIC_FLAG_137_oRDR_DETECTION_137_140_oPCAN_RADAR_762664eb_Tx: ComBitPosition=104, ComBitSize=1, ComSignalInitValue=0, ComSignalType=BOOLEAN, ComHandleId=2895, ComSystemTemplateSystemSignalRef=DET_BI_STATIC_FLAG_137
            DET_AZIMUTH_ERR_140_oRDR_DETECTION_137_140_oPCAN_RADAR_ec3dfb2d_Tx: ComBitPosition=441, ComBitSize=7, ComSignalInitValue=0, ComSignalType=UINT8, ComHandleId=2890, ComSystemTemplateSystemSignalRef=DET_AZIMUTH_ERR_140
            DET_RANGE_VELOCITY_139_oRDR_DETECTION_137_140_oPCAN_RADAR_fc57d322_Tx: ComBitPosition=272, ComBitSize=15, ComSignalInitValue=16384, ComSignalType=UINT16, ComHandleId=2948, ComSystemTemplateSystemSignalRef=DET_RANGE_VELOCITY_139
            DET_RCS_138_oRDR_DETECTION_137_140_oPCAN_RADAR_eea730ed_Tx: ComBitPosition=240, ComBitSize=8, ComSignalInitValue=128, ComSignalType=UINT8, ComHandleId=2955, ComSystemTemplateSystemSignalRef=DET_RCS_138
            DET_RANGE_139_oRDR_DETECTION_137_140_oPCAN_RADAR_89f11107_Tx: ComBitPosition=248, ComBitSize=15, ComSignalInitValue=0, ComSignalType=UINT16, ComHandleId=2940, ComSystemTemplateSystemSignalRef=DET_RANGE_139
            DET_HVC_FLAG_138_oRDR_DETECTION_137_140_oPCAN_RADAR_697bc74f_Tx: ComBitPosition=198, ComBitSize=1, ComSignalInitValue=0, ComSignalType=BOOLEAN, ComHandleId=2920, ComSystemTemplateSystemSignalRef=DET_HVC_FLAG_138
            DET_RANGE_137_oRDR_DETECTION_137_140_oPCAN_RADAR_309157d5_Tx: ComBitPosition=24, ComBitSize=15, ComSignalInitValue=0, ComSignalType=UINT16, ComHandleId=2938, ComSystemTemplateSystemSignalRef=DET_RANGE_137
            DET_RANGE_ERR_138_oRDR_DETECTION_137_140_oPCAN_RADAR_bb697ffb_Tx: ComBitPosition=152, ComBitSize=7, ComSignalInitValue=0, ComSignalType=UINT8, ComHandleId=2943, ComSystemTemplateSystemSignalRef=DET_RANGE_ERR_138
            DET_SNR_137_oRDR_DETECTION_137_140_oPCAN_RADAR_1f19f6a8_Tx: ComBitPosition=120, ComBitSize=8, ComSignalInitValue=0, ComSignalType=UINT8, ComHandleId=2958, ComSystemTemplateSystemSignalRef=DET_SNR_137
            DET_CONFD_AZIMUTH_140_oRDR_DETECTION_137_140_oPCAN_RADAR_4a6e6412_Tx: ComBitPosition=454, ComBitSize=2, ComSignalInitValue=0, ComSignalType=UINT8, ComHandleId=2902, ComSystemTemplateSystemSignalRef=DET_CONFD_AZIMUTH_140
            DET_RCS_139_oRDR_DETECTION_137_140_oPCAN_RADAR_7bd7e478_Tx: ComBitPosition=352, ComBitSize=8, ComSignalInitValue=128, ComSignalType=UINT8, ComHandleId=2956, ComSystemTemplateSystemSignalRef=DET_RCS_139
            DET_SNR_138_oRDR_DETECTION_137_140_oPCAN_RADAR_330964ef_Tx: ComBitPosition=232, ComBitSize=8, ComSignalInitValue=0, ComSignalType=UINT8, ComHandleId=2959, ComSystemTemplateSystemSignalRef=DET_SNR_138
            DET_ELEVATION_ERR_138_oRDR_DETECTION_137_140_oPCAN_RADAR_5a90f150_Tx: ComBitPosition=192, ComBitSize=6, ComSignalInitValue=0, ComSignalType=UINT8, ComHandleId=2912, ComSystemTemplateSystemSignalRef=DET_ELEVATION_ERR_138
            DET_MH_CYCLE_COUNTER_137_140_oRDR_DETECTION_137_140_oPCAN_RADAR_e9899358_Tx: ComBitPosition=16, ComBitSize=8, ComSignalInitValue=0, ComSignalType=UINT8, ComHandleId=2928, ComSystemTemplateSystemSignalRef=DET_MH_CYCLE_COUNTER_137_140
            DET_EXISTENCE_PROB_140_oRDR_DETECTION_137_140_oPCAN_RADAR_cc9d5cc1_Tx: ComBitPosition=448, ComBitSize=6, ComSignalInitValue=0, ComSignalType=UINT8, ComHandleId=2918, ComSystemTemplateSystemSignalRef=DET_EXISTENCE_PROB_140
            DET_CONFD_ELEVATION_139_oRDR_DETECTION_137_140_oPCAN_RADAR_9919698c_Tx: ComBitPosition=325, ComBitSize=2, ComSignalInitValue=0, ComSignalType=UINT8, ComHandleId=2905, ComSystemTemplateSystemSignalRef=DET_CONFD_ELEVATION_139
            DET_ELEVATION_137_oRDR_DETECTION_137_140_oPCAN_RADAR_f1b9fb62_Tx: ComBitPosition=72, ComBitSize=8, ComSignalInitValue=0, ComSignalType=UINT8, ComHandleId=2907, ComSystemTemplateSystemSignalRef=DET_ELEVATION_137
            DET_RANGE_ERR_137_oRDR_DETECTION_137_140_oPCAN_RADAR_9779edbc_Tx: ComBitPosition=40, ComBitSize=7, ComSignalInitValue=0, ComSignalType=UINT8, ComHandleId=2942, ComSystemTemplateSystemSignalRef=DET_RANGE_ERR_137
            DET_AZIMUTH_140_oRDR_DETECTION_137_140_oPCAN_RADAR_48886ed8_Tx: ComBitPosition=424, ComBitSize=13, ComSignalInitValue=0, ComSignalType=UINT16, ComHandleId=2886, ComSystemTemplateSystemSignalRef=DET_AZIMUTH_140
            DET_EXISTENCE_PROB_137_oRDR_DETECTION_137_140_oPCAN_RADAR_a41f1677_Tx: ComBitPosition=112, ComBitSize=6, ComSignalInitValue=0, ComSignalType=UINT8, ComHandleId=2915, ComSystemTemplateSystemSignalRef=DET_EXISTENCE_PROB_137
            DET_CONFD_AZIMUTH_137_oRDR_DETECTION_137_140_oPCAN_RADAR_22ec2ea4_Tx: ComBitPosition=118, ComBitSize=2, ComSignalInitValue=0, ComSignalType=UINT8, ComHandleId=2899, ComSystemTemplateSystemSignalRef=DET_CONFD_AZIMUTH_137
            DET_ELEVATION_ERR_140_oRDR_DETECTION_137_140_oPCAN_RADAR_1e0229a1_Tx: ComBitPosition=416, ComBitSize=6, ComSignalInitValue=0, ComSignalType=UINT8, ComHandleId=2914, ComSystemTemplateSystemSignalRef=DET_ELEVATION_ERR_140
            DET_HVC_FLAG_140_oRDR_DETECTION_137_140_oPCAN_RADAR_2de91fbe_Tx: ComBitPosition=422, ComBitSize=1, ComSignalInitValue=0, ComSignalType=BOOLEAN, ComHandleId=2922, ComSystemTemplateSystemSignalRef=DET_HVC_FLAG_140
            DET_RANGE_ERR_140_oRDR_DETECTION_137_140_oPCAN_RADAR_fffba70a_Tx: ComBitPosition=376, ComBitSize=7, ComSignalInitValue=0, ComSignalType=UINT8, ComHandleId=2945, ComSystemTemplateSystemSignalRef=DET_RANGE_ERR_140
            DET_RCS_137_oRDR_DETECTION_137_140_oPCAN_RADAR_c2b7a2aa_Tx: ComBitPosition=128, ComBitSize=8, ComSignalInitValue=128, ComSignalType=UINT8, ComHandleId=2954, ComSystemTemplateSystemSignalRef=DET_RCS_137
            DET_HVC_FLAG_139_oRDR_DETECTION_137_140_oPCAN_RADAR_fc0b13da_Tx: ComBitPosition=310, ComBitSize=1, ComSignalInitValue=0, ComSignalType=BOOLEAN, ComHandleId=2921, ComSystemTemplateSystemSignalRef=DET_HVC_FLAG_139
            DET_RANGE_VELOCITY_137_oRDR_DETECTION_137_140_oPCAN_RADAR_453795f0_Tx: ComBitPosition=48, ComBitSize=15, ComSignalInitValue=16384, ComSignalType=UINT16, ComHandleId=2946, ComSystemTemplateSystemSignalRef=DET_RANGE_VELOCITY_137
            DET_AZIMUTH_139_oRDR_DETECTION_137_140_oPCAN_RADAR_996a62bc_Tx: ComBitPosition=312, ComBitSize=13, ComSignalInitValue=0, ComSignalType=UINT16, ComHandleId=2885, ComSystemTemplateSystemSignalRef=DET_AZIMUTH_139
            DET_RANGE_VELOCITY_ERR_138_oRDR_DETECTION_137_140_oPCAN_RADAR_669cfc05_Tx: ComBitPosition=176, ComBitSize=8, ComSignalInitValue=0, ComSignalType=UINT8, ComHandleId=2951, ComSystemTemplateSystemSignalRef=DET_RANGE_VELOCITY_ERR_138
            DET_BI_STATIC_FLAG_140_oRDR_DETECTION_137_140_oPCAN_RADAR_1ea42e5d_Tx: ComBitPosition=440, ComBitSize=1, ComSignalInitValue=0, ComSignalType=BOOLEAN, ComHandleId=2898, ComSystemTemplateSystemSignalRef=DET_BI_STATIC_FLAG_140
            DET_SUPER_RES_TARGET_138_oRDR_DETECTION_137_140_oPCAN_RADAR_02904c8a_Tx: ComBitPosition=199, ComBitSize=1, ComSignalInitValue=0, ComSignalType=BOOLEAN, ComHandleId=2963, ComSystemTemplateSystemSignalRef=DET_SUPER_RES_TARGET_138
            DET_RANGE_VELOCITY_140_oRDR_DETECTION_137_140_oPCAN_RADAR_2db5df46_Tx: ComBitPosition=384, ComBitSize=15, ComSignalInitValue=16384, ComSignalType=UINT16, ComHandleId=2949, ComSystemTemplateSystemSignalRef=DET_RANGE_VELOCITY_140
            DET_AZIMUTH_ERR_138_oRDR_DETECTION_137_140_oPCAN_RADAR_a8af23dc_Tx: ComBitPosition=217, ComBitSize=7, ComSignalInitValue=0, ComSignalType=UINT8, ComHandleId=2888, ComSystemTemplateSystemSignalRef=DET_AZIMUTH_ERR_138
            DET_EXISTENCE_PROB_139_oRDR_DETECTION_137_140_oPCAN_RADAR_1d7f50a5_Tx: ComBitPosition=336, ComBitSize=6, ComSignalInitValue=0, ComSignalType=UINT8, ComHandleId=2917, ComSystemTemplateSystemSignalRef=DET_EXISTENCE_PROB_139
            DET_ELEVATION_ERR_139_oRDR_DETECTION_137_140_oPCAN_RADAR_cfe025c5_Tx: ComBitPosition=304, ComBitSize=6, ComSignalInitValue=0, ComSignalType=UINT8, ComHandleId=2913, ComSystemTemplateSystemSignalRef=DET_ELEVATION_ERR_139
            DET_ELEVATION_140_oRDR_DETECTION_137_140_oPCAN_RADAR_993bb1d4_Tx: ComBitPosition=408, ComBitSize=8, ComSignalInitValue=0, ComSignalType=UINT8, ComHandleId=2910, ComSystemTemplateSystemSignalRef=DET_ELEVATION_140
            DET_AZIMUTH_ERR_139_oRDR_DETECTION_137_140_oPCAN_RADAR_3ddff749_Tx: ComBitPosition=329, ComBitSize=7, ComSignalInitValue=0, ComSignalType=UINT8, ComHandleId=2889, ComSystemTemplateSystemSignalRef=DET_AZIMUTH_ERR_139
            DET_RANGE_ERR_139_oRDR_DETECTION_137_140_oPCAN_RADAR_2e19ab6e_Tx: ComBitPosition=264, ComBitSize=7, ComSignalInitValue=0, ComSignalType=UINT8, ComHandleId=2944, ComSystemTemplateSystemSignalRef=DET_RANGE_ERR_139
            DET_BELOW_RAIN_THOLD_140_oRDR_DETECTION_137_140_oPCAN_RADAR_9d89fd18_Tx: ComBitPosition=375, ComBitSize=1, ComSignalInitValue=0, ComSignalType=UINT8, ComHandleId=2894, ComSystemTemplateSystemSignalRef=DET_BELOW_RAIN_THOLD_140
            DET_IDM_140_oRDR_DETECTION_137_140_oPCAN_RADAR_a6bb2403_Tx: ComBitPosition=399, ComBitSize=1, ComSignalInitValue=0, ComSignalType=UINT8, ComHandleId=2926, ComSystemTemplateSystemSignalRef=DET_IDM_140
            DET_BELOW_RAIN_THOLD_137_oRDR_DETECTION_137_140_oPCAN_RADAR_f50bb7ae_Tx: ComBitPosition=39, ComBitSize=1, ComSignalInitValue=0, ComSignalType=UINT8, ComHandleId=2891, ComSystemTemplateSystemSignalRef=DET_BELOW_RAIN_THOLD_137
            DET_MTD_137_oRDR_DETECTION_137_140_oPCAN_RADAR_a88a5c6e_Tx: ComBitPosition=47, ComBitSize=1, ComSignalInitValue=0, ComSignalType=UINT8, ComHandleId=2930, ComSystemTemplateSystemSignalRef=DET_MTD_137
            DET_MTD_140_oRDR_DETECTION_137_140_oPCAN_RADAR_c00816d8_Tx: ComBitPosition=383, ComBitSize=1, ComSignalInitValue=0, ComSignalType=UINT8, ComHandleId=2933, ComSystemTemplateSystemSignalRef=DET_MTD_140
            DET_IDM_139_oRDR_DETECTION_137_140_oPCAN_RADAR_77592867_Tx: ComBitPosition=287, ComBitSize=1, ComSignalInitValue=0, ComSignalType=UINT8, ComHandleId=2925, ComSystemTemplateSystemSignalRef=DET_IDM_139
            DET_PROB_1STAZHYPO_139_oRDR_DETECTION_137_140_oPCAN_RADAR_825ef271_Tx: ComBitPosition=327, ComBitSize=1, ComSignalInitValue=0, ComSignalType=BOOLEAN, ComHandleId=2936, ComSystemTemplateSystemSignalRef=DET_PROB_1STAZHYPO_139
            DET_MTD_139_oRDR_DETECTION_137_140_oPCAN_RADAR_11ea1abc_Tx: ComBitPosition=271, ComBitSize=1, ComSignalInitValue=0, ComSignalType=UINT8, ComHandleId=2932, ComSystemTemplateSystemSignalRef=DET_MTD_139
            DET_BELOW_RAIN_THOLD_139_oRDR_DETECTION_137_140_oPCAN_RADAR_4c6bf17c_Tx: ComBitPosition=263, ComBitSize=1, ComSignalInitValue=0, ComSignalType=UINT8, ComHandleId=2893, ComSystemTemplateSystemSignalRef=DET_BELOW_RAIN_THOLD_139
            DET_IDM_137_oRDR_DETECTION_137_140_oPCAN_RADAR_ce396eb5_Tx: ComBitPosition=63, ComBitSize=1, ComSignalInitValue=0, ComSignalType=UINT8, ComHandleId=2923, ComSystemTemplateSystemSignalRef=DET_IDM_137
            DET_PROB_1STAZHYPO_140_oRDR_DETECTION_137_140_oPCAN_RADAR_53bcfe15_Tx: ComBitPosition=439, ComBitSize=1, ComSignalInitValue=0, ComSignalType=BOOLEAN, ComHandleId=2937, ComSystemTemplateSystemSignalRef=DET_PROB_1STAZHYPO_140
            DET_IDM_138_oRDR_DETECTION_137_140_oPCAN_RADAR_e229fcf2_Tx: ComBitPosition=175, ComBitSize=1, ComSignalInitValue=0, ComSignalType=UINT8, ComHandleId=2924, ComSystemTemplateSystemSignalRef=DET_IDM_138
            DET_BELOW_RAIN_THOLD_138_oRDR_DETECTION_137_140_oPCAN_RADAR_d91b25e9_Tx: ComBitPosition=151, ComBitSize=1, ComSignalInitValue=0, ComSignalType=UINT8, ComHandleId=2892, ComSystemTemplateSystemSignalRef=DET_BELOW_RAIN_THOLD_138
            DET_MTD_138_oRDR_DETECTION_137_140_oPCAN_RADAR_849ace29_Tx: ComBitPosition=159, ComBitSize=1, ComSignalInitValue=0, ComSignalType=UINT8, ComHandleId=2931, ComSystemTemplateSystemSignalRef=DET_MTD_138
            DET_PROB_1STAZHYPO_138_oRDR_DETECTION_137_140_oPCAN_RADAR_172e26e4_Tx: ComBitPosition=215, ComBitSize=1, ComSignalInitValue=0, ComSignalType=BOOLEAN, ComHandleId=2935, ComSystemTemplateSystemSignalRef=DET_PROB_1STAZHYPO_138
            DET_PROB_1STAZHYPO_137_oRDR_DETECTION_137_140_oPCAN_RADAR_3b3eb4a3_Tx: ComBitPosition=103, ComBitSize=1, ComSignalInitValue=0, ComSignalType=BOOLEAN, ComHandleId=2934, ComSystemTemplateSystemSignalRef=DET_PROB_1STAZHYPO_137
