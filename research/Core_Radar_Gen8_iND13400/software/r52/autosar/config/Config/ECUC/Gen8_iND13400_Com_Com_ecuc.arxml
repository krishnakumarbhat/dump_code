[part 2 of 20: package /ActiveEcuC]
AUTOSAR XML (schema 00053)
package /ActiveEcuC  (continued)
  module config Com: implementation-config-variant=VARIANT-PRE-COMPILE, module-description=Com_Impl  (continued)
    ComConfig: ComConfigurationId=0, ComRxImmediateNotificationCacheSize=0, ComRxDeferredNotificationCacheSize=1  (continued)
      3 x ComSignalGroup, all with ComTransferProperty=TRIGGERED, ComSignalGroupAccess=ACCESS_NEEDED_BY_SWC_OR_COM, ComSignalGroupArrayAccess=true:
        SG_TrackerObject027_oRDR_TRACKER_OBJ_027_oPCAN_RADAR_7b75aa88_Tx: ComHandleId=136, ComSystemTemplateSignalGroupRef=SG_TrackerObject027
          49 x ComGroupSignal, all with ComSignalEndianness=BIG_ENDIAN, ComSignalInitValue=0, ComTransferProperty=PENDING, ComSignalAccess=ACCESS_NEEDED_BY_SWC_OR_COM:
            OBJ_VELOCITY_ERR_CRR_COEF_027_oRDR_TRACKER_OBJ_027_oPCAN_RADAR_89d207d1_Tx: ComBitPosition=423, ComBitSize=8, ComSignalType=UINT8, ComHandleId=9843, ComSystemTemplateSystemSignalRef=OBJ_VELOCITY_ERR_CRR_COEF_027
            OBJ_ACCELERATION_LONG_ERR_027_oRDR_TRACKER_OBJ_027_oPCAN_RADAR_bf006eeb_Tx: ComBitPosition=215, ComBitSize=8, ComSignalType=UINT8, ComHandleId=9806, ComSystemTemplateSystemSignalRef=OBJ_ACCELERATION_LONG_ERR_027
            OBJ_CLS_TYPE6_027_oRDR_TRACKER_OBJ_027_oPCAN_RADAR_e643ffa9_Tx: ComBitPosition=282, ComBitSize=4, ComSignalType=UINT8, ComHandleId=9819, ComSystemTemplateSystemSignalRef=OBJ_CLS_TYPE6_027
            OBJ_YAW_RATE_027_oRDR_TRACKER_OBJ_027_oPCAN_RADAR_4f57e35c_Tx: ComBitPosition=399, ComBitSize=10, ComSignalType=UINT16, ComHandleId=9850, ComSystemTemplateSystemSignalRef=OBJ_YAW_RATE_027
            OBJ_CLS_TYPE2_PROB_027_oRDR_TRACKER_OBJ_027_oPCAN_RADAR_9177ce7b_Tx: ComBitPosition=311, ComBitSize=8, ComSignalType=UINT8, ComHandleId=9812, ComSystemTemplateSystemSignalRef=OBJ_CLS_TYPE2_PROB_027
            OBJ_REF_PT_LAT_OFFSET_027_oRDR_TRACKER_OBJ_027_oPCAN_RADAR_15f5fa0e_Tx: ComBitPosition=370, ComBitSize=14, ComSignalType=UINT16, ComHandleId=9838, ComSystemTemplateSystemSignalRef=OBJ_REF_PT_LAT_OFFSET_027
            OBJ_CLS_TYPE2_027_oRDR_TRACKER_OBJ_027_oPCAN_RADAR_bdf302e2_Tx: ComBitPosition=267, ComBitSize=4, ComSignalType=UINT8, ComHandleId=9811, ComSystemTemplateSystemSignalRef=OBJ_CLS_TYPE2_027
            OBJ_POS_ERR_CRR_COEF_027_oRDR_TRACKER_OBJ_027_oPCAN_RADAR_20a83a30_Tx: ComBitPosition=415, ComBitSize=8, ComSignalType=UINT8, ComHandleId=9832, ComSystemTemplateSystemSignalRef=OBJ_POS_ERR_CRR_COEF_027
            OBJ_DIMENSION_WIDTH_027_oRDR_TRACKER_OBJ_027_oPCAN_RADAR_914ba66c_Tx: ComBitPosition=17, ComBitSize=10, ComSignalType=UINT16, ComHandleId=9823, ComSystemTemplateSystemSignalRef=OBJ_DIMENSION_WIDTH_027
            OBJ_TIMESTAMP_OFFSET_027_oRDR_TRACKER_OBJ_027_oPCAN_RADAR_e064912d_Tx: ComBitPosition=247, ComBitSize=8, ComSignalType=UINT8, ComHandleId=9840, ComSystemTemplateSystemSignalRef=OBJ_TIMESTAMP_OFFSET_027
            OBJ_ACCELERATION_LAT_027_oRDR_TRACKER_OBJ_027_oPCAN_RADAR_7551f1ff_Tx: ComBitPosition=177, ComBitSize=10, ComSignalType=UINT16, ComHandleId=9803, ComSystemTemplateSystemSignalRef=OBJ_ACCELERATION_LAT_027
            OBJ_DIMENSION_LENGTH_ERR_027_oRDR_TRACKER_OBJ_027_oPCAN_RADAR_897d4ebb_Tx: ComBitPosition=41, ComBitSize=10, ComSignalType=UINT16, ComHandleId=9822, ComSystemTemplateSystemSignalRef=OBJ_DIMENSION_LENGTH_ERR_027
            OBJ_CLS_TYPE5_027_oRDR_TRACKER_OBJ_027_oPCAN_RADAR_ababffce_Tx: ComBitPosition=287, ComBitSize=4, ComSignalType=UINT8, ComHandleId=9817, ComSystemTemplateSystemSignalRef=OBJ_CLS_TYPE5_027
            OBJ_TRACK_MOTION_MODEL_027_oRDR_TRACKER_OBJ_027_oPCAN_RADAR_2c6790f0_Tx: ComBitPosition=9, ComBitSize=2, ComSignalType=UINT8, ComHandleId=9841, ComSystemTemplateSystemSignalRef=OBJ_TRACK_MOTION_MODEL_027
            OBJ_ACCEL_ERR_CRR_COEF_027_oRDR_TRACKER_OBJ_027_oPCAN_RADAR_1fa34f8d_Tx: ComBitPosition=431, ComBitSize=8, ComSignalType=UINT8, ComHandleId=9807, ComSystemTemplateSystemSignalRef=OBJ_ACCEL_ERR_CRR_COEF_027
            OBJ_CLS_TYPE3_PROB_027_oRDR_TRACKER_OBJ_027_oPCAN_RADAR_d6643880_Tx: ComBitPosition=319, ComBitSize=8, ComSignalType=UINT8, ComHandleId=9814, ComSystemTemplateSystemSignalRef=OBJ_CLS_TYPE3_PROB_027
            OBJ_CLS_TYPE5_PROB_027_oRDR_TRACKER_OBJ_027_oPCAN_RADAR_9f7d08db_Tx: ComBitPosition=335, ComBitSize=8, ComSignalType=UINT8, ComHandleId=9818, ComSystemTemplateSystemSignalRef=OBJ_CLS_TYPE5_PROB_027
            OBJ_POS_LAT_027_oRDR_TRACKER_OBJ_027_oPCAN_RADAR_c207c77c_Tx: ComBitPosition=79, ComBitSize=16, ComSignalType=UINT16, ComHandleId=9833, ComSystemTemplateSystemSignalRef=OBJ_POS_LAT_027
            OBJ_DIMENSION_LENGTH_027_oRDR_TRACKER_OBJ_027_oPCAN_RADAR_b28551c1_Tx: ComBitPosition=37, ComBitSize=12, ComSignalType=UINT16, ComHandleId=9821, ComSystemTemplateSystemSignalRef=OBJ_DIMENSION_LENGTH_027
            OBJ_MOVEMENT_STATUS_027_oRDR_TRACKER_OBJ_027_oPCAN_RADAR_b0d7fa0a_Tx: ComBitPosition=196, ComBitSize=3, ComSignalType=UINT8, ComHandleId=9831, ComSystemTemplateSystemSignalRef=OBJ_MOVEMENT_STATUS_027
            OBJ_CLS_TYPE1_027_oRDR_TRACKER_OBJ_027_oPCAN_RADAR_f01b0285_Tx: ComBitPosition=271, ComBitSize=4, ComSignalType=UINT8, ComHandleId=9809, ComSystemTemplateSystemSignalRef=OBJ_CLS_TYPE1_027
            OBJ_EXISTENCE_PROB_027_oRDR_TRACKER_OBJ_027_oPCAN_RADAR_9af72251_Tx: ComBitPosition=229, ComBitSize=14, ComSignalType=UINT16, ComHandleId=9825, ComSystemTemplateSystemSignalRef=OBJ_EXISTENCE_PROB_027
            OBJ_POS_LONG_ERR_027_oRDR_TRACKER_OBJ_027_oPCAN_RADAR_5fb369a9_Tx: ComBitPosition=95, ComBitSize=8, ComSignalType=UINT8, ComHandleId=9836, ComSystemTemplateSystemSignalRef=OBJ_POS_LONG_ERR_027
            OBJ_MEASUREMENT_STATUS_027_oRDR_TRACKER_OBJ_027_oPCAN_RADAR_9f796f46_Tx: ComBitPosition=14, ComBitSize=3, ComSignalType=UINT8, ComHandleId=9828, ComSystemTemplateSystemSignalRef=OBJ_MEASUREMENT_STATUS_027
            OBJ_VEH_TRACK_FLAG_027_oRDR_TRACKER_OBJ_027_oPCAN_RADAR_ae4d66ad_Tx: ComBitPosition=10, ComBitSize=1, ComSignalType=BOOLEAN, ComHandleId=9842, ComSystemTemplateSystemSignalRef=OBJ_VEH_TRACK_FLAG_027
            OBJ_ACCELERATION_LAT_ERR_027_oRDR_TRACKER_OBJ_027_oPCAN_RADAR_a0a5cb41_Tx: ComBitPosition=223, ComBitSize=8, ComSignalType=UINT8, ComHandleId=9804, ComSystemTemplateSystemSignalRef=OBJ_ACCELERATION_LAT_ERR_027
            OBJ_ACCELERATION_LONG_027_oRDR_TRACKER_OBJ_027_oPCAN_RADAR_07a1a81f_Tx: ComBitPosition=193, ComBitSize=10, ComSignalType=UINT16, ComHandleId=9805, ComSystemTemplateSystemSignalRef=OBJ_ACCELERATION_LONG_027
            OBJ_DIMENSION_WIDTH_ERR_027_oRDR_TRACKER_OBJ_027_oPCAN_RADAR_71e96184_Tx: ComBitPosition=23, ComBitSize=6, ComSignalType=UINT8, ComHandleId=9824, ComSystemTemplateSystemSignalRef=OBJ_DIMENSION_WIDTH_ERR_027
            OBJ_RCS_027_oRDR_TRACKER_OBJ_027_oPCAN_RADAR_e0c8917b_Tx: ComBitPosition=351, ComBitSize=7, ComSignalType=UINT8, ComHandleId=9837, ComSystemTemplateSystemSignalRef=OBJ_RCS_027
            OBJ_VELOCITY_LONG_ERR_027_oRDR_TRACKER_OBJ_027_oPCAN_RADAR_5e1ccdca_Tx: ComBitPosition=143, ComBitSize=8, ComSignalType=UINT8, ComHandleId=9847, ComSystemTemplateSystemSignalRef=OBJ_VELOCITY_LONG_ERR_027
            OBJ_VELOCITY_LAT_027_oRDR_TRACKER_OBJ_027_oPCAN_RADAR_8664825b_Tx: ComBitPosition=126, ComBitSize=15, ComSignalType=UINT16, ComHandleId=9844, ComSystemTemplateSystemSignalRef=OBJ_VELOCITY_LAT_027
            OBJ_VELOCITY_LONG_027_oRDR_TRACKER_OBJ_027_oPCAN_RADAR_d6e9fa9d_Tx: ComBitPosition=110, ComBitSize=15, ComSignalType=UINT16, ComHandleId=9846, ComSystemTemplateSystemSignalRef=OBJ_VELOCITY_LONG_027
            OBJ_CLS_TYPE4_027_oRDR_TRACKER_OBJ_027_oPCAN_RADAR_2623022c_Tx: ComBitPosition=275, ComBitSize=4, ComSignalType=UINT8, ComHandleId=9815, ComSystemTemplateSystemSignalRef=OBJ_CLS_TYPE4_027
            OBJ_YAW_ANGLE_027_oRDR_TRACKER_OBJ_027_oPCAN_RADAR_6ad8c61b_Tx: ComBitPosition=155, ComBitSize=12, ComSignalType=UINT16, ComHandleId=9848, ComSystemTemplateSystemSignalRef=OBJ_YAW_ANGLE_027
            OBJ_ALIVE_TIME_027_oRDR_TRACKER_OBJ_027_oPCAN_RADAR_67c0e3a3_Tx: ComBitPosition=255, ComBitSize=16, ComSignalType=UINT16, ComHandleId=9808, ComSystemTemplateSystemSignalRef=OBJ_ALIVE_TIME_027
            OBJ_POS_LONG_027_oRDR_TRACKER_OBJ_027_oPCAN_RADAR_73a72cb3_Tx: ComBitPosition=63, ComBitSize=16, ComSignalType=UINT16, ComHandleId=9835, ComSystemTemplateSystemSignalRef=OBJ_POS_LONG_027
            OBJ_GROUP_ID_027_oRDR_TRACKER_OBJ_027_oPCAN_RADAR_138536fc_Tx: ComBitPosition=405, ComBitSize=6, ComSignalType=UINT8, ComHandleId=9826, ComSystemTemplateSystemSignalRef=OBJ_GROUP_ID_027
            OBJ_POS_LAT_ERR_027_oRDR_TRACKER_OBJ_027_oPCAN_RADAR_c64b974b_Tx: ComBitPosition=103, ComBitSize=8, ComSignalType=UINT8, ComHandleId=9834, ComSystemTemplateSystemSignalRef=OBJ_POS_LAT_ERR_027
            OBJ_REF_PT_LONG_OFFSET_027_oRDR_TRACKER_OBJ_027_oPCAN_RADAR_5aa70a0d_Tx: ComBitPosition=357, ComBitSize=14, ComSignalType=UINT16, ComHandleId=9839, ComSystemTemplateSystemSignalRef=OBJ_REF_PT_LONG_OFFSET_027
            OBJ_CLS_TYPE6_PROB_027_oRDR_TRACKER_OBJ_027_oPCAN_RADAR_564913d6_Tx: ComBitPosition=343, ComBitSize=8, ComSignalType=UINT8, ComHandleId=9820, ComSystemTemplateSystemSignalRef=OBJ_CLS_TYPE6_PROB_027
            OBJ_CLS_TYPE3_027_oRDR_TRACKER_OBJ_027_oPCAN_RADAR_307bff00_Tx: ComBitPosition=279, ComBitSize=4, ComSignalType=UINT8, ComHandleId=9813, ComSystemTemplateSystemSignalRef=OBJ_CLS_TYPE3_027
            OBJ_VELOCITY_LAT_ERR_027_oRDR_TRACKER_OBJ_027_oPCAN_RADAR_b29ef20a_Tx: ComBitPosition=151, ComBitSize=8, ComSignalType=UINT8, ComHandleId=9845, ComSystemTemplateSystemSignalRef=OBJ_VELOCITY_LAT_ERR_027
            OBJ_CLS_TYPE1_PROB_027_oRDR_TRACKER_OBJ_027_oPCAN_RADAR_5843d576_Tx: ComBitPosition=303, ComBitSize=8, ComSignalType=UINT8, ComHandleId=9810, ComSystemTemplateSystemSignalRef=OBJ_CLS_TYPE1_PROB_027
            OBJ_CLS_TYPE4_PROB_027_oRDR_TRACKER_OBJ_027_oPCAN_RADAR_d86efe20_Tx: ComBitPosition=327, ComBitSize=8, ComSignalType=UINT8, ComHandleId=9816, ComSystemTemplateSystemSignalRef=OBJ_CLS_TYPE4_PROB_027
            OBJ_ID_027_oRDR_TRACKER_OBJ_027_oPCAN_RADAR_e0ab1dfb_Tx: ComBitPosition=7, ComBitSize=8, ComSignalType=UINT8, ComHandleId=9827, ComSystemTemplateSystemSignalRef=OBJ_ID_027
            OBJ_YAW_RATE_ERR_027_oRDR_TRACKER_OBJ_027_oPCAN_RADAR_708f7480_Tx: ComBitPosition=388, ComBitSize=5, ComSignalType=UINT8, ComHandleId=9851, ComSystemTemplateSystemSignalRef=OBJ_YAW_RATE_ERR_027
            OBJ_YAW_ANGLE_ERR_027_oRDR_TRACKER_OBJ_027_oPCAN_RADAR_bfd5c0cc_Tx: ComBitPosition=175, ComBitSize=7, ComSignalType=UINT8, ComHandleId=9849, ComSystemTemplateSystemSignalRef=OBJ_YAW_ANGLE_ERR_027
            OBJ_MH_CYCLE_COUNTER_027_oRDR_TRACKER_OBJ_027_oPCAN_RADAR_92fd829b_Tx: ComBitPosition=487, ComBitSize=8, ComSignalType=UINT8, ComHandleId=9830, ComSystemTemplateSystemSignalRef=OBJ_MH_CYCLE_COUNTER_027
            OBJ_MH_CRC16_027_oRDR_TRACKER_OBJ_027_oPCAN_RADAR_e319d87a_Tx: ComBitPosition=495, ComBitSize=16, ComSignalType=UINT16, ComHandleId=9829, ComSystemTemplateSystemSignalRef=OBJ_MH_CRC16_027
        SG_TrackerObject011_oRDR_TRACKER_OBJ_011_oPCAN_RADAR_f72f8823_Tx: ComHandleId=120, ComSystemTemplateSignalGroupRef=SG_TrackerObject011
          49 x ComGroupSignal, all with ComSignalEndianness=BIG_ENDIAN, ComSignalInitValue=0, ComTransferProperty=PENDING, ComSignalAccess=ACCESS_NEEDED_BY_SWC_OR_COM:
            OBJ_ID_011_oRDR_TRACKER_OBJ_011_oPCAN_RADAR_6cf13f50_Tx: ComBitPosition=7, ComBitSize=8, ComSignalType=UINT8, ComHandleId=9043, ComSystemTemplateSystemSignalRef=OBJ_ID_011
            OBJ_DIMENSION_LENGTH_011_oRDR_TRACKER_OBJ_011_oPCAN_RADAR_3edf736a_Tx: ComBitPosition=37, ComBitSize=12, ComSignalType=UINT16, ComHandleId=9037, ComSystemTemplateSystemSignalRef=OBJ_DIMENSION_LENGTH_011
            OBJ_CLS_TYPE5_PROB_011_oRDR_TRACKER_OBJ_011_oPCAN_RADAR_13272a70_Tx: ComBitPosition=335, ComBitSize=8, ComSignalType=UINT8, ComHandleId=9034, ComSystemTemplateSystemSignalRef=OBJ_CLS_TYPE5_PROB_011
            OBJ_ACCELERATION_LAT_011_oRDR_TRACKER_OBJ_011_oPCAN_RADAR_f90bd354_Tx: ComBitPosition=177, ComBitSize=10, ComSignalType=UINT16, ComHandleId=9019, ComSystemTemplateSystemSignalRef=OBJ_ACCELERATION_LAT_011
            OBJ_DIMENSION_WIDTH_ERR_011_oRDR_TRACKER_OBJ_011_oPCAN_RADAR_fdb3432f_Tx: ComBitPosition=23, ComBitSize=6, ComSignalType=UINT8, ComHandleId=9040, ComSystemTemplateSystemSignalRef=OBJ_DIMENSION_WIDTH_ERR_011
            OBJ_ACCELERATION_LONG_011_oRDR_TRACKER_OBJ_011_oPCAN_RADAR_8bfb8ab4_Tx: ComBitPosition=193, ComBitSize=10, ComSignalType=UINT16, ComHandleId=9021, ComSystemTemplateSystemSignalRef=OBJ_ACCELERATION_LONG_011
            OBJ_ACCEL_ERR_CRR_COEF_011_oRDR_TRACKER_OBJ_011_oPCAN_RADAR_93f96d26_Tx: ComBitPosition=431, ComBitSize=8, ComSignalType=UINT8, ComHandleId=9023, ComSystemTemplateSystemSignalRef=OBJ_ACCEL_ERR_CRR_COEF_011
            OBJ_CLS_TYPE1_PROB_011_oRDR_TRACKER_OBJ_011_oPCAN_RADAR_d419f7dd_Tx: ComBitPosition=303, ComBitSize=8, ComSignalType=UINT8, ComHandleId=9026, ComSystemTemplateSystemSignalRef=OBJ_CLS_TYPE1_PROB_011
            OBJ_ACCELERATION_LAT_ERR_011_oRDR_TRACKER_OBJ_011_oPCAN_RADAR_2cffe9ea_Tx: ComBitPosition=223, ComBitSize=8, ComSignalType=UINT8, ComHandleId=9020, ComSystemTemplateSystemSignalRef=OBJ_ACCELERATION_LAT_ERR_011
            OBJ_YAW_RATE_ERR_011_oRDR_TRACKER_OBJ_011_oPCAN_RADAR_fcd5562b_Tx: ComBitPosition=388, ComBitSize=5, ComSignalType=UINT8, ComHandleId=9067, ComSystemTemplateSystemSignalRef=OBJ_YAW_RATE_ERR_011
            OBJ_CLS_TYPE2_PROB_011_oRDR_TRACKER_OBJ_011_oPCAN_RADAR_1d2decd0_Tx: ComBitPosition=311, ComBitSize=8, ComSignalType=UINT8, ComHandleId=9028, ComSystemTemplateSystemSignalRef=OBJ_CLS_TYPE2_PROB_011
            OBJ_YAW_ANGLE_011_oRDR_TRACKER_OBJ_011_oPCAN_RADAR_e682e4b0_Tx: ComBitPosition=155, ComBitSize=12, ComSignalType=UINT16, ComHandleId=9064, ComSystemTemplateSystemSignalRef=OBJ_YAW_ANGLE_011
            OBJ_CLS_TYPE4_011_oRDR_TRACKER_OBJ_011_oPCAN_RADAR_aa792087_Tx: ComBitPosition=275, ComBitSize=4, ComSignalType=UINT8, ComHandleId=9031, ComSystemTemplateSystemSignalRef=OBJ_CLS_TYPE4_011
            OBJ_YAW_RATE_011_oRDR_TRACKER_OBJ_011_oPCAN_RADAR_c30dc1f7_Tx: ComBitPosition=399, ComBitSize=10, ComSignalType=UINT16, ComHandleId=9066, ComSystemTemplateSystemSignalRef=OBJ_YAW_RATE_011
            OBJ_YAW_ANGLE_ERR_011_oRDR_TRACKER_OBJ_011_oPCAN_RADAR_338fe267_Tx: ComBitPosition=175, ComBitSize=7, ComSignalType=UINT8, ComHandleId=9065, ComSystemTemplateSystemSignalRef=OBJ_YAW_ANGLE_ERR_011
            OBJ_ACCELERATION_LONG_ERR_011_oRDR_TRACKER_OBJ_011_oPCAN_RADAR_335a4c40_Tx: ComBitPosition=215, ComBitSize=8, ComSignalType=UINT8, ComHandleId=9022, ComSystemTemplateSystemSignalRef=OBJ_ACCELERATION_LONG_ERR_011
            OBJ_POS_ERR_CRR_COEF_011_oRDR_TRACKER_OBJ_011_oPCAN_RADAR_acf2189b_Tx: ComBitPosition=415, ComBitSize=8, ComSignalType=UINT8, ComHandleId=9048, ComSystemTemplateSystemSignalRef=OBJ_POS_ERR_CRR_COEF_011
            OBJ_RCS_011_oRDR_TRACKER_OBJ_011_oPCAN_RADAR_6c92b3d0_Tx: ComBitPosition=351, ComBitSize=7, ComSignalType=UINT8, ComHandleId=9053, ComSystemTemplateSystemSignalRef=OBJ_RCS_011
            OBJ_VELOCITY_LONG_011_oRDR_TRACKER_OBJ_011_oPCAN_RADAR_5ab3d836_Tx: ComBitPosition=110, ComBitSize=15, ComSignalType=UINT16, ComHandleId=9062, ComSystemTemplateSystemSignalRef=OBJ_VELOCITY_LONG_011
            OBJ_CLS_TYPE1_011_oRDR_TRACKER_OBJ_011_oPCAN_RADAR_7c41202e_Tx: ComBitPosition=271, ComBitSize=4, ComSignalType=UINT8, ComHandleId=9025, ComSystemTemplateSystemSignalRef=OBJ_CLS_TYPE1_011
            OBJ_VELOCITY_LAT_ERR_011_oRDR_TRACKER_OBJ_011_oPCAN_RADAR_3ec4d0a1_Tx: ComBitPosition=151, ComBitSize=8, ComSignalType=UINT8, ComHandleId=9061, ComSystemTemplateSystemSignalRef=OBJ_VELOCITY_LAT_ERR_011
            OBJ_TIMESTAMP_OFFSET_011_oRDR_TRACKER_OBJ_011_oPCAN_RADAR_6c3eb386_Tx: ComBitPosition=247, ComBitSize=8, ComSignalType=UINT8, ComHandleId=9056, ComSystemTemplateSystemSignalRef=OBJ_TIMESTAMP_OFFSET_011
            OBJ_CLS_TYPE5_011_oRDR_TRACKER_OBJ_011_oPCAN_RADAR_27f1dd65_Tx: ComBitPosition=287, ComBitSize=4, ComSignalType=UINT8, ComHandleId=9033, ComSystemTemplateSystemSignalRef=OBJ_CLS_TYPE5_011
            OBJ_REF_PT_LONG_OFFSET_011_oRDR_TRACKER_OBJ_011_oPCAN_RADAR_d6fd28a6_Tx: ComBitPosition=357, ComBitSize=14, ComSignalType=UINT16, ComHandleId=9055, ComSystemTemplateSystemSignalRef=OBJ_REF_PT_LONG_OFFSET_011
            OBJ_VELOCITY_ERR_CRR_COEF_011_oRDR_TRACKER_OBJ_011_oPCAN_RADAR_0588257a_Tx: ComBitPosition=423, ComBitSize=8, ComSignalType=UINT8, ComHandleId=9059, ComSystemTemplateSystemSignalRef=OBJ_VELOCITY_ERR_CRR_COEF_011
            OBJ_VELOCITY_LAT_011_oRDR_TRACKER_OBJ_011_oPCAN_RADAR_0a3ea0f0_Tx: ComBitPosition=126, ComBitSize=15, ComSignalType=UINT16, ComHandleId=9060, ComSystemTemplateSystemSignalRef=OBJ_VELOCITY_LAT_011
            OBJ_CLS_TYPE2_011_oRDR_TRACKER_OBJ_011_oPCAN_RADAR_31a92049_Tx: ComBitPosition=267, ComBitSize=4, ComSignalType=UINT8, ComHandleId=9027, ComSystemTemplateSystemSignalRef=OBJ_CLS_TYPE2_011
            OBJ_GROUP_ID_011_oRDR_TRACKER_OBJ_011_oPCAN_RADAR_9fdf1457_Tx: ComBitPosition=405, ComBitSize=6, ComSignalType=UINT8, ComHandleId=9042, ComSystemTemplateSystemSignalRef=OBJ_GROUP_ID_011
            OBJ_ALIVE_TIME_011_oRDR_TRACKER_OBJ_011_oPCAN_RADAR_eb9ac108_Tx: ComBitPosition=255, ComBitSize=16, ComSignalType=UINT16, ComHandleId=9024, ComSystemTemplateSystemSignalRef=OBJ_ALIVE_TIME_011
            OBJ_MEASUREMENT_STATUS_011_oRDR_TRACKER_OBJ_011_oPCAN_RADAR_13234ded_Tx: ComBitPosition=14, ComBitSize=3, ComSignalType=UINT8, ComHandleId=9044, ComSystemTemplateSystemSignalRef=OBJ_MEASUREMENT_STATUS_011
            OBJ_CLS_TYPE3_011_oRDR_TRACKER_OBJ_011_oPCAN_RADAR_bc21ddab_Tx: ComBitPosition=279, ComBitSize=4, ComSignalType=UINT8, ComHandleId=9029, ComSystemTemplateSystemSignalRef=OBJ_CLS_TYPE3_011
            OBJ_CLS_TYPE6_011_oRDR_TRACKER_OBJ_011_oPCAN_RADAR_6a19dd02_Tx: ComBitPosition=282, ComBitSize=4, ComSignalType=UINT8, ComHandleId=9035, ComSystemTemplateSystemSignalRef=OBJ_CLS_TYPE6_011
            OBJ_CLS_TYPE6_PROB_011_oRDR_TRACKER_OBJ_011_oPCAN_RADAR_da13317d_Tx: ComBitPosition=343, ComBitSize=8, ComSignalType=UINT8, ComHandleId=9036, ComSystemTemplateSystemSignalRef=OBJ_CLS_TYPE6_PROB_011
            OBJ_POS_LAT_011_oRDR_TRACKER_OBJ_011_oPCAN_RADAR_4e5de5d7_Tx: ComBitPosition=79, ComBitSize=16, ComSignalType=UINT16, ComHandleId=9049, ComSystemTemplateSystemSignalRef=OBJ_POS_LAT_011
            OBJ_VEH_TRACK_FLAG_011_oRDR_TRACKER_OBJ_011_oPCAN_RADAR_22174406_Tx: ComBitPosition=10, ComBitSize=1, ComSignalType=BOOLEAN, ComHandleId=9058, ComSystemTemplateSystemSignalRef=OBJ_VEH_TRACK_FLAG_011
            OBJ_EXISTENCE_PROB_011_oRDR_TRACKER_OBJ_011_oPCAN_RADAR_16ad00fa_Tx: ComBitPosition=229, ComBitSize=14, ComSignalType=UINT16, ComHandleId=9041, ComSystemTemplateSystemSignalRef=OBJ_EXISTENCE_PROB_011
            OBJ_DIMENSION_LENGTH_ERR_011_oRDR_TRACKER_OBJ_011_oPCAN_RADAR_05276c10_Tx: ComBitPosition=41, ComBitSize=10, ComSignalType=UINT16, ComHandleId=9038, ComSystemTemplateSystemSignalRef=OBJ_DIMENSION_LENGTH_ERR_011
            OBJ_REF_PT_LAT_OFFSET_011_oRDR_TRACKER_OBJ_011_oPCAN_RADAR_99afd8a5_Tx: ComBitPosition=370, ComBitSize=14, ComSignalType=UINT16, ComHandleId=9054, ComSystemTemplateSystemSignalRef=OBJ_REF_PT_LAT_OFFSET_011
            OBJ_CLS_TYPE3_PROB_011_oRDR_TRACKER_OBJ_011_oPCAN_RADAR_5a3e1a2b_Tx: ComBitPosition=319, ComBitSize=8, ComSignalType=UINT8, ComHandleId=9030, ComSystemTemplateSystemSignalRef=OBJ_CLS_TYPE3_PROB_011
            OBJ_CLS_TYPE4_PROB_011_oRDR_TRACKER_OBJ_011_oPCAN_RADAR_5434dc8b_Tx: ComBitPosition=327, ComBitSize=8, ComSignalType=UINT8, ComHandleId=9032, ComSystemTemplateSystemSignalRef=OBJ_CLS_TYPE4_PROB_011
            OBJ_POS_LONG_011_oRDR_TRACKER_OBJ_011_oPCAN_RADAR_fffd0e18_Tx: ComBitPosition=63, ComBitSize=16, ComSignalType=UINT16, ComHandleId=9051, ComSystemTemplateSystemSignalRef=OBJ_POS_LONG_011
            OBJ_POS_LONG_ERR_011_oRDR_TRACKER_OBJ_011_oPCAN_RADAR_d3e94b02_Tx: ComBitPosition=95, ComBitSize=8, ComSignalType=UINT8, ComHandleId=9052, ComSystemTemplateSystemSignalRef=OBJ_POS_LONG_ERR_011
            OBJ_MOVEMENT_STATUS_011_oRDR_TRACKER_OBJ_011_oPCAN_RADAR_3c8dd8a1_Tx: ComBitPosition=196, ComBitSize=3, ComSignalType=UINT8, ComHandleId=9047, ComSystemTemplateSystemSignalRef=OBJ_MOVEMENT_STATUS_011
            OBJ_POS_LAT_ERR_011_oRDR_TRACKER_OBJ_011_oPCAN_RADAR_4a11b5e0_Tx: ComBitPosition=103, ComBitSize=8, ComSignalType=UINT8, ComHandleId=9050, ComSystemTemplateSystemSignalRef=OBJ_POS_LAT_ERR_011
            OBJ_TRACK_MOTION_MODEL_011_oRDR_TRACKER_OBJ_011_oPCAN_RADAR_a03db25b_Tx: ComBitPosition=9, ComBitSize=2, ComSignalType=UINT8, ComHandleId=9057, ComSystemTemplateSystemSignalRef=OBJ_TRACK_MOTION_MODEL_011
            OBJ_VELOCITY_LONG_ERR_011_oRDR_TRACKER_OBJ_011_oPCAN_RADAR_d246ef61_Tx: ComBitPosition=143, ComBitSize=8, ComSignalType=UINT8, ComHandleId=9063, ComSystemTemplateSystemSignalRef=OBJ_VELOCITY_LONG_ERR_011
            OBJ_DIMENSION_WIDTH_011_oRDR_TRACKER_OBJ_011_oPCAN_RADAR_1d1184c7_Tx: ComBitPosition=17, ComBitSize=10, ComSignalType=UINT16, ComHandleId=9039, ComSystemTemplateSystemSignalRef=OBJ_DIMENSION_WIDTH_011
            OBJ_MH_CRC16_011_oRDR_TRACKER_OBJ_011_oPCAN_RADAR_6f43fad1_Tx: ComBitPosition=495, ComBitSize=16, ComSignalType=UINT16, ComHandleId=9045, ComSystemTemplateSystemSignalRef=OBJ_MH_CRC16_011
            OBJ_MH_CYCLE_COUNTER_011_oRDR_TRACKER_OBJ_011_oPCAN_RADAR_1ea7a030_Tx: ComBitPosition=487, ComBitSize=8, ComSignalType=UINT8, ComHandleId=9046, ComSystemTemplateSystemSignalRef=OBJ_MH_CYCLE_COUNTER_011
        SG_TrackerObject024_oRDR_TRACKER_OBJ_024_oPCAN_RADAR_ab39351c_Tx: ComHandleId=133, ComSystemTemplateSignalGroupRef=SG_TrackerObject024
          49 x ComGroupSignal, all with ComSignalEndianness=BIG_ENDIAN, ComSignalInitValue=0, ComTransferProperty=PENDING, ComSignalAccess=ACCESS_NEEDED_BY_SWC_OR_COM:
            OBJ_ACCELERATION_LONG_ERR_024_oRDR_TRACKER_OBJ_024_oPCAN_RADAR_6f4cf17f_Tx: ComBitPosition=215, ComBitSize=8, ComSignalType=UINT8, ComHandleId=9659, ComSystemTemplateSystemSignalRef=OBJ_ACCELERATION_LONG_ERR_024
            OBJ_POS_LAT_024_oRDR_TRACKER_OBJ_024_oPCAN_RADAR_124b58e8_Tx: ComBitPosition=79, ComBitSize=16, ComSignalType=UINT16, ComHandleId=9686, ComSystemTemplateSystemSignalRef=OBJ_POS_LAT_024
            OBJ_POS_LONG_ERR_024_oRDR_TRACKER_OBJ_024_oPCAN_RADAR_8ffff63d_Tx: ComBitPosition=95, ComBitSize=8, ComSignalType=UINT8, ComHandleId=9689, ComSystemTemplateSystemSignalRef=OBJ_POS_LONG_ERR_024
            OBJ_ALIVE_TIME_024_oRDR_TRACKER_OBJ_024_oPCAN_RADAR_b78c7c37_Tx: ComBitPosition=255, ComBitSize=16, ComSignalType=UINT16, ComHandleId=9661, ComSystemTemplateSystemSignalRef=OBJ_ALIVE_TIME_024
            OBJ_POS_ERR_CRR_COEF_024_oRDR_TRACKER_OBJ_024_oPCAN_RADAR_f0e4a5a4_Tx: ComBitPosition=415, ComBitSize=8, ComSignalType=UINT8, ComHandleId=9685, ComSystemTemplateSystemSignalRef=OBJ_POS_ERR_CRR_COEF_024
            OBJ_CLS_TYPE2_PROB_024_oRDR_TRACKER_OBJ_024_oPCAN_RADAR_413b51ef_Tx: ComBitPosition=311, ComBitSize=8, ComSignalType=UINT8, ComHandleId=9665, ComSystemTemplateSystemSignalRef=OBJ_CLS_TYPE2_PROB_024
            OBJ_CLS_TYPE3_024_oRDR_TRACKER_OBJ_024_oPCAN_RADAR_e0376094_Tx: ComBitPosition=279, ComBitSize=4, ComSignalType=UINT8, ComHandleId=9666, ComSystemTemplateSystemSignalRef=OBJ_CLS_TYPE3_024
            OBJ_YAW_RATE_024_oRDR_TRACKER_OBJ_024_oPCAN_RADAR_9f1b7cc8_Tx: ComBitPosition=399, ComBitSize=10, ComSignalType=UINT16, ComHandleId=9703, ComSystemTemplateSystemSignalRef=OBJ_YAW_RATE_024
            OBJ_CLS_TYPE3_PROB_024_oRDR_TRACKER_OBJ_024_oPCAN_RADAR_0628a714_Tx: ComBitPosition=319, ComBitSize=8, ComSignalType=UINT8, ComHandleId=9667, ComSystemTemplateSystemSignalRef=OBJ_CLS_TYPE3_PROB_024
            OBJ_DIMENSION_LENGTH_024_oRDR_TRACKER_OBJ_024_oPCAN_RADAR_62c9ce55_Tx: ComBitPosition=37, ComBitSize=12, ComSignalType=UINT16, ComHandleId=9674, ComSystemTemplateSystemSignalRef=OBJ_DIMENSION_LENGTH_024
            OBJ_RCS_024_oRDR_TRACKER_OBJ_024_oPCAN_RADAR_30840eef_Tx: ComBitPosition=351, ComBitSize=7, ComSignalType=UINT8, ComHandleId=9690, ComSystemTemplateSystemSignalRef=OBJ_RCS_024
            OBJ_VELOCITY_ERR_CRR_COEF_024_oRDR_TRACKER_OBJ_024_oPCAN_RADAR_599e9845_Tx: ComBitPosition=423, ComBitSize=8, ComSignalType=UINT8, ComHandleId=9696, ComSystemTemplateSystemSignalRef=OBJ_VELOCITY_ERR_CRR_COEF_024
            OBJ_REF_PT_LAT_OFFSET_024_oRDR_TRACKER_OBJ_024_oPCAN_RADAR_c5b9659a_Tx: ComBitPosition=370, ComBitSize=14, ComSignalType=UINT16, ComHandleId=9691, ComSystemTemplateSystemSignalRef=OBJ_REF_PT_LAT_OFFSET_024
            OBJ_VELOCITY_LONG_ERR_024_oRDR_TRACKER_OBJ_024_oPCAN_RADAR_8e50525e_Tx: ComBitPosition=143, ComBitSize=8, ComSignalType=UINT8, ComHandleId=9700, ComSystemTemplateSystemSignalRef=OBJ_VELOCITY_LONG_ERR_024
            OBJ_DIMENSION_WIDTH_024_oRDR_TRACKER_OBJ_024_oPCAN_RADAR_410739f8_Tx: ComBitPosition=17, ComBitSize=10, ComSignalType=UINT16, ComHandleId=9676, ComSystemTemplateSystemSignalRef=OBJ_DIMENSION_WIDTH_024
            OBJ_GROUP_ID_024_oRDR_TRACKER_OBJ_024_oPCAN_RADAR_c3c9a968_Tx: ComBitPosition=405, ComBitSize=6, ComSignalType=UINT8, ComHandleId=9679, ComSystemTemplateSystemSignalRef=OBJ_GROUP_ID_024
            OBJ_TIMESTAMP_OFFSET_024_oRDR_TRACKER_OBJ_024_oPCAN_RADAR_30280eb9_Tx: ComBitPosition=247, ComBitSize=8, ComSignalType=UINT8, ComHandleId=9693, ComSystemTemplateSystemSignalRef=OBJ_TIMESTAMP_OFFSET_024
            OBJ_POS_LAT_ERR_024_oRDR_TRACKER_OBJ_024_oPCAN_RADAR_160708df_Tx: ComBitPosition=103, ComBitSize=8, ComSignalType=UINT8, ComHandleId=9687, ComSystemTemplateSystemSignalRef=OBJ_POS_LAT_ERR_024
            OBJ_VEH_TRACK_FLAG_024_oRDR_TRACKER_OBJ_024_oPCAN_RADAR_7e01f939_Tx: ComBitPosition=10, ComBitSize=1, ComSignalType=BOOLEAN, ComHandleId=9695, ComSystemTemplateSystemSignalRef=OBJ_VEH_TRACK_FLAG_024
            OBJ_YAW_ANGLE_ERR_024_oRDR_TRACKER_OBJ_024_oPCAN_RADAR_6f995f58_Tx: ComBitPosition=175, ComBitSize=7, ComSignalType=UINT8, ComHandleId=9702, ComSystemTemplateSystemSignalRef=OBJ_YAW_ANGLE_ERR_024
            OBJ_REF_PT_LONG_OFFSET_024_oRDR_TRACKER_OBJ_024_oPCAN_RADAR_8aeb9599_Tx: ComBitPosition=357, ComBitSize=14, ComSignalType=UINT16, ComHandleId=9692, ComSystemTemplateSystemSignalRef=OBJ_REF_PT_LONG_OFFSET_024
            OBJ_TRACK_MOTION_MODEL_024_oRDR_TRACKER_OBJ_024_oPCAN_RADAR_fc2b0f64_Tx: ComBitPosition=9, ComBitSize=2, ComSignalType=UINT8, ComHandleId=9694, ComSystemTemplateSystemSignalRef=OBJ_TRACK_MOTION_MODEL_024
            OBJ_CLS_TYPE5_PROB_024_oRDR_TRACKER_OBJ_024_oPCAN_RADAR_4f31974f_Tx: ComBitPosition=335, ComBitSize=8, ComSignalType=UINT8, ComHandleId=9671, ComSystemTemplateSystemSignalRef=OBJ_CLS_TYPE5_PROB_024
            OBJ_DIMENSION_WIDTH_ERR_024_oRDR_TRACKER_OBJ_024_oPCAN_RADAR_a1a5fe10_Tx: ComBitPosition=23, ComBitSize=6, ComSignalType=UINT8, ComHandleId=9677, ComSystemTemplateSystemSignalRef=OBJ_DIMENSION_WIDTH_ERR_024
            OBJ_CLS_TYPE6_024_oRDR_TRACKER_OBJ_024_oPCAN_RADAR_360f603d_Tx: ComBitPosition=282, ComBitSize=4, ComSignalType=UINT8, ComHandleId=9672, ComSystemTemplateSystemSignalRef=OBJ_CLS_TYPE6_024
            OBJ_VELOCITY_LAT_ERR_024_oRDR_TRACKER_OBJ_024_oPCAN_RADAR_62d26d9e_Tx: ComBitPosition=151, ComBitSize=8, ComSignalType=UINT8, ComHandleId=9698, ComSystemTemplateSystemSignalRef=OBJ_VELOCITY_LAT_ERR_024
            OBJ_CLS_TYPE2_024_oRDR_TRACKER_OBJ_024_oPCAN_RADAR_6dbf9d76_Tx: ComBitPosition=267, ComBitSize=4, ComSignalType=UINT8, ComHandleId=9664, ComSystemTemplateSystemSignalRef=OBJ_CLS_TYPE2_024
            OBJ_ACCELERATION_LAT_ERR_024_oRDR_TRACKER_OBJ_024_oPCAN_RADAR_70e954d5_Tx: ComBitPosition=223, ComBitSize=8, ComSignalType=UINT8, ComHandleId=9657, ComSystemTemplateSystemSignalRef=OBJ_ACCELERATION_LAT_ERR_024
            OBJ_MOVEMENT_STATUS_024_oRDR_TRACKER_OBJ_024_oPCAN_RADAR_609b659e_Tx: ComBitPosition=196, ComBitSize=3, ComSignalType=UINT8, ComHandleId=9684, ComSystemTemplateSystemSignalRef=OBJ_MOVEMENT_STATUS_024
            OBJ_ACCELERATION_LAT_024_oRDR_TRACKER_OBJ_024_oPCAN_RADAR_a51d6e6b_Tx: ComBitPosition=177, ComBitSize=10, ComSignalType=UINT16, ComHandleId=9656, ComSystemTemplateSystemSignalRef=OBJ_ACCELERATION_LAT_024
            OBJ_CLS_TYPE4_024_oRDR_TRACKER_OBJ_024_oPCAN_RADAR_f66f9db8_Tx: ComBitPosition=275, ComBitSize=4, ComSignalType=UINT8, ComHandleId=9668, ComSystemTemplateSystemSignalRef=OBJ_CLS_TYPE4_024
            OBJ_CLS_TYPE4_PROB_024_oRDR_TRACKER_OBJ_024_oPCAN_RADAR_082261b4_Tx: ComBitPosition=327, ComBitSize=8, ComSignalType=UINT8, ComHandleId=9669, ComSystemTemplateSystemSignalRef=OBJ_CLS_TYPE4_PROB_024
            OBJ_EXISTENCE_PROB_024_oRDR_TRACKER_OBJ_024_oPCAN_RADAR_4abbbdc5_Tx: ComBitPosition=229, ComBitSize=14, ComSignalType=UINT16, ComHandleId=9678, ComSystemTemplateSystemSignalRef=OBJ_EXISTENCE_PROB_024
            OBJ_ID_024_oRDR_TRACKER_OBJ_024_oPCAN_RADAR_30e7826f_Tx: ComBitPosition=7, ComBitSize=8, ComSignalType=UINT8, ComHandleId=9680, ComSystemTemplateSystemSignalRef=OBJ_ID_024
            OBJ_ACCELERATION_LONG_024_oRDR_TRACKER_OBJ_024_oPCAN_RADAR_d7ed378b_Tx: ComBitPosition=193, ComBitSize=10, ComSignalType=UINT16, ComHandleId=9658, ComSystemTemplateSystemSignalRef=OBJ_ACCELERATION_LONG_024
            OBJ_ACCEL_ERR_CRR_COEF_024_oRDR_TRACKER_OBJ_024_oPCAN_RADAR_cfefd019_Tx: ComBitPosition=431, ComBitSize=8, ComSignalType=UINT8, ComHandleId=9660, ComSystemTemplateSystemSignalRef=OBJ_ACCEL_ERR_CRR_COEF_024
            OBJ_YAW_RATE_ERR_024_oRDR_TRACKER_OBJ_024_oPCAN_RADAR_a0c3eb14_Tx: ComBitPosition=388, ComBitSize=5, ComSignalType=UINT8, ComHandleId=9704, ComSystemTemplateSystemSignalRef=OBJ_YAW_RATE_ERR_024
            OBJ_CLS_TYPE1_PROB_024_oRDR_TRACKER_OBJ_024_oPCAN_RADAR_880f4ae2_Tx: ComBitPosition=303, ComBitSize=8, ComSignalType=UINT8, ComHandleId=9663, ComSystemTemplateSystemSignalRef=OBJ_CLS_TYPE1_PROB_024
            OBJ_CLS_TYPE1_024_oRDR_TRACKER_OBJ_024_oPCAN_RADAR_20579d11_Tx: ComBitPosition=271, ComBitSize=4, ComSignalType=UINT8, ComHandleId=9662, ComSystemTemplateSystemSignalRef=OBJ_CLS_TYPE1_024
            OBJ_YAW_ANGLE_024_oRDR_TRACKER_OBJ_024_oPCAN_RADAR_ba94598f_Tx: ComBitPosition=155, ComBitSize=12, ComSignalType=UINT16, ComHandleId=9701, ComSystemTemplateSystemSignalRef=OBJ_YAW_ANGLE_024
            OBJ_MEASUREMENT_STATUS_024_oRDR_TRACKER_OBJ_024_oPCAN_RADAR_4f35f0d2_Tx: ComBitPosition=14, ComBitSize=3, ComSignalType=UINT8, ComHandleId=9681, ComSystemTemplateSystemSignalRef=OBJ_MEASUREMENT_STATUS_024
            OBJ_VELOCITY_LONG_024_oRDR_TRACKER_OBJ_024_oPCAN_RADAR_06a56509_Tx: ComBitPosition=110, ComBitSize=15, ComSignalType=UINT16, ComHandleId=9699, ComSystemTemplateSystemSignalRef=OBJ_VELOCITY_LONG_024
            OBJ_VELOCITY_LAT_024_oRDR_TRACKER_OBJ_024_oPCAN_RADAR_56281dcf_Tx: ComBitPosition=126, ComBitSize=15, ComSignalType=UINT16, ComHandleId=9697, ComSystemTemplateSystemSignalRef=OBJ_VELOCITY_LAT_024
            OBJ_CLS_TYPE5_024_oRDR_TRACKER_OBJ_024_oPCAN_RADAR_7be7605a_Tx: ComBitPosition=287, ComBitSize=4, ComSignalType=UINT8, ComHandleId=9670, ComSystemTemplateSystemSignalRef=OBJ_CLS_TYPE5_024
            OBJ_DIMENSION_LENGTH_ERR_024_oRDR_TRACKER_OBJ_024_oPCAN_RADAR_5931d12f_Tx: ComBitPosition=41, ComBitSize=10, ComSignalType=UINT16, ComHandleId=9675, ComSystemTemplateSystemSignalRef=OBJ_DIMENSION_LENGTH_ERR_024
            OBJ_POS_LONG_024_oRDR_TRACKER_OBJ_024_oPCAN_RADAR_a3ebb327_Tx: ComBitPosition=63, ComBitSize=16, ComSignalType=UINT16, ComHandleId=9688, ComSystemTemplateSystemSignalRef=OBJ_POS_LONG_024
            OBJ_CLS_TYPE6_PROB_024_oRDR_TRACKER_OBJ_024_oPCAN_RADAR_86058c42_Tx: ComBitPosition=343, ComBitSize=8, ComSignalType=UINT8, ComHandleId=9673, ComSystemTemplateSystemSignalRef=OBJ_CLS_TYPE6_PROB_024
            OBJ_MH_CYCLE_COUNTER_024_oRDR_TRACKER_OBJ_024_oPCAN_RADAR_42b11d0f_Tx: ComBitPosition=487, ComBitSize=8, ComSignalType=UINT8, ComHandleId=9683, ComSystemTemplateSystemSignalRef=OBJ_MH_CYCLE_COUNTER_024
            OBJ_MH_CRC16_024_oRDR_TRACKER_OBJ_024_oPCAN_RADAR_335547ee_Tx: ComBitPosition=495, ComBitSize=16, ComSignalType=UINT16, ComHandleId=9682, ComSystemTemplateSystemSignalRef=OBJ_MH_CRC16_024
      RDR_TRACKER_OBJ_008_oPCAN_RADAR_a912f1be_Tx (ComIPdu):
        ComIPduDirection = SEND
        ComIPduType = NORMAL
        ComIPduCancellationSupport = false
        ComIPduHandleId = 118
        ComIPduSignalProcessing = DEFERRED
        ComIPduChannelRef = CN_PCAN_RADAR_458ff0f1
        ComIPduGroupRef = RDR01_oPCAN_RADAR_Tx_b6bdb067 if post-build-variant-condition{matching-criterion=RDR_POS, value=0}
        ComIPduSignalGroupRef = SG_TrackerObject008_oRDR_TRACKER_OBJ_008_oPCAN_RADAR_f9caaab2_Tx
        ComPduIdRef = RDR_TRACKER_OBJ_008_oPCAN_RADAR_a912f1be_Tx
        ComIPduMainFunctionRef = ComMainFunctionTx_Event
        ComIPduGroupRef = RDR02_oPCAN_RADAR_Tx_9f750495 if post-build-variant-condition{matching-criterion=RDR_POS, value=1}
        ComIPduGroupRef = RDR03_oPCAN_RADAR_Tx_311d9504 if post-build-variant-condition{matching-criterion=RDR_POS, value=2}
        ComIPduGroupRef = RDR04_oPCAN_RADAR_Tx_cce46d71 if post-build-variant-condition{matching-criterion=RDR_POS, value=3}
        ComIPduGroupRef = RDR05_oPCAN_RADAR_Tx_628cfce0 if post-build-variant-condition{matching-criterion=RDR_POS, value=4}
        ComIPduGroupRef = RDR06_oPCAN_RADAR_Tx_4b444812 if post-build-variant-condition{matching-criterion=RDR_POS, value=5}
        ComIPduGroupRef = RDR07_oPCAN_RADAR_Tx_e52cd983 if post-build-variant-condition{matching-criterion=RDR_POS, value=6}
        ComIPduGroupRef = RDR08_oPCAN_RADAR_Tx_6bc6beb9 if post-build-variant-condition{matching-criterion=RDR_POS, value=7}
        ComTxIPdu: ComMinimumDelayTime=0, ComTxIPduUnusedAreasDefault=0
          ComTxModeTrue
            ComTxMode: ComTxModeMode=DIRECT, ComTxModeNumberOfRepetitions=0
          ComTxModeFalse
            ComTxMode: ComTxModeMode=NONE
      RDR_TRACKER_OBJ_024_oPCAN_RADAR_d2c68ce8_Tx (ComIPdu):
        ComIPduDirection = SEND
        ComIPduType = NORMAL
        ComIPduCancellationSupport = false
        ComIPduHandleId = 134
        ComIPduSignalProcessing = DEFERRED
        ComIPduChannelRef = CN_PCAN_RADAR_458ff0f1
        ComIPduGroupRef = RDR01_oPCAN_RADAR_Tx_b6bdb067 if post-build-variant-condition{matching-criterion=RDR_POS, value=0}
        ComIPduSignalGroupRef = SG_TrackerObject024_oRDR_TRACKER_OBJ_024_oPCAN_RADAR_ab39351c_Tx
        ComPduIdRef = RDR_TRACKER_OBJ_024_oPCAN_RADAR_d2c68ce8_Tx
        ComIPduMainFunctionRef = ComMainFunctionTx_Event
        ComIPduGroupRef = RDR02_oPCAN_RADAR_Tx_9f750495 if post-build-variant-condition{matching-criterion=RDR_POS, value=1}
        ComIPduGroupRef = RDR03_oPCAN_RADAR_Tx_311d9504 if post-build-variant-condition{matching-criterion=RDR_POS, value=2}
        ComIPduGroupRef = RDR04_oPCAN_RADAR_Tx_cce46d71 if post-build-variant-condition{matching-criterion=RDR_POS, value=3}
        ComIPduGroupRef = RDR05_oPCAN_RADAR_Tx_628cfce0 if post-build-variant-condition{matching-criterion=RDR_POS, value=4}
        ComIPduGroupRef = RDR06_oPCAN_RADAR_Tx_4b444812 if post-build-variant-condition{matching-criterion=RDR_POS, value=5}
        ComIPduGroupRef = RDR07_oPCAN_RADAR_Tx_e52cd983 if post-build-variant-condition{matching-criterion=RDR_POS, value=6}
        ComIPduGroupRef = RDR08_oPCAN_RADAR_Tx_6bc6beb9 if post-build-variant-condition{matching-criterion=RDR_POS, value=7}
        ComTxIPdu: ComMinimumDelayTime=0, ComTxIPduUnusedAreasDefault=0
          ComTxModeTrue
            ComTxMode: ComTxModeMode=DIRECT, ComTxModeNumberOfRepetitions=0
          ComTxModeFalse
            ComTxMode: ComTxModeMode=NONE
      SG_TrackerObject038_oRDR_TRACKER_OBJ_038_oPCAN_RADAR_0e78b170_Tx (ComSignalGroup):
        ComTransferProperty = TRIGGERED
        ComSignalGroupAccess = ACCESS_NEEDED_BY_SWC_OR_COM
        ComHandleId = 147
        ComSignalGroupArrayAccess = true
        ComSystemTemplateSignalGroupRef = SG_TrackerObject038
        49 x ComGroupSignal, all with ComSignalEndianness=BIG_ENDIAN, ComSignalInitValue=0, ComTransferProperty=PENDING, ComSignalAccess=ACCESS_NEEDED_BY_SWC_OR_COM:
          OBJ_POS_ERR_CRR_COEF_038_oRDR_TRACKER_OBJ_038_oPCAN_RADAR_55a521c8_Tx: ComBitPosition=415, ComBitSize=8, ComSignalType=UINT8, ComHandleId=10371, ComSystemTemplateSystemSignalRef=OBJ_POS_ERR_CRR_COEF_038
          OBJ_CLS_TYPE1_038_oRDR_TRACKER_OBJ_038_oPCAN_RADAR_8516197d_Tx: ComBitPosition=271, ComBitSize=4, ComSignalType=UINT8, ComHandleId=10348, ComSystemTemplateSystemSignalRef=OBJ_CLS_TYPE1_038
          OBJ_MEASUREMENT_STATUS_038_oRDR_TRACKER_OBJ_038_oPCAN_RADAR_ea7474be_Tx: ComBitPosition=14, ComBitSize=3, ComSignalType=UINT8, ComHandleId=10367, ComSystemTemplateSystemSignalRef=OBJ_MEASUREMENT_STATUS_038
          OBJ_REF_PT_LAT_OFFSET_038_oRDR_TRACKER_OBJ_038_oPCAN_RADAR_60f8e1f6_Tx: ComBitPosition=370, ComBitSize=14, ComSignalType=UINT16, ComHandleId=10377, ComSystemTemplateSystemSignalRef=OBJ_REF_PT_LAT_OFFSET_038
          OBJ_REF_PT_LONG_OFFSET_038_oRDR_TRACKER_OBJ_038_oPCAN_RADAR_2faa11f5_Tx: ComBitPosition=357, ComBitSize=14, ComSignalType=UINT16, ComHandleId=10378, ComSystemTemplateSystemSignalRef=OBJ_REF_PT_LONG_OFFSET_038
          OBJ_ID_038_oRDR_TRACKER_OBJ_038_oPCAN_RADAR_95a60603_Tx: ComBitPosition=7, ComBitSize=8, ComSignalType=UINT8, ComHandleId=10366, ComSystemTemplateSystemSignalRef=OBJ_ID_038
          OBJ_ACCELERATION_LONG_ERR_038_oRDR_TRACKER_OBJ_038_oPCAN_RADAR_ca0d7513_Tx: ComBitPosition=215, ComBitSize=8, ComSignalType=UINT8, ComHandleId=10345, ComSystemTemplateSystemSignalRef=OBJ_ACCELERATION_LONG_ERR_038
          OBJ_VEH_TRACK_FLAG_038_oRDR_TRACKER_OBJ_038_oPCAN_RADAR_db407d55_Tx: ComBitPosition=10, ComBitSize=1, ComSignalType=BOOLEAN, ComHandleId=10381, ComSystemTemplateSystemSignalRef=OBJ_VEH_TRACK_FLAG_038
          OBJ_EXISTENCE_PROB_038_oRDR_TRACKER_OBJ_038_oPCAN_RADAR_effa39a9_Tx: ComBitPosition=229, ComBitSize=14, ComSignalType=UINT16, ComHandleId=10364, ComSystemTemplateSystemSignalRef=OBJ_EXISTENCE_PROB_038
          OBJ_YAW_RATE_038_oRDR_TRACKER_OBJ_038_oPCAN_RADAR_3a5af8a4_Tx: ComBitPosition=399, ComBitSize=10, ComSignalType=UINT16, ComHandleId=10389, ComSystemTemplateSystemSignalRef=OBJ_YAW_RATE_038
          OBJ_DIMENSION_WIDTH_ERR_038_oRDR_TRACKER_OBJ_038_oPCAN_RADAR_04e47a7c_Tx: ComBitPosition=23, ComBitSize=6, ComSignalType=UINT8, ComHandleId=10363, ComSystemTemplateSystemSignalRef=OBJ_DIMENSION_WIDTH_ERR_038
          OBJ_VELOCITY_LONG_038_oRDR_TRACKER_OBJ_038_oPCAN_RADAR_a3e4e165_Tx: ComBitPosition=110, ComBitSize=15, ComSignalType=UINT16, ComHandleId=10385, ComSystemTemplateSystemSignalRef=OBJ_VELOCITY_LONG_038
          OBJ_VELOCITY_ERR_CRR_COEF_038_oRDR_TRACKER_OBJ_038_oPCAN_RADAR_fcdf1c29_Tx: ComBitPosition=423, ComBitSize=8, ComSignalType=UINT8, ComHandleId=10382, ComSystemTemplateSystemSignalRef=OBJ_VELOCITY_ERR_CRR_COEF_038
          OBJ_CLS_TYPE5_038_oRDR_TRACKER_OBJ_038_oPCAN_RADAR_dea6e436_Tx: ComBitPosition=287, ComBitSize=4, ComSignalType=UINT8, ComHandleId=10356, ComSystemTemplateSystemSignalRef=OBJ_CLS_TYPE5_038
          OBJ_CLS_TYPE1_PROB_038_oRDR_TRACKER_OBJ_038_oPCAN_RADAR_2d4ece8e_Tx: ComBitPosition=303, ComBitSize=8, ComSignalType=UINT8, ComHandleId=10349, ComSystemTemplateSystemSignalRef=OBJ_CLS_TYPE1_PROB_038
          OBJ_VELOCITY_LONG_ERR_038_oRDR_TRACKER_OBJ_038_oPCAN_RADAR_2b11d632_Tx: ComBitPosition=143, ComBitSize=8, ComSignalType=UINT8, ComHandleId=10386, ComSystemTemplateSystemSignalRef=OBJ_VELOCITY_LONG_ERR_038
          OBJ_ALIVE_TIME_038_oRDR_TRACKER_OBJ_038_oPCAN_RADAR_12cdf85b_Tx: ComBitPosition=255, ComBitSize=16, ComSignalType=UINT16, ComHandleId=10347, ComSystemTemplateSystemSignalRef=OBJ_ALIVE_TIME_038
          OBJ_CLS_TYPE4_038_oRDR_TRACKER_OBJ_038_oPCAN_RADAR_532e19d4_Tx: ComBitPosition=275, ComBitSize=4, ComSignalType=UINT8, ComHandleId=10354, ComSystemTemplateSystemSignalRef=OBJ_CLS_TYPE4_038
          OBJ_VELOCITY_LAT_ERR_038_oRDR_TRACKER_OBJ_038_oPCAN_RADAR_c793e9f2_Tx: ComBitPosition=151, ComBitSize=8, ComSignalType=UINT8, ComHandleId=10384, ComSystemTemplateSystemSignalRef=OBJ_VELOCITY_LAT_ERR_038
          OBJ_ACCELERATION_LONG_038_oRDR_TRACKER_OBJ_038_oPCAN_RADAR_72acb3e7_Tx: ComBitPosition=193, ComBitSize=10, ComSignalType=UINT16, ComHandleId=10344, ComSystemTemplateSystemSignalRef=OBJ_ACCELERATION_LONG_038
          OBJ_MOVEMENT_STATUS_038_oRDR_TRACKER_OBJ_038_oPCAN_RADAR_c5dae1f2_Tx: ComBitPosition=196, ComBitSize=3, ComSignalType=UINT8, ComHandleId=10370, ComSystemTemplateSystemSignalRef=OBJ_MOVEMENT_STATUS_038
          OBJ_CLS_TYPE6_PROB_038_oRDR_TRACKER_OBJ_038_oPCAN_RADAR_2344082e_Tx: ComBitPosition=343, ComBitSize=8, ComSignalType=UINT8, ComHandleId=10359, ComSystemTemplateSystemSignalRef=OBJ_CLS_TYPE6_PROB_038
          OBJ_YAW_RATE_ERR_038_oRDR_TRACKER_OBJ_038_oPCAN_RADAR_05826f78_Tx: ComBitPosition=388, ComBitSize=5, ComSignalType=UINT8, ComHandleId=10390, ComSystemTemplateSystemSignalRef=OBJ_YAW_RATE_ERR_038
          OBJ_GROUP_ID_038_oRDR_TRACKER_OBJ_038_oPCAN_RADAR_66882d04_Tx: ComBitPosition=405, ComBitSize=6, ComSignalType=UINT8, ComHandleId=10365, ComSystemTemplateSystemSignalRef=OBJ_GROUP_ID_038
          OBJ_ACCELERATION_LAT_038_oRDR_TRACKER_OBJ_038_oPCAN_RADAR_005cea07_Tx: ComBitPosition=177, ComBitSize=10, ComSignalType=UINT16, ComHandleId=10342, ComSystemTemplateSystemSignalRef=OBJ_ACCELERATION_LAT_038
          OBJ_VELOCITY_LAT_038_oRDR_TRACKER_OBJ_038_oPCAN_RADAR_f36999a3_Tx: ComBitPosition=126, ComBitSize=15, ComSignalType=UINT16, ComHandleId=10383, ComSystemTemplateSystemSignalRef=OBJ_VELOCITY_LAT_038
          OBJ_TRACK_MOTION_MODEL_038_oRDR_TRACKER_OBJ_038_oPCAN_RADAR_596a8b08_Tx: ComBitPosition=9, ComBitSize=2, ComSignalType=UINT8, ComHandleId=10380, ComSystemTemplateSystemSignalRef=OBJ_TRACK_MOTION_MODEL_038
          OBJ_TIMESTAMP_OFFSET_038_oRDR_TRACKER_OBJ_038_oPCAN_RADAR_95698ad5_Tx: ComBitPosition=247, ComBitSize=8, ComSignalType=UINT8, ComHandleId=10379, ComSystemTemplateSystemSignalRef=OBJ_TIMESTAMP_OFFSET_038
          OBJ_POS_LAT_038_oRDR_TRACKER_OBJ_038_oPCAN_RADAR_b70adc84_Tx: ComBitPosition=79, ComBitSize=16, ComSignalType=UINT16, ComHandleId=10372, ComSystemTemplateSystemSignalRef=OBJ_POS_LAT_038
          OBJ_DIMENSION_WIDTH_038_oRDR_TRACKER_OBJ_038_oPCAN_RADAR_e446bd94_Tx: ComBitPosition=17, ComBitSize=10, ComSignalType=UINT16, ComHandleId=10362, ComSystemTemplateSystemSignalRef=OBJ_DIMENSION_WIDTH_038
          OBJ_CLS_TYPE3_PROB_038_oRDR_TRACKER_OBJ_038_oPCAN_RADAR_a3692378_Tx: ComBitPosition=319, ComBitSize=8, ComSignalType=UINT8, ComHandleId=10353, ComSystemTemplateSystemSignalRef=OBJ_CLS_TYPE3_PROB_038
          OBJ_CLS_TYPE6_038_oRDR_TRACKER_OBJ_038_oPCAN_RADAR_934ee451_Tx: ComBitPosition=282, ComBitSize=4, ComSignalType=UINT8, ComHandleId=10358, ComSystemTemplateSystemSignalRef=OBJ_CLS_TYPE6_038
          OBJ_POS_LONG_ERR_038_oRDR_TRACKER_OBJ_038_oPCAN_RADAR_2abe7251_Tx: ComBitPosition=95, ComBitSize=8, ComSignalType=UINT8, ComHandleId=10375, ComSystemTemplateSystemSignalRef=OBJ_POS_LONG_ERR_038
          OBJ_CLS_TYPE3_038_oRDR_TRACKER_OBJ_038_oPCAN_RADAR_4576e4f8_Tx: ComBitPosition=279, ComBitSize=4, ComSignalType=UINT8, ComHandleId=10352, ComSystemTemplateSystemSignalRef=OBJ_CLS_TYPE3_038
          OBJ_DIMENSION_LENGTH_ERR_038_oRDR_TRACKER_OBJ_038_oPCAN_RADAR_fc705543_Tx: ComBitPosition=41, ComBitSize=10, ComSignalType=UINT16, ComHandleId=10361, ComSystemTemplateSystemSignalRef=OBJ_DIMENSION_LENGTH_ERR_038
          OBJ_CLS_TYPE2_038_oRDR_TRACKER_OBJ_038_oPCAN_RADAR_c8fe191a_Tx: ComBitPosition=267, ComBitSize=4, ComSignalType=UINT8, ComHandleId=10350, ComSystemTemplateSystemSignalRef=OBJ_CLS_TYPE2_038
          OBJ_CLS_TYPE5_PROB_038_oRDR_TRACKER_OBJ_038_oPCAN_RADAR_ea701323_Tx: ComBitPosition=335, ComBitSize=8, ComSignalType=UINT8, ComHandleId=10357, ComSystemTemplateSystemSignalRef=OBJ_CLS_TYPE5_PROB_038
          OBJ_CLS_TYPE2_PROB_038_oRDR_TRACKER_OBJ_038_oPCAN_RADAR_e47ad583_Tx: ComBitPosition=311, ComBitSize=8, ComSignalType=UINT8, ComHandleId=10351, ComSystemTemplateSystemSignalRef=OBJ_CLS_TYPE2_PROB_038
          OBJ_RCS_038_oRDR_TRACKER_OBJ_038_oPCAN_RADAR_95c58a83_Tx: ComBitPosition=351, ComBitSize=7, ComSignalType=UINT8, ComHandleId=10376, ComSystemTemplateSystemSignalRef=OBJ_RCS_038
          OBJ_POS_LAT_ERR_038_oRDR_TRACKER_OBJ_038_oPCAN_RADAR_b3468cb3_Tx: ComBitPosition=103, ComBitSize=8, ComSignalType=UINT8, ComHandleId=10373, ComSystemTemplateSystemSignalRef=OBJ_POS_LAT_ERR_038
          OBJ_ACCELERATION_LAT_ERR_038_oRDR_TRACKER_OBJ_038_oPCAN_RADAR_d5a8d0b9_Tx: ComBitPosition=223, ComBitSize=8, ComSignalType=UINT8, ComHandleId=10343, ComSystemTemplateSystemSignalRef=OBJ_ACCELERATION_LAT_ERR_038
          OBJ_ACCEL_ERR_CRR_COEF_038_oRDR_TRACKER_OBJ_038_oPCAN_RADAR_6aae5475_Tx: ComBitPosition=431, ComBitSize=8, ComSignalType=UINT8, ComHandleId=10346, ComSystemTemplateSystemSignalRef=OBJ_ACCEL_ERR_CRR_COEF_038
          OBJ_POS_LONG_038_oRDR_TRACKER_OBJ_038_oPCAN_RADAR_06aa374b_Tx: ComBitPosition=63, ComBitSize=16, ComSignalType=UINT16, ComHandleId=10374, ComSystemTemplateSystemSignalRef=OBJ_POS_LONG_038
          OBJ_YAW_ANGLE_038_oRDR_TRACKER_OBJ_038_oPCAN_RADAR_1fd5dde3_Tx: ComBitPosition=155, ComBitSize=12, ComSignalType=UINT16, ComHandleId=10387, ComSystemTemplateSystemSignalRef=OBJ_YAW_ANGLE_038
          OBJ_YAW_ANGLE_ERR_038_oRDR_TRACKER_OBJ_038_oPCAN_RADAR_cad8db34_Tx: ComBitPosition=175, ComBitSize=7, ComSignalType=UINT8, ComHandleId=10388, ComSystemTemplateSystemSignalRef=OBJ_YAW_ANGLE_ERR_038
          OBJ_CLS_TYPE4_PROB_038_oRDR_TRACKER_OBJ_038_oPCAN_RADAR_ad63e5d8_Tx: ComBitPosition=327, ComBitSize=8, ComSignalType=UINT8, ComHandleId=10355, ComSystemTemplateSystemSignalRef=OBJ_CLS_TYPE4_PROB_038
          OBJ_DIMENSION_LENGTH_038_oRDR_TRACKER_OBJ_038_oPCAN_RADAR_c7884a39_Tx: ComBitPosition=37, ComBitSize=12, ComSignalType=UINT16, ComHandleId=10360, ComSystemTemplateSystemSignalRef=OBJ_DIMENSION_LENGTH_038
          OBJ_MH_CRC16_038_oRDR_TRACKER_OBJ_038_oPCAN_RADAR_9614c382_Tx: ComBitPosition=495, ComBitSize=16, ComSignalType=UINT16, ComHandleId=10368, ComSystemTemplateSystemSignalRef=OBJ_MH_CRC16_038
          OBJ_MH_CYCLE_COUNTER_038_oRDR_TRACKER_OBJ_038_oPCAN_RADAR_e7f09963_Tx: ComBitPosition=487, ComBitSize=8, ComSignalType=UINT8, ComHandleId=10369, ComSystemTemplateSystemSignalRef=OBJ_MH_CYCLE_COUNTER_038
      RDR_DETECTION_221_224_oPCAN_RADAR_88ca180e_Tx (ComIPdu):
        ComIPduDirection = SEND
        ComIPduType = NORMAL
        ComIPduCancellationSupport = false
        ComIPduHandleId = 61
        ComIPduSignalProcessing = DEFERRED
        ComIPduChannelRef = CN_PCAN_RADAR_458ff0f1
        ComIPduGroupRef = RDR01_oPCAN_RADAR_Tx_b6bdb067 if post-build-variant-condition{matching-criterion=RDR_POS, value=0}
        ComIPduSignalGroupRef = SG_Detections_221_224_oRDR_DETECTION_221_224_oPCAN_RADAR_6f6d708f_Tx
        ComPduIdRef = RDR_DETECTION_221_224_oPCAN_RADAR_88ca180e_Tx
        ComIPduMainFunctionRef = ComMainFunctionTx_Event
        ComIPduGroupRef = RDR02_oPCAN_RADAR_Tx_9f750495 if post-build-variant-condition{matching-criterion=RDR_POS, value=1}
        ComIPduGroupRef = RDR03_oPCAN_RADAR_Tx_311d9504 if post-build-variant-condition{matching-criterion=RDR_POS, value=2}
        ComIPduGroupRef = RDR04_oPCAN_RADAR_Tx_cce46d71 if post-build-variant-condition{matching-criterion=RDR_POS, value=3}
        ComIPduGroupRef = RDR05_oPCAN_RADAR_Tx_628cfce0 if post-build-variant-condition{matching-criterion=RDR_POS, value=4}
        ComIPduGroupRef = RDR06_oPCAN_RADAR_Tx_4b444812 if post-build-variant-condition{matching-criterion=RDR_POS, value=5}
        ComIPduGroupRef = RDR07_oPCAN_RADAR_Tx_e52cd983 if post-build-variant-condition{matching-criterion=RDR_POS, value=6}
        ComIPduGroupRef = RDR08_oPCAN_RADAR_Tx_6bc6beb9 if post-build-variant-condition{matching-criterion=RDR_POS, value=7}
        ComTxIPdu: ComMinimumDelayTime=0, ComTxIPduUnusedAreasDefault=0
          ComTxModeTrue
            ComTxMode: ComTxModeMode=DIRECT, ComTxModeNumberOfRepetitions=0
          ComTxModeFalse
            ComTxMode: ComTxModeMode=NONE
      SG_TrackerObject059_oRDR_TRACKER_OBJ_059_oPCAN_RADAR_c3790806_Tx (ComSignalGroup):
        ComTransferProperty = TRIGGERED
        ComSignalGroupAccess = ACCESS_NEEDED_BY_SWC_OR_COM
        ComHandleId = 168
        ComSignalGroupArrayAccess = true
        ComSystemTemplateSignalGroupRef = SG_TrackerObject059
        49 x ComGroupSignal, all with ComSignalEndianness=BIG_ENDIAN, ComSignalInitValue=0, ComTransferProperty=PENDING, ComSignalAccess=ACCESS_NEEDED_BY_SWC_OR_COM:
          OBJ_CLS_TYPE5_059_oRDR_TRACKER_OBJ_059_oPCAN_RADAR_13a75d40_Tx: ComBitPosition=287, ComBitSize=4, ComSignalType=UINT8, ComHandleId=11385, ComSystemTemplateSystemSignalRef=OBJ_CLS_TYPE5_059
          OBJ_CLS_TYPE6_059_oRDR_TRACKER_OBJ_059_oPCAN_RADAR_5e4f5d27_Tx: ComBitPosition=282, ComBitSize=4, ComSignalType=UINT8, ComHandleId=11387, ComSystemTemplateSystemSignalRef=OBJ_CLS_TYPE6_059
          OBJ_POS_LAT_059_oRDR_TRACKER_OBJ_059_oPCAN_RADAR_7a0b65f2_Tx: ComBitPosition=79, ComBitSize=16, ComSignalType=UINT16, ComHandleId=11401, ComSystemTemplateSystemSignalRef=OBJ_POS_LAT_059
          OBJ_POS_LAT_ERR_059_oRDR_TRACKER_OBJ_059_oPCAN_RADAR_7e4735c5_Tx: ComBitPosition=103, ComBitSize=8, ComSignalType=UINT8, ComHandleId=11402, ComSystemTemplateSystemSignalRef=OBJ_POS_LAT_ERR_059
          OBJ_CLS_TYPE5_PROB_059_oRDR_TRACKER_OBJ_059_oPCAN_RADAR_2771aa55_Tx: ComBitPosition=335, ComBitSize=8, ComSignalType=UINT8, ComHandleId=11386, ComSystemTemplateSystemSignalRef=OBJ_CLS_TYPE5_PROB_059
          OBJ_ACCELERATION_LAT_ERR_059_oRDR_TRACKER_OBJ_059_oPCAN_RADAR_18a969cf_Tx: ComBitPosition=223, ComBitSize=8, ComSignalType=UINT8, ComHandleId=11372, ComSystemTemplateSystemSignalRef=OBJ_ACCELERATION_LAT_ERR_059
          OBJ_EXISTENCE_PROB_059_oRDR_TRACKER_OBJ_059_oPCAN_RADAR_22fb80df_Tx: ComBitPosition=229, ComBitSize=14, ComSignalType=UINT16, ComHandleId=11393, ComSystemTemplateSystemSignalRef=OBJ_EXISTENCE_PROB_059
          OBJ_TRACK_MOTION_MODEL_059_oRDR_TRACKER_OBJ_059_oPCAN_RADAR_946b327e_Tx: ComBitPosition=9, ComBitSize=2, ComSignalType=UINT8, ComHandleId=11409, ComSystemTemplateSystemSignalRef=OBJ_TRACK_MOTION_MODEL_059
          OBJ_RCS_059_oRDR_TRACKER_OBJ_059_oPCAN_RADAR_58c433f5_Tx: ComBitPosition=351, ComBitSize=7, ComSignalType=UINT8, ComHandleId=11405, ComSystemTemplateSystemSignalRef=OBJ_RCS_059
          OBJ_MEASUREMENT_STATUS_059_oRDR_TRACKER_OBJ_059_oPCAN_RADAR_2775cdc8_Tx: ComBitPosition=14, ComBitSize=3, ComSignalType=UINT8, ComHandleId=11396, ComSystemTemplateSystemSignalRef=OBJ_MEASUREMENT_STATUS_059
          OBJ_REF_PT_LAT_OFFSET_059_oRDR_TRACKER_OBJ_059_oPCAN_RADAR_adf95880_Tx: ComBitPosition=370, ComBitSize=14, ComSignalType=UINT16, ComHandleId=11406, ComSystemTemplateSystemSignalRef=OBJ_REF_PT_LAT_OFFSET_059
          OBJ_CLS_TYPE1_059_oRDR_TRACKER_OBJ_059_oPCAN_RADAR_4817a00b_Tx: ComBitPosition=271, ComBitSize=4, ComSignalType=UINT8, ComHandleId=11377, ComSystemTemplateSystemSignalRef=OBJ_CLS_TYPE1_059
          OBJ_CLS_TYPE2_059_oRDR_TRACKER_OBJ_059_oPCAN_RADAR_05ffa06c_Tx: ComBitPosition=267, ComBitSize=4, ComSignalType=UINT8, ComHandleId=11379, ComSystemTemplateSystemSignalRef=OBJ_CLS_TYPE2_059
          OBJ_CLS_TYPE3_PROB_059_oRDR_TRACKER_OBJ_059_oPCAN_RADAR_6e689a0e_Tx: ComBitPosition=319, ComBitSize=8, ComSignalType=UINT8, ComHandleId=11382, ComSystemTemplateSystemSignalRef=OBJ_CLS_TYPE3_PROB_059
          OBJ_VELOCITY_ERR_CRR_COEF_059_oRDR_TRACKER_OBJ_059_oPCAN_RADAR_31dea55f_Tx: ComBitPosition=423, ComBitSize=8, ComSignalType=UINT8, ComHandleId=11411, ComSystemTemplateSystemSignalRef=OBJ_VELOCITY_ERR_CRR_COEF_059
          OBJ_VELOCITY_LAT_ERR_059_oRDR_TRACKER_OBJ_059_oPCAN_RADAR_0a925084_Tx: ComBitPosition=151, ComBitSize=8, ComSignalType=UINT8, ComHandleId=11413, ComSystemTemplateSystemSignalRef=OBJ_VELOCITY_LAT_ERR_059
          OBJ_ACCELERATION_LONG_ERR_059_oRDR_TRACKER_OBJ_059_oPCAN_RADAR_070ccc65_Tx: ComBitPosition=215, ComBitSize=8, ComSignalType=UINT8, ComHandleId=11374, ComSystemTemplateSystemSignalRef=OBJ_ACCELERATION_LONG_ERR_059
          OBJ_ALIVE_TIME_059_oRDR_TRACKER_OBJ_059_oPCAN_RADAR_dfcc412d_Tx: ComBitPosition=255, ComBitSize=16, ComSignalType=UINT16, ComHandleId=11376, ComSystemTemplateSystemSignalRef=OBJ_ALIVE_TIME_059
          OBJ_DIMENSION_WIDTH_ERR_059_oRDR_TRACKER_OBJ_059_oPCAN_RADAR_c9e5c30a_Tx: ComBitPosition=23, ComBitSize=6, ComSignalType=UINT8, ComHandleId=11392, ComSystemTemplateSystemSignalRef=OBJ_DIMENSION_WIDTH_ERR_059
          OBJ_POS_LONG_059_oRDR_TRACKER_OBJ_059_oPCAN_RADAR_cbab8e3d_Tx: ComBitPosition=63, ComBitSize=16, ComSignalType=UINT16, ComHandleId=11403, ComSystemTemplateSystemSignalRef=OBJ_POS_LONG_059
          OBJ_POS_ERR_CRR_COEF_059_oRDR_TRACKER_OBJ_059_oPCAN_RADAR_98a498be_Tx: ComBitPosition=415, ComBitSize=8, ComSignalType=UINT8, ComHandleId=11400, ComSystemTemplateSystemSignalRef=OBJ_POS_ERR_CRR_COEF_059
          OBJ_ACCELERATION_LAT_059_oRDR_TRACKER_OBJ_059_oPCAN_RADAR_cd5d5371_Tx: ComBitPosition=177, ComBitSize=10, ComSignalType=UINT16, ComHandleId=11371, ComSystemTemplateSystemSignalRef=OBJ_ACCELERATION_LAT_059
          OBJ_GROUP_ID_059_oRDR_TRACKER_OBJ_059_oPCAN_RADAR_ab899472_Tx: ComBitPosition=405, ComBitSize=6, ComSignalType=UINT8, ComHandleId=11394, ComSystemTemplateSystemSignalRef=OBJ_GROUP_ID_059
          OBJ_DIMENSION_LENGTH_ERR_059_oRDR_TRACKER_OBJ_059_oPCAN_RADAR_3171ec35_Tx: ComBitPosition=41, ComBitSize=10, ComSignalType=UINT16, ComHandleId=11390, ComSystemTemplateSystemSignalRef=OBJ_DIMENSION_LENGTH_ERR_059
          OBJ_CLS_TYPE4_PROB_059_oRDR_TRACKER_OBJ_059_oPCAN_RADAR_60625cae_Tx: ComBitPosition=327, ComBitSize=8, ComSignalType=UINT8, ComHandleId=11384, ComSystemTemplateSystemSignalRef=OBJ_CLS_TYPE4_PROB_059
          OBJ_YAW_ANGLE_059_oRDR_TRACKER_OBJ_059_oPCAN_RADAR_d2d46495_Tx: ComBitPosition=155, ComBitSize=12, ComSignalType=UINT16, ComHandleId=11416, ComSystemTemplateSystemSignalRef=OBJ_YAW_ANGLE_059
          OBJ_VELOCITY_LONG_ERR_059_oRDR_TRACKER_OBJ_059_oPCAN_RADAR_e6106f44_Tx: ComBitPosition=143, ComBitSize=8, ComSignalType=UINT8, ComHandleId=11415, ComSystemTemplateSystemSignalRef=OBJ_VELOCITY_LONG_ERR_059
          OBJ_DIMENSION_LENGTH_059_oRDR_TRACKER_OBJ_059_oPCAN_RADAR_0a89f34f_Tx: ComBitPosition=37, ComBitSize=12, ComSignalType=UINT16, ComHandleId=11389, ComSystemTemplateSystemSignalRef=OBJ_DIMENSION_LENGTH_059
          OBJ_REF_PT_LONG_OFFSET_059_oRDR_TRACKER_OBJ_059_oPCAN_RADAR_e2aba883_Tx: ComBitPosition=357, ComBitSize=14, ComSignalType=UINT16, ComHandleId=11407, ComSystemTemplateSystemSignalRef=OBJ_REF_PT_LONG_OFFSET_059
          OBJ_VELOCITY_LAT_059_oRDR_TRACKER_OBJ_059_oPCAN_RADAR_3e6820d5_Tx: ComBitPosition=126, ComBitSize=15, ComSignalType=UINT16, ComHandleId=11412, ComSystemTemplateSystemSignalRef=OBJ_VELOCITY_LAT_059
          OBJ_YAW_ANGLE_ERR_059_oRDR_TRACKER_OBJ_059_oPCAN_RADAR_07d96242_Tx: ComBitPosition=175, ComBitSize=7, ComSignalType=UINT8, ComHandleId=11417, ComSystemTemplateSystemSignalRef=OBJ_YAW_ANGLE_ERR_059
          OBJ_CLS_TYPE4_059_oRDR_TRACKER_OBJ_059_oPCAN_RADAR_9e2fa0a2_Tx: ComBitPosition=275, ComBitSize=4, ComSignalType=UINT8, ComHandleId=11383, ComSystemTemplateSystemSignalRef=OBJ_CLS_TYPE4_059
          OBJ_YAW_RATE_059_oRDR_TRACKER_OBJ_059_oPCAN_RADAR_f75b41d2_Tx: ComBitPosition=399, ComBitSize=10, ComSignalType=UINT16, ComHandleId=11418, ComSystemTemplateSystemSignalRef=OBJ_YAW_RATE_059
          OBJ_VELOCITY_LONG_059_oRDR_TRACKER_OBJ_059_oPCAN_RADAR_6ee55813_Tx: ComBitPosition=110, ComBitSize=15, ComSignalType=UINT16, ComHandleId=11414, ComSystemTemplateSystemSignalRef=OBJ_VELOCITY_LONG_059
          OBJ_ID_059_oRDR_TRACKER_OBJ_059_oPCAN_RADAR_58a7bf75_Tx: ComBitPosition=7, ComBitSize=8, ComSignalType=UINT8, ComHandleId=11395, ComSystemTemplateSystemSignalRef=OBJ_ID_059
          OBJ_ACCELERATION_LONG_059_oRDR_TRACKER_OBJ_059_oPCAN_RADAR_bfad0a91_Tx: ComBitPosition=193, ComBitSize=10, ComSignalType=UINT16, ComHandleId=11373, ComSystemTemplateSystemSignalRef=OBJ_ACCELERATION_LONG_059
          OBJ_VEH_TRACK_FLAG_059_oRDR_TRACKER_OBJ_059_oPCAN_RADAR_1641c423_Tx: ComBitPosition=10, ComBitSize=1, ComSignalType=BOOLEAN, ComHandleId=11410, ComSystemTemplateSystemSignalRef=OBJ_VEH_TRACK_FLAG_059
          OBJ_CLS_TYPE2_PROB_059_oRDR_TRACKER_OBJ_059_oPCAN_RADAR_297b6cf5_Tx: ComBitPosition=311, ComBitSize=8, ComSignalType=UINT8, ComHandleId=11380, ComSystemTemplateSystemSignalRef=OBJ_CLS_TYPE2_PROB_059
          OBJ_POS_LONG_ERR_059_oRDR_TRACKER_OBJ_059_oPCAN_RADAR_e7bfcb27_Tx: ComBitPosition=95, ComBitSize=8, ComSignalType=UINT8, ComHandleId=11404, ComSystemTemplateSystemSignalRef=OBJ_POS_LONG_ERR_059
          OBJ_MOVEMENT_STATUS_059_oRDR_TRACKER_OBJ_059_oPCAN_RADAR_08db5884_Tx: ComBitPosition=196, ComBitSize=3, ComSignalType=UINT8, ComHandleId=11399, ComSystemTemplateSystemSignalRef=OBJ_MOVEMENT_STATUS_059
          OBJ_TIMESTAMP_OFFSET_059_oRDR_TRACKER_OBJ_059_oPCAN_RADAR_586833a3_Tx: ComBitPosition=247, ComBitSize=8, ComSignalType=UINT8, ComHandleId=11408, ComSystemTemplateSystemSignalRef=OBJ_TIMESTAMP_OFFSET_059
          OBJ_ACCEL_ERR_CRR_COEF_059_oRDR_TRACKER_OBJ_059_oPCAN_RADAR_a7afed03_Tx: ComBitPosition=431, ComBitSize=8, ComSignalType=UINT8, ComHandleId=11375, ComSystemTemplateSystemSignalRef=OBJ_ACCEL_ERR_CRR_COEF_059
          OBJ_CLS_TYPE3_059_oRDR_TRACKER_OBJ_059_oPCAN_RADAR_88775d8e_Tx: ComBitPosition=279, ComBitSize=4, ComSignalType=UINT8, ComHandleId=11381, ComSystemTemplateSystemSignalRef=OBJ_CLS_TYPE3_059
          OBJ_CLS_TYPE1_PROB_059_oRDR_TRACKER_OBJ_059_oPCAN_RADAR_e04f77f8_Tx: ComBitPosition=303, ComBitSize=8, ComSignalType=UINT8, ComHandleId=11378, ComSystemTemplateSystemSignalRef=OBJ_CLS_TYPE1_PROB_059
          OBJ_YAW_RATE_ERR_059_oRDR_TRACKER_OBJ_059_oPCAN_RADAR_c883d60e_Tx: ComBitPosition=388, ComBitSize=5, ComSignalType=UINT8, ComHandleId=11419, ComSystemTemplateSystemSignalRef=OBJ_YAW_RATE_ERR_059
          OBJ_CLS_TYPE6_PROB_059_oRDR_TRACKER_OBJ_059_oPCAN_RADAR_ee45b158_Tx: ComBitPosition=343, ComBitSize=8, ComSignalType=UINT8, ComHandleId=11388, ComSystemTemplateSystemSignalRef=OBJ_CLS_TYPE6_PROB_059
          OBJ_DIMENSION_WIDTH_059_oRDR_TRACKER_OBJ_059_oPCAN_RADAR_294704e2_Tx: ComBitPosition=17, ComBitSize=10, ComSignalType=UINT16, ComHandleId=11391, ComSystemTemplateSystemSignalRef=OBJ_DIMENSION_WIDTH_059
          OBJ_MH_CRC16_059_oRDR_TRACKER_OBJ_059_oPCAN_RADAR_5b157af4_Tx: ComBitPosition=495, ComBitSize=16, ComSignalType=UINT16, ComHandleId=11397, ComSystemTemplateSystemSignalRef=OBJ_MH_CRC16_059
          OBJ_MH_CYCLE_COUNTER_059_oRDR_TRACKER_OBJ_059_oPCAN_RADAR_2af12015_Tx: ComBitPosition=487, ComBitSize=8, ComSignalType=UINT8, ComHandleId=11398, ComSystemTemplateSystemSignalRef=OBJ_MH_CYCLE_COUNTER_059
      SG_TrackerObject040_oRDR_TRACKER_OBJ_040_oPCAN_RADAR_cd9c2a97_Tx (ComSignalGroup):
        ComTransferProperty = TRIGGERED
        ComSignalGroupAccess = ACCESS_NEEDED_BY_SWC_OR_COM
        ComHandleId = 149
        ComSignalGroupArrayAccess = true
        ComSystemTemplateSignalGroupRef = SG_TrackerObject040
        49 x ComGroupSignal, all with ComSignalEndianness=BIG_ENDIAN, ComSignalInitValue=0, ComTransferProperty=PENDING, ComSignalAccess=ACCESS_NEEDED_BY_SWC_OR_COM:
          OBJ_CLS_TYPE6_PROB_040_oRDR_TRACKER_OBJ_040_oPCAN_RADAR_e0a093c9_Tx: ComBitPosition=343, ComBitSize=8, ComSignalType=UINT8, ComHandleId=10457, ComSystemTemplateSystemSignalRef=OBJ_CLS_TYPE6_PROB_040
          OBJ_CLS_TYPE4_040_oRDR_TRACKER_OBJ_040_oPCAN_RADAR_90ca8233_Tx: ComBitPosition=275, ComBitSize=4, ComSignalType=UINT8, ComHandleId=10452, ComSystemTemplateSystemSignalRef=OBJ_CLS_TYPE4_040
          OBJ_ID_040_oRDR_TRACKER_OBJ_040_oPCAN_RADAR_56429de4_Tx: ComBitPosition=7, ComBitSize=8, ComSignalType=UINT8, ComHandleId=10464, ComSystemTemplateSystemSignalRef=OBJ_ID_040
          OBJ_CLS_TYPE2_PROB_040_oRDR_TRACKER_OBJ_040_oPCAN_RADAR_279e4e64_Tx: ComBitPosition=311, ComBitSize=8, ComSignalType=UINT8, ComHandleId=10449, ComSystemTemplateSystemSignalRef=OBJ_CLS_TYPE2_PROB_040
          OBJ_YAW_RATE_ERR_040_oRDR_TRACKER_OBJ_040_oPCAN_RADAR_c666f49f_Tx: ComBitPosition=388, ComBitSize=5, ComSignalType=UINT8, ComHandleId=10488, ComSystemTemplateSystemSignalRef=OBJ_YAW_RATE_ERR_040
          OBJ_CLS_TYPE3_PROB_040_oRDR_TRACKER_OBJ_040_oPCAN_RADAR_608db89f_Tx: ComBitPosition=319, ComBitSize=8, ComSignalType=UINT8, ComHandleId=10451, ComSystemTemplateSystemSignalRef=OBJ_CLS_TYPE3_PROB_040
          OBJ_EXISTENCE_PROB_040_oRDR_TRACKER_OBJ_040_oPCAN_RADAR_2c1ea24e_Tx: ComBitPosition=229, ComBitSize=14, ComSignalType=UINT16, ComHandleId=10462, ComSystemTemplateSystemSignalRef=OBJ_EXISTENCE_PROB_040
          OBJ_GROUP_ID_040_oRDR_TRACKER_OBJ_040_oPCAN_RADAR_a56cb6e3_Tx: ComBitPosition=405, ComBitSize=6, ComSignalType=UINT8, ComHandleId=10463, ComSystemTemplateSystemSignalRef=OBJ_GROUP_ID_040
          OBJ_TRACK_MOTION_MODEL_040_oRDR_TRACKER_OBJ_040_oPCAN_RADAR_9a8e10ef_Tx: ComBitPosition=9, ComBitSize=2, ComSignalType=UINT8, ComHandleId=10478, ComSystemTemplateSystemSignalRef=OBJ_TRACK_MOTION_MODEL_040
          OBJ_VEH_TRACK_FLAG_040_oRDR_TRACKER_OBJ_040_oPCAN_RADAR_18a4e6b2_Tx: ComBitPosition=10, ComBitSize=1, ComSignalType=BOOLEAN, ComHandleId=10479, ComSystemTemplateSystemSignalRef=OBJ_VEH_TRACK_FLAG_040
          OBJ_ACCELERATION_LAT_040_oRDR_TRACKER_OBJ_040_oPCAN_RADAR_c3b871e0_Tx: ComBitPosition=177, ComBitSize=10, ComSignalType=UINT16, ComHandleId=10440, ComSystemTemplateSystemSignalRef=OBJ_ACCELERATION_LAT_040
          OBJ_POS_LAT_ERR_040_oRDR_TRACKER_OBJ_040_oPCAN_RADAR_70a21754_Tx: ComBitPosition=103, ComBitSize=8, ComSignalType=UINT8, ComHandleId=10471, ComSystemTemplateSystemSignalRef=OBJ_POS_LAT_ERR_040
          OBJ_YAW_ANGLE_ERR_040_oRDR_TRACKER_OBJ_040_oPCAN_RADAR_093c40d3_Tx: ComBitPosition=175, ComBitSize=7, ComSignalType=UINT8, ComHandleId=10486, ComSystemTemplateSystemSignalRef=OBJ_YAW_ANGLE_ERR_040
          OBJ_CLS_TYPE5_PROB_040_oRDR_TRACKER_OBJ_040_oPCAN_RADAR_299488c4_Tx: ComBitPosition=335, ComBitSize=8, ComSignalType=UINT8, ComHandleId=10455, ComSystemTemplateSystemSignalRef=OBJ_CLS_TYPE5_PROB_040
          OBJ_MOVEMENT_STATUS_040_oRDR_TRACKER_OBJ_040_oPCAN_RADAR_063e7a15_Tx: ComBitPosition=196, ComBitSize=3, ComSignalType=UINT8, ComHandleId=10468, ComSystemTemplateSystemSignalRef=OBJ_MOVEMENT_STATUS_040
          OBJ_POS_LONG_040_oRDR_TRACKER_OBJ_040_oPCAN_RADAR_c54eacac_Tx: ComBitPosition=63, ComBitSize=16, ComSignalType=UINT16, ComHandleId=10472, ComSystemTemplateSystemSignalRef=OBJ_POS_LONG_040
          OBJ_CLS_TYPE5_040_oRDR_TRACKER_OBJ_040_oPCAN_RADAR_1d427fd1_Tx: ComBitPosition=287, ComBitSize=4, ComSignalType=UINT8, ComHandleId=10454, ComSystemTemplateSystemSignalRef=OBJ_CLS_TYPE5_040
          OBJ_ACCELERATION_LONG_040_oRDR_TRACKER_OBJ_040_oPCAN_RADAR_b1482800_Tx: ComBitPosition=193, ComBitSize=10, ComSignalType=UINT16, ComHandleId=10442, ComSystemTemplateSystemSignalRef=OBJ_ACCELERATION_LONG_040
          OBJ_CLS_TYPE3_040_oRDR_TRACKER_OBJ_040_oPCAN_RADAR_86927f1f_Tx: ComBitPosition=279, ComBitSize=4, ComSignalType=UINT8, ComHandleId=10450, ComSystemTemplateSystemSignalRef=OBJ_CLS_TYPE3_040
          OBJ_RCS_040_oRDR_TRACKER_OBJ_040_oPCAN_RADAR_56211164_Tx: ComBitPosition=351, ComBitSize=7, ComSignalType=UINT8, ComHandleId=10474, ComSystemTemplateSystemSignalRef=OBJ_RCS_040
          OBJ_VELOCITY_LONG_040_oRDR_TRACKER_OBJ_040_oPCAN_RADAR_60007a82_Tx: ComBitPosition=110, ComBitSize=15, ComSignalType=UINT16, ComHandleId=10483, ComSystemTemplateSystemSignalRef=OBJ_VELOCITY_LONG_040
          OBJ_CLS_TYPE1_040_oRDR_TRACKER_OBJ_040_oPCAN_RADAR_46f2829a_Tx: ComBitPosition=271, ComBitSize=4, ComSignalType=UINT8, ComHandleId=10446, ComSystemTemplateSystemSignalRef=OBJ_CLS_TYPE1_040
          OBJ_POS_ERR_CRR_COEF_040_oRDR_TRACKER_OBJ_040_oPCAN_RADAR_9641ba2f_Tx: ComBitPosition=415, ComBitSize=8, ComSignalType=UINT8, ComHandleId=10469, ComSystemTemplateSystemSignalRef=OBJ_POS_ERR_CRR_COEF_040
          OBJ_DIMENSION_LENGTH_040_oRDR_TRACKER_OBJ_040_oPCAN_RADAR_046cd1de_Tx: ComBitPosition=37, ComBitSize=12, ComSignalType=UINT16, ComHandleId=10458, ComSystemTemplateSystemSignalRef=OBJ_DIMENSION_LENGTH_040
          OBJ_ACCEL_ERR_CRR_COEF_040_oRDR_TRACKER_OBJ_040_oPCAN_RADAR_a94acf92_Tx: ComBitPosition=431, ComBitSize=8, ComSignalType=UINT8, ComHandleId=10444, ComSystemTemplateSystemSignalRef=OBJ_ACCEL_ERR_CRR_COEF_040
          OBJ_VELOCITY_LONG_ERR_040_oRDR_TRACKER_OBJ_040_oPCAN_RADAR_e8f54dd5_Tx: ComBitPosition=143, ComBitSize=8, ComSignalType=UINT8, ComHandleId=10484, ComSystemTemplateSystemSignalRef=OBJ_VELOCITY_LONG_ERR_040
          OBJ_DIMENSION_WIDTH_040_oRDR_TRACKER_OBJ_040_oPCAN_RADAR_27a22673_Tx: ComBitPosition=17, ComBitSize=10, ComSignalType=UINT16, ComHandleId=10460, ComSystemTemplateSystemSignalRef=OBJ_DIMENSION_WIDTH_040
          OBJ_MEASUREMENT_STATUS_040_oRDR_TRACKER_OBJ_040_oPCAN_RADAR_2990ef59_Tx: ComBitPosition=14, ComBitSize=3, ComSignalType=UINT8, ComHandleId=10465, ComSystemTemplateSystemSignalRef=OBJ_MEASUREMENT_STATUS_040
          OBJ_REF_PT_LAT_OFFSET_040_oRDR_TRACKER_OBJ_040_oPCAN_RADAR_a31c7a11_Tx: ComBitPosition=370, ComBitSize=14, ComSignalType=UINT16, ComHandleId=10475, ComSystemTemplateSystemSignalRef=OBJ_REF_PT_LAT_OFFSET_040
          OBJ_YAW_ANGLE_040_oRDR_TRACKER_OBJ_040_oPCAN_RADAR_dc314604_Tx: ComBitPosition=155, ComBitSize=12, ComSignalType=UINT16, ComHandleId=10485, ComSystemTemplateSystemSignalRef=OBJ_YAW_ANGLE_040
          OBJ_POS_LAT_040_oRDR_TRACKER_OBJ_040_oPCAN_RADAR_74ee4763_Tx: ComBitPosition=79, ComBitSize=16, ComSignalType=UINT16, ComHandleId=10470, ComSystemTemplateSystemSignalRef=OBJ_POS_LAT_040
          OBJ_CLS_TYPE1_PROB_040_oRDR_TRACKER_OBJ_040_oPCAN_RADAR_eeaa5569_Tx: ComBitPosition=303, ComBitSize=8, ComSignalType=UINT8, ComHandleId=10447, ComSystemTemplateSystemSignalRef=OBJ_CLS_TYPE1_PROB_040
          OBJ_ALIVE_TIME_040_oRDR_TRACKER_OBJ_040_oPCAN_RADAR_d12963bc_Tx: ComBitPosition=255, ComBitSize=16, ComSignalType=UINT16, ComHandleId=10445, ComSystemTemplateSystemSignalRef=OBJ_ALIVE_TIME_040
          OBJ_DIMENSION_WIDTH_ERR_040_oRDR_TRACKER_OBJ_040_oPCAN_RADAR_c700e19b_Tx: ComBitPosition=23, ComBitSize=6, ComSignalType=UINT8, ComHandleId=10461, ComSystemTemplateSystemSignalRef=OBJ_DIMENSION_WIDTH_ERR_040
          OBJ_ACCELERATION_LONG_ERR_040_oRDR_TRACKER_OBJ_040_oPCAN_RADAR_09e9eef4_Tx: ComBitPosition=215, ComBitSize=8, ComSignalType=UINT8, ComHandleId=10443, ComSystemTemplateSystemSignalRef=OBJ_ACCELERATION_LONG_ERR_040
          OBJ_VELOCITY_LAT_040_oRDR_TRACKER_OBJ_040_oPCAN_RADAR_308d0244_Tx: ComBitPosition=126, ComBitSize=15, ComSignalType=UINT16, ComHandleId=10481, ComSystemTemplateSystemSignalRef=OBJ_VELOCITY_LAT_040
          OBJ_ACCELERATION_LAT_ERR_040_oRDR_TRACKER_OBJ_040_oPCAN_RADAR_164c4b5e_Tx: ComBitPosition=223, ComBitSize=8, ComSignalType=UINT8, ComHandleId=10441, ComSystemTemplateSystemSignalRef=OBJ_ACCELERATION_LAT_ERR_040
          OBJ_CLS_TYPE2_040_oRDR_TRACKER_OBJ_040_oPCAN_RADAR_0b1a82fd_Tx: ComBitPosition=267, ComBitSize=4, ComSignalType=UINT8, ComHandleId=10448, ComSystemTemplateSystemSignalRef=OBJ_CLS_TYPE2_040
          OBJ_POS_LONG_ERR_040_oRDR_TRACKER_OBJ_040_oPCAN_RADAR_e95ae9b6_Tx: ComBitPosition=95, ComBitSize=8, ComSignalType=UINT8, ComHandleId=10473, ComSystemTemplateSystemSignalRef=OBJ_POS_LONG_ERR_040
          OBJ_VELOCITY_LAT_ERR_040_oRDR_TRACKER_OBJ_040_oPCAN_RADAR_04777215_Tx: ComBitPosition=151, ComBitSize=8, ComSignalType=UINT8, ComHandleId=10482, ComSystemTemplateSystemSignalRef=OBJ_VELOCITY_LAT_ERR_040
          OBJ_TIMESTAMP_OFFSET_040_oRDR_TRACKER_OBJ_040_oPCAN_RADAR_568d1132_Tx: ComBitPosition=247, ComBitSize=8, ComSignalType=UINT8, ComHandleId=10477, ComSystemTemplateSystemSignalRef=OBJ_TIMESTAMP_OFFSET_040
          OBJ_CLS_TYPE6_040_oRDR_TRACKER_OBJ_040_oPCAN_RADAR_50aa7fb6_Tx: ComBitPosition=282, ComBitSize=4, ComSignalType=UINT8, ComHandleId=10456, ComSystemTemplateSystemSignalRef=OBJ_CLS_TYPE6_040
          OBJ_CLS_TYPE4_PROB_040_oRDR_TRACKER_OBJ_040_oPCAN_RADAR_6e877e3f_Tx: ComBitPosition=327, ComBitSize=8, ComSignalType=UINT8, ComHandleId=10453, ComSystemTemplateSystemSignalRef=OBJ_CLS_TYPE4_PROB_040
          OBJ_REF_PT_LONG_OFFSET_040_oRDR_TRACKER_OBJ_040_oPCAN_RADAR_ec4e8a12_Tx: ComBitPosition=357, ComBitSize=14, ComSignalType=UINT16, ComHandleId=10476, ComSystemTemplateSystemSignalRef=OBJ_REF_PT_LONG_OFFSET_040
          OBJ_VELOCITY_ERR_CRR_COEF_040_oRDR_TRACKER_OBJ_040_oPCAN_RADAR_3f3b87ce_Tx: ComBitPosition=423, ComBitSize=8, ComSignalType=UINT8, ComHandleId=10480, ComSystemTemplateSystemSignalRef=OBJ_VELOCITY_ERR_CRR_COEF_040
          OBJ_DIMENSION_LENGTH_ERR_040_oRDR_TRACKER_OBJ_040_oPCAN_RADAR_3f94cea4_Tx: ComBitPosition=41, ComBitSize=10, ComSignalType=UINT16, ComHandleId=10459, ComSystemTemplateSystemSignalRef=OBJ_DIMENSION_LENGTH_ERR_040
          OBJ_YAW_RATE_040_oRDR_TRACKER_OBJ_040_oPCAN_RADAR_f9be6343_Tx: ComBitPosition=399, ComBitSize=10, ComSignalType=UINT16, ComHandleId=10487, ComSystemTemplateSystemSignalRef=OBJ_YAW_RATE_040
          OBJ_MH_CYCLE_COUNTER_040_oRDR_TRACKER_OBJ_040_oPCAN_RADAR_24140284_Tx: ComBitPosition=487, ComBitSize=8, ComSignalType=UINT8, ComHandleId=10467, ComSystemTemplateSystemSignalRef=OBJ_MH_CYCLE_COUNTER_040
          OBJ_MH_CRC16_040_oRDR_TRACKER_OBJ_040_oPCAN_RADAR_55f05865_Tx: ComBitPosition=495, ComBitSize=16, ComSignalType=UINT16, ComHandleId=10466, ComSystemTemplateSystemSignalRef=OBJ_MH_CRC16_040
      3 x ComIPdu, all with ComIPduDirection=SEND, ComIPduType=NORMAL, ComIPduCancellationSupport=false, ComIPduSignalProcessing=DEFERRED, ComIPduChannelRef=CN_PCAN_RADAR_458ff0f1, ComIPduGroupRef=RDR01_oPCAN_RADAR_Tx_b6bdb067 if post-build-variant-condition{matching-criterion=RDR_POS, value=0}, ComIPduMainFunctionRef=ComMainFunctionTx_Event, ComIPduGroupRef=RDR02_oPCAN_RADAR_Tx_9f750495 if post-build-variant-condition{matching-criterion=RDR_POS, value=1}, ComIPduGroupRef=RDR03_oPCAN_RADAR_Tx_311d9504 if post-build-variant-condition{matching-criterion=RDR_POS, value=2}, ComIPduGroupRef=RDR04_oPCAN_RADAR_Tx_cce46d71 if post-build-variant-condition{matching-criterion=RDR_POS, value=3}, ComIPduGroupRef=RDR05_oPCAN_RADAR_Tx_628cfce0 if post-build-variant-condition{matching-criterion=RDR_POS, value=4}, ComIPduGroupRef=RDR06_oPCAN_RADAR_Tx_4b444812 if post-build-variant-condition{matching-criterion=RDR_POS, value=5}, ComIPduGroupRef=RDR07_oPCAN_RADAR_Tx_e52cd983 if post-build-variant-condition{matching-criterion=RDR_POS, value=6}, ComIPduGroupRef=RDR08_oPCAN_RADAR_Tx_6bc6beb9 if post-build-variant-condition{matching-criterion=RDR_POS, value=7}:
        RDR_DETECTION_049_052_oPCAN_RADAR_79bc2968_Tx: ComIPduHandleId=18, ComIPduSignalGroupRef=SG_Detections_049_052_oRDR_DETECTION_049_052_oPCAN_RADAR_5d1ac528_Tx, ComPduIdRef=RDR_DETECTION_049_052_oPCAN_RADAR_79bc2968_Tx
          ComTxIPdu: ComMinimumDelayTime=0, ComTxIPduUnusedAreasDefault=0
            ComTxModeTrue
              ComTxMode: ComTxModeMode=DIRECT, ComTxModeNumberOfRepetitions=0
            ComTxModeFalse
              ComTxMode: ComTxModeMode=NONE
        RDR_DETECTION_277_280_oPCAN_RADAR_d98a7eec_Tx: ComIPduHandleId=75, ComIPduSignalGroupRef=SG_Detections_277_280_oRDR_DETECTION_277_280_oPCAN_RADAR_ab98744c_Tx, ComPduIdRef=RDR_DETECTION_277_280_oPCAN_RADAR_d98a7eec_Tx
          ComTxIPdu: ComMinimumDelayTime=0, ComTxIPduUnusedAreasDefault=0
            ComTxModeTrue
              ComTxMode: ComTxModeMode=DIRECT, ComTxModeNumberOfRepetitions=0
            ComTxModeFalse
              ComTxMode: ComTxModeMode=NONE
        RDR_DETECTION_165_168_oPCAN_RADAR_c15732f7_Tx: ComIPduHandleId=47, ComIPduSignalGroupRef=SG_Detections_165_168_oRDR_DETECTION_165_168_oPCAN_RADAR_b3bd63bd_Tx, ComPduIdRef=RDR_DETECTION_165_168_oPCAN_RADAR_c15732f7_Tx
          ComTxIPdu: ComMinimumDelayTime=0, ComTxIPduUnusedAreasDefault=0
            ComTxModeTrue
              ComTxMode: ComTxModeMode=DIRECT, ComTxModeNumberOfRepetitions=0
            ComTxModeFalse
              ComTxMode: ComTxModeMode=NONE
      SG_TrackerObject010_oRDR_TRACKER_OBJ_010_oPCAN_RADAR_0e3b0090_Tx (ComSignalGroup):
        ComTransferProperty = TRIGGERED
        ComSignalGroupAccess = ACCESS_NEEDED_BY_SWC_OR_COM
        ComHandleId = 119
        ComSignalGroupArrayAccess = true
        ComSystemTemplateSignalGroupRef = SG_TrackerObject010
        49 x ComGroupSignal, all with ComSignalEndianness=BIG_ENDIAN, ComSignalInitValue=0, ComTransferProperty=PENDING, ComSignalAccess=ACCESS_NEEDED_BY_SWC_OR_COM:
          OBJ_TRACK_MOTION_MODEL_010_oRDR_TRACKER_OBJ_010_oPCAN_RADAR_59293ae8_Tx: ComBitPosition=9, ComBitSize=2, ComSignalType=UINT8, ComHandleId=9008, ComSystemTemplateSystemSignalRef=OBJ_TRACK_MOTION_MODEL_010
          OBJ_MEASUREMENT_STATUS_010_oRDR_TRACKER_OBJ_010_oPCAN_RADAR_ea37c55e_Tx: ComBitPosition=14, ComBitSize=3, ComSignalType=UINT8, ComHandleId=8995, ComSystemTemplateSystemSignalRef=OBJ_MEASUREMENT_STATUS_010
          OBJ_REF_PT_LONG_OFFSET_010_oRDR_TRACKER_OBJ_010_oPCAN_RADAR_2fe9a015_Tx: ComBitPosition=357, ComBitSize=14, ComSignalType=UINT16, ComHandleId=9006, ComSystemTemplateSystemSignalRef=OBJ_REF_PT_LONG_OFFSET_010
          OBJ_ACCELERATION_LAT_ERR_010_oRDR_TRACKER_OBJ_010_oPCAN_RADAR_d5eb6159_Tx: ComBitPosition=223, ComBitSize=8, ComSignalType=UINT8, ComHandleId=8971, ComSystemTemplateSystemSignalRef=OBJ_ACCELERATION_LAT_ERR_010
          OBJ_POS_LONG_010_oRDR_TRACKER_OBJ_010_oPCAN_RADAR_06e986ab_Tx: ComBitPosition=63, ComBitSize=16, ComSignalType=UINT16, ComHandleId=9002, ComSystemTemplateSystemSignalRef=OBJ_POS_LONG_010
          OBJ_YAW_RATE_010_oRDR_TRACKER_OBJ_010_oPCAN_RADAR_3a194944_Tx: ComBitPosition=399, ComBitSize=10, ComSignalType=UINT16, ComHandleId=9017, ComSystemTemplateSystemSignalRef=OBJ_YAW_RATE_010
          OBJ_ACCELERATION_LAT_010_oRDR_TRACKER_OBJ_010_oPCAN_RADAR_001f5be7_Tx: ComBitPosition=177, ComBitSize=10, ComSignalType=UINT16, ComHandleId=8970, ComSystemTemplateSystemSignalRef=OBJ_ACCELERATION_LAT_010
          OBJ_POS_LAT_010_oRDR_TRACKER_OBJ_010_oPCAN_RADAR_b7496d64_Tx: ComBitPosition=79, ComBitSize=16, ComSignalType=UINT16, ComHandleId=9000, ComSystemTemplateSystemSignalRef=OBJ_POS_LAT_010
          OBJ_ACCELERATION_LONG_010_oRDR_TRACKER_OBJ_010_oPCAN_RADAR_72ef0207_Tx: ComBitPosition=193, ComBitSize=10, ComSignalType=UINT16, ComHandleId=8972, ComSystemTemplateSystemSignalRef=OBJ_ACCELERATION_LONG_010
          OBJ_CLS_TYPE3_PROB_010_oRDR_TRACKER_OBJ_010_oPCAN_RADAR_a32a9298_Tx: ComBitPosition=319, ComBitSize=8, ComSignalType=UINT8, ComHandleId=8981, ComSystemTemplateSystemSignalRef=OBJ_CLS_TYPE3_PROB_010
          OBJ_DIMENSION_LENGTH_ERR_010_oRDR_TRACKER_OBJ_010_oPCAN_RADAR_fc33e4a3_Tx: ComBitPosition=41, ComBitSize=10, ComSignalType=UINT16, ComHandleId=8989, ComSystemTemplateSystemSignalRef=OBJ_DIMENSION_LENGTH_ERR_010
          OBJ_CLS_TYPE6_010_oRDR_TRACKER_OBJ_010_oPCAN_RADAR_930d55b1_Tx: ComBitPosition=282, ComBitSize=4, ComSignalType=UINT8, ComHandleId=8986, ComSystemTemplateSystemSignalRef=OBJ_CLS_TYPE6_010
          OBJ_YAW_ANGLE_010_oRDR_TRACKER_OBJ_010_oPCAN_RADAR_1f966c03_Tx: ComBitPosition=155, ComBitSize=12, ComSignalType=UINT16, ComHandleId=9015, ComSystemTemplateSystemSignalRef=OBJ_YAW_ANGLE_010
          OBJ_VELOCITY_ERR_CRR_COEF_010_oRDR_TRACKER_OBJ_010_oPCAN_RADAR_fc9cadc9_Tx: ComBitPosition=423, ComBitSize=8, ComSignalType=UINT8, ComHandleId=9010, ComSystemTemplateSystemSignalRef=OBJ_VELOCITY_ERR_CRR_COEF_010
          OBJ_VELOCITY_LONG_ERR_010_oRDR_TRACKER_OBJ_010_oPCAN_RADAR_2b5267d2_Tx: ComBitPosition=143, ComBitSize=8, ComSignalType=UINT8, ComHandleId=9014, ComSystemTemplateSystemSignalRef=OBJ_VELOCITY_LONG_ERR_010
          OBJ_DIMENSION_LENGTH_010_oRDR_TRACKER_OBJ_010_oPCAN_RADAR_c7cbfbd9_Tx: ComBitPosition=37, ComBitSize=12, ComSignalType=UINT16, ComHandleId=8988, ComSystemTemplateSystemSignalRef=OBJ_DIMENSION_LENGTH_010
          OBJ_ALIVE_TIME_010_oRDR_TRACKER_OBJ_010_oPCAN_RADAR_128e49bb_Tx: ComBitPosition=255, ComBitSize=16, ComSignalType=UINT16, ComHandleId=8975, ComSystemTemplateSystemSignalRef=OBJ_ALIVE_TIME_010
          OBJ_CLS_TYPE1_PROB_010_oRDR_TRACKER_OBJ_010_oPCAN_RADAR_2d0d7f6e_Tx: ComBitPosition=303, ComBitSize=8, ComSignalType=UINT8, ComHandleId=8977, ComSystemTemplateSystemSignalRef=OBJ_CLS_TYPE1_PROB_010
          OBJ_POS_LONG_ERR_010_oRDR_TRACKER_OBJ_010_oPCAN_RADAR_2afdc3b1_Tx: ComBitPosition=95, ComBitSize=8, ComSignalType=UINT8, ComHandleId=9003, ComSystemTemplateSystemSignalRef=OBJ_POS_LONG_ERR_010
          OBJ_RCS_010_oRDR_TRACKER_OBJ_010_oPCAN_RADAR_95863b63_Tx: ComBitPosition=351, ComBitSize=7, ComSignalType=UINT8, ComHandleId=9004, ComSystemTemplateSystemSignalRef=OBJ_RCS_010
          OBJ_POS_LAT_ERR_010_oRDR_TRACKER_OBJ_010_oPCAN_RADAR_b3053d53_Tx: ComBitPosition=103, ComBitSize=8, ComSignalType=UINT8, ComHandleId=9001, ComSystemTemplateSystemSignalRef=OBJ_POS_LAT_ERR_010
          OBJ_DIMENSION_WIDTH_ERR_010_oRDR_TRACKER_OBJ_010_oPCAN_RADAR_04a7cb9c_Tx: ComBitPosition=23, ComBitSize=6, ComSignalType=UINT8, ComHandleId=8991, ComSystemTemplateSystemSignalRef=OBJ_DIMENSION_WIDTH_ERR_010
          OBJ_POS_ERR_CRR_COEF_010_oRDR_TRACKER_OBJ_010_oPCAN_RADAR_55e69028_Tx: ComBitPosition=415, ComBitSize=8, ComSignalType=UINT8, ComHandleId=8999, ComSystemTemplateSystemSignalRef=OBJ_POS_ERR_CRR_COEF_010
          OBJ_VELOCITY_LAT_ERR_010_oRDR_TRACKER_OBJ_010_oPCAN_RADAR_c7d05812_Tx: ComBitPosition=151, ComBitSize=8, ComSignalType=UINT8, ComHandleId=9012, ComSystemTemplateSystemSignalRef=OBJ_VELOCITY_LAT_ERR_010
          OBJ_VELOCITY_LONG_010_oRDR_TRACKER_OBJ_010_oPCAN_RADAR_a3a75085_Tx: ComBitPosition=110, ComBitSize=15, ComSignalType=UINT16, ComHandleId=9013, ComSystemTemplateSystemSignalRef=OBJ_VELOCITY_LONG_010
          OBJ_ID_010_oRDR_TRACKER_OBJ_010_oPCAN_RADAR_95e5b7e3_Tx: ComBitPosition=7, ComBitSize=8, ComSignalType=UINT8, ComHandleId=8994, ComSystemTemplateSystemSignalRef=OBJ_ID_010
          OBJ_VELOCITY_LAT_010_oRDR_TRACKER_OBJ_010_oPCAN_RADAR_f32a2843_Tx: ComBitPosition=126, ComBitSize=15, ComSignalType=UINT16, ComHandleId=9011, ComSystemTemplateSystemSignalRef=OBJ_VELOCITY_LAT_010
          OBJ_REF_PT_LAT_OFFSET_010_oRDR_TRACKER_OBJ_010_oPCAN_RADAR_60bb5016_Tx: ComBitPosition=370, ComBitSize=14, ComSignalType=UINT16, ComHandleId=9005, ComSystemTemplateSystemSignalRef=OBJ_REF_PT_LAT_OFFSET_010
          OBJ_TIMESTAMP_OFFSET_010_oRDR_TRACKER_OBJ_010_oPCAN_RADAR_952a3b35_Tx: ComBitPosition=247, ComBitSize=8, ComSignalType=UINT8, ComHandleId=9007, ComSystemTemplateSystemSignalRef=OBJ_TIMESTAMP_OFFSET_010
          OBJ_YAW_ANGLE_ERR_010_oRDR_TRACKER_OBJ_010_oPCAN_RADAR_ca9b6ad4_Tx: ComBitPosition=175, ComBitSize=7, ComSignalType=UINT8, ComHandleId=9016, ComSystemTemplateSystemSignalRef=OBJ_YAW_ANGLE_ERR_010
          OBJ_MOVEMENT_STATUS_010_oRDR_TRACKER_OBJ_010_oPCAN_RADAR_c5995012_Tx: ComBitPosition=196, ComBitSize=3, ComSignalType=UINT8, ComHandleId=8998, ComSystemTemplateSystemSignalRef=OBJ_MOVEMENT_STATUS_010
          OBJ_ACCEL_ERR_CRR_COEF_010_oRDR_TRACKER_OBJ_010_oPCAN_RADAR_6aede595_Tx: ComBitPosition=431, ComBitSize=8, ComSignalType=UINT8, ComHandleId=8974, ComSystemTemplateSystemSignalRef=OBJ_ACCEL_ERR_CRR_COEF_010
          OBJ_CLS_TYPE1_010_oRDR_TRACKER_OBJ_010_oPCAN_RADAR_8555a89d_Tx: ComBitPosition=271, ComBitSize=4, ComSignalType=UINT8, ComHandleId=8976, ComSystemTemplateSystemSignalRef=OBJ_CLS_TYPE1_010
          OBJ_CLS_TYPE3_010_oRDR_TRACKER_OBJ_010_oPCAN_RADAR_45355518_Tx: ComBitPosition=279, ComBitSize=4, ComSignalType=UINT8, ComHandleId=8980, ComSystemTemplateSystemSignalRef=OBJ_CLS_TYPE3_010
          OBJ_CLS_TYPE2_010_oRDR_TRACKER_OBJ_010_oPCAN_RADAR_c8bda8fa_Tx: ComBitPosition=267, ComBitSize=4, ComSignalType=UINT8, ComHandleId=8978, ComSystemTemplateSystemSignalRef=OBJ_CLS_TYPE2_010
          OBJ_CLS_TYPE6_PROB_010_oRDR_TRACKER_OBJ_010_oPCAN_RADAR_2307b9ce_Tx: ComBitPosition=343, ComBitSize=8, ComSignalType=UINT8, ComHandleId=8987, ComSystemTemplateSystemSignalRef=OBJ_CLS_TYPE6_PROB_010
          OBJ_CLS_TYPE4_PROB_010_oRDR_TRACKER_OBJ_010_oPCAN_RADAR_ad205438_Tx: ComBitPosition=327, ComBitSize=8, ComSignalType=UINT8, ComHandleId=8983, ComSystemTemplateSystemSignalRef=OBJ_CLS_TYPE4_PROB_010
          OBJ_ACCELERATION_LONG_ERR_010_oRDR_TRACKER_OBJ_010_oPCAN_RADAR_ca4ec4f3_Tx: ComBitPosition=215, ComBitSize=8, ComSignalType=UINT8, ComHandleId=8973, ComSystemTemplateSystemSignalRef=OBJ_ACCELERATION_LONG_ERR_010
          OBJ_EXISTENCE_PROB_010_oRDR_TRACKER_OBJ_010_oPCAN_RADAR_efb98849_Tx: ComBitPosition=229, ComBitSize=14, ComSignalType=UINT16, ComHandleId=8992, ComSystemTemplateSystemSignalRef=OBJ_EXISTENCE_PROB_010
          OBJ_GROUP_ID_010_oRDR_TRACKER_OBJ_010_oPCAN_RADAR_66cb9ce4_Tx: ComBitPosition=405, ComBitSize=6, ComSignalType=UINT8, ComHandleId=8993, ComSystemTemplateSystemSignalRef=OBJ_GROUP_ID_010
          OBJ_YAW_RATE_ERR_010_oRDR_TRACKER_OBJ_010_oPCAN_RADAR_05c1de98_Tx: ComBitPosition=388, ComBitSize=5, ComSignalType=UINT8, ComHandleId=9018, ComSystemTemplateSystemSignalRef=OBJ_YAW_RATE_ERR_010
          OBJ_CLS_TYPE5_PROB_010_oRDR_TRACKER_OBJ_010_oPCAN_RADAR_ea33a2c3_Tx: ComBitPosition=335, ComBitSize=8, ComSignalType=UINT8, ComHandleId=8985, ComSystemTemplateSystemSignalRef=OBJ_CLS_TYPE5_PROB_010
          OBJ_CLS_TYPE5_010_oRDR_TRACKER_OBJ_010_oPCAN_RADAR_dee555d6_Tx: ComBitPosition=287, ComBitSize=4, ComSignalType=UINT8, ComHandleId=8984, ComSystemTemplateSystemSignalRef=OBJ_CLS_TYPE5_010
          OBJ_CLS_TYPE2_PROB_010_oRDR_TRACKER_OBJ_010_oPCAN_RADAR_e4396463_Tx: ComBitPosition=311, ComBitSize=8, ComSignalType=UINT8, ComHandleId=8979, ComSystemTemplateSystemSignalRef=OBJ_CLS_TYPE2_PROB_010
          OBJ_DIMENSION_WIDTH_010_oRDR_TRACKER_OBJ_010_oPCAN_RADAR_e4050c74_Tx: ComBitPosition=17, ComBitSize=10, ComSignalType=UINT16, ComHandleId=8990, ComSystemTemplateSystemSignalRef=OBJ_DIMENSION_WIDTH_010
          OBJ_CLS_TYPE4_010_oRDR_TRACKER_OBJ_010_oPCAN_RADAR_536da834_Tx: ComBitPosition=275, ComBitSize=4, ComSignalType=UINT8, ComHandleId=8982, ComSystemTemplateSystemSignalRef=OBJ_CLS_TYPE4_010
          OBJ_VEH_TRACK_FLAG_010_oRDR_TRACKER_OBJ_010_oPCAN_RADAR_db03ccb5_Tx: ComBitPosition=10, ComBitSize=1, ComSignalType=BOOLEAN, ComHandleId=9009, ComSystemTemplateSystemSignalRef=OBJ_VEH_TRACK_FLAG_010
          OBJ_MH_CRC16_010_oRDR_TRACKER_OBJ_010_oPCAN_RADAR_96577262_Tx: ComBitPosition=495, ComBitSize=16, ComSignalType=UINT16, ComHandleId=8996, ComSystemTemplateSystemSignalRef=OBJ_MH_CRC16_010
          OBJ_MH_CYCLE_COUNTER_010_oRDR_TRACKER_OBJ_010_oPCAN_RADAR_e7b32883_Tx: ComBitPosition=487, ComBitSize=8, ComSignalType=UINT8, ComHandleId=8997, ComSystemTemplateSystemSignalRef=OBJ_MH_CYCLE_COUNTER_010
      RDR_DETECTION_233_236_oPCAN_RADAR_4ef76a15_Tx (ComIPdu):
        ComIPduDirection = SEND
        ComIPduType = NORMAL
        ComIPduCancellationSupport = false
        ComIPduHandleId = 64
        ComIPduSignalProcessing = DEFERRED
        ComIPduChannelRef = CN_PCAN_RADAR_458ff0f1
        ComIPduGroupRef = RDR01_oPCAN_RADAR_Tx_b6bdb067 if post-build-variant-condition{matching-criterion=RDR_POS, value=0}
        ComIPduSignalGroupRef = SG_Detections_233_236_oRDR_DETECTION_233_236_oPCAN_RADAR_b5df088e_Tx
        ComPduIdRef = RDR_DETECTION_233_236_oPCAN_RADAR_4ef76a15_Tx
        ComIPduMainFunctionRef = ComMainFunctionTx_Event
        ComIPduGroupRef = RDR02_oPCAN_RADAR_Tx_9f750495 if post-build-variant-condition{matching-criterion=RDR_POS, value=1}
        ComIPduGroupRef = RDR03_oPCAN_RADAR_Tx_311d9504 if post-build-variant-condition{matching-criterion=RDR_POS, value=2}
        ComIPduGroupRef = RDR04_oPCAN_RADAR_Tx_cce46d71 if post-build-variant-condition{matching-criterion=RDR_POS, value=3}
        ComIPduGroupRef = RDR05_oPCAN_RADAR_Tx_628cfce0 if post-build-variant-condition{matching-criterion=RDR_POS, value=4}
        ComIPduGroupRef = RDR06_oPCAN_RADAR_Tx_4b444812 if post-build-variant-condition{matching-criterion=RDR_POS, value=5}
        ComIPduGroupRef = RDR07_oPCAN_RADAR_Tx_e52cd983 if post-build-variant-condition{matching-criterion=RDR_POS, value=6}
        ComIPduGroupRef = RDR08_oPCAN_RADAR_Tx_6bc6beb9 if post-build-variant-condition{matching-criterion=RDR_POS, value=7}
        ComTxIPdu: ComMinimumDelayTime=0, ComTxIPduUnusedAreasDefault=0
          ComTxModeTrue
            ComTxMode: ComTxModeMode=DIRECT, ComTxModeNumberOfRepetitions=0
          ComTxModeFalse
            ComTxMode: ComTxModeMode=NONE
      RDR_TRACKER_OBJ_041_oPCAN_RADAR_372b744d_Tx (ComIPdu):
        ComIPduDirection = SEND
        ComIPduType = NORMAL
        ComIPduCancellationSupport = false
        ComIPduHandleId = 151
        ComIPduSignalProcessing = DEFERRED
        ComIPduChannelRef = CN_PCAN_RADAR_458ff0f1
        ComIPduGroupRef = RDR01_oPCAN_RADAR_Tx_b6bdb067 if post-build-variant-condition{matching-criterion=RDR_POS, value=0}
        ComIPduSignalGroupRef = SG_TrackerObject041_oRDR_TRACKER_OBJ_041_oPCAN_RADAR_3488a224_Tx
        ComPduIdRef = RDR_TRACKER_OBJ_041_oPCAN_RADAR_372b744d_Tx
        ComIPduMainFunctionRef = ComMainFunctionTx_Event
        ComIPduGroupRef = RDR02_oPCAN_RADAR_Tx_9f750495 if post-build-variant-condition{matching-criterion=RDR_POS, value=1}
        ComIPduGroupRef = RDR03_oPCAN_RADAR_Tx_311d9504 if post-build-variant-condition{matching-criterion=RDR_POS, value=2}
        ComIPduGroupRef = RDR04_oPCAN_RADAR_Tx_cce46d71 if post-build-variant-condition{matching-criterion=RDR_POS, value=3}
        ComIPduGroupRef = RDR05_oPCAN_RADAR_Tx_628cfce0 if post-build-variant-condition{matching-criterion=RDR_POS, value=4}
        ComIPduGroupRef = RDR06_oPCAN_RADAR_Tx_4b444812 if post-build-variant-condition{matching-criterion=RDR_POS, value=5}
        ComIPduGroupRef = RDR07_oPCAN_RADAR_Tx_e52cd983 if post-build-variant-condition{matching-criterion=RDR_POS, value=6}
        ComIPduGroupRef = RDR08_oPCAN_RADAR_Tx_6bc6beb9 if post-build-variant-condition{matching-criterion=RDR_POS, value=7}
        ComTxIPdu: ComMinimumDelayTime=0, ComTxIPduUnusedAreasDefault=0
          ComTxModeTrue
            ComTxMode: ComTxModeMode=DIRECT, ComTxModeNumberOfRepetitions=0
          ComTxModeFalse
            ComTxMode: ComTxModeMode=NONE
      SG_TrackerObject006_oRDR_TRACKER_OBJ_006_oPCAN_RADAR_2742cf47_Tx (ComSignalGroup):
        ComTransferProperty = TRIGGERED
        ComSignalGroupAccess = ACCESS_NEEDED_BY_SWC_OR_COM
        ComHandleId = 115
        ComSignalGroupArrayAccess = true
        ComSystemTemplateSignalGroupRef = SG_TrackerObject006
        49 x ComGroupSignal, all with ComSignalEndianness=BIG_ENDIAN, ComSignalInitValue=0, ComTransferProperty=PENDING, ComSignalAccess=ACCESS_NEEDED_BY_SWC_OR_COM:
          OBJ_POS_ERR_CRR_COEF_006_oRDR_TRACKER_OBJ_006_oPCAN_RADAR_7c9f5fff_Tx: ComBitPosition=415, ComBitSize=8, ComSignalType=UINT8, ComHandleId=8803, ComSystemTemplateSystemSignalRef=OBJ_POS_ERR_CRR_COEF_006
          OBJ_TIMESTAMP_OFFSET_006_oRDR_TRACKER_OBJ_006_oPCAN_RADAR_bc53f4e2_Tx: ComBitPosition=247, ComBitSize=8, ComSignalType=UINT8, ComHandleId=8811, ComSystemTemplateSystemSignalRef=OBJ_TIMESTAMP_OFFSET_006
          OBJ_ACCELERATION_LAT_ERR_006_oRDR_TRACKER_OBJ_006_oPCAN_RADAR_fc92ae8e_Tx: ComBitPosition=223, ComBitSize=8, ComSignalType=UINT8, ComHandleId=8775, ComSystemTemplateSystemSignalRef=OBJ_ACCELERATION_LAT_ERR_006
          OBJ_ID_006_oRDR_TRACKER_OBJ_006_oPCAN_RADAR_bc9c7834_Tx: ComBitPosition=7, ComBitSize=8, ComSignalType=UINT8, ComHandleId=8798, ComSystemTemplateSystemSignalRef=OBJ_ID_006
          OBJ_DIMENSION_WIDTH_ERR_006_oRDR_TRACKER_OBJ_006_oPCAN_RADAR_2dde044b_Tx: ComBitPosition=23, ComBitSize=6, ComSignalType=UINT8, ComHandleId=8795, ComSystemTemplateSystemSignalRef=OBJ_DIMENSION_WIDTH_ERR_006
          OBJ_MEASUREMENT_STATUS_006_oRDR_TRACKER_OBJ_006_oPCAN_RADAR_c34e0a89_Tx: ComBitPosition=14, ComBitSize=3, ComSignalType=UINT8, ComHandleId=8799, ComSystemTemplateSystemSignalRef=OBJ_MEASUREMENT_STATUS_006
          OBJ_POS_LAT_ERR_006_oRDR_TRACKER_OBJ_006_oPCAN_RADAR_9a7cf284_Tx: ComBitPosition=103, ComBitSize=8, ComSignalType=UINT8, ComHandleId=8805, ComSystemTemplateSystemSignalRef=OBJ_POS_LAT_ERR_006
          OBJ_REF_PT_LAT_OFFSET_006_oRDR_TRACKER_OBJ_006_oPCAN_RADAR_49c29fc1_Tx: ComBitPosition=370, ComBitSize=14, ComSignalType=UINT16, ComHandleId=8809, ComSystemTemplateSystemSignalRef=OBJ_REF_PT_LAT_OFFSET_006
          OBJ_VELOCITY_LAT_ERR_006_oRDR_TRACKER_OBJ_006_oPCAN_RADAR_eea997c5_Tx: ComBitPosition=151, ComBitSize=8, ComSignalType=UINT8, ComHandleId=8816, ComSystemTemplateSystemSignalRef=OBJ_VELOCITY_LAT_ERR_006
          OBJ_YAW_ANGLE_006_oRDR_TRACKER_OBJ_006_oPCAN_RADAR_36efa3d4_Tx: ComBitPosition=155, ComBitSize=12, ComSignalType=UINT16, ComHandleId=8819, ComSystemTemplateSystemSignalRef=OBJ_YAW_ANGLE_006
          OBJ_CLS_TYPE3_PROB_006_oRDR_TRACKER_OBJ_006_oPCAN_RADAR_8a535d4f_Tx: ComBitPosition=319, ComBitSize=8, ComSignalType=UINT8, ComHandleId=8785, ComSystemTemplateSystemSignalRef=OBJ_CLS_TYPE3_PROB_006
          OBJ_POS_LONG_006_oRDR_TRACKER_OBJ_006_oPCAN_RADAR_2f90497c_Tx: ComBitPosition=63, ComBitSize=16, ComSignalType=UINT16, ComHandleId=8806, ComSystemTemplateSystemSignalRef=OBJ_POS_LONG_006
          OBJ_DIMENSION_LENGTH_ERR_006_oRDR_TRACKER_OBJ_006_oPCAN_RADAR_d54a2b74_Tx: ComBitPosition=41, ComBitSize=10, ComSignalType=UINT16, ComHandleId=8793, ComSystemTemplateSystemSignalRef=OBJ_DIMENSION_LENGTH_ERR_006
          OBJ_CLS_TYPE2_PROB_006_oRDR_TRACKER_OBJ_006_oPCAN_RADAR_cd40abb4_Tx: ComBitPosition=311, ComBitSize=8, ComSignalType=UINT8, ComHandleId=8783, ComSystemTemplateSystemSignalRef=OBJ_CLS_TYPE2_PROB_006
          OBJ_GROUP_ID_006_oRDR_TRACKER_OBJ_006_oPCAN_RADAR_4fb25333_Tx: ComBitPosition=405, ComBitSize=6, ComSignalType=UINT8, ComHandleId=8797, ComSystemTemplateSystemSignalRef=OBJ_GROUP_ID_006
          OBJ_RCS_006_oRDR_TRACKER_OBJ_006_oPCAN_RADAR_bcfff4b4_Tx: ComBitPosition=351, ComBitSize=7, ComSignalType=UINT8, ComHandleId=8808, ComSystemTemplateSystemSignalRef=OBJ_RCS_006
          OBJ_CLS_TYPE5_006_oRDR_TRACKER_OBJ_006_oPCAN_RADAR_f79c9a01_Tx: ComBitPosition=287, ComBitSize=4, ComSignalType=UINT8, ComHandleId=8788, ComSystemTemplateSystemSignalRef=OBJ_CLS_TYPE5_006
          OBJ_CLS_TYPE3_006_oRDR_TRACKER_OBJ_006_oPCAN_RADAR_6c4c9acf_Tx: ComBitPosition=279, ComBitSize=4, ComSignalType=UINT8, ComHandleId=8784, ComSystemTemplateSystemSignalRef=OBJ_CLS_TYPE3_006
          OBJ_DIMENSION_LENGTH_006_oRDR_TRACKER_OBJ_006_oPCAN_RADAR_eeb2340e_Tx: ComBitPosition=37, ComBitSize=12, ComSignalType=UINT16, ComHandleId=8792, ComSystemTemplateSystemSignalRef=OBJ_DIMENSION_LENGTH_006
          OBJ_DIMENSION_WIDTH_006_oRDR_TRACKER_OBJ_006_oPCAN_RADAR_cd7cc3a3_Tx: ComBitPosition=17, ComBitSize=10, ComSignalType=UINT16, ComHandleId=8794, ComSystemTemplateSystemSignalRef=OBJ_DIMENSION_WIDTH_006
          OBJ_ALIVE_TIME_006_oRDR_TRACKER_OBJ_006_oPCAN_RADAR_3bf7866c_Tx: ComBitPosition=255, ComBitSize=16, ComSignalType=UINT16, ComHandleId=8779, ComSystemTemplateSystemSignalRef=OBJ_ALIVE_TIME_006
          OBJ_CLS_TYPE4_PROB_006_oRDR_TRACKER_OBJ_006_oPCAN_RADAR_84599bef_Tx: ComBitPosition=327, ComBitSize=8, ComSignalType=UINT8, ComHandleId=8787, ComSystemTemplateSystemSignalRef=OBJ_CLS_TYPE4_PROB_006
          OBJ_CLS_TYPE6_006_oRDR_TRACKER_OBJ_006_oPCAN_RADAR_ba749a66_Tx: ComBitPosition=282, ComBitSize=4, ComSignalType=UINT8, ComHandleId=8790, ComSystemTemplateSystemSignalRef=OBJ_CLS_TYPE6_006
          OBJ_YAW_ANGLE_ERR_006_oRDR_TRACKER_OBJ_006_oPCAN_RADAR_e3e2a503_Tx: ComBitPosition=175, ComBitSize=7, ComSignalType=UINT8, ComHandleId=8820, ComSystemTemplateSystemSignalRef=OBJ_YAW_ANGLE_ERR_006
          OBJ_ACCELERATION_LAT_006_oRDR_TRACKER_OBJ_006_oPCAN_RADAR_29669430_Tx: ComBitPosition=177, ComBitSize=10, ComSignalType=UINT16, ComHandleId=8774, ComSystemTemplateSystemSignalRef=OBJ_ACCELERATION_LAT_006
          OBJ_VEH_TRACK_FLAG_006_oRDR_TRACKER_OBJ_006_oPCAN_RADAR_f27a0362_Tx: ComBitPosition=10, ComBitSize=1, ComSignalType=BOOLEAN, ComHandleId=8813, ComSystemTemplateSystemSignalRef=OBJ_VEH_TRACK_FLAG_006
          OBJ_CLS_TYPE5_PROB_006_oRDR_TRACKER_OBJ_006_oPCAN_RADAR_c34a6d14_Tx: ComBitPosition=335, ComBitSize=8, ComSignalType=UINT8, ComHandleId=8789, ComSystemTemplateSystemSignalRef=OBJ_CLS_TYPE5_PROB_006
          OBJ_YAW_RATE_ERR_006_oRDR_TRACKER_OBJ_006_oPCAN_RADAR_2cb8114f_Tx: ComBitPosition=388, ComBitSize=5, ComSignalType=UINT8, ComHandleId=8822, ComSystemTemplateSystemSignalRef=OBJ_YAW_RATE_ERR_006
          OBJ_ACCEL_ERR_CRR_COEF_006_oRDR_TRACKER_OBJ_006_oPCAN_RADAR_43942a42_Tx: ComBitPosition=431, ComBitSize=8, ComSignalType=UINT8, ComHandleId=8778, ComSystemTemplateSystemSignalRef=OBJ_ACCEL_ERR_CRR_COEF_006
          OBJ_ACCELERATION_LONG_006_oRDR_TRACKER_OBJ_006_oPCAN_RADAR_5b96cdd0_Tx: ComBitPosition=193, ComBitSize=10, ComSignalType=UINT16, ComHandleId=8776, ComSystemTemplateSystemSignalRef=OBJ_ACCELERATION_LONG_006
          OBJ_ACCELERATION_LONG_ERR_006_oRDR_TRACKER_OBJ_006_oPCAN_RADAR_e3370b24_Tx: ComBitPosition=215, ComBitSize=8, ComSignalType=UINT8, ComHandleId=8777, ComSystemTemplateSystemSignalRef=OBJ_ACCELERATION_LONG_ERR_006
          OBJ_POS_LAT_006_oRDR_TRACKER_OBJ_006_oPCAN_RADAR_9e30a2b3_Tx: ComBitPosition=79, ComBitSize=16, ComSignalType=UINT16, ComHandleId=8804, ComSystemTemplateSystemSignalRef=OBJ_POS_LAT_006
          OBJ_CLS_TYPE1_PROB_006_oRDR_TRACKER_OBJ_006_oPCAN_RADAR_0474b0b9_Tx: ComBitPosition=303, ComBitSize=8, ComSignalType=UINT8, ComHandleId=8781, ComSystemTemplateSystemSignalRef=OBJ_CLS_TYPE1_PROB_006
          OBJ_EXISTENCE_PROB_006_oRDR_TRACKER_OBJ_006_oPCAN_RADAR_c6c0479e_Tx: ComBitPosition=229, ComBitSize=14, ComSignalType=UINT16, ComHandleId=8796, ComSystemTemplateSystemSignalRef=OBJ_EXISTENCE_PROB_006
          OBJ_REF_PT_LONG_OFFSET_006_oRDR_TRACKER_OBJ_006_oPCAN_RADAR_06906fc2_Tx: ComBitPosition=357, ComBitSize=14, ComSignalType=UINT16, ComHandleId=8810, ComSystemTemplateSystemSignalRef=OBJ_REF_PT_LONG_OFFSET_006
          OBJ_CLS_TYPE4_006_oRDR_TRACKER_OBJ_006_oPCAN_RADAR_7a1467e3_Tx: ComBitPosition=275, ComBitSize=4, ComSignalType=UINT8, ComHandleId=8786, ComSystemTemplateSystemSignalRef=OBJ_CLS_TYPE4_006
          OBJ_VELOCITY_LONG_006_oRDR_TRACKER_OBJ_006_oPCAN_RADAR_8ade9f52_Tx: ComBitPosition=110, ComBitSize=15, ComSignalType=UINT16, ComHandleId=8817, ComSystemTemplateSystemSignalRef=OBJ_VELOCITY_LONG_006
          OBJ_POS_LONG_ERR_006_oRDR_TRACKER_OBJ_006_oPCAN_RADAR_03840c66_Tx: ComBitPosition=95, ComBitSize=8, ComSignalType=UINT8, ComHandleId=8807, ComSystemTemplateSystemSignalRef=OBJ_POS_LONG_ERR_006
          OBJ_VELOCITY_LAT_006_oRDR_TRACKER_OBJ_006_oPCAN_RADAR_da53e794_Tx: ComBitPosition=126, ComBitSize=15, ComSignalType=UINT16, ComHandleId=8815, ComSystemTemplateSystemSignalRef=OBJ_VELOCITY_LAT_006
          OBJ_VELOCITY_LONG_ERR_006_oRDR_TRACKER_OBJ_006_oPCAN_RADAR_022ba805_Tx: ComBitPosition=143, ComBitSize=8, ComSignalType=UINT8, ComHandleId=8818, ComSystemTemplateSystemSignalRef=OBJ_VELOCITY_LONG_ERR_006
          OBJ_MOVEMENT_STATUS_006_oRDR_TRACKER_OBJ_006_oPCAN_RADAR_ece09fc5_Tx: ComBitPosition=196, ComBitSize=3, ComSignalType=UINT8, ComHandleId=8802, ComSystemTemplateSystemSignalRef=OBJ_MOVEMENT_STATUS_006
          OBJ_VELOCITY_ERR_CRR_COEF_006_oRDR_TRACKER_OBJ_006_oPCAN_RADAR_d5e5621e_Tx: ComBitPosition=423, ComBitSize=8, ComSignalType=UINT8, ComHandleId=8814, ComSystemTemplateSystemSignalRef=OBJ_VELOCITY_ERR_CRR_COEF_006
          OBJ_CLS_TYPE6_PROB_006_oRDR_TRACKER_OBJ_006_oPCAN_RADAR_0a7e7619_Tx: ComBitPosition=343, ComBitSize=8, ComSignalType=UINT8, ComHandleId=8791, ComSystemTemplateSystemSignalRef=OBJ_CLS_TYPE6_PROB_006
          OBJ_YAW_RATE_006_oRDR_TRACKER_OBJ_006_oPCAN_RADAR_13608693_Tx: ComBitPosition=399, ComBitSize=10, ComSignalType=UINT16, ComHandleId=8821, ComSystemTemplateSystemSignalRef=OBJ_YAW_RATE_006
          OBJ_TRACK_MOTION_MODEL_006_oRDR_TRACKER_OBJ_006_oPCAN_RADAR_7050f53f_Tx: ComBitPosition=9, ComBitSize=2, ComSignalType=UINT8, ComHandleId=8812, ComSystemTemplateSystemSignalRef=OBJ_TRACK_MOTION_MODEL_006
          OBJ_CLS_TYPE1_006_oRDR_TRACKER_OBJ_006_oPCAN_RADAR_ac2c674a_Tx: ComBitPosition=271, ComBitSize=4, ComSignalType=UINT8, ComHandleId=8780, ComSystemTemplateSystemSignalRef=OBJ_CLS_TYPE1_006
          OBJ_CLS_TYPE2_006_oRDR_TRACKER_OBJ_006_oPCAN_RADAR_e1c4672d_Tx: ComBitPosition=267, ComBitSize=4, ComSignalType=UINT8, ComHandleId=8782, ComSystemTemplateSystemSignalRef=OBJ_CLS_TYPE2_006
          OBJ_MH_CRC16_006_oRDR_TRACKER_OBJ_006_oPCAN_RADAR_bf2ebdb5_Tx: ComBitPosition=495, ComBitSize=16, ComSignalType=UINT16, ComHandleId=8800, ComSystemTemplateSystemSignalRef=OBJ_MH_CRC16_006
          OBJ_MH_CYCLE_COUNTER_006_oRDR_TRACKER_OBJ_006_oPCAN_RADAR_cecae754_Tx: ComBitPosition=487, ComBitSize=8, ComSignalType=UINT8, ComHandleId=8801, ComSystemTemplateSystemSignalRef=OBJ_MH_CYCLE_COUNTER_006
      SG_TrackerObject003_oRDR_TRACKER_OBJ_003_oPCAN_RADAR_8ce669ba_Tx (ComSignalGroup):
        ComTransferProperty = TRIGGERED
        ComSignalGroupAccess = ACCESS_NEEDED_BY_SWC_OR_COM
        ComHandleId = 112
        ComSignalGroupArrayAccess = true
        ComSystemTemplateSignalGroupRef = SG_TrackerObject003
        49 x ComGroupSignal, all with ComSignalEndianness=BIG_ENDIAN, ComSignalInitValue=0, ComTransferProperty=PENDING, ComSignalAccess=ACCESS_NEEDED_BY_SWC_OR_COM:
          OBJ_POS_LONG_ERR_003_oRDR_TRACKER_OBJ_003_oPCAN_RADAR_a820aa9b_Tx: ComBitPosition=95, ComBitSize=8, ComSignalType=UINT8, ComHandleId=8660, ComSystemTemplateSystemSignalRef=OBJ_POS_LONG_ERR_003
          OBJ_POS_LAT_ERR_003_oRDR_TRACKER_OBJ_003_oPCAN_RADAR_31d85479_Tx: ComBitPosition=103, ComBitSize=8, ComSignalType=UINT8, ComHandleId=8658, ComSystemTemplateSystemSignalRef=OBJ_POS_LAT_ERR_003
          OBJ_POS_ERR_CRR_COEF_003_oRDR_TRACKER_OBJ_003_oPCAN_RADAR_d73bf902_Tx: ComBitPosition=415, ComBitSize=8, ComSignalType=UINT8, ComHandleId=8656, ComSystemTemplateSystemSignalRef=OBJ_POS_ERR_CRR_COEF_003
          OBJ_YAW_RATE_ERR_003_oRDR_TRACKER_OBJ_003_oPCAN_RADAR_871cb7b2_Tx: ComBitPosition=388, ComBitSize=5, ComSignalType=UINT8, ComHandleId=8675, ComSystemTemplateSystemSignalRef=OBJ_YAW_RATE_ERR_003
          OBJ_CLS_TYPE1_003_oRDR_TRACKER_OBJ_003_oPCAN_RADAR_0788c1b7_Tx: ComBitPosition=271, ComBitSize=4, ComSignalType=UINT8, ComHandleId=8633, ComSystemTemplateSystemSignalRef=OBJ_CLS_TYPE1_003
          OBJ_CLS_TYPE2_PROB_003_oRDR_TRACKER_OBJ_003_oPCAN_RADAR_66e40d49_Tx: ComBitPosition=311, ComBitSize=8, ComSignalType=UINT8, ComHandleId=8636, ComSystemTemplateSystemSignalRef=OBJ_CLS_TYPE2_PROB_003
          OBJ_ACCELERATION_LONG_003_oRDR_TRACKER_OBJ_003_oPCAN_RADAR_f0326b2d_Tx: ComBitPosition=193, ComBitSize=10, ComSignalType=UINT16, ComHandleId=8629, ComSystemTemplateSystemSignalRef=OBJ_ACCELERATION_LONG_003
          OBJ_DIMENSION_LENGTH_ERR_003_oRDR_TRACKER_OBJ_003_oPCAN_RADAR_7eee8d89_Tx: ComBitPosition=41, ComBitSize=10, ComSignalType=UINT16, ComHandleId=8646, ComSystemTemplateSystemSignalRef=OBJ_DIMENSION_LENGTH_ERR_003
          OBJ_REF_PT_LONG_OFFSET_003_oRDR_TRACKER_OBJ_003_oPCAN_RADAR_ad34c93f_Tx: ComBitPosition=357, ComBitSize=14, ComSignalType=UINT16, ComHandleId=8663, ComSystemTemplateSystemSignalRef=OBJ_REF_PT_LONG_OFFSET_003
          OBJ_RCS_003_oRDR_TRACKER_OBJ_003_oPCAN_RADAR_175b5249_Tx: ComBitPosition=351, ComBitSize=7, ComSignalType=UINT8, ComHandleId=8661, ComSystemTemplateSystemSignalRef=OBJ_RCS_003
          OBJ_ACCEL_ERR_CRR_COEF_003_oRDR_TRACKER_OBJ_003_oPCAN_RADAR_e8308cbf_Tx: ComBitPosition=431, ComBitSize=8, ComSignalType=UINT8, ComHandleId=8631, ComSystemTemplateSystemSignalRef=OBJ_ACCEL_ERR_CRR_COEF_003
          OBJ_YAW_RATE_003_oRDR_TRACKER_OBJ_003_oPCAN_RADAR_b8c4206e_Tx: ComBitPosition=399, ComBitSize=10, ComSignalType=UINT16, ComHandleId=8674, ComSystemTemplateSystemSignalRef=OBJ_YAW_RATE_003
          OBJ_CLS_TYPE5_PROB_003_oRDR_TRACKER_OBJ_003_oPCAN_RADAR_68eecbe9_Tx: ComBitPosition=335, ComBitSize=8, ComSignalType=UINT8, ComHandleId=8642, ComSystemTemplateSystemSignalRef=OBJ_CLS_TYPE5_PROB_003
          OBJ_GROUP_ID_003_oRDR_TRACKER_OBJ_003_oPCAN_RADAR_e416f5ce_Tx: ComBitPosition=405, ComBitSize=6, ComSignalType=UINT8, ComHandleId=8650, ComSystemTemplateSystemSignalRef=OBJ_GROUP_ID_003
          OBJ_DIMENSION_WIDTH_003_oRDR_TRACKER_OBJ_003_oPCAN_RADAR_66d8655e_Tx: ComBitPosition=17, ComBitSize=10, ComSignalType=UINT16, ComHandleId=8647, ComSystemTemplateSystemSignalRef=OBJ_DIMENSION_WIDTH_003
          OBJ_ID_003_oRDR_TRACKER_OBJ_003_oPCAN_RADAR_1738dec9_Tx: ComBitPosition=7, ComBitSize=8, ComSignalType=UINT8, ComHandleId=8651, ComSystemTemplateSystemSignalRef=OBJ_ID_003
          OBJ_CLS_TYPE4_PROB_003_oRDR_TRACKER_OBJ_003_oPCAN_RADAR_2ffd3d12_Tx: ComBitPosition=327, ComBitSize=8, ComSignalType=UINT8, ComHandleId=8640, ComSystemTemplateSystemSignalRef=OBJ_CLS_TYPE4_PROB_003
          OBJ_EXISTENCE_PROB_003_oRDR_TRACKER_OBJ_003_oPCAN_RADAR_6d64e163_Tx: ComBitPosition=229, ComBitSize=14, ComSignalType=UINT16, ComHandleId=8649, ComSystemTemplateSystemSignalRef=OBJ_EXISTENCE_PROB_003
          OBJ_ACCELERATION_LAT_003_oRDR_TRACKER_OBJ_003_oPCAN_RADAR_82c232cd_Tx: ComBitPosition=177, ComBitSize=10, ComSignalType=UINT16, ComHandleId=8627, ComSystemTemplateSystemSignalRef=OBJ_ACCELERATION_LAT_003
          OBJ_ALIVE_TIME_003_oRDR_TRACKER_OBJ_003_oPCAN_RADAR_90532091_Tx: ComBitPosition=255, ComBitSize=16, ComSignalType=UINT16, ComHandleId=8632, ComSystemTemplateSystemSignalRef=OBJ_ALIVE_TIME_003
          OBJ_VEH_TRACK_FLAG_003_oRDR_TRACKER_OBJ_003_oPCAN_RADAR_59dea59f_Tx: ComBitPosition=10, ComBitSize=1, ComSignalType=BOOLEAN, ComHandleId=8666, ComSystemTemplateSystemSignalRef=OBJ_VEH_TRACK_FLAG_003
          OBJ_POS_LONG_003_oRDR_TRACKER_OBJ_003_oPCAN_RADAR_8434ef81_Tx: ComBitPosition=63, ComBitSize=16, ComSignalType=UINT16, ComHandleId=8659, ComSystemTemplateSystemSignalRef=OBJ_POS_LONG_003
          OBJ_CLS_TYPE6_PROB_003_oRDR_TRACKER_OBJ_003_oPCAN_RADAR_a1dad0e4_Tx: ComBitPosition=343, ComBitSize=8, ComSignalType=UINT8, ComHandleId=8644, ComSystemTemplateSystemSignalRef=OBJ_CLS_TYPE6_PROB_003
          OBJ_ACCELERATION_LONG_ERR_003_oRDR_TRACKER_OBJ_003_oPCAN_RADAR_4893add9_Tx: ComBitPosition=215, ComBitSize=8, ComSignalType=UINT8, ComHandleId=8630, ComSystemTemplateSystemSignalRef=OBJ_ACCELERATION_LONG_ERR_003
          OBJ_MOVEMENT_STATUS_003_oRDR_TRACKER_OBJ_003_oPCAN_RADAR_47443938_Tx: ComBitPosition=196, ComBitSize=3, ComSignalType=UINT8, ComHandleId=8655, ComSystemTemplateSystemSignalRef=OBJ_MOVEMENT_STATUS_003
          OBJ_VELOCITY_LONG_ERR_003_oRDR_TRACKER_OBJ_003_oPCAN_RADAR_a98f0ef8_Tx: ComBitPosition=143, ComBitSize=8, ComSignalType=UINT8, ComHandleId=8671, ComSystemTemplateSystemSignalRef=OBJ_VELOCITY_LONG_ERR_003
          OBJ_TRACK_MOTION_MODEL_003_oRDR_TRACKER_OBJ_003_oPCAN_RADAR_dbf453c2_Tx: ComBitPosition=9, ComBitSize=2, ComSignalType=UINT8, ComHandleId=8665, ComSystemTemplateSystemSignalRef=OBJ_TRACK_MOTION_MODEL_003
          OBJ_CLS_TYPE4_003_oRDR_TRACKER_OBJ_003_oPCAN_RADAR_d1b0c11e_Tx: ComBitPosition=275, ComBitSize=4, ComSignalType=UINT8, ComHandleId=8639, ComSystemTemplateSystemSignalRef=OBJ_CLS_TYPE4_003
          OBJ_VELOCITY_LAT_ERR_003_oRDR_TRACKER_OBJ_003_oPCAN_RADAR_450d3138_Tx: ComBitPosition=151, ComBitSize=8, ComSignalType=UINT8, ComHandleId=8669, ComSystemTemplateSystemSignalRef=OBJ_VELOCITY_LAT_ERR_003
          OBJ_ACCELERATION_LAT_ERR_003_oRDR_TRACKER_OBJ_003_oPCAN_RADAR_57360873_Tx: ComBitPosition=223, ComBitSize=8, ComSignalType=UINT8, ComHandleId=8628, ComSystemTemplateSystemSignalRef=OBJ_ACCELERATION_LAT_ERR_003
          OBJ_CLS_TYPE2_003_oRDR_TRACKER_OBJ_003_oPCAN_RADAR_4a60c1d0_Tx: ComBitPosition=267, ComBitSize=4, ComSignalType=UINT8, ComHandleId=8635, ComSystemTemplateSystemSignalRef=OBJ_CLS_TYPE2_003
          OBJ_CLS_TYPE1_PROB_003_oRDR_TRACKER_OBJ_003_oPCAN_RADAR_afd01644_Tx: ComBitPosition=303, ComBitSize=8, ComSignalType=UINT8, ComHandleId=8634, ComSystemTemplateSystemSignalRef=OBJ_CLS_TYPE1_PROB_003
          OBJ_REF_PT_LAT_OFFSET_003_oRDR_TRACKER_OBJ_003_oPCAN_RADAR_e266393c_Tx: ComBitPosition=370, ComBitSize=14, ComSignalType=UINT16, ComHandleId=8662, ComSystemTemplateSystemSignalRef=OBJ_REF_PT_LAT_OFFSET_003
          OBJ_TIMESTAMP_OFFSET_003_oRDR_TRACKER_OBJ_003_oPCAN_RADAR_17f7521f_Tx: ComBitPosition=247, ComBitSize=8, ComSignalType=UINT8, ComHandleId=8664, ComSystemTemplateSystemSignalRef=OBJ_TIMESTAMP_OFFSET_003
          OBJ_CLS_TYPE6_003_oRDR_TRACKER_OBJ_003_oPCAN_RADAR_11d03c9b_Tx: ComBitPosition=282, ComBitSize=4, ComSignalType=UINT8, ComHandleId=8643, ComSystemTemplateSystemSignalRef=OBJ_CLS_TYPE6_003
          OBJ_VELOCITY_ERR_CRR_COEF_003_oRDR_TRACKER_OBJ_003_oPCAN_RADAR_7e41c4e3_Tx: ComBitPosition=423, ComBitSize=8, ComSignalType=UINT8, ComHandleId=8667, ComSystemTemplateSystemSignalRef=OBJ_VELOCITY_ERR_CRR_COEF_003
          OBJ_VELOCITY_LAT_003_oRDR_TRACKER_OBJ_003_oPCAN_RADAR_71f74169_Tx: ComBitPosition=126, ComBitSize=15, ComSignalType=UINT16, ComHandleId=8668, ComSystemTemplateSystemSignalRef=OBJ_VELOCITY_LAT_003
          OBJ_CLS_TYPE5_003_oRDR_TRACKER_OBJ_003_oPCAN_RADAR_5c383cfc_Tx: ComBitPosition=287, ComBitSize=4, ComSignalType=UINT8, ComHandleId=8641, ComSystemTemplateSystemSignalRef=OBJ_CLS_TYPE5_003
          OBJ_MEASUREMENT_STATUS_003_oRDR_TRACKER_OBJ_003_oPCAN_RADAR_68eaac74_Tx: ComBitPosition=14, ComBitSize=3, ComSignalType=UINT8, ComHandleId=8652, ComSystemTemplateSystemSignalRef=OBJ_MEASUREMENT_STATUS_003
          OBJ_POS_LAT_003_oRDR_TRACKER_OBJ_003_oPCAN_RADAR_3594044e_Tx: ComBitPosition=79, ComBitSize=16, ComSignalType=UINT16, ComHandleId=8657, ComSystemTemplateSystemSignalRef=OBJ_POS_LAT_003
          OBJ_CLS_TYPE3_PROB_003_oRDR_TRACKER_OBJ_003_oPCAN_RADAR_21f7fbb2_Tx: ComBitPosition=319, ComBitSize=8, ComSignalType=UINT8, ComHandleId=8638, ComSystemTemplateSystemSignalRef=OBJ_CLS_TYPE3_PROB_003
          OBJ_CLS_TYPE3_003_oRDR_TRACKER_OBJ_003_oPCAN_RADAR_c7e83c32_Tx: ComBitPosition=279, ComBitSize=4, ComSignalType=UINT8, ComHandleId=8637, ComSystemTemplateSystemSignalRef=OBJ_CLS_TYPE3_003
          OBJ_DIMENSION_LENGTH_003_oRDR_TRACKER_OBJ_003_oPCAN_RADAR_451692f3_Tx: ComBitPosition=37, ComBitSize=12, ComSignalType=UINT16, ComHandleId=8645, ComSystemTemplateSystemSignalRef=OBJ_DIMENSION_LENGTH_003
          OBJ_YAW_ANGLE_003_oRDR_TRACKER_OBJ_003_oPCAN_RADAR_9d4b0529_Tx: ComBitPosition=155, ComBitSize=12, ComSignalType=UINT16, ComHandleId=8672, ComSystemTemplateSystemSignalRef=OBJ_YAW_ANGLE_003
          OBJ_DIMENSION_WIDTH_ERR_003_oRDR_TRACKER_OBJ_003_oPCAN_RADAR_867aa2b6_Tx: ComBitPosition=23, ComBitSize=6, ComSignalType=UINT8, ComHandleId=8648, ComSystemTemplateSystemSignalRef=OBJ_DIMENSION_WIDTH_ERR_003
          OBJ_VELOCITY_LONG_003_oRDR_TRACKER_OBJ_003_oPCAN_RADAR_217a39af_Tx: ComBitPosition=110, ComBitSize=15, ComSignalType=UINT16, ComHandleId=8670, ComSystemTemplateSystemSignalRef=OBJ_VELOCITY_LONG_003
          OBJ_YAW_ANGLE_ERR_003_oRDR_TRACKER_OBJ_003_oPCAN_RADAR_484603fe_Tx: ComBitPosition=175, ComBitSize=7, ComSignalType=UINT8, ComHandleId=8673, ComSystemTemplateSystemSignalRef=OBJ_YAW_ANGLE_ERR_003
          OBJ_MH_CRC16_003_oRDR_TRACKER_OBJ_003_oPCAN_RADAR_148a1b48_Tx: ComBitPosition=495, ComBitSize=16, ComSignalType=UINT16, ComHandleId=8653, ComSystemTemplateSystemSignalRef=OBJ_MH_CRC16_003
          OBJ_MH_CYCLE_COUNTER_003_oRDR_TRACKER_OBJ_003_oPCAN_RADAR_656e41a9_Tx: ComBitPosition=487, ComBitSize=8, ComSignalType=UINT8, ComHandleId=8654, ComSystemTemplateSystemSignalRef=OBJ_MH_CYCLE_COUNTER_003
      3 x ComIPdu, all with ComIPduDirection=SEND, ComIPduType=NORMAL, ComIPduCancellationSupport=false, ComIPduSignalProcessing=DEFERRED, ComIPduChannelRef=CN_PCAN_RADAR_458ff0f1, ComIPduGroupRef=RDR01_oPCAN_RADAR_Tx_b6bdb067 if post-build-variant-condition{matching-criterion=RDR_POS, value=0}, ComIPduMainFunctionRef=ComMainFunctionTx_Event, ComIPduGroupRef=RDR02_oPCAN_RADAR_Tx_9f750495 if post-build-variant-condition{matching-criterion=RDR_POS, value=1}, ComIPduGroupRef=RDR03_oPCAN_RADAR_Tx_311d9504 if post-build-variant-condition{matching-criterion=RDR_POS, value=2}, ComIPduGroupRef=RDR04_oPCAN_RADAR_Tx_cce46d71 if post-build-variant-condition{matching-criterion=RDR_POS, value=3}, ComIPduGroupRef=RDR05_oPCAN_RADAR_Tx_628cfce0 if post-build-variant-condition{matching-criterion=RDR_POS, value=4}, ComIPduGroupRef=RDR06_oPCAN_RADAR_Tx_4b444812 if post-build-variant-condition{matching-criterion=RDR_POS, value=5}, ComIPduGroupRef=RDR07_oPCAN_RADAR_Tx_e52cd983 if post-build-variant-condition{matching-criterion=RDR_POS, value=6}, ComIPduGroupRef=RDR08_oPCAN_RADAR_Tx_6bc6beb9 if post-build-variant-condition{matching-criterion=RDR_POS, value=7}:
        RDR_TRACKER_OBJ_062_oPCAN_RADAR_6b8fdc2e_Tx: ComIPduHandleId=172, ComIPduSignalGroupRef=SG_TrackerObject062_oRDR_TRACKER_OBJ_062_oPCAN_RADAR_41e7d0cc_Tx, ComPduIdRef=RDR_TRACKER_OBJ_062_oPCAN_RADAR_6b8fdc2e_Tx
          ComTxIPdu: ComMinimumDelayTime=0, ComTxIPduUnusedAreasDefault=0
            ComTxModeTrue
              ComTxMode: ComTxModeMode=DIRECT, ComTxModeNumberOfRepetitions=0
            ComTxModeFalse
              ComTxMode: ComTxModeMode=NONE
        RDR_DETECTION_089_092_oPCAN_RADAR_4fb0c14f_Tx: ComIPduHandleId=28, ComIPduSignalGroupRef=SG_Detections_089_092_oRDR_DETECTION_089_092_oPCAN_RADAR_e22704c4_Tx, ComPduIdRef=RDR_DETECTION_089_092_oPCAN_RADAR_4fb0c14f_Tx
          ComTxIPdu: ComMinimumDelayTime=0, ComTxIPduUnusedAreasDefault=0
            ComTxModeTrue
              ComTxMode: ComTxModeMode=DIRECT, ComTxModeNumberOfRepetitions=0
            ComTxModeFalse
              ComTxMode: ComTxModeMode=NONE
        RDR_DETECTION_193_196_oPCAN_RADAR_3c6e99d1_Tx: ComIPduHandleId=54, ComIPduSignalGroupRef=SG_Detections_193_196_oRDR_DETECTION_193_196_oPCAN_RADAR_92844e50_Tx, ComPduIdRef=RDR_DETECTION_193_196_oPCAN_RADAR_3c6e99d1_Tx
          ComTxIPdu: ComMinimumDelayTime=0, ComTxIPduUnusedAreasDefault=0
            ComTxModeTrue
              ComTxMode: ComTxModeMode=DIRECT, ComTxModeNumberOfRepetitions=0
            ComTxModeFalse
              ComTxMode: ComTxModeMode=NONE
      SG_TrackerObject052_oRDR_TRACKER_OBJ_052_oPCAN_RADAR_b655cb0e_Tx (ComSignalGroup):
        ComTransferProperty = TRIGGERED
        ComSignalGroupAccess = ACCESS_NEEDED_BY_SWC_OR_COM
        ComHandleId = 161
        ComSignalGroupArrayAccess = true
        ComSystemTemplateSignalGroupRef = SG_TrackerObject052
        49 x ComGroupSignal, all with ComSignalEndianness=BIG_ENDIAN, ComSignalInitValue=0, ComTransferProperty=PENDING, ComSignalAccess=ACCESS_NEEDED_BY_SWC_OR_COM:
          OBJ_CLS_TYPE5_052_oRDR_TRACKER_OBJ_052_oPCAN_RADAR_668b9e48_Tx: ComBitPosition=287, ComBitSize=4, ComSignalType=UINT8, ComHandleId=11042, ComSystemTemplateSystemSignalRef=OBJ_CLS_TYPE5_052
          OBJ_DIMENSION_WIDTH_052_oRDR_TRACKER_OBJ_052_oPCAN_RADAR_5c6bc7ea_Tx: ComBitPosition=17, ComBitSize=10, ComSignalType=UINT16, ComHandleId=11048, ComSystemTemplateSystemSignalRef=OBJ_DIMENSION_WIDTH_052
          OBJ_CLS_TYPE6_PROB_052_oRDR_TRACKER_OBJ_052_oPCAN_RADAR_9b697250_Tx: ComBitPosition=343, ComBitSize=8, ComSignalType=UINT8, ComHandleId=11045, ComSystemTemplateSystemSignalRef=OBJ_CLS_TYPE6_PROB_052
          OBJ_RCS_052_oRDR_TRACKER_OBJ_052_oPCAN_RADAR_2de8f0fd_Tx: ComBitPosition=351, ComBitSize=7, ComSignalType=UINT8, ComHandleId=11062, ComSystemTemplateSystemSignalRef=OBJ_RCS_052
          OBJ_ACCELERATION_LAT_052_oRDR_TRACKER_OBJ_052_oPCAN_RADAR_b8719079_Tx: ComBitPosition=177, ComBitSize=10, ComSignalType=UINT16, ComHandleId=11028, ComSystemTemplateSystemSignalRef=OBJ_ACCELERATION_LAT_052
          OBJ_ALIVE_TIME_052_oRDR_TRACKER_OBJ_052_oPCAN_RADAR_aae08225_Tx: ComBitPosition=255, ComBitSize=16, ComSignalType=UINT16, ComHandleId=11033, ComSystemTemplateSystemSignalRef=OBJ_ALIVE_TIME_052
          OBJ_DIMENSION_WIDTH_ERR_052_oRDR_TRACKER_OBJ_052_oPCAN_RADAR_bcc90002_Tx: ComBitPosition=23, ComBitSize=6, ComSignalType=UINT8, ComHandleId=11049, ComSystemTemplateSystemSignalRef=OBJ_DIMENSION_WIDTH_ERR_052
          OBJ_ID_052_oRDR_TRACKER_OBJ_052_oPCAN_RADAR_2d8b7c7d_Tx: ComBitPosition=7, ComBitSize=8, ComSignalType=UINT8, ComHandleId=11052, ComSystemTemplateSystemSignalRef=OBJ_ID_052
          OBJ_MEASUREMENT_STATUS_052_oRDR_TRACKER_OBJ_052_oPCAN_RADAR_52590ec0_Tx: ComBitPosition=14, ComBitSize=3, ComSignalType=UINT8, ComHandleId=11053, ComSystemTemplateSystemSignalRef=OBJ_MEASUREMENT_STATUS_052
          OBJ_VELOCITY_LAT_ERR_052_oRDR_TRACKER_OBJ_052_oPCAN_RADAR_7fbe938c_Tx: ComBitPosition=151, ComBitSize=8, ComSignalType=UINT8, ComHandleId=11070, ComSystemTemplateSystemSignalRef=OBJ_VELOCITY_LAT_ERR_052
          OBJ_CLS_TYPE5_PROB_052_oRDR_TRACKER_OBJ_052_oPCAN_RADAR_525d695d_Tx: ComBitPosition=335, ComBitSize=8, ComSignalType=UINT8, ComHandleId=11043, ComSystemTemplateSystemSignalRef=OBJ_CLS_TYPE5_PROB_052
          OBJ_CLS_TYPE4_052_oRDR_TRACKER_OBJ_052_oPCAN_RADAR_eb0363aa_Tx: ComBitPosition=275, ComBitSize=4, ComSignalType=UINT8, ComHandleId=11040, ComSystemTemplateSystemSignalRef=OBJ_CLS_TYPE4_052
          OBJ_VELOCITY_ERR_CRR_COEF_052_oRDR_TRACKER_OBJ_052_oPCAN_RADAR_44f26657_Tx: ComBitPosition=423, ComBitSize=8, ComSignalType=UINT8, ComHandleId=11068, ComSystemTemplateSystemSignalRef=OBJ_VELOCITY_ERR_CRR_COEF_052
          OBJ_CLS_TYPE6_052_oRDR_TRACKER_OBJ_052_oPCAN_RADAR_2b639e2f_Tx: ComBitPosition=282, ComBitSize=4, ComSignalType=UINT8, ComHandleId=11044, ComSystemTemplateSystemSignalRef=OBJ_CLS_TYPE6_052
          OBJ_POS_LONG_ERR_052_oRDR_TRACKER_OBJ_052_oPCAN_RADAR_9293082f_Tx: ComBitPosition=95, ComBitSize=8, ComSignalType=UINT8, ComHandleId=11061, ComSystemTemplateSystemSignalRef=OBJ_POS_LONG_ERR_052
          OBJ_GROUP_ID_052_oRDR_TRACKER_OBJ_052_oPCAN_RADAR_dea5577a_Tx: ComBitPosition=405, ComBitSize=6, ComSignalType=UINT8, ComHandleId=11051, ComSystemTemplateSystemSignalRef=OBJ_GROUP_ID_052
          OBJ_CLS_TYPE1_052_oRDR_TRACKER_OBJ_052_oPCAN_RADAR_3d3b6303_Tx: ComBitPosition=271, ComBitSize=4, ComSignalType=UINT8, ComHandleId=11034, ComSystemTemplateSystemSignalRef=OBJ_CLS_TYPE1_052
          OBJ_ACCELERATION_LAT_ERR_052_oRDR_TRACKER_OBJ_052_oPCAN_RADAR_6d85aac7_Tx: ComBitPosition=223, ComBitSize=8, ComSignalType=UINT8, ComHandleId=11029, ComSystemTemplateSystemSignalRef=OBJ_ACCELERATION_LAT_ERR_052
          OBJ_ACCEL_ERR_CRR_COEF_052_oRDR_TRACKER_OBJ_052_oPCAN_RADAR_d2832e0b_Tx: ComBitPosition=431, ComBitSize=8, ComSignalType=UINT8, ComHandleId=11032, ComSystemTemplateSystemSignalRef=OBJ_ACCEL_ERR_CRR_COEF_052
          OBJ_VELOCITY_LAT_052_oRDR_TRACKER_OBJ_052_oPCAN_RADAR_4b44e3dd_Tx: ComBitPosition=126, ComBitSize=15, ComSignalType=UINT16, ComHandleId=11069, ComSystemTemplateSystemSignalRef=OBJ_VELOCITY_LAT_052
          OBJ_ACCELERATION_LONG_ERR_052_oRDR_TRACKER_OBJ_052_oPCAN_RADAR_72200f6d_Tx: ComBitPosition=215, ComBitSize=8, ComSignalType=UINT8, ComHandleId=11031, ComSystemTemplateSystemSignalRef=OBJ_ACCELERATION_LONG_ERR_052
          OBJ_CLS_TYPE3_PROB_052_oRDR_TRACKER_OBJ_052_oPCAN_RADAR_1b445906_Tx: ComBitPosition=319, ComBitSize=8, ComSignalType=UINT8, ComHandleId=11039, ComSystemTemplateSystemSignalRef=OBJ_CLS_TYPE3_PROB_052
          OBJ_TRACK_MOTION_MODEL_052_oRDR_TRACKER_OBJ_052_oPCAN_RADAR_e147f176_Tx: ComBitPosition=9, ComBitSize=2, ComSignalType=UINT8, ComHandleId=11066, ComSystemTemplateSystemSignalRef=OBJ_TRACK_MOTION_MODEL_052
          OBJ_DIMENSION_LENGTH_052_oRDR_TRACKER_OBJ_052_oPCAN_RADAR_7fa53047_Tx: ComBitPosition=37, ComBitSize=12, ComSignalType=UINT16, ComHandleId=11046, ComSystemTemplateSystemSignalRef=OBJ_DIMENSION_LENGTH_052
          OBJ_YAW_RATE_052_oRDR_TRACKER_OBJ_052_oPCAN_RADAR_827782da_Tx: ComBitPosition=399, ComBitSize=10, ComSignalType=UINT16, ComHandleId=11075, ComSystemTemplateSystemSignalRef=OBJ_YAW_RATE_052
          OBJ_MOVEMENT_STATUS_052_oRDR_TRACKER_OBJ_052_oPCAN_RADAR_7df79b8c_Tx: ComBitPosition=196, ComBitSize=3, ComSignalType=UINT8, ComHandleId=11056, ComSystemTemplateSystemSignalRef=OBJ_MOVEMENT_STATUS_052
          OBJ_YAW_ANGLE_052_oRDR_TRACKER_OBJ_052_oPCAN_RADAR_a7f8a79d_Tx: ComBitPosition=155, ComBitSize=12, ComSignalType=UINT16, ComHandleId=11073, ComSystemTemplateSystemSignalRef=OBJ_YAW_ANGLE_052
          OBJ_POS_ERR_CRR_COEF_052_oRDR_TRACKER_OBJ_052_oPCAN_RADAR_ed885bb6_Tx: ComBitPosition=415, ComBitSize=8, ComSignalType=UINT8, ComHandleId=11057, ComSystemTemplateSystemSignalRef=OBJ_POS_ERR_CRR_COEF_052
          OBJ_TIMESTAMP_OFFSET_052_oRDR_TRACKER_OBJ_052_oPCAN_RADAR_2d44f0ab_Tx: ComBitPosition=247, ComBitSize=8, ComSignalType=UINT8, ComHandleId=11065, ComSystemTemplateSystemSignalRef=OBJ_TIMESTAMP_OFFSET_052
          OBJ_ACCELERATION_LONG_052_oRDR_TRACKER_OBJ_052_oPCAN_RADAR_ca81c999_Tx: ComBitPosition=193, ComBitSize=10, ComSignalType=UINT16, ComHandleId=11030, ComSystemTemplateSystemSignalRef=OBJ_ACCELERATION_LONG_052
          OBJ_YAW_ANGLE_ERR_052_oRDR_TRACKER_OBJ_052_oPCAN_RADAR_72f5a14a_Tx: ComBitPosition=175, ComBitSize=7, ComSignalType=UINT8, ComHandleId=11074, ComSystemTemplateSystemSignalRef=OBJ_YAW_ANGLE_ERR_052
          OBJ_VEH_TRACK_FLAG_052_oRDR_TRACKER_OBJ_052_oPCAN_RADAR_636d072b_Tx: ComBitPosition=10, ComBitSize=1, ComSignalType=BOOLEAN, ComHandleId=11067, ComSystemTemplateSystemSignalRef=OBJ_VEH_TRACK_FLAG_052
          OBJ_POS_LONG_052_oRDR_TRACKER_OBJ_052_oPCAN_RADAR_be874d35_Tx: ComBitPosition=63, ComBitSize=16, ComSignalType=UINT16, ComHandleId=11060, ComSystemTemplateSystemSignalRef=OBJ_POS_LONG_052
          OBJ_CLS_TYPE2_PROB_052_oRDR_TRACKER_OBJ_052_oPCAN_RADAR_5c57affd_Tx: ComBitPosition=311, ComBitSize=8, ComSignalType=UINT8, ComHandleId=11037, ComSystemTemplateSystemSignalRef=OBJ_CLS_TYPE2_PROB_052
          OBJ_CLS_TYPE3_052_oRDR_TRACKER_OBJ_052_oPCAN_RADAR_fd5b9e86_Tx: ComBitPosition=279, ComBitSize=4, ComSignalType=UINT8, ComHandleId=11038, ComSystemTemplateSystemSignalRef=OBJ_CLS_TYPE3_052
          OBJ_CLS_TYPE4_PROB_052_oRDR_TRACKER_OBJ_052_oPCAN_RADAR_154e9fa6_Tx: ComBitPosition=327, ComBitSize=8, ComSignalType=UINT8, ComHandleId=11041, ComSystemTemplateSystemSignalRef=OBJ_CLS_TYPE4_PROB_052
          OBJ_VELOCITY_LONG_ERR_052_oRDR_TRACKER_OBJ_052_oPCAN_RADAR_933cac4c_Tx: ComBitPosition=143, ComBitSize=8, ComSignalType=UINT8, ComHandleId=11072, ComSystemTemplateSystemSignalRef=OBJ_VELOCITY_LONG_ERR_052
          OBJ_REF_PT_LAT_OFFSET_052_oRDR_TRACKER_OBJ_052_oPCAN_RADAR_d8d59b88_Tx: ComBitPosition=370, ComBitSize=14, ComSignalType=UINT16, ComHandleId=11063, ComSystemTemplateSystemSignalRef=OBJ_REF_PT_LAT_OFFSET_052
          OBJ_EXISTENCE_PROB_052_oRDR_TRACKER_OBJ_052_oPCAN_RADAR_57d743d7_Tx: ComBitPosition=229, ComBitSize=14, ComSignalType=UINT16, ComHandleId=11050, ComSystemTemplateSystemSignalRef=OBJ_EXISTENCE_PROB_052
          OBJ_YAW_RATE_ERR_052_oRDR_TRACKER_OBJ_052_oPCAN_RADAR_bdaf1506_Tx: ComBitPosition=388, ComBitSize=5, ComSignalType=UINT8, ComHandleId=11076, ComSystemTemplateSystemSignalRef=OBJ_YAW_RATE_ERR_052
          OBJ_DIMENSION_LENGTH_ERR_052_oRDR_TRACKER_OBJ_052_oPCAN_RADAR_445d2f3d_Tx: ComBitPosition=41, ComBitSize=10, ComSignalType=UINT16, ComHandleId=11047, ComSystemTemplateSystemSignalRef=OBJ_DIMENSION_LENGTH_ERR_052
          OBJ_REF_PT_LONG_OFFSET_052_oRDR_TRACKER_OBJ_052_oPCAN_RADAR_97876b8b_Tx: ComBitPosition=357, ComBitSize=14, ComSignalType=UINT16, ComHandleId=11064, ComSystemTemplateSystemSignalRef=OBJ_REF_PT_LONG_OFFSET_052
          OBJ_POS_LAT_ERR_052_oRDR_TRACKER_OBJ_052_oPCAN_RADAR_0b6bf6cd_Tx: ComBitPosition=103, ComBitSize=8, ComSignalType=UINT8, ComHandleId=11059, ComSystemTemplateSystemSignalRef=OBJ_POS_LAT_ERR_052
          OBJ_POS_LAT_052_oRDR_TRACKER_OBJ_052_oPCAN_RADAR_0f27a6fa_Tx: ComBitPosition=79, ComBitSize=16, ComSignalType=UINT16, ComHandleId=11058, ComSystemTemplateSystemSignalRef=OBJ_POS_LAT_052
          OBJ_VELOCITY_LONG_052_oRDR_TRACKER_OBJ_052_oPCAN_RADAR_1bc99b1b_Tx: ComBitPosition=110, ComBitSize=15, ComSignalType=UINT16, ComHandleId=11071, ComSystemTemplateSystemSignalRef=OBJ_VELOCITY_LONG_052
          OBJ_CLS_TYPE1_PROB_052_oRDR_TRACKER_OBJ_052_oPCAN_RADAR_9563b4f0_Tx: ComBitPosition=303, ComBitSize=8, ComSignalType=UINT8, ComHandleId=11035, ComSystemTemplateSystemSignalRef=OBJ_CLS_TYPE1_PROB_052
          OBJ_CLS_TYPE2_052_oRDR_TRACKER_OBJ_052_oPCAN_RADAR_70d36364_Tx: ComBitPosition=267, ComBitSize=4, ComSignalType=UINT8, ComHandleId=11036, ComSystemTemplateSystemSignalRef=OBJ_CLS_TYPE2_052
          OBJ_MH_CRC16_052_oRDR_TRACKER_OBJ_052_oPCAN_RADAR_2e39b9fc_Tx: ComBitPosition=495, ComBitSize=16, ComSignalType=UINT16, ComHandleId=11054, ComSystemTemplateSystemSignalRef=OBJ_MH_CRC16_052
          OBJ_MH_CYCLE_COUNTER_052_oRDR_TRACKER_OBJ_052_oPCAN_RADAR_5fdde31d_Tx: ComBitPosition=487, ComBitSize=8, ComSignalType=UINT8, ComHandleId=11055, ComSystemTemplateSystemSignalRef=OBJ_MH_CYCLE_COUNTER_052
      RDR_DETECTION_061_064_oPCAN_RADAR_46fcf773_Tx (ComIPdu):
        ComIPduDirection = SEND
        ComIPduType = NORMAL
        ComIPduCancellationSupport = false
        ComIPduHandleId = 21
        ComIPduSignalProcessing = DEFERRED
        ComIPduChannelRef = CN_PCAN_RADAR_458ff0f1
        ComIPduGroupRef = RDR01_oPCAN_RADAR_Tx_b6bdb067 if post-build-variant-condition{matching-criterion=RDR_POS, value=0}
        ComIPduSignalGroupRef = SG_Detections_061_064_oRDR_DETECTION_061_064_oPCAN_RADAR_80d67553_Tx
        ComPduIdRef = RDR_DETECTION_061_064_oPCAN_RADAR_46fcf773_Tx
        ComIPduMainFunctionRef = ComMainFunctionTx_Event
        ComIPduGroupRef = RDR02_oPCAN_RADAR_Tx_9f750495 if post-build-variant-condition{matching-criterion=RDR_POS, value=1}
        ComIPduGroupRef = RDR03_oPCAN_RADAR_Tx_311d9504 if post-build-variant-condition{matching-criterion=RDR_POS, value=2}
        ComIPduGroupRef = RDR04_oPCAN_RADAR_Tx_cce46d71 if post-build-variant-condition{matching-criterion=RDR_POS, value=3}
        ComIPduGroupRef = RDR05_oPCAN_RADAR_Tx_628cfce0 if post-build-variant-condition{matching-criterion=RDR_POS, value=4}
        ComIPduGroupRef = RDR06_oPCAN_RADAR_Tx_4b444812 if post-build-variant-condition{matching-criterion=RDR_POS, value=5}
        ComIPduGroupRef = RDR07_oPCAN_RADAR_Tx_e52cd983 if post-build-variant-condition{matching-criterion=RDR_POS, value=6}
        ComIPduGroupRef = RDR08_oPCAN_RADAR_Tx_6bc6beb9 if post-build-variant-condition{matching-criterion=RDR_POS, value=7}
        ComTxIPdu: ComMinimumDelayTime=0, ComTxIPduUnusedAreasDefault=0
          ComTxModeTrue
            ComTxMode: ComTxModeMode=DIRECT, ComTxModeNumberOfRepetitions=0
          ComTxModeFalse
            ComTxMode: ComTxModeMode=NONE
      RDR_DETECTION_097_100_oPCAN_RADAR_96371edb_Tx (ComIPdu):
        ComIPduDirection = SEND
        ComIPduType = NORMAL
        ComIPduCancellationSupport = false
        ComIPduHandleId = 30
        ComIPduSignalProcessing = DEFERRED
        ComIPduChannelRef = CN_PCAN_RADAR_458ff0f1
        ComIPduGroupRef = RDR01_oPCAN_RADAR_Tx_b6bdb067 if post-build-variant-condition{matching-criterion=RDR_POS, value=0}
        ComIPduSignalGroupRef = SG_Detections_097_100_oRDR_DETECTION_097_100_oPCAN_RADAR_dcf343f6_Tx
        ComPduIdRef = RDR_DETECTION_097_100_oPCAN_RADAR_96371edb_Tx
        ComIPduMainFunctionRef = ComMainFunctionTx_Event
        ComIPduGroupRef = RDR02_oPCAN_RADAR_Tx_9f750495 if post-build-variant-condition{matching-criterion=RDR_POS, value=1}
        ComIPduGroupRef = RDR03_oPCAN_RADAR_Tx_311d9504 if post-build-variant-condition{matching-criterion=RDR_POS, value=2}
        ComIPduGroupRef = RDR04_oPCAN_RADAR_Tx_cce46d71 if post-build-variant-condition{matching-criterion=RDR_POS, value=3}
        ComIPduGroupRef = RDR05_oPCAN_RADAR_Tx_628cfce0 if post-build-variant-condition{matching-criterion=RDR_POS, value=4}
        ComIPduGroupRef = RDR06_oPCAN_RADAR_Tx_4b444812 if post-build-variant-condition{matching-criterion=RDR_POS, value=5}
        ComIPduGroupRef = RDR07_oPCAN_RADAR_Tx_e52cd983 if post-build-variant-condition{matching-criterion=RDR_POS, value=6}
        ComIPduGroupRef = RDR08_oPCAN_RADAR_Tx_6bc6beb9 if post-build-variant-condition{matching-criterion=RDR_POS, value=7}
        ComTxIPdu: ComMinimumDelayTime=0, ComTxIPduUnusedAreasDefault=0
          ComTxModeTrue
            ComTxMode: ComTxModeMode=DIRECT, ComTxModeNumberOfRepetitions=0
          ComTxModeFalse
            ComTxMode: ComTxModeMode=NONE
      SG_TrackerObject039_oRDR_TRACKER_OBJ_039_oPCAN_RADAR_f76c39c3_Tx (ComSignalGroup):
        ComTransferProperty = TRIGGERED
        ComSignalGroupAccess = ACCESS_NEEDED_BY_SWC_OR_COM
        ComHandleId = 148
        ComSignalGroupArrayAccess = true
        ComSystemTemplateSignalGroupRef = SG_TrackerObject039
        49 x ComGroupSignal, all with ComSignalEndianness=BIG_ENDIAN, ComSignalInitValue=0, ComTransferProperty=PENDING, ComSignalAccess=ACCESS_NEEDED_BY_SWC_OR_COM:
          OBJ_ALIVE_TIME_039_oRDR_TRACKER_OBJ_039_oPCAN_RADAR_ebd970e8_Tx: ComBitPosition=255, ComBitSize=16, ComSignalType=UINT16, ComHandleId=10396, ComSystemTemplateSystemSignalRef=OBJ_ALIVE_TIME_039
          OBJ_ACCELERATION_LONG_039_oRDR_TRACKER_OBJ_039_oPCAN_RADAR_8bb83b54_Tx: ComBitPosition=193, ComBitSize=10, ComSignalType=UINT16, ComHandleId=10393, ComSystemTemplateSystemSignalRef=OBJ_ACCELERATION_LONG_039
          OBJ_CLS_TYPE1_PROB_039_oRDR_TRACKER_OBJ_039_oPCAN_RADAR_d45a463d_Tx: ComBitPosition=303, ComBitSize=8, ComSignalType=UINT8, ComHandleId=10398, ComSystemTemplateSystemSignalRef=OBJ_CLS_TYPE1_PROB_039
          OBJ_REF_PT_LONG_OFFSET_039_oRDR_TRACKER_OBJ_039_oPCAN_RADAR_d6be9946_Tx: ComBitPosition=357, ComBitSize=14, ComSignalType=UINT16, ComHandleId=10427, ComSystemTemplateSystemSignalRef=OBJ_REF_PT_LONG_OFFSET_039
          OBJ_ACCELERATION_LONG_ERR_039_oRDR_TRACKER_OBJ_039_oPCAN_RADAR_3319fda0_Tx: ComBitPosition=215, ComBitSize=8, ComSignalType=UINT8, ComHandleId=10394, ComSystemTemplateSystemSignalRef=OBJ_ACCELERATION_LONG_ERR_039
          OBJ_DIMENSION_WIDTH_039_oRDR_TRACKER_OBJ_039_oPCAN_RADAR_1d523527_Tx: ComBitPosition=17, ComBitSize=10, ComSignalType=UINT16, ComHandleId=10411, ComSystemTemplateSystemSignalRef=OBJ_DIMENSION_WIDTH_039
          OBJ_YAW_RATE_ERR_039_oRDR_TRACKER_OBJ_039_oPCAN_RADAR_fc96e7cb_Tx: ComBitPosition=388, ComBitSize=5, ComSignalType=UINT8, ComHandleId=10439, ComSystemTemplateSystemSignalRef=OBJ_YAW_RATE_ERR_039
          OBJ_POS_LONG_039_oRDR_TRACKER_OBJ_039_oPCAN_RADAR_ffbebff8_Tx: ComBitPosition=63, ComBitSize=16, ComSignalType=UINT16, ComHandleId=10423, ComSystemTemplateSystemSignalRef=OBJ_POS_LONG_039
          OBJ_CLS_TYPE5_039_oRDR_TRACKER_OBJ_039_oPCAN_RADAR_27b26c85_Tx: ComBitPosition=287, ComBitSize=4, ComSignalType=UINT8, ComHandleId=10405, ComSystemTemplateSystemSignalRef=OBJ_CLS_TYPE5_039
          OBJ_TRACK_MOTION_MODEL_039_oRDR_TRACKER_OBJ_039_oPCAN_RADAR_a07e03bb_Tx: ComBitPosition=9, ComBitSize=2, ComSignalType=UINT8, ComHandleId=10429, ComSystemTemplateSystemSignalRef=OBJ_TRACK_MOTION_MODEL_039
          OBJ_POS_LAT_039_oRDR_TRACKER_OBJ_039_oPCAN_RADAR_4e1e5437_Tx: ComBitPosition=79, ComBitSize=16, ComSignalType=UINT16, ComHandleId=10421, ComSystemTemplateSystemSignalRef=OBJ_POS_LAT_039
          OBJ_CLS_TYPE6_039_oRDR_TRACKER_OBJ_039_oPCAN_RADAR_6a5a6ce2_Tx: ComBitPosition=282, ComBitSize=4, ComSignalType=UINT8, ComHandleId=10407, ComSystemTemplateSystemSignalRef=OBJ_CLS_TYPE6_039
          OBJ_ID_039_oRDR_TRACKER_OBJ_039_oPCAN_RADAR_6cb28eb0_Tx: ComBitPosition=7, ComBitSize=8, ComSignalType=UINT8, ComHandleId=10415, ComSystemTemplateSystemSignalRef=OBJ_ID_039
          OBJ_POS_LAT_ERR_039_oRDR_TRACKER_OBJ_039_oPCAN_RADAR_4a520400_Tx: ComBitPosition=103, ComBitSize=8, ComSignalType=UINT8, ComHandleId=10422, ComSystemTemplateSystemSignalRef=OBJ_POS_LAT_ERR_039
          OBJ_CLS_TYPE2_039_oRDR_TRACKER_OBJ_039_oPCAN_RADAR_31ea91a9_Tx: ComBitPosition=267, ComBitSize=4, ComSignalType=UINT8, ComHandleId=10399, ComSystemTemplateSystemSignalRef=OBJ_CLS_TYPE2_039
          OBJ_ACCELERATION_LAT_ERR_039_oRDR_TRACKER_OBJ_039_oPCAN_RADAR_2cbc580a_Tx: ComBitPosition=223, ComBitSize=8, ComSignalType=UINT8, ComHandleId=10392, ComSystemTemplateSystemSignalRef=OBJ_ACCELERATION_LAT_ERR_039
          OBJ_GROUP_ID_039_oRDR_TRACKER_OBJ_039_oPCAN_RADAR_9f9ca5b7_Tx: ComBitPosition=405, ComBitSize=6, ComSignalType=UINT8, ComHandleId=10414, ComSystemTemplateSystemSignalRef=OBJ_GROUP_ID_039
          OBJ_EXISTENCE_PROB_039_oRDR_TRACKER_OBJ_039_oPCAN_RADAR_16eeb11a_Tx: ComBitPosition=229, ComBitSize=14, ComSignalType=UINT16, ComHandleId=10413, ComSystemTemplateSystemSignalRef=OBJ_EXISTENCE_PROB_039
          OBJ_REF_PT_LAT_OFFSET_039_oRDR_TRACKER_OBJ_039_oPCAN_RADAR_99ec6945_Tx: ComBitPosition=370, ComBitSize=14, ComSignalType=UINT16, ComHandleId=10426, ComSystemTemplateSystemSignalRef=OBJ_REF_PT_LAT_OFFSET_039
          OBJ_VELOCITY_ERR_CRR_COEF_039_oRDR_TRACKER_OBJ_039_oPCAN_RADAR_05cb949a_Tx: ComBitPosition=423, ComBitSize=8, ComSignalType=UINT8, ComHandleId=10431, ComSystemTemplateSystemSignalRef=OBJ_VELOCITY_ERR_CRR_COEF_039
          OBJ_CLS_TYPE4_PROB_039_oRDR_TRACKER_OBJ_039_oPCAN_RADAR_54776d6b_Tx: ComBitPosition=327, ComBitSize=8, ComSignalType=UINT8, ComHandleId=10404, ComSystemTemplateSystemSignalRef=OBJ_CLS_TYPE4_PROB_039
          OBJ_ACCELERATION_LAT_039_oRDR_TRACKER_OBJ_039_oPCAN_RADAR_f94862b4_Tx: ComBitPosition=177, ComBitSize=10, ComSignalType=UINT16, ComHandleId=10391, ComSystemTemplateSystemSignalRef=OBJ_ACCELERATION_LAT_039
          OBJ_CLS_TYPE5_PROB_039_oRDR_TRACKER_OBJ_039_oPCAN_RADAR_13649b90_Tx: ComBitPosition=335, ComBitSize=8, ComSignalType=UINT8, ComHandleId=10406, ComSystemTemplateSystemSignalRef=OBJ_CLS_TYPE5_PROB_039
          OBJ_VELOCITY_LONG_039_oRDR_TRACKER_OBJ_039_oPCAN_RADAR_5af069d6_Tx: ComBitPosition=110, ComBitSize=15, ComSignalType=UINT16, ComHandleId=10434, ComSystemTemplateSystemSignalRef=OBJ_VELOCITY_LONG_039
          OBJ_TIMESTAMP_OFFSET_039_oRDR_TRACKER_OBJ_039_oPCAN_RADAR_6c7d0266_Tx: ComBitPosition=247, ComBitSize=8, ComSignalType=UINT8, ComHandleId=10428, ComSystemTemplateSystemSignalRef=OBJ_TIMESTAMP_OFFSET_039
          OBJ_CLS_TYPE4_039_oRDR_TRACKER_OBJ_039_oPCAN_RADAR_aa3a9167_Tx: ComBitPosition=275, ComBitSize=4, ComSignalType=UINT8, ComHandleId=10403, ComSystemTemplateSystemSignalRef=OBJ_CLS_TYPE4_039
          OBJ_MOVEMENT_STATUS_039_oRDR_TRACKER_OBJ_039_oPCAN_RADAR_3cce6941_Tx: ComBitPosition=196, ComBitSize=3, ComSignalType=UINT8, ComHandleId=10419, ComSystemTemplateSystemSignalRef=OBJ_MOVEMENT_STATUS_039
          OBJ_POS_LONG_ERR_039_oRDR_TRACKER_OBJ_039_oPCAN_RADAR_d3aafae2_Tx: ComBitPosition=95, ComBitSize=8, ComSignalType=UINT8, ComHandleId=10424, ComSystemTemplateSystemSignalRef=OBJ_POS_LONG_ERR_039
          OBJ_YAW_ANGLE_ERR_039_oRDR_TRACKER_OBJ_039_oPCAN_RADAR_33cc5387_Tx: ComBitPosition=175, ComBitSize=7, ComSignalType=UINT8, ComHandleId=10437, ComSystemTemplateSystemSignalRef=OBJ_YAW_ANGLE_ERR_039
          OBJ_CLS_TYPE1_039_oRDR_TRACKER_OBJ_039_oPCAN_RADAR_7c0291ce_Tx: ComBitPosition=271, ComBitSize=4, ComSignalType=UINT8, ComHandleId=10397, ComSystemTemplateSystemSignalRef=OBJ_CLS_TYPE1_039
          OBJ_DIMENSION_LENGTH_ERR_039_oRDR_TRACKER_OBJ_039_oPCAN_RADAR_0564ddf0_Tx: ComBitPosition=41, ComBitSize=10, ComSignalType=UINT16, ComHandleId=10410, ComSystemTemplateSystemSignalRef=OBJ_DIMENSION_LENGTH_ERR_039
          OBJ_YAW_RATE_039_oRDR_TRACKER_OBJ_039_oPCAN_RADAR_c34e7017_Tx: ComBitPosition=399, ComBitSize=10, ComSignalType=UINT16, ComHandleId=10438, ComSystemTemplateSystemSignalRef=OBJ_YAW_RATE_039
          OBJ_ACCEL_ERR_CRR_COEF_039_oRDR_TRACKER_OBJ_039_oPCAN_RADAR_93badcc6_Tx: ComBitPosition=431, ComBitSize=8, ComSignalType=UINT8, ComHandleId=10395, ComSystemTemplateSystemSignalRef=OBJ_ACCEL_ERR_CRR_COEF_039
          OBJ_RCS_039_oRDR_TRACKER_OBJ_039_oPCAN_RADAR_6cd10230_Tx: ComBitPosition=351, ComBitSize=7, ComSignalType=UINT8, ComHandleId=10425, ComSystemTemplateSystemSignalRef=OBJ_RCS_039
          OBJ_DIMENSION_LENGTH_039_oRDR_TRACKER_OBJ_039_oPCAN_RADAR_3e9cc28a_Tx: ComBitPosition=37, ComBitSize=12, ComSignalType=UINT16, ComHandleId=10409, ComSystemTemplateSystemSignalRef=OBJ_DIMENSION_LENGTH_039
          OBJ_YAW_ANGLE_039_oRDR_TRACKER_OBJ_039_oPCAN_RADAR_e6c15550_Tx: ComBitPosition=155, ComBitSize=12, ComSignalType=UINT16, ComHandleId=10436, ComSystemTemplateSystemSignalRef=OBJ_YAW_ANGLE_039
          OBJ_VELOCITY_LAT_039_oRDR_TRACKER_OBJ_039_oPCAN_RADAR_0a7d1110_Tx: ComBitPosition=126, ComBitSize=15, ComSignalType=UINT16, ComHandleId=10432, ComSystemTemplateSystemSignalRef=OBJ_VELOCITY_LAT_039
          OBJ_CLS_TYPE6_PROB_039_oRDR_TRACKER_OBJ_039_oPCAN_RADAR_da50809d_Tx: ComBitPosition=343, ComBitSize=8, ComSignalType=UINT8, ComHandleId=10408, ComSystemTemplateSystemSignalRef=OBJ_CLS_TYPE6_PROB_039
          OBJ_VEH_TRACK_FLAG_039_oRDR_TRACKER_OBJ_039_oPCAN_RADAR_2254f5e6_Tx: ComBitPosition=10, ComBitSize=1, ComSignalType=BOOLEAN, ComHandleId=10430, ComSystemTemplateSystemSignalRef=OBJ_VEH_TRACK_FLAG_039
          OBJ_VELOCITY_LAT_ERR_039_oRDR_TRACKER_OBJ_039_oPCAN_RADAR_3e876141_Tx: ComBitPosition=151, ComBitSize=8, ComSignalType=UINT8, ComHandleId=10433, ComSystemTemplateSystemSignalRef=OBJ_VELOCITY_LAT_ERR_039
          OBJ_CLS_TYPE3_039_oRDR_TRACKER_OBJ_039_oPCAN_RADAR_bc626c4b_Tx: ComBitPosition=279, ComBitSize=4, ComSignalType=UINT8, ComHandleId=10401, ComSystemTemplateSystemSignalRef=OBJ_CLS_TYPE3_039
          OBJ_CLS_TYPE3_PROB_039_oRDR_TRACKER_OBJ_039_oPCAN_RADAR_5a7dabcb_Tx: ComBitPosition=319, ComBitSize=8, ComSignalType=UINT8, ComHandleId=10402, ComSystemTemplateSystemSignalRef=OBJ_CLS_TYPE3_PROB_039
          OBJ_POS_ERR_CRR_COEF_039_oRDR_TRACKER_OBJ_039_oPCAN_RADAR_acb1a97b_Tx: ComBitPosition=415, ComBitSize=8, ComSignalType=UINT8, ComHandleId=10420, ComSystemTemplateSystemSignalRef=OBJ_POS_ERR_CRR_COEF_039
          OBJ_DIMENSION_WIDTH_ERR_039_oRDR_TRACKER_OBJ_039_oPCAN_RADAR_fdf0f2cf_Tx: ComBitPosition=23, ComBitSize=6, ComSignalType=UINT8, ComHandleId=10412, ComSystemTemplateSystemSignalRef=OBJ_DIMENSION_WIDTH_ERR_039
          OBJ_VELOCITY_LONG_ERR_039_oRDR_TRACKER_OBJ_039_oPCAN_RADAR_d2055e81_Tx: ComBitPosition=143, ComBitSize=8, ComSignalType=UINT8, ComHandleId=10435, ComSystemTemplateSystemSignalRef=OBJ_VELOCITY_LONG_ERR_039
          OBJ_CLS_TYPE2_PROB_039_oRDR_TRACKER_OBJ_039_oPCAN_RADAR_1d6e5d30_Tx: ComBitPosition=311, ComBitSize=8, ComSignalType=UINT8, ComHandleId=10400, ComSystemTemplateSystemSignalRef=OBJ_CLS_TYPE2_PROB_039
          OBJ_MEASUREMENT_STATUS_039_oRDR_TRACKER_OBJ_039_oPCAN_RADAR_1360fc0d_Tx: ComBitPosition=14, ComBitSize=3, ComSignalType=UINT8, ComHandleId=10416, ComSystemTemplateSystemSignalRef=OBJ_MEASUREMENT_STATUS_039
          OBJ_MH_CRC16_039_oRDR_TRACKER_OBJ_039_oPCAN_RADAR_6f004b31_Tx: ComBitPosition=495, ComBitSize=16, ComSignalType=UINT16, ComHandleId=10417, ComSystemTemplateSystemSignalRef=OBJ_MH_CRC16_039
          OBJ_MH_CYCLE_COUNTER_039_oRDR_TRACKER_OBJ_039_oPCAN_RADAR_1ee411d0_Tx: ComBitPosition=487, ComBitSize=8, ComSignalType=UINT8, ComHandleId=10418, ComSystemTemplateSystemSignalRef=OBJ_MH_CYCLE_COUNTER_039
      9 x ComIPdu, all with ComIPduDirection=SEND, ComIPduType=NORMAL, ComIPduCancellationSupport=false, ComIPduSignalProcessing=DEFERRED, ComIPduChannelRef=CN_PCAN_RADAR_458ff0f1, ComIPduGroupRef=RDR01_oPCAN_RADAR_Tx_b6bdb067 if post-build-variant-condition{matching-criterion=RDR_POS, value=0}, ComIPduMainFunctionRef=ComMainFunctionTx_Event, ComIPduGroupRef=RDR02_oPCAN_RADAR_Tx_9f750495 if post-build-variant-condition{matching-criterion=RDR_POS, value=1}, ComIPduGroupRef=RDR03_oPCAN_RADAR_Tx_311d9504 if post-build-variant-condition{matching-criterion=RDR_POS, value=2}, ComIPduGroupRef=RDR04_oPCAN_RADAR_Tx_cce46d71 if post-build-variant-condition{matching-criterion=RDR_POS, value=3}, ComIPduGroupRef=RDR05_oPCAN_RADAR_Tx_628cfce0 if post-build-variant-condition{matching-criterion=RDR_POS, value=4}, ComIPduGroupRef=RDR06_oPCAN_RADAR_Tx_4b444812 if post-build-variant-condition{matching-criterion=RDR_POS, value=5}, ComIPduGroupRef=RDR07_oPCAN_RADAR_Tx_e52cd983 if post-build-variant-condition{matching-criterion=RDR_POS, value=6}, ComIPduGroupRef=RDR08_oPCAN_RADAR_Tx_6bc6beb9 if post-build-variant-condition{matching-criterion=RDR_POS, value=7}:
        RDR_DETECTION_125_128_oPCAN_RADAR_d3536aea_Tx: ComIPduHandleId=37, ComIPduSignalGroupRef=SG_Detections_125_128_oRDR_DETECTION_125_128_oPCAN_RADAR_d9562319_Tx, ComPduIdRef=RDR_DETECTION_125_128_oPCAN_RADAR_d3536aea_Tx
          ComTxIPdu: ComMinimumDelayTime=0, ComTxIPduUnusedAreasDefault=0
            ComTxModeTrue
              ComTxMode: ComTxModeMode=DIRECT, ComTxModeNumberOfRepetitions=0
            ComTxModeFalse
              ComTxMode: ComTxModeMode=NONE
        RDR_DETECTION_121_124_oPCAN_RADAR_3ae1f4de_Tx: ComIPduHandleId=36, ComIPduSignalGroupRef=SG_Detections_121_124_oRDR_DETECTION_121_124_oPCAN_RADAR_a895174b_Tx, ComPduIdRef=RDR_DETECTION_121_124_oPCAN_RADAR_3ae1f4de_Tx
          ComTxIPdu: ComMinimumDelayTime=0, ComTxIPduUnusedAreasDefault=0
            ComTxModeTrue
              ComTxMode: ComTxModeMode=DIRECT, ComTxModeNumberOfRepetitions=0
            ComTxModeFalse
              ComTxMode: ComTxModeMode=NONE
        RDR_DETECTION_081_084_oPCAN_RADAR_944ab07a_Tx: ComIPduHandleId=26, ComIPduSignalGroupRef=SG_Detections_081_084_oRDR_DETECTION_081_084_oPCAN_RADAR_0a9e14ed_Tx, ComPduIdRef=RDR_DETECTION_081_084_oPCAN_RADAR_944ab07a_Tx
          ComTxIPdu: ComMinimumDelayTime=0, ComTxIPduUnusedAreasDefault=0
            ComTxModeTrue
              ComTxMode: ComTxModeMode=DIRECT, ComTxModeNumberOfRepetitions=0
            ComTxModeFalse
              ComTxMode: ComTxModeMode=NONE
        RDR_DETECTION_361_364_oPCAN_RADAR_f4d71ba3_Tx: ComIPduHandleId=96, ComIPduSignalGroupRef=SG_Detections_361_364_oRDR_DETECTION_361_364_oPCAN_RADAR_472e1297_Tx, ComPduIdRef=RDR_DETECTION_361_364_oPCAN_RADAR_f4d71ba3_Tx
          ComTxIPdu: ComMinimumDelayTime=0, ComTxIPduUnusedAreasDefault=0
            ComTxModeTrue
              ComTxMode: ComTxModeMode=DIRECT, ComTxModeNumberOfRepetitions=0
            ComTxModeFalse
              ComTxMode: ComTxModeMode=NONE
        RDR_TRACKER_OBJ_026_oPCAN_RADAR_b29a39a3_Tx: ComIPduHandleId=136, ComIPduSignalGroupRef=SG_TrackerObject026_oRDR_TRACKER_OBJ_026_oPCAN_RADAR_8261223b_Tx, ComPduIdRef=RDR_TRACKER_OBJ_026_oPCAN_RADAR_b29a39a3_Tx
          ComTxIPdu: ComMinimumDelayTime=0, ComTxIPduUnusedAreasDefault=0
            ComTxModeTrue
              ComTxMode: ComTxModeMode=DIRECT, ComTxModeNumberOfRepetitions=0
            ComTxModeFalse
              ComTxMode: ComTxModeMode=NONE
        RDR_TRACKER_OBJ_052_oPCAN_RADAR_17eef9f5_Tx: ComIPduHandleId=162, ComIPduSignalGroupRef=SG_TrackerObject052_oRDR_TRACKER_OBJ_052_oPCAN_RADAR_b655cb0e_Tx, ComPduIdRef=RDR_TRACKER_OBJ_052_oPCAN_RADAR_17eef9f5_Tx
          ComTxIPdu: ComMinimumDelayTime=0, ComTxIPduUnusedAreasDefault=0
            ComTxModeTrue
              ComTxMode: ComTxModeMode=DIRECT, ComTxModeNumberOfRepetitions=0
            ComTxModeFalse
              ComTxMode: ComTxModeMode=NONE
        RDR_TRACKER_OBJ_057_oPCAN_RADAR_0ac14ae6_Tx: ComIPduHandleId=167, ComIPduSignalGroupRef=SG_TrackerObject057_oRDR_TRACKER_OBJ_057_oPCAN_RADAR_1df16df3_Tx, ComPduIdRef=RDR_TRACKER_OBJ_057_oPCAN_RADAR_0ac14ae6_Tx
          ComTxIPdu: ComMinimumDelayTime=0, ComTxIPduUnusedAreasDefault=0
            ComTxModeTrue
              ComTxMode: ComTxModeMode=DIRECT, ComTxModeNumberOfRepetitions=0
            ComTxModeFalse
              ComTxMode: ComTxModeMode=NONE
        RDR_TRACKER_OBJ_037_oPCAN_RADAR_f2030150_Tx: ComIPduHandleId=147, ComIPduSignalGroupRef=SG_TrackerObject037_oRDR_TRACKER_OBJ_037_oPCAN_RADAR_29e45c36_Tx, ComPduIdRef=RDR_TRACKER_OBJ_037_oPCAN_RADAR_f2030150_Tx
          ComTxIPdu: ComMinimumDelayTime=0, ComTxIPduUnusedAreasDefault=0
            ComTxModeTrue
              ComTxMode: ComTxModeMode=DIRECT, ComTxModeNumberOfRepetitions=0
            ComTxModeFalse
              ComTxMode: ComTxModeMode=NONE
        RDR_DETECTION_273_276_oPCAN_RADAR_5cf33208_Tx: ComIPduHandleId=74, ComIPduSignalGroupRef=SG_Detections_273_276_oRDR_DETECTION_273_276_oPCAN_RADAR_df34482a_Tx, ComPduIdRef=RDR_DETECTION_273_276_oPCAN_RADAR_5cf33208_Tx
          ComTxIPdu: ComMinimumDelayTime=0, ComTxIPduUnusedAreasDefault=0
            ComTxModeTrue
              ComTxMode: ComTxModeMode=DIRECT, ComTxModeNumberOfRepetitions=0
            ComTxModeFalse
              ComTxMode: ComTxModeMode=NONE
      SG_TrackerObject012_oRDR_TRACKER_OBJ_012_oPCAN_RADAR_276317b7_Tx (ComSignalGroup):
        ComTransferProperty = TRIGGERED
        ComSignalGroupAccess = ACCESS_NEEDED_BY_SWC_OR_COM
        ComHandleId = 121
        ComSignalGroupArrayAccess = true
        ComSystemTemplateSignalGroupRef = SG_TrackerObject012
        49 x ComGroupSignal, all with ComSignalEndianness=BIG_ENDIAN, ComSignalInitValue=0, ComTransferProperty=PENDING, ComSignalAccess=ACCESS_NEEDED_BY_SWC_OR_COM:
          OBJ_CLS_TYPE6_012_oRDR_TRACKER_OBJ_012_oPCAN_RADAR_ba554296_Tx: ComBitPosition=282, ComBitSize=4, ComSignalType=UINT8, ComHandleId=9084, ComSystemTemplateSystemSignalRef=OBJ_CLS_TYPE6_012
          OBJ_ID_012_oRDR_TRACKER_OBJ_012_oPCAN_RADAR_bcbda0c4_Tx: ComBitPosition=7, ComBitSize=8, ComSignalType=UINT8, ComHandleId=9092, ComSystemTemplateSystemSignalRef=OBJ_ID_012
          OBJ_YAW_RATE_012_oRDR_TRACKER_OBJ_012_oPCAN_RADAR_13415e63_Tx: ComBitPosition=399, ComBitSize=10, ComSignalType=UINT16, ComHandleId=9115, ComSystemTemplateSystemSignalRef=OBJ_YAW_RATE_012
          OBJ_YAW_RATE_ERR_012_oRDR_TRACKER_OBJ_012_oPCAN_RADAR_2c99c9bf_Tx: ComBitPosition=388, ComBitSize=5, ComSignalType=UINT8, ComHandleId=9116, ComSystemTemplateSystemSignalRef=OBJ_YAW_RATE_ERR_012
          OBJ_ALIVE_TIME_012_oRDR_TRACKER_OBJ_012_oPCAN_RADAR_3bd65e9c_Tx: ComBitPosition=255, ComBitSize=16, ComSignalType=UINT16, ComHandleId=9073, ComSystemTemplateSystemSignalRef=OBJ_ALIVE_TIME_012
          OBJ_CLS_TYPE5_PROB_012_oRDR_TRACKER_OBJ_012_oPCAN_RADAR_c36bb5e4_Tx: ComBitPosition=335, ComBitSize=8, ComSignalType=UINT8, ComHandleId=9083, ComSystemTemplateSystemSignalRef=OBJ_CLS_TYPE5_PROB_012
          OBJ_MOVEMENT_STATUS_012_oRDR_TRACKER_OBJ_012_oPCAN_RADAR_ecc14735_Tx: ComBitPosition=196, ComBitSize=3, ComSignalType=UINT8, ComHandleId=9096, ComSystemTemplateSystemSignalRef=OBJ_MOVEMENT_STATUS_012
          OBJ_ACCELERATION_LAT_ERR_012_oRDR_TRACKER_OBJ_012_oPCAN_RADAR_fcb3767e_Tx: ComBitPosition=223, ComBitSize=8, ComSignalType=UINT8, ComHandleId=9069, ComSystemTemplateSystemSignalRef=OBJ_ACCELERATION_LAT_ERR_012
          OBJ_CLS_TYPE2_012_oRDR_TRACKER_OBJ_012_oPCAN_RADAR_e1e5bfdd_Tx: ComBitPosition=267, ComBitSize=4, ComSignalType=UINT8, ComHandleId=9076, ComSystemTemplateSystemSignalRef=OBJ_CLS_TYPE2_012
          OBJ_DIMENSION_WIDTH_012_oRDR_TRACKER_OBJ_012_oPCAN_RADAR_cd5d1b53_Tx: ComBitPosition=17, ComBitSize=10, ComSignalType=UINT16, ComHandleId=9088, ComSystemTemplateSystemSignalRef=OBJ_DIMENSION_WIDTH_012
          OBJ_EXISTENCE_PROB_012_oRDR_TRACKER_OBJ_012_oPCAN_RADAR_c6e19f6e_Tx: ComBitPosition=229, ComBitSize=14, ComSignalType=UINT16, ComHandleId=9090, ComSystemTemplateSystemSignalRef=OBJ_EXISTENCE_PROB_012
          OBJ_VELOCITY_LAT_012_oRDR_TRACKER_OBJ_012_oPCAN_RADAR_da723f64_Tx: ComBitPosition=126, ComBitSize=15, ComSignalType=UINT16, ComHandleId=9109, ComSystemTemplateSystemSignalRef=OBJ_VELOCITY_LAT_012
          OBJ_CLS_TYPE6_PROB_012_oRDR_TRACKER_OBJ_012_oPCAN_RADAR_0a5faee9_Tx: ComBitPosition=343, ComBitSize=8, ComSignalType=UINT8, ComHandleId=9085, ComSystemTemplateSystemSignalRef=OBJ_CLS_TYPE6_PROB_012
          OBJ_DIMENSION_LENGTH_012_oRDR_TRACKER_OBJ_012_oPCAN_RADAR_ee93ecfe_Tx: ComBitPosition=37, ComBitSize=12, ComSignalType=UINT16, ComHandleId=9086, ComSystemTemplateSystemSignalRef=OBJ_DIMENSION_LENGTH_012
          OBJ_POS_LAT_ERR_012_oRDR_TRACKER_OBJ_012_oPCAN_RADAR_9a5d2a74_Tx: ComBitPosition=103, ComBitSize=8, ComSignalType=UINT8, ComHandleId=9099, ComSystemTemplateSystemSignalRef=OBJ_POS_LAT_ERR_012
          OBJ_POS_LONG_012_oRDR_TRACKER_OBJ_012_oPCAN_RADAR_2fb1918c_Tx: ComBitPosition=63, ComBitSize=16, ComSignalType=UINT16, ComHandleId=9100, ComSystemTemplateSystemSignalRef=OBJ_POS_LONG_012
          OBJ_VELOCITY_LONG_ERR_012_oRDR_TRACKER_OBJ_012_oPCAN_RADAR_020a70f5_Tx: ComBitPosition=143, ComBitSize=8, ComSignalType=UINT8, ComHandleId=9112, ComSystemTemplateSystemSignalRef=OBJ_VELOCITY_LONG_ERR_012
          OBJ_RCS_012_oRDR_TRACKER_OBJ_012_oPCAN_RADAR_bcde2c44_Tx: ComBitPosition=351, ComBitSize=7, ComSignalType=UINT8, ComHandleId=9102, ComSystemTemplateSystemSignalRef=OBJ_RCS_012
          OBJ_ACCELERATION_LONG_ERR_012_oRDR_TRACKER_OBJ_012_oPCAN_RADAR_e316d3d4_Tx: ComBitPosition=215, ComBitSize=8, ComSignalType=UINT8, ComHandleId=9071, ComSystemTemplateSystemSignalRef=OBJ_ACCELERATION_LONG_ERR_012
          OBJ_CLS_TYPE1_012_oRDR_TRACKER_OBJ_012_oPCAN_RADAR_ac0dbfba_Tx: ComBitPosition=271, ComBitSize=4, ComSignalType=UINT8, ComHandleId=9074, ComSystemTemplateSystemSignalRef=OBJ_CLS_TYPE1_012
          OBJ_ACCEL_ERR_CRR_COEF_012_oRDR_TRACKER_OBJ_012_oPCAN_RADAR_43b5f2b2_Tx: ComBitPosition=431, ComBitSize=8, ComSignalType=UINT8, ComHandleId=9072, ComSystemTemplateSystemSignalRef=OBJ_ACCEL_ERR_CRR_COEF_012
          OBJ_ACCELERATION_LONG_012_oRDR_TRACKER_OBJ_012_oPCAN_RADAR_5bb71520_Tx: ComBitPosition=193, ComBitSize=10, ComSignalType=UINT16, ComHandleId=9070, ComSystemTemplateSystemSignalRef=OBJ_ACCELERATION_LONG_012
          OBJ_POS_ERR_CRR_COEF_012_oRDR_TRACKER_OBJ_012_oPCAN_RADAR_7cbe870f_Tx: ComBitPosition=415, ComBitSize=8, ComSignalType=UINT8, ComHandleId=9097, ComSystemTemplateSystemSignalRef=OBJ_POS_ERR_CRR_COEF_012
          OBJ_ACCELERATION_LAT_012_oRDR_TRACKER_OBJ_012_oPCAN_RADAR_29474cc0_Tx: ComBitPosition=177, ComBitSize=10, ComSignalType=UINT16, ComHandleId=9068, ComSystemTemplateSystemSignalRef=OBJ_ACCELERATION_LAT_012
          OBJ_CLS_TYPE5_012_oRDR_TRACKER_OBJ_012_oPCAN_RADAR_f7bd42f1_Tx: ComBitPosition=287, ComBitSize=4, ComSignalType=UINT8, ComHandleId=9082, ComSystemTemplateSystemSignalRef=OBJ_CLS_TYPE5_012
          OBJ_POS_LONG_ERR_012_oRDR_TRACKER_OBJ_012_oPCAN_RADAR_03a5d496_Tx: ComBitPosition=95, ComBitSize=8, ComSignalType=UINT8, ComHandleId=9101, ComSystemTemplateSystemSignalRef=OBJ_POS_LONG_ERR_012
          OBJ_POS_LAT_012_oRDR_TRACKER_OBJ_012_oPCAN_RADAR_9e117a43_Tx: ComBitPosition=79, ComBitSize=16, ComSignalType=UINT16, ComHandleId=9098, ComSystemTemplateSystemSignalRef=OBJ_POS_LAT_012
          OBJ_YAW_ANGLE_ERR_012_oRDR_TRACKER_OBJ_012_oPCAN_RADAR_e3c37df3_Tx: ComBitPosition=175, ComBitSize=7, ComSignalType=UINT8, ComHandleId=9114, ComSystemTemplateSystemSignalRef=OBJ_YAW_ANGLE_ERR_012
          OBJ_TRACK_MOTION_MODEL_012_oRDR_TRACKER_OBJ_012_oPCAN_RADAR_70712dcf_Tx: ComBitPosition=9, ComBitSize=2, ComSignalType=UINT8, ComHandleId=9106, ComSystemTemplateSystemSignalRef=OBJ_TRACK_MOTION_MODEL_012
          OBJ_VELOCITY_LAT_ERR_012_oRDR_TRACKER_OBJ_012_oPCAN_RADAR_ee884f35_Tx: ComBitPosition=151, ComBitSize=8, ComSignalType=UINT8, ComHandleId=9110, ComSystemTemplateSystemSignalRef=OBJ_VELOCITY_LAT_ERR_012
          OBJ_VEH_TRACK_FLAG_012_oRDR_TRACKER_OBJ_012_oPCAN_RADAR_f25bdb92_Tx: ComBitPosition=10, ComBitSize=1, ComSignalType=BOOLEAN, ComHandleId=9107, ComSystemTemplateSystemSignalRef=OBJ_VEH_TRACK_FLAG_012
          OBJ_CLS_TYPE3_PROB_012_oRDR_TRACKER_OBJ_012_oPCAN_RADAR_8a7285bf_Tx: ComBitPosition=319, ComBitSize=8, ComSignalType=UINT8, ComHandleId=9079, ComSystemTemplateSystemSignalRef=OBJ_CLS_TYPE3_PROB_012
          OBJ_CLS_TYPE1_PROB_012_oRDR_TRACKER_OBJ_012_oPCAN_RADAR_04556849_Tx: ComBitPosition=303, ComBitSize=8, ComSignalType=UINT8, ComHandleId=9075, ComSystemTemplateSystemSignalRef=OBJ_CLS_TYPE1_PROB_012
          OBJ_DIMENSION_LENGTH_ERR_012_oRDR_TRACKER_OBJ_012_oPCAN_RADAR_d56bf384_Tx: ComBitPosition=41, ComBitSize=10, ComSignalType=UINT16, ComHandleId=9087, ComSystemTemplateSystemSignalRef=OBJ_DIMENSION_LENGTH_ERR_012
          OBJ_MEASUREMENT_STATUS_012_oRDR_TRACKER_OBJ_012_oPCAN_RADAR_c36fd279_Tx: ComBitPosition=14, ComBitSize=3, ComSignalType=UINT8, ComHandleId=9093, ComSystemTemplateSystemSignalRef=OBJ_MEASUREMENT_STATUS_012
          OBJ_TIMESTAMP_OFFSET_012_oRDR_TRACKER_OBJ_012_oPCAN_RADAR_bc722c12_Tx: ComBitPosition=247, ComBitSize=8, ComSignalType=UINT8, ComHandleId=9105, ComSystemTemplateSystemSignalRef=OBJ_TIMESTAMP_OFFSET_012
          OBJ_CLS_TYPE3_012_oRDR_TRACKER_OBJ_012_oPCAN_RADAR_6c6d423f_Tx: ComBitPosition=279, ComBitSize=4, ComSignalType=UINT8, ComHandleId=9078, ComSystemTemplateSystemSignalRef=OBJ_CLS_TYPE3_012
          OBJ_CLS_TYPE4_PROB_012_oRDR_TRACKER_OBJ_012_oPCAN_RADAR_8478431f_Tx: ComBitPosition=327, ComBitSize=8, ComSignalType=UINT8, ComHandleId=9081, ComSystemTemplateSystemSignalRef=OBJ_CLS_TYPE4_PROB_012
          OBJ_YAW_ANGLE_012_oRDR_TRACKER_OBJ_012_oPCAN_RADAR_36ce7b24_Tx: ComBitPosition=155, ComBitSize=12, ComSignalType=UINT16, ComHandleId=9113, ComSystemTemplateSystemSignalRef=OBJ_YAW_ANGLE_012
          OBJ_REF_PT_LONG_OFFSET_012_oRDR_TRACKER_OBJ_012_oPCAN_RADAR_06b1b732_Tx: ComBitPosition=357, ComBitSize=14, ComSignalType=UINT16, ComHandleId=9104, ComSystemTemplateSystemSignalRef=OBJ_REF_PT_LONG_OFFSET_012
          OBJ_DIMENSION_WIDTH_ERR_012_oRDR_TRACKER_OBJ_012_oPCAN_RADAR_2dffdcbb_Tx: ComBitPosition=23, ComBitSize=6, ComSignalType=UINT8, ComHandleId=9089, ComSystemTemplateSystemSignalRef=OBJ_DIMENSION_WIDTH_ERR_012
          OBJ_REF_PT_LAT_OFFSET_012_oRDR_TRACKER_OBJ_012_oPCAN_RADAR_49e34731_Tx: ComBitPosition=370, ComBitSize=14, ComSignalType=UINT16, ComHandleId=9103, ComSystemTemplateSystemSignalRef=OBJ_REF_PT_LAT_OFFSET_012
          OBJ_CLS_TYPE4_012_oRDR_TRACKER_OBJ_012_oPCAN_RADAR_7a35bf13_Tx: ComBitPosition=275, ComBitSize=4, ComSignalType=UINT8, ComHandleId=9080, ComSystemTemplateSystemSignalRef=OBJ_CLS_TYPE4_012
          OBJ_VELOCITY_ERR_CRR_COEF_012_oRDR_TRACKER_OBJ_012_oPCAN_RADAR_d5c4baee_Tx: ComBitPosition=423, ComBitSize=8, ComSignalType=UINT8, ComHandleId=9108, ComSystemTemplateSystemSignalRef=OBJ_VELOCITY_ERR_CRR_COEF_012
          OBJ_VELOCITY_LONG_012_oRDR_TRACKER_OBJ_012_oPCAN_RADAR_8aff47a2_Tx: ComBitPosition=110, ComBitSize=15, ComSignalType=UINT16, ComHandleId=9111, ComSystemTemplateSystemSignalRef=OBJ_VELOCITY_LONG_012
          OBJ_CLS_TYPE2_PROB_012_oRDR_TRACKER_OBJ_012_oPCAN_RADAR_cd617344_Tx: ComBitPosition=311, ComBitSize=8, ComSignalType=UINT8, ComHandleId=9077, ComSystemTemplateSystemSignalRef=OBJ_CLS_TYPE2_PROB_012
          OBJ_GROUP_ID_012_oRDR_TRACKER_OBJ_012_oPCAN_RADAR_4f938bc3_Tx: ComBitPosition=405, ComBitSize=6, ComSignalType=UINT8, ComHandleId=9091, ComSystemTemplateSystemSignalRef=OBJ_GROUP_ID_012
          OBJ_MH_CYCLE_COUNTER_012_oRDR_TRACKER_OBJ_012_oPCAN_RADAR_ceeb3fa4_Tx: ComBitPosition=487, ComBitSize=8, ComSignalType=UINT8, ComHandleId=9095, ComSystemTemplateSystemSignalRef=OBJ_MH_CYCLE_COUNTER_012
          OBJ_MH_CRC16_012_oRDR_TRACKER_OBJ_012_oPCAN_RADAR_bf0f6545_Tx: ComBitPosition=495, ComBitSize=16, ComSignalType=UINT16, ComHandleId=9094, ComSystemTemplateSystemSignalRef=OBJ_MH_CRC16_012
      SG_TrackerObject058_oRDR_TRACKER_OBJ_058_oPCAN_RADAR_3a6d80b5_Tx (ComSignalGroup):
        ComTransferProperty = TRIGGERED
        ComSignalGroupAccess = ACCESS_NEEDED_BY_SWC_OR_COM
        ComHandleId = 167
        ComSignalGroupArrayAccess = true
        ComSystemTemplateSignalGroupRef = SG_TrackerObject058
        49 x ComGroupSignal, all with ComSignalEndianness=BIG_ENDIAN, ComSignalInitValue=0, ComTransferProperty=PENDING, ComSignalAccess=ACCESS_NEEDED_BY_SWC_OR_COM:
          OBJ_POS_LONG_ERR_058_oRDR_TRACKER_OBJ_058_oPCAN_RADAR_1eab4394_Tx: ComBitPosition=95, ComBitSize=8, ComSignalType=UINT8, ComHandleId=11355, ComSystemTemplateSystemSignalRef=OBJ_POS_LONG_ERR_058
          OBJ_TRACK_MOTION_MODEL_058_oRDR_TRACKER_OBJ_058_oPCAN_RADAR_6d7fbacd_Tx: ComBitPosition=9, ComBitSize=2, ComSignalType=UINT8, ComHandleId=11360, ComSystemTemplateSystemSignalRef=OBJ_TRACK_MOTION_MODEL_058
          OBJ_ALIVE_TIME_058_oRDR_TRACKER_OBJ_058_oPCAN_RADAR_26d8c99e_Tx: ComBitPosition=255, ComBitSize=16, ComSignalType=UINT16, ComHandleId=11327, ComSystemTemplateSystemSignalRef=OBJ_ALIVE_TIME_058
          OBJ_CLS_TYPE6_058_oRDR_TRACKER_OBJ_058_oPCAN_RADAR_a75bd594_Tx: ComBitPosition=282, ComBitSize=4, ComSignalType=UINT8, ComHandleId=11338, ComSystemTemplateSystemSignalRef=OBJ_CLS_TYPE6_058
          OBJ_TIMESTAMP_OFFSET_058_oRDR_TRACKER_OBJ_058_oPCAN_RADAR_a17cbb10_Tx: ComBitPosition=247, ComBitSize=8, ComSignalType=UINT8, ComHandleId=11359, ComSystemTemplateSystemSignalRef=OBJ_TIMESTAMP_OFFSET_058
          OBJ_CLS_TYPE1_PROB_058_oRDR_TRACKER_OBJ_058_oPCAN_RADAR_195bff4b_Tx: ComBitPosition=303, ComBitSize=8, ComSignalType=UINT8, ComHandleId=11329, ComSystemTemplateSystemSignalRef=OBJ_CLS_TYPE1_PROB_058
          OBJ_GROUP_ID_058_oRDR_TRACKER_OBJ_058_oPCAN_RADAR_529d1cc1_Tx: ComBitPosition=405, ComBitSize=6, ComSignalType=UINT8, ComHandleId=11345, ComSystemTemplateSystemSignalRef=OBJ_GROUP_ID_058
          OBJ_VELOCITY_LAT_ERR_058_oRDR_TRACKER_OBJ_058_oPCAN_RADAR_f386d837_Tx: ComBitPosition=151, ComBitSize=8, ComSignalType=UINT8, ComHandleId=11364, ComSystemTemplateSystemSignalRef=OBJ_VELOCITY_LAT_ERR_058
          OBJ_ACCELERATION_LONG_058_oRDR_TRACKER_OBJ_058_oPCAN_RADAR_46b98222_Tx: ComBitPosition=193, ComBitSize=10, ComSignalType=UINT16, ComHandleId=11324, ComSystemTemplateSystemSignalRef=OBJ_ACCELERATION_LONG_058
          OBJ_MOVEMENT_STATUS_058_oRDR_TRACKER_OBJ_058_oPCAN_RADAR_f1cfd037_Tx: ComBitPosition=196, ComBitSize=3, ComSignalType=UINT8, ComHandleId=11350, ComSystemTemplateSystemSignalRef=OBJ_MOVEMENT_STATUS_058
          OBJ_ACCEL_ERR_CRR_COEF_058_oRDR_TRACKER_OBJ_058_oPCAN_RADAR_5ebb65b0_Tx: ComBitPosition=431, ComBitSize=8, ComSignalType=UINT8, ComHandleId=11326, ComSystemTemplateSystemSignalRef=OBJ_ACCEL_ERR_CRR_COEF_058
          OBJ_POS_LONG_058_oRDR_TRACKER_OBJ_058_oPCAN_RADAR_32bf068e_Tx: ComBitPosition=63, ComBitSize=16, ComSignalType=UINT16, ComHandleId=11354, ComSystemTemplateSystemSignalRef=OBJ_POS_LONG_058
          OBJ_YAW_RATE_058_oRDR_TRACKER_OBJ_058_oPCAN_RADAR_0e4fc961_Tx: ComBitPosition=399, ComBitSize=10, ComSignalType=UINT16, ComHandleId=11369, ComSystemTemplateSystemSignalRef=OBJ_YAW_RATE_058
          OBJ_DIMENSION_LENGTH_ERR_058_oRDR_TRACKER_OBJ_058_oPCAN_RADAR_c8656486_Tx: ComBitPosition=41, ComBitSize=10, ComSignalType=UINT16, ComHandleId=11341, ComSystemTemplateSystemSignalRef=OBJ_DIMENSION_LENGTH_ERR_058
          OBJ_POS_ERR_CRR_COEF_058_oRDR_TRACKER_OBJ_058_oPCAN_RADAR_61b0100d_Tx: ComBitPosition=415, ComBitSize=8, ComSignalType=UINT8, ComHandleId=11351, ComSystemTemplateSystemSignalRef=OBJ_POS_ERR_CRR_COEF_058
          OBJ_ACCELERATION_LAT_ERR_058_oRDR_TRACKER_OBJ_058_oPCAN_RADAR_e1bde17c_Tx: ComBitPosition=223, ComBitSize=8, ComSignalType=UINT8, ComHandleId=11323, ComSystemTemplateSystemSignalRef=OBJ_ACCELERATION_LAT_ERR_058
          OBJ_DIMENSION_WIDTH_ERR_058_oRDR_TRACKER_OBJ_058_oPCAN_RADAR_30f14bb9_Tx: ComBitPosition=23, ComBitSize=6, ComSignalType=UINT8, ComHandleId=11343, ComSystemTemplateSystemSignalRef=OBJ_DIMENSION_WIDTH_ERR_058
          OBJ_CLS_TYPE1_058_oRDR_TRACKER_OBJ_058_oPCAN_RADAR_b10328b8_Tx: ComBitPosition=271, ComBitSize=4, ComSignalType=UINT8, ComHandleId=11328, ComSystemTemplateSystemSignalRef=OBJ_CLS_TYPE1_058
          OBJ_ID_058_oRDR_TRACKER_OBJ_058_oPCAN_RADAR_a1b337c6_Tx: ComBitPosition=7, ComBitSize=8, ComSignalType=UINT8, ComHandleId=11346, ComSystemTemplateSystemSignalRef=OBJ_ID_058
          OBJ_POS_LAT_058_oRDR_TRACKER_OBJ_058_oPCAN_RADAR_831fed41_Tx: ComBitPosition=79, ComBitSize=16, ComSignalType=UINT16, ComHandleId=11352, ComSystemTemplateSystemSignalRef=OBJ_POS_LAT_058
          OBJ_CLS_TYPE2_PROB_058_oRDR_TRACKER_OBJ_058_oPCAN_RADAR_d06fe446_Tx: ComBitPosition=311, ComBitSize=8, ComSignalType=UINT8, ComHandleId=11331, ComSystemTemplateSystemSignalRef=OBJ_CLS_TYPE2_PROB_058
          OBJ_REF_PT_LAT_OFFSET_058_oRDR_TRACKER_OBJ_058_oPCAN_RADAR_54edd033_Tx: ComBitPosition=370, ComBitSize=14, ComSignalType=UINT16, ComHandleId=11357, ComSystemTemplateSystemSignalRef=OBJ_REF_PT_LAT_OFFSET_058
          OBJ_VELOCITY_LAT_058_oRDR_TRACKER_OBJ_058_oPCAN_RADAR_c77ca866_Tx: ComBitPosition=126, ComBitSize=15, ComSignalType=UINT16, ComHandleId=11363, ComSystemTemplateSystemSignalRef=OBJ_VELOCITY_LAT_058
          OBJ_CLS_TYPE2_058_oRDR_TRACKER_OBJ_058_oPCAN_RADAR_fceb28df_Tx: ComBitPosition=267, ComBitSize=4, ComSignalType=UINT8, ComHandleId=11330, ComSystemTemplateSystemSignalRef=OBJ_CLS_TYPE2_058
          OBJ_CLS_TYPE4_PROB_058_oRDR_TRACKER_OBJ_058_oPCAN_RADAR_9976d41d_Tx: ComBitPosition=327, ComBitSize=8, ComSignalType=UINT8, ComHandleId=11335, ComSystemTemplateSystemSignalRef=OBJ_CLS_TYPE4_PROB_058
          OBJ_CLS_TYPE5_PROB_058_oRDR_TRACKER_OBJ_058_oPCAN_RADAR_de6522e6_Tx: ComBitPosition=335, ComBitSize=8, ComSignalType=UINT8, ComHandleId=11337, ComSystemTemplateSystemSignalRef=OBJ_CLS_TYPE5_PROB_058
          OBJ_ACCELERATION_LONG_ERR_058_oRDR_TRACKER_OBJ_058_oPCAN_RADAR_fe1844d6_Tx: ComBitPosition=215, ComBitSize=8, ComSignalType=UINT8, ComHandleId=11325, ComSystemTemplateSystemSignalRef=OBJ_ACCELERATION_LONG_ERR_058
          OBJ_EXISTENCE_PROB_058_oRDR_TRACKER_OBJ_058_oPCAN_RADAR_dbef086c_Tx: ComBitPosition=229, ComBitSize=14, ComSignalType=UINT16, ComHandleId=11344, ComSystemTemplateSystemSignalRef=OBJ_EXISTENCE_PROB_058
          OBJ_CLS_TYPE6_PROB_058_oRDR_TRACKER_OBJ_058_oPCAN_RADAR_175139eb_Tx: ComBitPosition=343, ComBitSize=8, ComSignalType=UINT8, ComHandleId=11339, ComSystemTemplateSystemSignalRef=OBJ_CLS_TYPE6_PROB_058
          OBJ_ACCELERATION_LAT_058_oRDR_TRACKER_OBJ_058_oPCAN_RADAR_3449dbc2_Tx: ComBitPosition=177, ComBitSize=10, ComSignalType=UINT16, ComHandleId=11322, ComSystemTemplateSystemSignalRef=OBJ_ACCELERATION_LAT_058
          OBJ_YAW_ANGLE_ERR_058_oRDR_TRACKER_OBJ_058_oPCAN_RADAR_fecdeaf1_Tx: ComBitPosition=175, ComBitSize=7, ComSignalType=UINT8, ComHandleId=11368, ComSystemTemplateSystemSignalRef=OBJ_YAW_ANGLE_ERR_058
          OBJ_DIMENSION_WIDTH_058_oRDR_TRACKER_OBJ_058_oPCAN_RADAR_d0538c51_Tx: ComBitPosition=17, ComBitSize=10, ComSignalType=UINT16, ComHandleId=11342, ComSystemTemplateSystemSignalRef=OBJ_DIMENSION_WIDTH_058
          OBJ_VELOCITY_LONG_058_oRDR_TRACKER_OBJ_058_oPCAN_RADAR_97f1d0a0_Tx: ComBitPosition=110, ComBitSize=15, ComSignalType=UINT16, ComHandleId=11365, ComSystemTemplateSystemSignalRef=OBJ_VELOCITY_LONG_058
          OBJ_RCS_058_oRDR_TRACKER_OBJ_058_oPCAN_RADAR_a1d0bb46_Tx: ComBitPosition=351, ComBitSize=7, ComSignalType=UINT8, ComHandleId=11356, ComSystemTemplateSystemSignalRef=OBJ_RCS_058
          OBJ_YAW_ANGLE_058_oRDR_TRACKER_OBJ_058_oPCAN_RADAR_2bc0ec26_Tx: ComBitPosition=155, ComBitSize=12, ComSignalType=UINT16, ComHandleId=11367, ComSystemTemplateSystemSignalRef=OBJ_YAW_ANGLE_058
          OBJ_CLS_TYPE3_058_oRDR_TRACKER_OBJ_058_oPCAN_RADAR_7163d53d_Tx: ComBitPosition=279, ComBitSize=4, ComSignalType=UINT8, ComHandleId=11332, ComSystemTemplateSystemSignalRef=OBJ_CLS_TYPE3_058
          OBJ_CLS_TYPE5_058_oRDR_TRACKER_OBJ_058_oPCAN_RADAR_eab3d5f3_Tx: ComBitPosition=287, ComBitSize=4, ComSignalType=UINT8, ComHandleId=11336, ComSystemTemplateSystemSignalRef=OBJ_CLS_TYPE5_058
          OBJ_VELOCITY_LONG_ERR_058_oRDR_TRACKER_OBJ_058_oPCAN_RADAR_1f04e7f7_Tx: ComBitPosition=143, ComBitSize=8, ComSignalType=UINT8, ComHandleId=11366, ComSystemTemplateSystemSignalRef=OBJ_VELOCITY_LONG_ERR_058
          OBJ_YAW_RATE_ERR_058_oRDR_TRACKER_OBJ_058_oPCAN_RADAR_31975ebd_Tx: ComBitPosition=388, ComBitSize=5, ComSignalType=UINT8, ComHandleId=11370, ComSystemTemplateSystemSignalRef=OBJ_YAW_RATE_ERR_058
          OBJ_CLS_TYPE4_058_oRDR_TRACKER_OBJ_058_oPCAN_RADAR_673b2811_Tx: ComBitPosition=275, ComBitSize=4, ComSignalType=UINT8, ComHandleId=11334, ComSystemTemplateSystemSignalRef=OBJ_CLS_TYPE4_058
          OBJ_MEASUREMENT_STATUS_058_oRDR_TRACKER_OBJ_058_oPCAN_RADAR_de61457b_Tx: ComBitPosition=14, ComBitSize=3, ComSignalType=UINT8, ComHandleId=11347, ComSystemTemplateSystemSignalRef=OBJ_MEASUREMENT_STATUS_058
          OBJ_POS_LAT_ERR_058_oRDR_TRACKER_OBJ_058_oPCAN_RADAR_8753bd76_Tx: ComBitPosition=103, ComBitSize=8, ComSignalType=UINT8, ComHandleId=11353, ComSystemTemplateSystemSignalRef=OBJ_POS_LAT_ERR_058
          OBJ_CLS_TYPE3_PROB_058_oRDR_TRACKER_OBJ_058_oPCAN_RADAR_977c12bd_Tx: ComBitPosition=319, ComBitSize=8, ComSignalType=UINT8, ComHandleId=11333, ComSystemTemplateSystemSignalRef=OBJ_CLS_TYPE3_PROB_058
          OBJ_REF_PT_LONG_OFFSET_058_oRDR_TRACKER_OBJ_058_oPCAN_RADAR_1bbf2030_Tx: ComBitPosition=357, ComBitSize=14, ComSignalType=UINT16, ComHandleId=11358, ComSystemTemplateSystemSignalRef=OBJ_REF_PT_LONG_OFFSET_058
          OBJ_VEH_TRACK_FLAG_058_oRDR_TRACKER_OBJ_058_oPCAN_RADAR_ef554c90_Tx: ComBitPosition=10, ComBitSize=1, ComSignalType=BOOLEAN, ComHandleId=11361, ComSystemTemplateSystemSignalRef=OBJ_VEH_TRACK_FLAG_058
          OBJ_DIMENSION_LENGTH_058_oRDR_TRACKER_OBJ_058_oPCAN_RADAR_f39d7bfc_Tx: ComBitPosition=37, ComBitSize=12, ComSignalType=UINT16, ComHandleId=11340, ComSystemTemplateSystemSignalRef=OBJ_DIMENSION_LENGTH_058
          OBJ_VELOCITY_ERR_CRR_COEF_058_oRDR_TRACKER_OBJ_058_oPCAN_RADAR_c8ca2dec_Tx: ComBitPosition=423, ComBitSize=8, ComSignalType=UINT8, ComHandleId=11362, ComSystemTemplateSystemSignalRef=OBJ_VELOCITY_ERR_CRR_COEF_058
          OBJ_MH_CYCLE_COUNTER_058_oRDR_TRACKER_OBJ_058_oPCAN_RADAR_d3e5a8a6_Tx: ComBitPosition=487, ComBitSize=8, ComSignalType=UINT8, ComHandleId=11349, ComSystemTemplateSystemSignalRef=OBJ_MH_CYCLE_COUNTER_058
          OBJ_MH_CRC16_058_oRDR_TRACKER_OBJ_058_oPCAN_RADAR_a201f247_Tx: ComBitPosition=495, ComBitSize=16, ComSignalType=UINT16, ComHandleId=11348, ComSystemTemplateSystemSignalRef=OBJ_MH_CRC16_058
      RDR_ALIGNMENT_STATUS_001_oPCAN_RADAR_dd819ed8_Tx (ComIPdu):
        ComIPduDirection = SEND
        ComIPduType = NORMAL
        ComIPduCancellationSupport = false
        ComIPduHandleId = 2
        ComIPduSignalProcessing = DEFERRED
        ComIPduChannelRef = CN_PCAN_RADAR_458ff0f1
        ComIPduGroupRef = RDR01_oPCAN_RADAR_Tx_b6bdb067 if post-build-variant-condition{matching-criterion=RDR_POS, value=0}
        ComIPduSignalGroupRef = SG_AlignmentStatus1_oRDR_ALIGNMENT_STATUS_001_oPCAN_RADAR_7714a623_Tx
        ComPduIdRef = RDR_ALIGNMENT_STATUS_001_oPCAN_RADAR_dd819ed8_Tx
        ComIPduMainFunctionRef = ComMainFunctionTx_Event
        ComIPduGroupRef = RDR02_oPCAN_RADAR_Tx_9f750495 if post-build-variant-condition{matching-criterion=RDR_POS, value=1}
        ComIPduGroupRef = RDR03_oPCAN_RADAR_Tx_311d9504 if post-build-variant-condition{matching-criterion=RDR_POS, value=2}
        ComIPduGroupRef = RDR04_oPCAN_RADAR_Tx_cce46d71 if post-build-variant-condition{matching-criterion=RDR_POS, value=3}
        ComIPduGroupRef = RDR05_oPCAN_RADAR_Tx_628cfce0 if post-build-variant-condition{matching-criterion=RDR_POS, value=4}
        ComIPduGroupRef = RDR06_oPCAN_RADAR_Tx_4b444812 if post-build-variant-condition{matching-criterion=RDR_POS, value=5}
        ComIPduGroupRef = RDR07_oPCAN_RADAR_Tx_e52cd983 if post-build-variant-condition{matching-criterion=RDR_POS, value=6}
        ComIPduGroupRef = RDR08_oPCAN_RADAR_Tx_6bc6beb9 if post-build-variant-condition{matching-criterion=RDR_POS, value=7}
        ComTxIPdu: ComMinimumDelayTime=0, ComTxIPduUnusedAreasDefault=0
          ComTxModeTrue
            ComTxMode: ComTxModeMode=DIRECT, ComTxModeTimeOffset=0, ComTxModeTimePeriod=0.05, ComTxModeNumberOfRepetitions=0
          ComTxModeFalse
            ComTxMode: ComTxModeMode=NONE, ComTxModeTimeOffset=0, ComTxModeTimePeriod=0.05
      RDR_TRACKER_OBJ_032_oPCAN_RADAR_ef2cb243_Tx (ComIPdu):
        ComIPduDirection = SEND
        ComIPduType = NORMAL
        ComIPduCancellationSupport = false
        ComIPduHandleId = 142
        ComIPduSignalProcessing = DEFERRED
        ComIPduChannelRef = CN_PCAN_RADAR_458ff0f1
        ComIPduGroupRef = RDR01_oPCAN_RADAR_Tx_b6bdb067 if post-build-variant-condition{matching-criterion=RDR_POS, value=0}
        ComIPduSignalGroupRef = SG_TrackerObject032_oRDR_TRACKER_OBJ_032_oPCAN_RADAR_8240facb_Tx
        ComPduIdRef = RDR_TRACKER_OBJ_032_oPCAN_RADAR_ef2cb243_Tx
        ComIPduMainFunctionRef = ComMainFunctionTx_Event
        ComIPduGroupRef = RDR02_oPCAN_RADAR_Tx_9f750495 if post-build-variant-condition{matching-criterion=RDR_POS, value=1}
        ComIPduGroupRef = RDR03_oPCAN_RADAR_Tx_311d9504 if post-build-variant-condition{matching-criterion=RDR_POS, value=2}
        ComIPduGroupRef = RDR04_oPCAN_RADAR_Tx_cce46d71 if post-build-variant-condition{matching-criterion=RDR_POS, value=3}
        ComIPduGroupRef = RDR05_oPCAN_RADAR_Tx_628cfce0 if post-build-variant-condition{matching-criterion=RDR_POS, value=4}
        ComIPduGroupRef = RDR06_oPCAN_RADAR_Tx_4b444812 if post-build-variant-condition{matching-criterion=RDR_POS, value=5}
        ComIPduGroupRef = RDR07_oPCAN_RADAR_Tx_e52cd983 if post-build-variant-condition{matching-criterion=RDR_POS, value=6}
        ComIPduGroupRef = RDR08_oPCAN_RADAR_Tx_6bc6beb9 if post-build-variant-condition{matching-criterion=RDR_POS, value=7}
        ComTxIPdu: ComMinimumDelayTime=0, ComTxIPduUnusedAreasDefault=0
          ComTxModeTrue
            ComTxMode: ComTxModeMode=DIRECT, ComTxModeNumberOfRepetitions=0
          ComTxModeFalse
            ComTxMode: ComTxModeMode=NONE
      SG_TrackerObject033_oRDR_TRACKER_OBJ_033_oPCAN_RADAR_7b547278_Tx (ComSignalGroup):
        ComTransferProperty = TRIGGERED
        ComSignalGroupAccess = ACCESS_NEEDED_BY_SWC_OR_COM
        ComHandleId = 142
        ComSignalGroupArrayAccess = true
        ComSystemTemplateSignalGroupRef = SG_TrackerObject033
        49 x ComGroupSignal, all with ComSignalEndianness=BIG_ENDIAN, ComSignalInitValue=0, ComTransferProperty=PENDING, ComSignalAccess=ACCESS_NEEDED_BY_SWC_OR_COM:
          OBJ_ACCELERATION_LONG_033_oRDR_TRACKER_OBJ_033_oPCAN_RADAR_078070ef_Tx: ComBitPosition=193, ComBitSize=10, ComSignalType=UINT16, ComHandleId=10099, ComSystemTemplateSystemSignalRef=OBJ_ACCELERATION_LONG_033
          OBJ_ACCEL_ERR_CRR_COEF_033_oRDR_TRACKER_OBJ_033_oPCAN_RADAR_1f82977d_Tx: ComBitPosition=431, ComBitSize=8, ComSignalType=UINT8, ComHandleId=10101, ComSystemTemplateSystemSignalRef=OBJ_ACCEL_ERR_CRR_COEF_033
          OBJ_CLS_TYPE4_033_oRDR_TRACKER_OBJ_033_oPCAN_RADAR_2602dadc_Tx: ComBitPosition=275, ComBitSize=4, ComSignalType=UINT8, ComHandleId=10109, ComSystemTemplateSystemSignalRef=OBJ_CLS_TYPE4_033
          OBJ_VELOCITY_LONG_ERR_033_oRDR_TRACKER_OBJ_033_oPCAN_RADAR_5e3d153a_Tx: ComBitPosition=143, ComBitSize=8, ComSignalType=UINT8, ComHandleId=10141, ComSystemTemplateSystemSignalRef=OBJ_VELOCITY_LONG_ERR_033
          OBJ_CLS_TYPE1_033_oRDR_TRACKER_OBJ_033_oPCAN_RADAR_f03ada75_Tx: ComBitPosition=271, ComBitSize=4, ComSignalType=UINT8, ComHandleId=10103, ComSystemTemplateSystemSignalRef=OBJ_CLS_TYPE1_033
          OBJ_ACCELERATION_LAT_ERR_033_oRDR_TRACKER_OBJ_033_oPCAN_RADAR_a08413b1_Tx: ComBitPosition=223, ComBitSize=8, ComSignalType=UINT8, ComHandleId=10098, ComSystemTemplateSystemSignalRef=OBJ_ACCELERATION_LAT_ERR_033
          OBJ_YAW_RATE_033_oRDR_TRACKER_OBJ_033_oPCAN_RADAR_4f763bac_Tx: ComBitPosition=399, ComBitSize=10, ComSignalType=UINT16, ComHandleId=10144, ComSystemTemplateSystemSignalRef=OBJ_YAW_RATE_033
          OBJ_POS_LONG_ERR_033_oRDR_TRACKER_OBJ_033_oPCAN_RADAR_5f92b159_Tx: ComBitPosition=95, ComBitSize=8, ComSignalType=UINT8, ComHandleId=10130, ComSystemTemplateSystemSignalRef=OBJ_POS_LONG_ERR_033
          OBJ_POS_LAT_ERR_033_oRDR_TRACKER_OBJ_033_oPCAN_RADAR_c66a4fbb_Tx: ComBitPosition=103, ComBitSize=8, ComSignalType=UINT8, ComHandleId=10128, ComSystemTemplateSystemSignalRef=OBJ_POS_LAT_ERR_033
          OBJ_TRACK_MOTION_MODEL_033_oRDR_TRACKER_OBJ_033_oPCAN_RADAR_2c464800_Tx: ComBitPosition=9, ComBitSize=2, ComSignalType=UINT8, ComHandleId=10135, ComSystemTemplateSystemSignalRef=OBJ_TRACK_MOTION_MODEL_033
          OBJ_RCS_033_oRDR_TRACKER_OBJ_033_oPCAN_RADAR_e0e9498b_Tx: ComBitPosition=351, ComBitSize=7, ComSignalType=UINT8, ComHandleId=10131, ComSystemTemplateSystemSignalRef=OBJ_RCS_033
          OBJ_VELOCITY_LAT_033_oRDR_TRACKER_OBJ_033_oPCAN_RADAR_86455aab_Tx: ComBitPosition=126, ComBitSize=15, ComSignalType=UINT16, ComHandleId=10138, ComSystemTemplateSystemSignalRef=OBJ_VELOCITY_LAT_033
          OBJ_CLS_TYPE3_033_oRDR_TRACKER_OBJ_033_oPCAN_RADAR_305a27f0_Tx: ComBitPosition=279, ComBitSize=4, ComSignalType=UINT8, ComHandleId=10107, ComSystemTemplateSystemSignalRef=OBJ_CLS_TYPE3_033
          OBJ_CLS_TYPE2_PROB_033_oRDR_TRACKER_OBJ_033_oPCAN_RADAR_9156168b_Tx: ComBitPosition=311, ComBitSize=8, ComSignalType=UINT8, ComHandleId=10106, ComSystemTemplateSystemSignalRef=OBJ_CLS_TYPE2_PROB_033
          OBJ_CLS_TYPE3_PROB_033_oRDR_TRACKER_OBJ_033_oPCAN_RADAR_d645e070_Tx: ComBitPosition=319, ComBitSize=8, ComSignalType=UINT8, ComHandleId=10108, ComSystemTemplateSystemSignalRef=OBJ_CLS_TYPE3_PROB_033
          OBJ_EXISTENCE_PROB_033_oRDR_TRACKER_OBJ_033_oPCAN_RADAR_9ad6faa1_Tx: ComBitPosition=229, ComBitSize=14, ComSignalType=UINT16, ComHandleId=10119, ComSystemTemplateSystemSignalRef=OBJ_EXISTENCE_PROB_033
          OBJ_YAW_ANGLE_033_oRDR_TRACKER_OBJ_033_oPCAN_RADAR_6af91eeb_Tx: ComBitPosition=155, ComBitSize=12, ComSignalType=UINT16, ComHandleId=10142, ComSystemTemplateSystemSignalRef=OBJ_YAW_ANGLE_033
          OBJ_DIMENSION_LENGTH_ERR_033_oRDR_TRACKER_OBJ_033_oPCAN_RADAR_895c964b_Tx: ComBitPosition=41, ComBitSize=10, ComSignalType=UINT16, ComHandleId=10116, ComSystemTemplateSystemSignalRef=OBJ_DIMENSION_LENGTH_ERR_033
          OBJ_TIMESTAMP_OFFSET_033_oRDR_TRACKER_OBJ_033_oPCAN_RADAR_e04549dd_Tx: ComBitPosition=247, ComBitSize=8, ComSignalType=UINT8, ComHandleId=10134, ComSystemTemplateSystemSignalRef=OBJ_TIMESTAMP_OFFSET_033
          OBJ_CLS_TYPE4_PROB_033_oRDR_TRACKER_OBJ_033_oPCAN_RADAR_d84f26d0_Tx: ComBitPosition=327, ComBitSize=8, ComSignalType=UINT8, ComHandleId=10110, ComSystemTemplateSystemSignalRef=OBJ_CLS_TYPE4_PROB_033
          OBJ_CLS_TYPE1_PROB_033_oRDR_TRACKER_OBJ_033_oPCAN_RADAR_58620d86_Tx: ComBitPosition=303, ComBitSize=8, ComSignalType=UINT8, ComHandleId=10104, ComSystemTemplateSystemSignalRef=OBJ_CLS_TYPE1_PROB_033
          OBJ_ALIVE_TIME_033_oRDR_TRACKER_OBJ_033_oPCAN_RADAR_67e13b53_Tx: ComBitPosition=255, ComBitSize=16, ComSignalType=UINT16, ComHandleId=10102, ComSystemTemplateSystemSignalRef=OBJ_ALIVE_TIME_033
          OBJ_REF_PT_LONG_OFFSET_033_oRDR_TRACKER_OBJ_033_oPCAN_RADAR_5a86d2fd_Tx: ComBitPosition=357, ComBitSize=14, ComSignalType=UINT16, ComHandleId=10133, ComSystemTemplateSystemSignalRef=OBJ_REF_PT_LONG_OFFSET_033
          OBJ_POS_LONG_033_oRDR_TRACKER_OBJ_033_oPCAN_RADAR_7386f443_Tx: ComBitPosition=63, ComBitSize=16, ComSignalType=UINT16, ComHandleId=10129, ComSystemTemplateSystemSignalRef=OBJ_POS_LONG_033
          OBJ_MEASUREMENT_STATUS_033_oRDR_TRACKER_OBJ_033_oPCAN_RADAR_9f58b7b6_Tx: ComBitPosition=14, ComBitSize=3, ComSignalType=UINT8, ComHandleId=10122, ComSystemTemplateSystemSignalRef=OBJ_MEASUREMENT_STATUS_033
          OBJ_VELOCITY_LONG_033_oRDR_TRACKER_OBJ_033_oPCAN_RADAR_d6c8226d_Tx: ComBitPosition=110, ComBitSize=15, ComSignalType=UINT16, ComHandleId=10140, ComSystemTemplateSystemSignalRef=OBJ_VELOCITY_LONG_033
          OBJ_DIMENSION_WIDTH_033_oRDR_TRACKER_OBJ_033_oPCAN_RADAR_916a7e9c_Tx: ComBitPosition=17, ComBitSize=10, ComSignalType=UINT16, ComHandleId=10117, ComSystemTemplateSystemSignalRef=OBJ_DIMENSION_WIDTH_033
          OBJ_GROUP_ID_033_oRDR_TRACKER_OBJ_033_oPCAN_RADAR_13a4ee0c_Tx: ComBitPosition=405, ComBitSize=6, ComSignalType=UINT8, ComHandleId=10120, ComSystemTemplateSystemSignalRef=OBJ_GROUP_ID_033
          OBJ_VELOCITY_ERR_CRR_COEF_033_oRDR_TRACKER_OBJ_033_oPCAN_RADAR_89f3df21_Tx: ComBitPosition=423, ComBitSize=8, ComSignalType=UINT8, ComHandleId=10137, ComSystemTemplateSystemSignalRef=OBJ_VELOCITY_ERR_CRR_COEF_033
          OBJ_MOVEMENT_STATUS_033_oRDR_TRACKER_OBJ_033_oPCAN_RADAR_b0f622fa_Tx: ComBitPosition=196, ComBitSize=3, ComSignalType=UINT8, ComHandleId=10125, ComSystemTemplateSystemSignalRef=OBJ_MOVEMENT_STATUS_033
          OBJ_VEH_TRACK_FLAG_033_oRDR_TRACKER_OBJ_033_oPCAN_RADAR_ae6cbe5d_Tx: ComBitPosition=10, ComBitSize=1, ComSignalType=BOOLEAN, ComHandleId=10136, ComSystemTemplateSystemSignalRef=OBJ_VEH_TRACK_FLAG_033
          OBJ_POS_LAT_033_oRDR_TRACKER_OBJ_033_oPCAN_RADAR_c2261f8c_Tx: ComBitPosition=79, ComBitSize=16, ComSignalType=UINT16, ComHandleId=10127, ComSystemTemplateSystemSignalRef=OBJ_POS_LAT_033
          OBJ_DIMENSION_LENGTH_033_oRDR_TRACKER_OBJ_033_oPCAN_RADAR_b2a48931_Tx: ComBitPosition=37, ComBitSize=12, ComSignalType=UINT16, ComHandleId=10115, ComSystemTemplateSystemSignalRef=OBJ_DIMENSION_LENGTH_033
          OBJ_YAW_ANGLE_ERR_033_oRDR_TRACKER_OBJ_033_oPCAN_RADAR_bff4183c_Tx: ComBitPosition=175, ComBitSize=7, ComSignalType=UINT8, ComHandleId=10143, ComSystemTemplateSystemSignalRef=OBJ_YAW_ANGLE_ERR_033
          OBJ_ACCELERATION_LAT_033_oRDR_TRACKER_OBJ_033_oPCAN_RADAR_7570290f_Tx: ComBitPosition=177, ComBitSize=10, ComSignalType=UINT16, ComHandleId=10097, ComSystemTemplateSystemSignalRef=OBJ_ACCELERATION_LAT_033
          OBJ_CLS_TYPE5_033_oRDR_TRACKER_OBJ_033_oPCAN_RADAR_ab8a273e_Tx: ComBitPosition=287, ComBitSize=4, ComSignalType=UINT8, ComHandleId=10111, ComSystemTemplateSystemSignalRef=OBJ_CLS_TYPE5_033
          OBJ_VELOCITY_LAT_ERR_033_oRDR_TRACKER_OBJ_033_oPCAN_RADAR_b2bf2afa_Tx: ComBitPosition=151, ComBitSize=8, ComSignalType=UINT8, ComHandleId=10139, ComSystemTemplateSystemSignalRef=OBJ_VELOCITY_LAT_ERR_033
          OBJ_CLS_TYPE5_PROB_033_oRDR_TRACKER_OBJ_033_oPCAN_RADAR_9f5cd02b_Tx: ComBitPosition=335, ComBitSize=8, ComSignalType=UINT8, ComHandleId=10112, ComSystemTemplateSystemSignalRef=OBJ_CLS_TYPE5_PROB_033
          OBJ_ID_033_oRDR_TRACKER_OBJ_033_oPCAN_RADAR_e08ac50b_Tx: ComBitPosition=7, ComBitSize=8, ComSignalType=UINT8, ComHandleId=10121, ComSystemTemplateSystemSignalRef=OBJ_ID_033
          OBJ_CLS_TYPE6_PROB_033_oRDR_TRACKER_OBJ_033_oPCAN_RADAR_5668cb26_Tx: ComBitPosition=343, ComBitSize=8, ComSignalType=UINT8, ComHandleId=10114, ComSystemTemplateSystemSignalRef=OBJ_CLS_TYPE6_PROB_033
          OBJ_CLS_TYPE6_033_oRDR_TRACKER_OBJ_033_oPCAN_RADAR_e6622759_Tx: ComBitPosition=282, ComBitSize=4, ComSignalType=UINT8, ComHandleId=10113, ComSystemTemplateSystemSignalRef=OBJ_CLS_TYPE6_033
          OBJ_DIMENSION_WIDTH_ERR_033_oRDR_TRACKER_OBJ_033_oPCAN_RADAR_71c8b974_Tx: ComBitPosition=23, ComBitSize=6, ComSignalType=UINT8, ComHandleId=10118, ComSystemTemplateSystemSignalRef=OBJ_DIMENSION_WIDTH_ERR_033
          OBJ_POS_ERR_CRR_COEF_033_oRDR_TRACKER_OBJ_033_oPCAN_RADAR_2089e2c0_Tx: ComBitPosition=415, ComBitSize=8, ComSignalType=UINT8, ComHandleId=10126, ComSystemTemplateSystemSignalRef=OBJ_POS_ERR_CRR_COEF_033
          OBJ_REF_PT_LAT_OFFSET_033_oRDR_TRACKER_OBJ_033_oPCAN_RADAR_15d422fe_Tx: ComBitPosition=370, ComBitSize=14, ComSignalType=UINT16, ComHandleId=10132, ComSystemTemplateSystemSignalRef=OBJ_REF_PT_LAT_OFFSET_033
          OBJ_YAW_RATE_ERR_033_oRDR_TRACKER_OBJ_033_oPCAN_RADAR_70aeac70_Tx: ComBitPosition=388, ComBitSize=5, ComSignalType=UINT8, ComHandleId=10145, ComSystemTemplateSystemSignalRef=OBJ_YAW_RATE_ERR_033
          OBJ_ACCELERATION_LONG_ERR_033_oRDR_TRACKER_OBJ_033_oPCAN_RADAR_bf21b61b_Tx: ComBitPosition=215, ComBitSize=8, ComSignalType=UINT8, ComHandleId=10100, ComSystemTemplateSystemSignalRef=OBJ_ACCELERATION_LONG_ERR_033
          OBJ_CLS_TYPE2_033_oRDR_TRACKER_OBJ_033_oPCAN_RADAR_bdd2da12_Tx: ComBitPosition=267, ComBitSize=4, ComSignalType=UINT8, ComHandleId=10105, ComSystemTemplateSystemSignalRef=OBJ_CLS_TYPE2_033
          OBJ_MH_CYCLE_COUNTER_033_oRDR_TRACKER_OBJ_033_oPCAN_RADAR_92dc5a6b_Tx: ComBitPosition=487, ComBitSize=8, ComSignalType=UINT8, ComHandleId=10124, ComSystemTemplateSystemSignalRef=OBJ_MH_CYCLE_COUNTER_033
          OBJ_MH_CRC16_033_oRDR_TRACKER_OBJ_033_oPCAN_RADAR_e338008a_Tx: ComBitPosition=495, ComBitSize=16, ComSignalType=UINT16, ComHandleId=10123, ComSystemTemplateSystemSignalRef=OBJ_MH_CRC16_033
      6 x ComIPdu, all with ComIPduDirection=SEND, ComIPduType=NORMAL, ComIPduCancellationSupport=false, ComIPduSignalProcessing=DEFERRED, ComIPduChannelRef=CN_PCAN_RADAR_458ff0f1, ComIPduGroupRef=RDR01_oPCAN_RADAR_Tx_b6bdb067 if post-build-variant-condition{matching-criterion=RDR_POS, value=0}, ComIPduMainFunctionRef=ComMainFunctionTx_Event, ComIPduGroupRef=RDR02_oPCAN_RADAR_Tx_9f750495 if post-build-variant-condition{matching-criterion=RDR_POS, value=1}, ComIPduGroupRef=RDR03_oPCAN_RADAR_Tx_311d9504 if post-build-variant-condition{matching-criterion=RDR_POS, value=2}, ComIPduGroupRef=RDR04_oPCAN_RADAR_Tx_cce46d71 if post-build-variant-condition{matching-criterion=RDR_POS, value=3}, ComIPduGroupRef=RDR05_oPCAN_RADAR_Tx_628cfce0 if post-build-variant-condition{matching-criterion=RDR_POS, value=4}, ComIPduGroupRef=RDR06_oPCAN_RADAR_Tx_4b444812 if post-build-variant-condition{matching-criterion=RDR_POS, value=5}, ComIPduGroupRef=RDR07_oPCAN_RADAR_Tx_e52cd983 if post-build-variant-condition{matching-criterion=RDR_POS, value=6}, ComIPduGroupRef=RDR08_oPCAN_RADAR_Tx_6bc6beb9 if post-build-variant-condition{matching-criterion=RDR_POS, value=7}:
        RDR_DETECTION_317_320_oPCAN_RADAR_6bd84342_Tx: ComIPduHandleId=85, ComIPduSignalGroupRef=SG_Detections_317_320_oRDR_DETECTION_317_320_oPCAN_RADAR_2eaedcea_Tx, ComPduIdRef=RDR_DETECTION_317_320_oPCAN_RADAR_6bd84342_Tx
          ComTxIPdu: ComMinimumDelayTime=0, ComTxIPduUnusedAreasDefault=0
            ComTxModeTrue
              ComTxMode: ComTxModeMode=DIRECT, ComTxModeNumberOfRepetitions=0
            ComTxModeFalse
              ComTxMode: ComTxModeMode=NONE
        RDR_TRACKER_OBJ_005_oPCAN_RADAR_ee3e91c0_Tx: ComIPduHandleId=115, ComIPduSignalGroupRef=SG_TrackerObject005_oRDR_TRACKER_OBJ_005_oPCAN_RADAR_f70e50d3_Tx, ComPduIdRef=RDR_TRACKER_OBJ_005_oPCAN_RADAR_ee3e91c0_Tx
          ComTxIPdu: ComMinimumDelayTime=0, ComTxIPduUnusedAreasDefault=0
            ComTxModeTrue
              ComTxMode: ComTxModeMode=DIRECT, ComTxModeNumberOfRepetitions=0
            ComTxModeFalse
              ComTxMode: ComTxModeMode=NONE
        RDR_DETECTION_005_008_oPCAN_RADAR_59f09e74_Tx: ComIPduHandleId=7, ComIPduSignalGroupRef=SG_Detections_005_008_oRDR_DETECTION_005_008_oPCAN_RADAR_ae8ba1f7_Tx, ComPduIdRef=RDR_DETECTION_005_008_oPCAN_RADAR_59f09e74_Tx
          ComTxIPdu: ComMinimumDelayTime=0, ComTxIPduUnusedAreasDefault=0
            ComTxModeTrue
              ComTxMode: ComTxModeMode=DIRECT, ComTxModeNumberOfRepetitions=0
            ComTxModeFalse
              ComTxMode: ComTxModeMode=NONE
        RDR_DETECTION_289_292_oPCAN_RADAR_9382762f_Tx: ComIPduHandleId=78, ComIPduSignalGroupRef=SG_Detections_289_292_oRDR_DETECTION_289_292_oPCAN_RADAR_677741bc_Tx, ComPduIdRef=RDR_DETECTION_289_292_oPCAN_RADAR_9382762f_Tx
          ComTxIPdu: ComMinimumDelayTime=0, ComTxIPduUnusedAreasDefault=0
            ComTxModeTrue
              ComTxMode: ComTxModeMode=DIRECT, ComTxModeNumberOfRepetitions=0
            ComTxModeFalse
              ComTxMode: ComTxModeMode=NONE
        RDR_DETECTION_305_308_oPCAN_RADAR_ebdb72a4_Tx: ComIPduHandleId=82, ComIPduSignalGroupRef=SG_Detections_305_308_oRDR_DETECTION_305_308_oPCAN_RADAR_6973c633_Tx, ComPduIdRef=RDR_DETECTION_305_308_oPCAN_RADAR_ebdb72a4_Tx
          ComTxIPdu: ComMinimumDelayTime=0, ComTxIPduUnusedAreasDefault=0
            ComTxModeTrue
              ComTxMode: ComTxModeMode=DIRECT, ComTxModeNumberOfRepetitions=0
            ComTxModeFalse
              ComTxMode: ComTxModeMode=NONE
        RDR_DETECTION_397_400_oPCAN_RADAR_06e626f9_Tx: ComIPduHandleId=105, ComIPduSignalGroupRef=SG_Detections_397_400_oRDR_DETECTION_397_400_oPCAN_RADAR_a221f00e_Tx, ComPduIdRef=RDR_DETECTION_397_400_oPCAN_RADAR_06e626f9_Tx
          ComTxIPdu: ComMinimumDelayTime=0, ComTxIPduUnusedAreasDefault=0
            ComTxModeTrue
              ComTxMode: ComTxModeMode=DIRECT, ComTxModeNumberOfRepetitions=0
            ComTxModeFalse
              ComTxMode: ComTxModeMode=NONE
