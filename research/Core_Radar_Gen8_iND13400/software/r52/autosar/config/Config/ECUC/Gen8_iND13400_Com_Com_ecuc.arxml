[part 4 of 20: package /ActiveEcuC]
AUTOSAR XML (schema 00053)
package /ActiveEcuC  (continued)
  module config Com: implementation-config-variant=VARIANT-PRE-COMPILE, module-description=Com_Impl  (continued)
    ComConfig: ComConfigurationId=0, ComRxImmediateNotificationCacheSize=0, ComRxDeferredNotificationCacheSize=1  (continued)
      SG_TrackerObject019_oRDR_TRACKER_OBJ_019_oPCAN_RADAR_524fd4bf_Tx (ComSignalGroup):
        ComTransferProperty = TRIGGERED
        ComSignalGroupAccess = ACCESS_NEEDED_BY_SWC_OR_COM
        ComHandleId = 128
        ComSignalGroupArrayAccess = true
        ComSystemTemplateSignalGroupRef = SG_TrackerObject019
        49 x ComGroupSignal, all with ComSignalEndianness=BIG_ENDIAN, ComSignalInitValue=0, ComTransferProperty=PENDING, ComSignalAccess=ACCESS_NEEDED_BY_SWC_OR_COM:
          OBJ_DIMENSION_LENGTH_019_oRDR_TRACKER_OBJ_019_oPCAN_RADAR_9bbf2ff6_Tx: ComBitPosition=37, ComBitSize=12, ComSignalType=UINT16, ComHandleId=9429, ComSystemTemplateSystemSignalRef=OBJ_DIMENSION_LENGTH_019
          OBJ_TIMESTAMP_OFFSET_019_oRDR_TRACKER_OBJ_019_oPCAN_RADAR_c95eef1a_Tx: ComBitPosition=247, ComBitSize=8, ComSignalType=UINT8, ComHandleId=9448, ComSystemTemplateSystemSignalRef=OBJ_TIMESTAMP_OFFSET_019
          OBJ_ACCELERATION_LONG_ERR_019_oRDR_TRACKER_OBJ_019_oPCAN_RADAR_963a10dc_Tx: ComBitPosition=215, ComBitSize=8, ComSignalType=UINT8, ComHandleId=9414, ComSystemTemplateSystemSignalRef=OBJ_ACCELERATION_LONG_ERR_019
          OBJ_YAW_RATE_019_oRDR_TRACKER_OBJ_019_oPCAN_RADAR_666d9d6b_Tx: ComBitPosition=399, ComBitSize=10, ComSignalType=UINT16, ComHandleId=9458, ComSystemTemplateSystemSignalRef=OBJ_YAW_RATE_019
          OBJ_REF_PT_LAT_OFFSET_019_oRDR_TRACKER_OBJ_019_oPCAN_RADAR_3ccf8439_Tx: ComBitPosition=370, ComBitSize=14, ComSignalType=UINT16, ComHandleId=9446, ComSystemTemplateSystemSignalRef=OBJ_REF_PT_LAT_OFFSET_019
          OBJ_CLS_TYPE5_019_oRDR_TRACKER_OBJ_019_oPCAN_RADAR_829181f9_Tx: ComBitPosition=287, ComBitSize=4, ComSignalType=UINT8, ComHandleId=9425, ComSystemTemplateSystemSignalRef=OBJ_CLS_TYPE5_019
          OBJ_ACCELERATION_LAT_019_oRDR_TRACKER_OBJ_019_oPCAN_RADAR_5c6b8fc8_Tx: ComBitPosition=177, ComBitSize=10, ComSignalType=UINT16, ComHandleId=9411, ComSystemTemplateSystemSignalRef=OBJ_ACCELERATION_LAT_019
          OBJ_GROUP_ID_019_oRDR_TRACKER_OBJ_019_oPCAN_RADAR_3abf48cb_Tx: ComBitPosition=405, ComBitSize=6, ComSignalType=UINT8, ComHandleId=9434, ComSystemTemplateSystemSignalRef=OBJ_GROUP_ID_019
          OBJ_CLS_TYPE1_019_oRDR_TRACKER_OBJ_019_oPCAN_RADAR_d9217cb2_Tx: ComBitPosition=271, ComBitSize=4, ComSignalType=UINT8, ComHandleId=9417, ComSystemTemplateSystemSignalRef=OBJ_CLS_TYPE1_019
          OBJ_CLS_TYPE6_PROB_019_oRDR_TRACKER_OBJ_019_oPCAN_RADAR_7f736de1_Tx: ComBitPosition=343, ComBitSize=8, ComSignalType=UINT8, ComHandleId=9428, ComSystemTemplateSystemSignalRef=OBJ_CLS_TYPE6_PROB_019
          OBJ_VELOCITY_LONG_ERR_019_oRDR_TRACKER_OBJ_019_oPCAN_RADAR_7726b3fd_Tx: ComBitPosition=143, ComBitSize=8, ComSignalType=UINT8, ComHandleId=9455, ComSystemTemplateSystemSignalRef=OBJ_VELOCITY_LONG_ERR_019
          OBJ_POS_LONG_019_oRDR_TRACKER_OBJ_019_oPCAN_RADAR_5a9d5284_Tx: ComBitPosition=63, ComBitSize=16, ComSignalType=UINT16, ComHandleId=9443, ComSystemTemplateSystemSignalRef=OBJ_POS_LONG_019
          OBJ_POS_LAT_019_oRDR_TRACKER_OBJ_019_oPCAN_RADAR_eb3db94b_Tx: ComBitPosition=79, ComBitSize=16, ComSignalType=UINT16, ComHandleId=9441, ComSystemTemplateSystemSignalRef=OBJ_POS_LAT_019
          OBJ_CLS_TYPE5_PROB_019_oRDR_TRACKER_OBJ_019_oPCAN_RADAR_b64776ec_Tx: ComBitPosition=335, ComBitSize=8, ComSignalType=UINT8, ComHandleId=9426, ComSystemTemplateSystemSignalRef=OBJ_CLS_TYPE5_PROB_019
          OBJ_ACCELERATION_LONG_019_oRDR_TRACKER_OBJ_019_oPCAN_RADAR_2e9bd628_Tx: ComBitPosition=193, ComBitSize=10, ComSignalType=UINT16, ComHandleId=9413, ComSystemTemplateSystemSignalRef=OBJ_ACCELERATION_LONG_019
          OBJ_VEH_TRACK_FLAG_019_oRDR_TRACKER_OBJ_019_oPCAN_RADAR_8777189a_Tx: ComBitPosition=10, ComBitSize=1, ComSignalType=BOOLEAN, ComHandleId=9450, ComSystemTemplateSystemSignalRef=OBJ_VEH_TRACK_FLAG_019
          OBJ_VELOCITY_LAT_019_oRDR_TRACKER_OBJ_019_oPCAN_RADAR_af5efc6c_Tx: ComBitPosition=126, ComBitSize=15, ComSignalType=UINT16, ComHandleId=9452, ComSystemTemplateSystemSignalRef=OBJ_VELOCITY_LAT_019
          OBJ_ACCELERATION_LAT_ERR_019_oRDR_TRACKER_OBJ_019_oPCAN_RADAR_899fb576_Tx: ComBitPosition=223, ComBitSize=8, ComSignalType=UINT8, ComHandleId=9412, ComSystemTemplateSystemSignalRef=OBJ_ACCELERATION_LAT_ERR_019
          OBJ_CLS_TYPE1_PROB_019_oRDR_TRACKER_OBJ_019_oPCAN_RADAR_7179ab41_Tx: ComBitPosition=303, ComBitSize=8, ComSignalType=UINT8, ComHandleId=9418, ComSystemTemplateSystemSignalRef=OBJ_CLS_TYPE1_PROB_019
          OBJ_EXISTENCE_PROB_019_oRDR_TRACKER_OBJ_019_oPCAN_RADAR_b3cd5c66_Tx: ComBitPosition=229, ComBitSize=14, ComSignalType=UINT16, ComHandleId=9433, ComSystemTemplateSystemSignalRef=OBJ_EXISTENCE_PROB_019
          OBJ_POS_ERR_CRR_COEF_019_oRDR_TRACKER_OBJ_019_oPCAN_RADAR_09924407_Tx: ComBitPosition=415, ComBitSize=8, ComSignalType=UINT8, ComHandleId=9440, ComSystemTemplateSystemSignalRef=OBJ_POS_ERR_CRR_COEF_019
          OBJ_MEASUREMENT_STATUS_019_oRDR_TRACKER_OBJ_019_oPCAN_RADAR_b6431171_Tx: ComBitPosition=14, ComBitSize=3, ComSignalType=UINT8, ComHandleId=9436, ComSystemTemplateSystemSignalRef=OBJ_MEASUREMENT_STATUS_019
          OBJ_VELOCITY_LONG_019_oRDR_TRACKER_OBJ_019_oPCAN_RADAR_ffd384aa_Tx: ComBitPosition=110, ComBitSize=15, ComSignalType=UINT16, ComHandleId=9454, ComSystemTemplateSystemSignalRef=OBJ_VELOCITY_LONG_019
          OBJ_CLS_TYPE4_PROB_019_oRDR_TRACKER_OBJ_019_oPCAN_RADAR_f1548017_Tx: ComBitPosition=327, ComBitSize=8, ComSignalType=UINT8, ComHandleId=9424, ComSystemTemplateSystemSignalRef=OBJ_CLS_TYPE4_PROB_019
          OBJ_YAW_RATE_ERR_019_oRDR_TRACKER_OBJ_019_oPCAN_RADAR_59b50ab7_Tx: ComBitPosition=388, ComBitSize=5, ComSignalType=UINT8, ComHandleId=9459, ComSystemTemplateSystemSignalRef=OBJ_YAW_RATE_ERR_019
          OBJ_CLS_TYPE4_019_oRDR_TRACKER_OBJ_019_oPCAN_RADAR_0f197c1b_Tx: ComBitPosition=275, ComBitSize=4, ComSignalType=UINT8, ComHandleId=9423, ComSystemTemplateSystemSignalRef=OBJ_CLS_TYPE4_019
          OBJ_REF_PT_LONG_OFFSET_019_oRDR_TRACKER_OBJ_019_oPCAN_RADAR_739d743a_Tx: ComBitPosition=357, ComBitSize=14, ComSignalType=UINT16, ComHandleId=9447, ComSystemTemplateSystemSignalRef=OBJ_REF_PT_LONG_OFFSET_019
          OBJ_DIMENSION_WIDTH_ERR_019_oRDR_TRACKER_OBJ_019_oPCAN_RADAR_58d31fb3_Tx: ComBitPosition=23, ComBitSize=6, ComSignalType=UINT8, ComHandleId=9432, ComSystemTemplateSystemSignalRef=OBJ_DIMENSION_WIDTH_ERR_019
          OBJ_RCS_019_oRDR_TRACKER_OBJ_019_oPCAN_RADAR_c9f2ef4c_Tx: ComBitPosition=351, ComBitSize=7, ComSignalType=UINT8, ComHandleId=9445, ComSystemTemplateSystemSignalRef=OBJ_RCS_019
          OBJ_CLS_TYPE6_019_oRDR_TRACKER_OBJ_019_oPCAN_RADAR_cf79819e_Tx: ComBitPosition=282, ComBitSize=4, ComSignalType=UINT8, ComHandleId=9427, ComSystemTemplateSystemSignalRef=OBJ_CLS_TYPE6_019
          OBJ_POS_LAT_ERR_019_oRDR_TRACKER_OBJ_019_oPCAN_RADAR_ef71e97c_Tx: ComBitPosition=103, ComBitSize=8, ComSignalType=UINT8, ComHandleId=9442, ComSystemTemplateSystemSignalRef=OBJ_POS_LAT_ERR_019
          OBJ_ACCEL_ERR_CRR_COEF_019_oRDR_TRACKER_OBJ_019_oPCAN_RADAR_369931ba_Tx: ComBitPosition=431, ComBitSize=8, ComSignalType=UINT8, ComHandleId=9415, ComSystemTemplateSystemSignalRef=OBJ_ACCEL_ERR_CRR_COEF_019
          OBJ_CLS_TYPE3_019_oRDR_TRACKER_OBJ_019_oPCAN_RADAR_19418137_Tx: ComBitPosition=279, ComBitSize=4, ComSignalType=UINT8, ComHandleId=9421, ComSystemTemplateSystemSignalRef=OBJ_CLS_TYPE3_019
          OBJ_ALIVE_TIME_019_oRDR_TRACKER_OBJ_019_oPCAN_RADAR_4efa9d94_Tx: ComBitPosition=255, ComBitSize=16, ComSignalType=UINT16, ComHandleId=9416, ComSystemTemplateSystemSignalRef=OBJ_ALIVE_TIME_019
          OBJ_MOVEMENT_STATUS_019_oRDR_TRACKER_OBJ_019_oPCAN_RADAR_99ed843d_Tx: ComBitPosition=196, ComBitSize=3, ComSignalType=UINT8, ComHandleId=9439, ComSystemTemplateSystemSignalRef=OBJ_MOVEMENT_STATUS_019
          OBJ_YAW_ANGLE_ERR_019_oRDR_TRACKER_OBJ_019_oPCAN_RADAR_96efbefb_Tx: ComBitPosition=175, ComBitSize=7, ComSignalType=UINT8, ComHandleId=9457, ComSystemTemplateSystemSignalRef=OBJ_YAW_ANGLE_ERR_019
          OBJ_CLS_TYPE3_PROB_019_oRDR_TRACKER_OBJ_019_oPCAN_RADAR_ff5e46b7_Tx: ComBitPosition=319, ComBitSize=8, ComSignalType=UINT8, ComHandleId=9422, ComSystemTemplateSystemSignalRef=OBJ_CLS_TYPE3_PROB_019
          OBJ_POS_LONG_ERR_019_oRDR_TRACKER_OBJ_019_oPCAN_RADAR_7689179e_Tx: ComBitPosition=95, ComBitSize=8, ComSignalType=UINT8, ComHandleId=9444, ComSystemTemplateSystemSignalRef=OBJ_POS_LONG_ERR_019
          OBJ_ID_019_oRDR_TRACKER_OBJ_019_oPCAN_RADAR_c99163cc_Tx: ComBitPosition=7, ComBitSize=8, ComSignalType=UINT8, ComHandleId=9435, ComSystemTemplateSystemSignalRef=OBJ_ID_019
          OBJ_YAW_ANGLE_019_oRDR_TRACKER_OBJ_019_oPCAN_RADAR_43e2b82c_Tx: ComBitPosition=155, ComBitSize=12, ComSignalType=UINT16, ComHandleId=9456, ComSystemTemplateSystemSignalRef=OBJ_YAW_ANGLE_019
          OBJ_DIMENSION_WIDTH_019_oRDR_TRACKER_OBJ_019_oPCAN_RADAR_b871d85b_Tx: ComBitPosition=17, ComBitSize=10, ComSignalType=UINT16, ComHandleId=9431, ComSystemTemplateSystemSignalRef=OBJ_DIMENSION_WIDTH_019
          OBJ_VELOCITY_ERR_CRR_COEF_019_oRDR_TRACKER_OBJ_019_oPCAN_RADAR_a0e879e6_Tx: ComBitPosition=423, ComBitSize=8, ComSignalType=UINT8, ComHandleId=9451, ComSystemTemplateSystemSignalRef=OBJ_VELOCITY_ERR_CRR_COEF_019
          OBJ_VELOCITY_LAT_ERR_019_oRDR_TRACKER_OBJ_019_oPCAN_RADAR_9ba48c3d_Tx: ComBitPosition=151, ComBitSize=8, ComSignalType=UINT8, ComHandleId=9453, ComSystemTemplateSystemSignalRef=OBJ_VELOCITY_LAT_ERR_019
          OBJ_DIMENSION_LENGTH_ERR_019_oRDR_TRACKER_OBJ_019_oPCAN_RADAR_a047308c_Tx: ComBitPosition=41, ComBitSize=10, ComSignalType=UINT16, ComHandleId=9430, ComSystemTemplateSystemSignalRef=OBJ_DIMENSION_LENGTH_ERR_019
          OBJ_TRACK_MOTION_MODEL_019_oRDR_TRACKER_OBJ_019_oPCAN_RADAR_055deec7_Tx: ComBitPosition=9, ComBitSize=2, ComSignalType=UINT8, ComHandleId=9449, ComSystemTemplateSystemSignalRef=OBJ_TRACK_MOTION_MODEL_019
          OBJ_CLS_TYPE2_019_oRDR_TRACKER_OBJ_019_oPCAN_RADAR_94c97cd5_Tx: ComBitPosition=267, ComBitSize=4, ComSignalType=UINT8, ComHandleId=9419, ComSystemTemplateSystemSignalRef=OBJ_CLS_TYPE2_019
          OBJ_CLS_TYPE2_PROB_019_oRDR_TRACKER_OBJ_019_oPCAN_RADAR_b84db04c_Tx: ComBitPosition=311, ComBitSize=8, ComSignalType=UINT8, ComHandleId=9420, ComSystemTemplateSystemSignalRef=OBJ_CLS_TYPE2_PROB_019
          OBJ_MH_CYCLE_COUNTER_019_oRDR_TRACKER_OBJ_019_oPCAN_RADAR_bbc7fcac_Tx: ComBitPosition=487, ComBitSize=8, ComSignalType=UINT8, ComHandleId=9438, ComSystemTemplateSystemSignalRef=OBJ_MH_CYCLE_COUNTER_019
          OBJ_MH_CRC16_019_oRDR_TRACKER_OBJ_019_oPCAN_RADAR_ca23a64d_Tx: ComBitPosition=495, ComBitSize=16, ComSignalType=UINT16, ComHandleId=9437, ComSystemTemplateSystemSignalRef=OBJ_MH_CRC16_019
      4 x ComIPdu, all with ComIPduDirection=SEND, ComIPduType=NORMAL, ComIPduCancellationSupport=false, ComIPduSignalProcessing=DEFERRED, ComIPduChannelRef=CN_PCAN_RADAR_458ff0f1, ComIPduGroupRef=RDR01_oPCAN_RADAR_Tx_b6bdb067 if post-build-variant-condition{matching-criterion=RDR_POS, value=0}, ComIPduMainFunctionRef=ComMainFunctionTx_Event, ComIPduGroupRef=RDR02_oPCAN_RADAR_Tx_9f750495 if post-build-variant-condition{matching-criterion=RDR_POS, value=1}, ComIPduGroupRef=RDR03_oPCAN_RADAR_Tx_311d9504 if post-build-variant-condition{matching-criterion=RDR_POS, value=2}, ComIPduGroupRef=RDR04_oPCAN_RADAR_Tx_cce46d71 if post-build-variant-condition{matching-criterion=RDR_POS, value=3}, ComIPduGroupRef=RDR05_oPCAN_RADAR_Tx_628cfce0 if post-build-variant-condition{matching-criterion=RDR_POS, value=4}, ComIPduGroupRef=RDR06_oPCAN_RADAR_Tx_4b444812 if post-build-variant-condition{matching-criterion=RDR_POS, value=5}, ComIPduGroupRef=RDR07_oPCAN_RADAR_Tx_e52cd983 if post-build-variant-condition{matching-criterion=RDR_POS, value=6}, ComIPduGroupRef=RDR08_oPCAN_RADAR_Tx_6bc6beb9 if post-build-variant-condition{matching-criterion=RDR_POS, value=7}:
        RDR_TRACKER_OBJ_035_oPCAN_RADAR_925fb41b_Tx: ComIPduHandleId=145, ComIPduSignalGroupRef=SG_TrackerObject035_oRDR_TRACKER_OBJ_035_oPCAN_RADAR_00bc4b11_Tx, ComPduIdRef=RDR_TRACKER_OBJ_035_oPCAN_RADAR_925fb41b_Tx
          ComTxIPdu: ComMinimumDelayTime=0, ComTxIPduUnusedAreasDefault=0
            ComTxModeTrue
              ComTxMode: ComTxModeMode=DIRECT, ComTxModeNumberOfRepetitions=0
            ComTxModeFalse
              ComTxMode: ComTxModeMode=NONE
        RDR_CAPABILITY_oPCAN_RADAR_18844568_Tx: ComIPduHandleId=5, ComIPduSignalGroupRef=SG_RadarCapability_oRDR_CAPABILITY_oPCAN_RADAR_be2920f1_Tx, ComPduIdRef=RDR_CAPABILITY_oPCAN_RADAR_18844568_Tx
          ComTxIPdu: ComMinimumDelayTime=0, ComTxIPduUnusedAreasDefault=0
            ComTxModeTrue
              ComTxMode: ComTxModeMode=DIRECT, ComTxModeTimeOffset=0, ComTxModeTimePeriod=0.05, ComTxModeNumberOfRepetitions=0
            ComTxModeFalse
              ComTxMode: ComTxModeMode=NONE, ComTxModeTimeOffset=0, ComTxModeTimePeriod=0.05
        RDR_DETECTION_353_356_oPCAN_RADAR_d650c696_Tx: ComIPduHandleId=94, ComIPduSignalGroupRef=SG_Detections_353_356_oRDR_DETECTION_353_356_oPCAN_RADAR_a8e9cac4_Tx, ComPduIdRef=RDR_DETECTION_353_356_oPCAN_RADAR_d650c696_Tx
          ComTxIPdu: ComMinimumDelayTime=0, ComTxIPduUnusedAreasDefault=0
            ComTxModeTrue
              ComTxMode: ComTxModeMode=DIRECT, ComTxModeNumberOfRepetitions=0
            ComTxModeFalse
              ComTxMode: ComTxModeMode=NONE
        RDR_DETECTION_369_372_oPCAN_RADAR_2f2d6a96_Tx: ComIPduHandleId=98, ComIPduSignalGroupRef=SG_Detections_369_372_oRDR_DETECTION_369_372_oPCAN_RADAR_af9702be_Tx, ComPduIdRef=RDR_DETECTION_369_372_oPCAN_RADAR_2f2d6a96_Tx
          ComTxIPdu: ComMinimumDelayTime=0, ComTxIPduUnusedAreasDefault=0
            ComTxModeTrue
              ComTxMode: ComTxModeMode=DIRECT, ComTxModeNumberOfRepetitions=0
            ComTxModeFalse
              ComTxMode: ComTxModeMode=NONE
      SG_TrackerObject022_oRDR_TRACKER_OBJ_022_oPCAN_RADAR_d0d10c75_Tx (ComSignalGroup):
        ComTransferProperty = TRIGGERED
        ComSignalGroupAccess = ACCESS_NEEDED_BY_SWC_OR_COM
        ComHandleId = 131
        ComSignalGroupArrayAccess = true
        ComSystemTemplateSignalGroupRef = SG_TrackerObject022
        49 x ComGroupSignal, all with ComSignalEndianness=BIG_ENDIAN, ComSignalInitValue=0, ComTransferProperty=PENDING, ComSignalAccess=ACCESS_NEEDED_BY_SWC_OR_COM:
          OBJ_ACCELERATION_LAT_ERR_022_oRDR_TRACKER_OBJ_022_oPCAN_RADAR_0b016dbc_Tx: ComBitPosition=223, ComBitSize=8, ComSignalType=UINT8, ComHandleId=9559, ComSystemTemplateSystemSignalRef=OBJ_ACCELERATION_LAT_ERR_022
          OBJ_MOVEMENT_STATUS_022_oRDR_TRACKER_OBJ_022_oPCAN_RADAR_1b735cf7_Tx: ComBitPosition=196, ComBitSize=3, ComSignalType=UINT8, ComHandleId=9586, ComSystemTemplateSystemSignalRef=OBJ_MOVEMENT_STATUS_022
          OBJ_VELOCITY_LONG_ERR_022_oRDR_TRACKER_OBJ_022_oPCAN_RADAR_f5b86b37_Tx: ComBitPosition=143, ComBitSize=8, ComSignalType=UINT8, ComHandleId=9602, ComSystemTemplateSystemSignalRef=OBJ_VELOCITY_LONG_ERR_022
          OBJ_POS_ERR_CRR_COEF_022_oRDR_TRACKER_OBJ_022_oPCAN_RADAR_8b0c9ccd_Tx: ComBitPosition=415, ComBitSize=8, ComSignalType=UINT8, ComHandleId=9587, ComSystemTemplateSystemSignalRef=OBJ_POS_ERR_CRR_COEF_022
          OBJ_YAW_RATE_022_oRDR_TRACKER_OBJ_022_oPCAN_RADAR_e4f345a1_Tx: ComBitPosition=399, ComBitSize=10, ComSignalType=UINT16, ComHandleId=9605, ComSystemTemplateSystemSignalRef=OBJ_YAW_RATE_022
          OBJ_CLS_TYPE1_022_oRDR_TRACKER_OBJ_022_oPCAN_RADAR_5bbfa478_Tx: ComBitPosition=271, ComBitSize=4, ComSignalType=UINT8, ComHandleId=9564, ComSystemTemplateSystemSignalRef=OBJ_CLS_TYPE1_022
          OBJ_ACCELERATION_LONG_ERR_022_oRDR_TRACKER_OBJ_022_oPCAN_RADAR_14a4c816_Tx: ComBitPosition=215, ComBitSize=8, ComSignalType=UINT8, ComHandleId=9561, ComSystemTemplateSystemSignalRef=OBJ_ACCELERATION_LONG_ERR_022
          OBJ_CLS_TYPE6_022_oRDR_TRACKER_OBJ_022_oPCAN_RADAR_4de75954_Tx: ComBitPosition=282, ComBitSize=4, ComSignalType=UINT8, ComHandleId=9574, ComSystemTemplateSystemSignalRef=OBJ_CLS_TYPE6_022
          OBJ_POS_LONG_ERR_022_oRDR_TRACKER_OBJ_022_oPCAN_RADAR_f417cf54_Tx: ComBitPosition=95, ComBitSize=8, ComSignalType=UINT8, ComHandleId=9591, ComSystemTemplateSystemSignalRef=OBJ_POS_LONG_ERR_022
          OBJ_REF_PT_LAT_OFFSET_022_oRDR_TRACKER_OBJ_022_oPCAN_RADAR_be515cf3_Tx: ComBitPosition=370, ComBitSize=14, ComSignalType=UINT16, ComHandleId=9593, ComSystemTemplateSystemSignalRef=OBJ_REF_PT_LAT_OFFSET_022
          OBJ_YAW_ANGLE_ERR_022_oRDR_TRACKER_OBJ_022_oPCAN_RADAR_14716631_Tx: ComBitPosition=175, ComBitSize=7, ComSignalType=UINT8, ComHandleId=9604, ComSystemTemplateSystemSignalRef=OBJ_YAW_ANGLE_ERR_022
          OBJ_CLS_TYPE4_022_oRDR_TRACKER_OBJ_022_oPCAN_RADAR_8d87a4d1_Tx: ComBitPosition=275, ComBitSize=4, ComSignalType=UINT8, ComHandleId=9570, ComSystemTemplateSystemSignalRef=OBJ_CLS_TYPE4_022
          OBJ_YAW_RATE_ERR_022_oRDR_TRACKER_OBJ_022_oPCAN_RADAR_db2bd27d_Tx: ComBitPosition=388, ComBitSize=5, ComSignalType=UINT8, ComHandleId=9606, ComSystemTemplateSystemSignalRef=OBJ_YAW_RATE_ERR_022
          OBJ_ACCELERATION_LAT_022_oRDR_TRACKER_OBJ_022_oPCAN_RADAR_def55702_Tx: ComBitPosition=177, ComBitSize=10, ComSignalType=UINT16, ComHandleId=9558, ComSystemTemplateSystemSignalRef=OBJ_ACCELERATION_LAT_022
          OBJ_CLS_TYPE5_022_oRDR_TRACKER_OBJ_022_oPCAN_RADAR_000f5933_Tx: ComBitPosition=287, ComBitSize=4, ComSignalType=UINT8, ComHandleId=9572, ComSystemTemplateSystemSignalRef=OBJ_CLS_TYPE5_022
          OBJ_VEH_TRACK_FLAG_022_oRDR_TRACKER_OBJ_022_oPCAN_RADAR_05e9c050_Tx: ComBitPosition=10, ComBitSize=1, ComSignalType=BOOLEAN, ComHandleId=9597, ComSystemTemplateSystemSignalRef=OBJ_VEH_TRACK_FLAG_022
          OBJ_POS_LAT_ERR_022_oRDR_TRACKER_OBJ_022_oPCAN_RADAR_6def31b6_Tx: ComBitPosition=103, ComBitSize=8, ComSignalType=UINT8, ComHandleId=9589, ComSystemTemplateSystemSignalRef=OBJ_POS_LAT_ERR_022
          OBJ_DIMENSION_WIDTH_ERR_022_oRDR_TRACKER_OBJ_022_oPCAN_RADAR_da4dc779_Tx: ComBitPosition=23, ComBitSize=6, ComSignalType=UINT8, ComHandleId=9579, ComSystemTemplateSystemSignalRef=OBJ_DIMENSION_WIDTH_ERR_022
          OBJ_POS_LONG_022_oRDR_TRACKER_OBJ_022_oPCAN_RADAR_d8038a4e_Tx: ComBitPosition=63, ComBitSize=16, ComSignalType=UINT16, ComHandleId=9590, ComSystemTemplateSystemSignalRef=OBJ_POS_LONG_022
          OBJ_CLS_TYPE2_PROB_022_oRDR_TRACKER_OBJ_022_oPCAN_RADAR_3ad36886_Tx: ComBitPosition=311, ComBitSize=8, ComSignalType=UINT8, ComHandleId=9567, ComSystemTemplateSystemSignalRef=OBJ_CLS_TYPE2_PROB_022
          OBJ_ALIVE_TIME_022_oRDR_TRACKER_OBJ_022_oPCAN_RADAR_cc64455e_Tx: ComBitPosition=255, ComBitSize=16, ComSignalType=UINT16, ComHandleId=9563, ComSystemTemplateSystemSignalRef=OBJ_ALIVE_TIME_022
          OBJ_TRACK_MOTION_MODEL_022_oRDR_TRACKER_OBJ_022_oPCAN_RADAR_87c3360d_Tx: ComBitPosition=9, ComBitSize=2, ComSignalType=UINT8, ComHandleId=9596, ComSystemTemplateSystemSignalRef=OBJ_TRACK_MOTION_MODEL_022
          OBJ_RCS_022_oRDR_TRACKER_OBJ_022_oPCAN_RADAR_4b6c3786_Tx: ComBitPosition=351, ComBitSize=7, ComSignalType=UINT8, ComHandleId=9592, ComSystemTemplateSystemSignalRef=OBJ_RCS_022
          OBJ_DIMENSION_LENGTH_ERR_022_oRDR_TRACKER_OBJ_022_oPCAN_RADAR_22d9e846_Tx: ComBitPosition=41, ComBitSize=10, ComSignalType=UINT16, ComHandleId=9577, ComSystemTemplateSystemSignalRef=OBJ_DIMENSION_LENGTH_ERR_022
          OBJ_MEASUREMENT_STATUS_022_oRDR_TRACKER_OBJ_022_oPCAN_RADAR_34ddc9bb_Tx: ComBitPosition=14, ComBitSize=3, ComSignalType=UINT8, ComHandleId=9583, ComSystemTemplateSystemSignalRef=OBJ_MEASUREMENT_STATUS_022
          OBJ_CLS_TYPE3_022_oRDR_TRACKER_OBJ_022_oPCAN_RADAR_9bdf59fd_Tx: ComBitPosition=279, ComBitSize=4, ComSignalType=UINT8, ComHandleId=9568, ComSystemTemplateSystemSignalRef=OBJ_CLS_TYPE3_022
          OBJ_EXISTENCE_PROB_022_oRDR_TRACKER_OBJ_022_oPCAN_RADAR_315384ac_Tx: ComBitPosition=229, ComBitSize=14, ComSignalType=UINT16, ComHandleId=9580, ComSystemTemplateSystemSignalRef=OBJ_EXISTENCE_PROB_022
          OBJ_VELOCITY_ERR_CRR_COEF_022_oRDR_TRACKER_OBJ_022_oPCAN_RADAR_2276a12c_Tx: ComBitPosition=423, ComBitSize=8, ComSignalType=UINT8, ComHandleId=9598, ComSystemTemplateSystemSignalRef=OBJ_VELOCITY_ERR_CRR_COEF_022
          OBJ_REF_PT_LONG_OFFSET_022_oRDR_TRACKER_OBJ_022_oPCAN_RADAR_f103acf0_Tx: ComBitPosition=357, ComBitSize=14, ComSignalType=UINT16, ComHandleId=9594, ComSystemTemplateSystemSignalRef=OBJ_REF_PT_LONG_OFFSET_022
          OBJ_CLS_TYPE1_PROB_022_oRDR_TRACKER_OBJ_022_oPCAN_RADAR_f3e7738b_Tx: ComBitPosition=303, ComBitSize=8, ComSignalType=UINT8, ComHandleId=9565, ComSystemTemplateSystemSignalRef=OBJ_CLS_TYPE1_PROB_022
          OBJ_DIMENSION_WIDTH_022_oRDR_TRACKER_OBJ_022_oPCAN_RADAR_3aef0091_Tx: ComBitPosition=17, ComBitSize=10, ComSignalType=UINT16, ComHandleId=9578, ComSystemTemplateSystemSignalRef=OBJ_DIMENSION_WIDTH_022
          OBJ_GROUP_ID_022_oRDR_TRACKER_OBJ_022_oPCAN_RADAR_b8219001_Tx: ComBitPosition=405, ComBitSize=6, ComSignalType=UINT8, ComHandleId=9581, ComSystemTemplateSystemSignalRef=OBJ_GROUP_ID_022
          OBJ_POS_LAT_022_oRDR_TRACKER_OBJ_022_oPCAN_RADAR_69a36181_Tx: ComBitPosition=79, ComBitSize=16, ComSignalType=UINT16, ComHandleId=9588, ComSystemTemplateSystemSignalRef=OBJ_POS_LAT_022
          OBJ_CLS_TYPE6_PROB_022_oRDR_TRACKER_OBJ_022_oPCAN_RADAR_fdedb52b_Tx: ComBitPosition=343, ComBitSize=8, ComSignalType=UINT8, ComHandleId=9575, ComSystemTemplateSystemSignalRef=OBJ_CLS_TYPE6_PROB_022
          OBJ_VELOCITY_LAT_022_oRDR_TRACKER_OBJ_022_oPCAN_RADAR_2dc024a6_Tx: ComBitPosition=126, ComBitSize=15, ComSignalType=UINT16, ComHandleId=9599, ComSystemTemplateSystemSignalRef=OBJ_VELOCITY_LAT_022
          OBJ_CLS_TYPE4_PROB_022_oRDR_TRACKER_OBJ_022_oPCAN_RADAR_73ca58dd_Tx: ComBitPosition=327, ComBitSize=8, ComSignalType=UINT8, ComHandleId=9571, ComSystemTemplateSystemSignalRef=OBJ_CLS_TYPE4_PROB_022
          OBJ_TIMESTAMP_OFFSET_022_oRDR_TRACKER_OBJ_022_oPCAN_RADAR_4bc037d0_Tx: ComBitPosition=247, ComBitSize=8, ComSignalType=UINT8, ComHandleId=9595, ComSystemTemplateSystemSignalRef=OBJ_TIMESTAMP_OFFSET_022
          OBJ_CLS_TYPE2_022_oRDR_TRACKER_OBJ_022_oPCAN_RADAR_1657a41f_Tx: ComBitPosition=267, ComBitSize=4, ComSignalType=UINT8, ComHandleId=9566, ComSystemTemplateSystemSignalRef=OBJ_CLS_TYPE2_022
          OBJ_CLS_TYPE5_PROB_022_oRDR_TRACKER_OBJ_022_oPCAN_RADAR_34d9ae26_Tx: ComBitPosition=335, ComBitSize=8, ComSignalType=UINT8, ComHandleId=9573, ComSystemTemplateSystemSignalRef=OBJ_CLS_TYPE5_PROB_022
          OBJ_ACCELERATION_LONG_022_oRDR_TRACKER_OBJ_022_oPCAN_RADAR_ac050ee2_Tx: ComBitPosition=193, ComBitSize=10, ComSignalType=UINT16, ComHandleId=9560, ComSystemTemplateSystemSignalRef=OBJ_ACCELERATION_LONG_022
          OBJ_CLS_TYPE3_PROB_022_oRDR_TRACKER_OBJ_022_oPCAN_RADAR_7dc09e7d_Tx: ComBitPosition=319, ComBitSize=8, ComSignalType=UINT8, ComHandleId=9569, ComSystemTemplateSystemSignalRef=OBJ_CLS_TYPE3_PROB_022
          OBJ_ACCEL_ERR_CRR_COEF_022_oRDR_TRACKER_OBJ_022_oPCAN_RADAR_b407e970_Tx: ComBitPosition=431, ComBitSize=8, ComSignalType=UINT8, ComHandleId=9562, ComSystemTemplateSystemSignalRef=OBJ_ACCEL_ERR_CRR_COEF_022
          OBJ_YAW_ANGLE_022_oRDR_TRACKER_OBJ_022_oPCAN_RADAR_c17c60e6_Tx: ComBitPosition=155, ComBitSize=12, ComSignalType=UINT16, ComHandleId=9603, ComSystemTemplateSystemSignalRef=OBJ_YAW_ANGLE_022
          OBJ_DIMENSION_LENGTH_022_oRDR_TRACKER_OBJ_022_oPCAN_RADAR_1921f73c_Tx: ComBitPosition=37, ComBitSize=12, ComSignalType=UINT16, ComHandleId=9576, ComSystemTemplateSystemSignalRef=OBJ_DIMENSION_LENGTH_022
          OBJ_ID_022_oRDR_TRACKER_OBJ_022_oPCAN_RADAR_4b0fbb06_Tx: ComBitPosition=7, ComBitSize=8, ComSignalType=UINT8, ComHandleId=9582, ComSystemTemplateSystemSignalRef=OBJ_ID_022
          OBJ_VELOCITY_LAT_ERR_022_oRDR_TRACKER_OBJ_022_oPCAN_RADAR_193a54f7_Tx: ComBitPosition=151, ComBitSize=8, ComSignalType=UINT8, ComHandleId=9600, ComSystemTemplateSystemSignalRef=OBJ_VELOCITY_LAT_ERR_022
          OBJ_VELOCITY_LONG_022_oRDR_TRACKER_OBJ_022_oPCAN_RADAR_7d4d5c60_Tx: ComBitPosition=110, ComBitSize=15, ComSignalType=UINT16, ComHandleId=9601, ComSystemTemplateSystemSignalRef=OBJ_VELOCITY_LONG_022
          OBJ_MH_CRC16_022_oRDR_TRACKER_OBJ_022_oPCAN_RADAR_48bd7e87_Tx: ComBitPosition=495, ComBitSize=16, ComSignalType=UINT16, ComHandleId=9584, ComSystemTemplateSystemSignalRef=OBJ_MH_CRC16_022
          OBJ_MH_CYCLE_COUNTER_022_oRDR_TRACKER_OBJ_022_oPCAN_RADAR_39592466_Tx: ComBitPosition=487, ComBitSize=8, ComSignalType=UINT8, ComHandleId=9585, ComSystemTemplateSystemSignalRef=OBJ_MH_CYCLE_COUNTER_022
      3 x ComIPdu, all with ComIPduDirection=SEND, ComIPduType=NORMAL, ComIPduCancellationSupport=false, ComIPduSignalProcessing=DEFERRED, ComIPduChannelRef=CN_PCAN_RADAR_458ff0f1, ComIPduGroupRef=RDR01_oPCAN_RADAR_Tx_b6bdb067 if post-build-variant-condition{matching-criterion=RDR_POS, value=0}, ComIPduMainFunctionRef=ComMainFunctionTx_Event, ComIPduGroupRef=RDR02_oPCAN_RADAR_Tx_9f750495 if post-build-variant-condition{matching-criterion=RDR_POS, value=1}, ComIPduGroupRef=RDR03_oPCAN_RADAR_Tx_311d9504 if post-build-variant-condition{matching-criterion=RDR_POS, value=2}, ComIPduGroupRef=RDR04_oPCAN_RADAR_Tx_cce46d71 if post-build-variant-condition{matching-criterion=RDR_POS, value=3}, ComIPduGroupRef=RDR05_oPCAN_RADAR_Tx_628cfce0 if post-build-variant-condition{matching-criterion=RDR_POS, value=4}, ComIPduGroupRef=RDR06_oPCAN_RADAR_Tx_4b444812 if post-build-variant-condition{matching-criterion=RDR_POS, value=5}, ComIPduGroupRef=RDR07_oPCAN_RADAR_Tx_e52cd983 if post-build-variant-condition{matching-criterion=RDR_POS, value=6}, ComIPduGroupRef=RDR08_oPCAN_RADAR_Tx_6bc6beb9 if post-build-variant-condition{matching-criterion=RDR_POS, value=7}:
        RDR_TRACKER_OBJ_001_oPCAN_RADAR_2e87fb56_Tx: ComIPduHandleId=111, ComIPduSignalGroupRef=SG_TrackerObject001_oRDR_TRACKER_OBJ_001_oPCAN_RADAR_a5be7e9d_Tx, ComPduIdRef=RDR_TRACKER_OBJ_001_oPCAN_RADAR_2e87fb56_Tx
          ComTxIPdu: ComMinimumDelayTime=0, ComTxIPduUnusedAreasDefault=0
            ComTxModeTrue
              ComTxMode: ComTxModeMode=DIRECT, ComTxModeNumberOfRepetitions=0
            ComTxModeFalse
              ComTxMode: ComTxModeMode=NONE
        RDR_DETECTION_385_388_oPCAN_RADAR_cfd3c29e_Tx: ComIPduHandleId=102, ComIPduSignalGroupRef=SG_Detections_385_388_oRDR_DETECTION_385_388_oPCAN_RADAR_bca5477b_Tx, ComPduIdRef=RDR_DETECTION_385_388_oPCAN_RADAR_cfd3c29e_Tx
          ComTxIPdu: ComMinimumDelayTime=0, ComTxIPduUnusedAreasDefault=0
            ComTxModeTrue
              ComTxMode: ComTxModeMode=DIRECT, ComTxModeNumberOfRepetitions=0
            ComTxModeFalse
              ComTxMode: ComTxModeMode=NONE
        RDR_TRACKER_OBJ_038_oPCAN_RADAR_d573d465_Tx: ComIPduHandleId=148, ComIPduSignalGroupRef=SG_TrackerObject038_oRDR_TRACKER_OBJ_038_oPCAN_RADAR_0e78b170_Tx, ComPduIdRef=RDR_TRACKER_OBJ_038_oPCAN_RADAR_d573d465_Tx
          ComTxIPdu: ComMinimumDelayTime=0, ComTxIPduUnusedAreasDefault=0
            ComTxModeTrue
              ComTxMode: ComTxModeMode=DIRECT, ComTxModeNumberOfRepetitions=0
            ComTxModeFalse
              ComTxMode: ComTxModeMode=NONE
      SG_TrackerObject007_oRDR_TRACKER_OBJ_007_oPCAN_RADAR_de5647f4_Tx (ComSignalGroup):
        ComTransferProperty = TRIGGERED
        ComSignalGroupAccess = ACCESS_NEEDED_BY_SWC_OR_COM
        ComHandleId = 116
        ComSignalGroupArrayAccess = true
        ComSystemTemplateSignalGroupRef = SG_TrackerObject007
        49 x ComGroupSignal, all with ComSignalEndianness=BIG_ENDIAN, ComSignalInitValue=0, ComTransferProperty=PENDING, ComSignalAccess=ACCESS_NEEDED_BY_SWC_OR_COM:
          OBJ_DIMENSION_WIDTH_007_oRDR_TRACKER_OBJ_007_oPCAN_RADAR_34684b10_Tx: ComBitPosition=17, ComBitSize=10, ComSignalType=UINT16, ComHandleId=8843, ComSystemTemplateSystemSignalRef=OBJ_DIMENSION_WIDTH_007
          OBJ_DIMENSION_WIDTH_ERR_007_oRDR_TRACKER_OBJ_007_oPCAN_RADAR_d4ca8cf8_Tx: ComBitPosition=23, ComBitSize=6, ComSignalType=UINT8, ComHandleId=8844, ComSystemTemplateSystemSignalRef=OBJ_DIMENSION_WIDTH_ERR_007
          OBJ_REF_PT_LAT_OFFSET_007_oRDR_TRACKER_OBJ_007_oPCAN_RADAR_b0d61772_Tx: ComBitPosition=370, ComBitSize=14, ComSignalType=UINT16, ComHandleId=8858, ComSystemTemplateSystemSignalRef=OBJ_REF_PT_LAT_OFFSET_007
          OBJ_CLS_TYPE4_PROB_007_oRDR_TRACKER_OBJ_007_oPCAN_RADAR_7d4d135c_Tx: ComBitPosition=327, ComBitSize=8, ComSignalType=UINT8, ComHandleId=8836, ComSystemTemplateSystemSignalRef=OBJ_CLS_TYPE4_PROB_007
          OBJ_CLS_TYPE6_007_oRDR_TRACKER_OBJ_007_oPCAN_RADAR_436012d5_Tx: ComBitPosition=282, ComBitSize=4, ComSignalType=UINT8, ComHandleId=8839, ComSystemTemplateSystemSignalRef=OBJ_CLS_TYPE6_007
          OBJ_VELOCITY_LAT_007_oRDR_TRACKER_OBJ_007_oPCAN_RADAR_23476f27_Tx: ComBitPosition=126, ComBitSize=15, ComSignalType=UINT16, ComHandleId=8864, ComSystemTemplateSystemSignalRef=OBJ_VELOCITY_LAT_007
          OBJ_VELOCITY_LAT_ERR_007_oRDR_TRACKER_OBJ_007_oPCAN_RADAR_17bd1f76_Tx: ComBitPosition=151, ComBitSize=8, ComSignalType=UINT8, ComHandleId=8865, ComSystemTemplateSystemSignalRef=OBJ_VELOCITY_LAT_ERR_007
          OBJ_CLS_TYPE3_PROB_007_oRDR_TRACKER_OBJ_007_oPCAN_RADAR_7347d5fc_Tx: ComBitPosition=319, ComBitSize=8, ComSignalType=UINT8, ComHandleId=8834, ComSystemTemplateSystemSignalRef=OBJ_CLS_TYPE3_PROB_007
          OBJ_CLS_TYPE5_007_oRDR_TRACKER_OBJ_007_oPCAN_RADAR_0e8812b2_Tx: ComBitPosition=287, ComBitSize=4, ComSignalType=UINT8, ComHandleId=8837, ComSystemTemplateSystemSignalRef=OBJ_CLS_TYPE5_007
          OBJ_POS_LAT_ERR_007_oRDR_TRACKER_OBJ_007_oPCAN_RADAR_63687a37_Tx: ComBitPosition=103, ComBitSize=8, ComSignalType=UINT8, ComHandleId=8854, ComSystemTemplateSystemSignalRef=OBJ_POS_LAT_ERR_007
          OBJ_CLS_TYPE1_007_oRDR_TRACKER_OBJ_007_oPCAN_RADAR_5538eff9_Tx: ComBitPosition=271, ComBitSize=4, ComSignalType=UINT8, ComHandleId=8829, ComSystemTemplateSystemSignalRef=OBJ_CLS_TYPE1_007
          OBJ_MOVEMENT_STATUS_007_oRDR_TRACKER_OBJ_007_oPCAN_RADAR_15f41776_Tx: ComBitPosition=196, ComBitSize=3, ComSignalType=UINT8, ComHandleId=8851, ComSystemTemplateSystemSignalRef=OBJ_MOVEMENT_STATUS_007
          OBJ_YAW_ANGLE_ERR_007_oRDR_TRACKER_OBJ_007_oPCAN_RADAR_1af62db0_Tx: ComBitPosition=175, ComBitSize=7, ComSignalType=UINT8, ComHandleId=8869, ComSystemTemplateSystemSignalRef=OBJ_YAW_ANGLE_ERR_007
          OBJ_YAW_RATE_007_oRDR_TRACKER_OBJ_007_oPCAN_RADAR_ea740e20_Tx: ComBitPosition=399, ComBitSize=10, ComSignalType=UINT16, ComHandleId=8870, ComSystemTemplateSystemSignalRef=OBJ_YAW_RATE_007
          OBJ_GROUP_ID_007_oRDR_TRACKER_OBJ_007_oPCAN_RADAR_b6a6db80_Tx: ComBitPosition=405, ComBitSize=6, ComSignalType=UINT8, ComHandleId=8846, ComSystemTemplateSystemSignalRef=OBJ_GROUP_ID_007
          OBJ_CLS_TYPE5_PROB_007_oRDR_TRACKER_OBJ_007_oPCAN_RADAR_3a5ee5a7_Tx: ComBitPosition=335, ComBitSize=8, ComSignalType=UINT8, ComHandleId=8838, ComSystemTemplateSystemSignalRef=OBJ_CLS_TYPE5_PROB_007
          OBJ_ACCELERATION_LONG_007_oRDR_TRACKER_OBJ_007_oPCAN_RADAR_a2824563_Tx: ComBitPosition=193, ComBitSize=10, ComSignalType=UINT16, ComHandleId=8825, ComSystemTemplateSystemSignalRef=OBJ_ACCELERATION_LONG_007
          OBJ_ID_007_oRDR_TRACKER_OBJ_007_oPCAN_RADAR_4588f087_Tx: ComBitPosition=7, ComBitSize=8, ComSignalType=UINT8, ComHandleId=8847, ComSystemTemplateSystemSignalRef=OBJ_ID_007
          OBJ_MEASUREMENT_STATUS_007_oRDR_TRACKER_OBJ_007_oPCAN_RADAR_3a5a823a_Tx: ComBitPosition=14, ComBitSize=3, ComSignalType=UINT8, ComHandleId=8848, ComSystemTemplateSystemSignalRef=OBJ_MEASUREMENT_STATUS_007
          OBJ_CLS_TYPE1_PROB_007_oRDR_TRACKER_OBJ_007_oPCAN_RADAR_fd60380a_Tx: ComBitPosition=303, ComBitSize=8, ComSignalType=UINT8, ComHandleId=8830, ComSystemTemplateSystemSignalRef=OBJ_CLS_TYPE1_PROB_007
          OBJ_CLS_TYPE2_007_oRDR_TRACKER_OBJ_007_oPCAN_RADAR_18d0ef9e_Tx: ComBitPosition=267, ComBitSize=4, ComSignalType=UINT8, ComHandleId=8831, ComSystemTemplateSystemSignalRef=OBJ_CLS_TYPE2_007
          OBJ_POS_LONG_ERR_007_oRDR_TRACKER_OBJ_007_oPCAN_RADAR_fa9084d5_Tx: ComBitPosition=95, ComBitSize=8, ComSignalType=UINT8, ComHandleId=8856, ComSystemTemplateSystemSignalRef=OBJ_POS_LONG_ERR_007
          OBJ_ALIVE_TIME_007_oRDR_TRACKER_OBJ_007_oPCAN_RADAR_c2e30edf_Tx: ComBitPosition=255, ComBitSize=16, ComSignalType=UINT16, ComHandleId=8828, ComSystemTemplateSystemSignalRef=OBJ_ALIVE_TIME_007
          OBJ_DIMENSION_LENGTH_007_oRDR_TRACKER_OBJ_007_oPCAN_RADAR_17a6bcbd_Tx: ComBitPosition=37, ComBitSize=12, ComSignalType=UINT16, ComHandleId=8841, ComSystemTemplateSystemSignalRef=OBJ_DIMENSION_LENGTH_007
          OBJ_VELOCITY_LONG_007_oRDR_TRACKER_OBJ_007_oPCAN_RADAR_73ca17e1_Tx: ComBitPosition=110, ComBitSize=15, ComSignalType=UINT16, ComHandleId=8866, ComSystemTemplateSystemSignalRef=OBJ_VELOCITY_LONG_007
          OBJ_YAW_RATE_ERR_007_oRDR_TRACKER_OBJ_007_oPCAN_RADAR_d5ac99fc_Tx: ComBitPosition=388, ComBitSize=5, ComSignalType=UINT8, ComHandleId=8871, ComSystemTemplateSystemSignalRef=OBJ_YAW_RATE_ERR_007
          OBJ_POS_LAT_007_oRDR_TRACKER_OBJ_007_oPCAN_RADAR_67242a00_Tx: ComBitPosition=79, ComBitSize=16, ComSignalType=UINT16, ComHandleId=8853, ComSystemTemplateSystemSignalRef=OBJ_POS_LAT_007
          OBJ_DIMENSION_LENGTH_ERR_007_oRDR_TRACKER_OBJ_007_oPCAN_RADAR_2c5ea3c7_Tx: ComBitPosition=41, ComBitSize=10, ComSignalType=UINT16, ComHandleId=8842, ComSystemTemplateSystemSignalRef=OBJ_DIMENSION_LENGTH_ERR_007
          OBJ_ACCEL_ERR_CRR_COEF_007_oRDR_TRACKER_OBJ_007_oPCAN_RADAR_ba80a2f1_Tx: ComBitPosition=431, ComBitSize=8, ComSignalType=UINT8, ComHandleId=8827, ComSystemTemplateSystemSignalRef=OBJ_ACCEL_ERR_CRR_COEF_007
          OBJ_CLS_TYPE4_007_oRDR_TRACKER_OBJ_007_oPCAN_RADAR_8300ef50_Tx: ComBitPosition=275, ComBitSize=4, ComSignalType=UINT8, ComHandleId=8835, ComSystemTemplateSystemSignalRef=OBJ_CLS_TYPE4_007
          OBJ_TIMESTAMP_OFFSET_007_oRDR_TRACKER_OBJ_007_oPCAN_RADAR_45477c51_Tx: ComBitPosition=247, ComBitSize=8, ComSignalType=UINT8, ComHandleId=8860, ComSystemTemplateSystemSignalRef=OBJ_TIMESTAMP_OFFSET_007
          OBJ_CLS_TYPE2_PROB_007_oRDR_TRACKER_OBJ_007_oPCAN_RADAR_34542307_Tx: ComBitPosition=311, ComBitSize=8, ComSignalType=UINT8, ComHandleId=8832, ComSystemTemplateSystemSignalRef=OBJ_CLS_TYPE2_PROB_007
          OBJ_ACCELERATION_LAT_ERR_007_oRDR_TRACKER_OBJ_007_oPCAN_RADAR_0586263d_Tx: ComBitPosition=223, ComBitSize=8, ComSignalType=UINT8, ComHandleId=8824, ComSystemTemplateSystemSignalRef=OBJ_ACCELERATION_LAT_ERR_007
          OBJ_VELOCITY_LONG_ERR_007_oRDR_TRACKER_OBJ_007_oPCAN_RADAR_fb3f20b6_Tx: ComBitPosition=143, ComBitSize=8, ComSignalType=UINT8, ComHandleId=8867, ComSystemTemplateSystemSignalRef=OBJ_VELOCITY_LONG_ERR_007
          OBJ_YAW_ANGLE_007_oRDR_TRACKER_OBJ_007_oPCAN_RADAR_cffb2b67_Tx: ComBitPosition=155, ComBitSize=12, ComSignalType=UINT16, ComHandleId=8868, ComSystemTemplateSystemSignalRef=OBJ_YAW_ANGLE_007
          OBJ_POS_ERR_CRR_COEF_007_oRDR_TRACKER_OBJ_007_oPCAN_RADAR_858bd74c_Tx: ComBitPosition=415, ComBitSize=8, ComSignalType=UINT8, ComHandleId=8852, ComSystemTemplateSystemSignalRef=OBJ_POS_ERR_CRR_COEF_007
          OBJ_ACCELERATION_LAT_007_oRDR_TRACKER_OBJ_007_oPCAN_RADAR_d0721c83_Tx: ComBitPosition=177, ComBitSize=10, ComSignalType=UINT16, ComHandleId=8823, ComSystemTemplateSystemSignalRef=OBJ_ACCELERATION_LAT_007
          OBJ_RCS_007_oRDR_TRACKER_OBJ_007_oPCAN_RADAR_45eb7c07_Tx: ComBitPosition=351, ComBitSize=7, ComSignalType=UINT8, ComHandleId=8857, ComSystemTemplateSystemSignalRef=OBJ_RCS_007
          OBJ_CLS_TYPE3_007_oRDR_TRACKER_OBJ_007_oPCAN_RADAR_9558127c_Tx: ComBitPosition=279, ComBitSize=4, ComSignalType=UINT8, ComHandleId=8833, ComSystemTemplateSystemSignalRef=OBJ_CLS_TYPE3_007
          OBJ_POS_LONG_007_oRDR_TRACKER_OBJ_007_oPCAN_RADAR_d684c1cf_Tx: ComBitPosition=63, ComBitSize=16, ComSignalType=UINT16, ComHandleId=8855, ComSystemTemplateSystemSignalRef=OBJ_POS_LONG_007
          OBJ_EXISTENCE_PROB_007_oRDR_TRACKER_OBJ_007_oPCAN_RADAR_3fd4cf2d_Tx: ComBitPosition=229, ComBitSize=14, ComSignalType=UINT16, ComHandleId=8845, ComSystemTemplateSystemSignalRef=OBJ_EXISTENCE_PROB_007
          OBJ_REF_PT_LONG_OFFSET_007_oRDR_TRACKER_OBJ_007_oPCAN_RADAR_ff84e771_Tx: ComBitPosition=357, ComBitSize=14, ComSignalType=UINT16, ComHandleId=8859, ComSystemTemplateSystemSignalRef=OBJ_REF_PT_LONG_OFFSET_007
          OBJ_CLS_TYPE6_PROB_007_oRDR_TRACKER_OBJ_007_oPCAN_RADAR_f36afeaa_Tx: ComBitPosition=343, ComBitSize=8, ComSignalType=UINT8, ComHandleId=8840, ComSystemTemplateSystemSignalRef=OBJ_CLS_TYPE6_PROB_007
          OBJ_TRACK_MOTION_MODEL_007_oRDR_TRACKER_OBJ_007_oPCAN_RADAR_89447d8c_Tx: ComBitPosition=9, ComBitSize=2, ComSignalType=UINT8, ComHandleId=8861, ComSystemTemplateSystemSignalRef=OBJ_TRACK_MOTION_MODEL_007
          OBJ_ACCELERATION_LONG_ERR_007_oRDR_TRACKER_OBJ_007_oPCAN_RADAR_1a238397_Tx: ComBitPosition=215, ComBitSize=8, ComSignalType=UINT8, ComHandleId=8826, ComSystemTemplateSystemSignalRef=OBJ_ACCELERATION_LONG_ERR_007
          OBJ_VEH_TRACK_FLAG_007_oRDR_TRACKER_OBJ_007_oPCAN_RADAR_0b6e8bd1_Tx: ComBitPosition=10, ComBitSize=1, ComSignalType=BOOLEAN, ComHandleId=8862, ComSystemTemplateSystemSignalRef=OBJ_VEH_TRACK_FLAG_007
          OBJ_VELOCITY_ERR_CRR_COEF_007_oRDR_TRACKER_OBJ_007_oPCAN_RADAR_2cf1eaad_Tx: ComBitPosition=423, ComBitSize=8, ComSignalType=UINT8, ComHandleId=8863, ComSystemTemplateSystemSignalRef=OBJ_VELOCITY_ERR_CRR_COEF_007
          OBJ_MH_CRC16_007_oRDR_TRACKER_OBJ_007_oPCAN_RADAR_463a3506_Tx: ComBitPosition=495, ComBitSize=16, ComSignalType=UINT16, ComHandleId=8849, ComSystemTemplateSystemSignalRef=OBJ_MH_CRC16_007
          OBJ_MH_CYCLE_COUNTER_007_oRDR_TRACKER_OBJ_007_oPCAN_RADAR_37de6fe7_Tx: ComBitPosition=487, ComBitSize=8, ComSignalType=UINT8, ComHandleId=8850, ComSystemTemplateSystemSignalRef=OBJ_MH_CYCLE_COUNTER_007
      SG_TrackerObject053_oRDR_TRACKER_OBJ_053_oPCAN_RADAR_4f4143bd_Tx (ComSignalGroup):
        ComTransferProperty = TRIGGERED
        ComSignalGroupAccess = ACCESS_NEEDED_BY_SWC_OR_COM
        ComHandleId = 162
        ComSignalGroupArrayAccess = true
        ComSystemTemplateSignalGroupRef = SG_TrackerObject053
        49 x ComGroupSignal, all with ComSignalEndianness=BIG_ENDIAN, ComSignalInitValue=0, ComTransferProperty=PENDING, ComSignalAccess=ACCESS_NEEDED_BY_SWC_OR_COM:
          OBJ_ACCELERATION_LAT_053_oRDR_TRACKER_OBJ_053_oPCAN_RADAR_416518ca_Tx: ComBitPosition=177, ComBitSize=10, ComSignalType=UINT16, ComHandleId=11077, ComSystemTemplateSystemSignalRef=OBJ_ACCELERATION_LAT_053
          OBJ_POS_LAT_053_oRDR_TRACKER_OBJ_053_oPCAN_RADAR_f6332e49_Tx: ComBitPosition=79, ComBitSize=16, ComSignalType=UINT16, ComHandleId=11107, ComSystemTemplateSystemSignalRef=OBJ_POS_LAT_053
          OBJ_ACCELERATION_LONG_ERR_053_oRDR_TRACKER_OBJ_053_oPCAN_RADAR_8b3487de_Tx: ComBitPosition=215, ComBitSize=8, ComSignalType=UINT8, ComHandleId=11080, ComSystemTemplateSystemSignalRef=OBJ_ACCELERATION_LONG_ERR_053
          OBJ_REF_PT_LAT_OFFSET_053_oRDR_TRACKER_OBJ_053_oPCAN_RADAR_21c1133b_Tx: ComBitPosition=370, ComBitSize=14, ComSignalType=UINT16, ComHandleId=11112, ComSystemTemplateSystemSignalRef=OBJ_REF_PT_LAT_OFFSET_053
          OBJ_TIMESTAMP_OFFSET_053_oRDR_TRACKER_OBJ_053_oPCAN_RADAR_d4507818_Tx: ComBitPosition=247, ComBitSize=8, ComSignalType=UINT8, ComHandleId=11114, ComSystemTemplateSystemSignalRef=OBJ_TIMESTAMP_OFFSET_053
          OBJ_EXISTENCE_PROB_053_oRDR_TRACKER_OBJ_053_oPCAN_RADAR_aec3cb64_Tx: ComBitPosition=229, ComBitSize=14, ComSignalType=UINT16, ComHandleId=11099, ComSystemTemplateSystemSignalRef=OBJ_EXISTENCE_PROB_053
          OBJ_MOVEMENT_STATUS_053_oRDR_TRACKER_OBJ_053_oPCAN_RADAR_84e3133f_Tx: ComBitPosition=196, ComBitSize=3, ComSignalType=UINT8, ComHandleId=11105, ComSystemTemplateSystemSignalRef=OBJ_MOVEMENT_STATUS_053
          OBJ_REF_PT_LONG_OFFSET_053_oRDR_TRACKER_OBJ_053_oPCAN_RADAR_6e93e338_Tx: ComBitPosition=357, ComBitSize=14, ComSignalType=UINT16, ComHandleId=11113, ComSystemTemplateSystemSignalRef=OBJ_REF_PT_LONG_OFFSET_053
          OBJ_ID_053_oRDR_TRACKER_OBJ_053_oPCAN_RADAR_d49ff4ce_Tx: ComBitPosition=7, ComBitSize=8, ComSignalType=UINT8, ComHandleId=11101, ComSystemTemplateSystemSignalRef=OBJ_ID_053
          OBJ_VELOCITY_LAT_053_oRDR_TRACKER_OBJ_053_oPCAN_RADAR_b2506b6e_Tx: ComBitPosition=126, ComBitSize=15, ComSignalType=UINT16, ComHandleId=11118, ComSystemTemplateSystemSignalRef=OBJ_VELOCITY_LAT_053
          OBJ_DIMENSION_LENGTH_053_oRDR_TRACKER_OBJ_053_oPCAN_RADAR_86b1b8f4_Tx: ComBitPosition=37, ComBitSize=12, ComSignalType=UINT16, ComHandleId=11095, ComSystemTemplateSystemSignalRef=OBJ_DIMENSION_LENGTH_053
          OBJ_VELOCITY_LONG_ERR_053_oRDR_TRACKER_OBJ_053_oPCAN_RADAR_6a2824ff_Tx: ComBitPosition=143, ComBitSize=8, ComSignalType=UINT8, ComHandleId=11121, ComSystemTemplateSystemSignalRef=OBJ_VELOCITY_LONG_ERR_053
          OBJ_POS_LONG_ERR_053_oRDR_TRACKER_OBJ_053_oPCAN_RADAR_6b87809c_Tx: ComBitPosition=95, ComBitSize=8, ComSignalType=UINT8, ComHandleId=11110, ComSystemTemplateSystemSignalRef=OBJ_POS_LONG_ERR_053
          OBJ_CLS_TYPE4_053_oRDR_TRACKER_OBJ_053_oPCAN_RADAR_1217eb19_Tx: ComBitPosition=275, ComBitSize=4, ComSignalType=UINT8, ComHandleId=11089, ComSystemTemplateSystemSignalRef=OBJ_CLS_TYPE4_053
          OBJ_POS_LAT_ERR_053_oRDR_TRACKER_OBJ_053_oPCAN_RADAR_f27f7e7e_Tx: ComBitPosition=103, ComBitSize=8, ComSignalType=UINT8, ComHandleId=11108, ComSystemTemplateSystemSignalRef=OBJ_POS_LAT_ERR_053
          OBJ_POS_LONG_053_oRDR_TRACKER_OBJ_053_oPCAN_RADAR_4793c586_Tx: ComBitPosition=63, ComBitSize=16, ComSignalType=UINT16, ComHandleId=11109, ComSystemTemplateSystemSignalRef=OBJ_POS_LONG_053
          OBJ_VELOCITY_LAT_ERR_053_oRDR_TRACKER_OBJ_053_oPCAN_RADAR_86aa1b3f_Tx: ComBitPosition=151, ComBitSize=8, ComSignalType=UINT8, ComHandleId=11119, ComSystemTemplateSystemSignalRef=OBJ_VELOCITY_LAT_ERR_053
          OBJ_YAW_ANGLE_053_oRDR_TRACKER_OBJ_053_oPCAN_RADAR_5eec2f2e_Tx: ComBitPosition=155, ComBitSize=12, ComSignalType=UINT16, ComHandleId=11122, ComSystemTemplateSystemSignalRef=OBJ_YAW_ANGLE_053
          OBJ_YAW_RATE_053_oRDR_TRACKER_OBJ_053_oPCAN_RADAR_7b630a69_Tx: ComBitPosition=399, ComBitSize=10, ComSignalType=UINT16, ComHandleId=11124, ComSystemTemplateSystemSignalRef=OBJ_YAW_RATE_053
          OBJ_CLS_TYPE3_PROB_053_oRDR_TRACKER_OBJ_053_oPCAN_RADAR_e250d1b5_Tx: ComBitPosition=319, ComBitSize=8, ComSignalType=UINT8, ComHandleId=11088, ComSystemTemplateSystemSignalRef=OBJ_CLS_TYPE3_PROB_053
          OBJ_ACCEL_ERR_CRR_COEF_053_oRDR_TRACKER_OBJ_053_oPCAN_RADAR_2b97a6b8_Tx: ComBitPosition=431, ComBitSize=8, ComSignalType=UINT8, ComHandleId=11081, ComSystemTemplateSystemSignalRef=OBJ_ACCEL_ERR_CRR_COEF_053
          OBJ_CLS_TYPE2_053_oRDR_TRACKER_OBJ_053_oPCAN_RADAR_89c7ebd7_Tx: ComBitPosition=267, ComBitSize=4, ComSignalType=UINT8, ComHandleId=11085, ComSystemTemplateSystemSignalRef=OBJ_CLS_TYPE2_053
          OBJ_YAW_ANGLE_ERR_053_oRDR_TRACKER_OBJ_053_oPCAN_RADAR_8be129f9_Tx: ComBitPosition=175, ComBitSize=7, ComSignalType=UINT8, ComHandleId=11123, ComSystemTemplateSystemSignalRef=OBJ_YAW_ANGLE_ERR_053
          OBJ_ALIVE_TIME_053_oRDR_TRACKER_OBJ_053_oPCAN_RADAR_53f40a96_Tx: ComBitPosition=255, ComBitSize=16, ComSignalType=UINT16, ComHandleId=11082, ComSystemTemplateSystemSignalRef=OBJ_ALIVE_TIME_053
          OBJ_CLS_TYPE2_PROB_053_oRDR_TRACKER_OBJ_053_oPCAN_RADAR_a543274e_Tx: ComBitPosition=311, ComBitSize=8, ComSignalType=UINT8, ComHandleId=11086, ComSystemTemplateSystemSignalRef=OBJ_CLS_TYPE2_PROB_053
          OBJ_DIMENSION_WIDTH_ERR_053_oRDR_TRACKER_OBJ_053_oPCAN_RADAR_45dd88b1_Tx: ComBitPosition=23, ComBitSize=6, ComSignalType=UINT8, ComHandleId=11098, ComSystemTemplateSystemSignalRef=OBJ_DIMENSION_WIDTH_ERR_053
          OBJ_DIMENSION_LENGTH_ERR_053_oRDR_TRACKER_OBJ_053_oPCAN_RADAR_bd49a78e_Tx: ComBitPosition=41, ComBitSize=10, ComSignalType=UINT16, ComHandleId=11096, ComSystemTemplateSystemSignalRef=OBJ_DIMENSION_LENGTH_ERR_053
          OBJ_VEH_TRACK_FLAG_053_oRDR_TRACKER_OBJ_053_oPCAN_RADAR_9a798f98_Tx: ComBitPosition=10, ComBitSize=1, ComSignalType=BOOLEAN, ComHandleId=11116, ComSystemTemplateSystemSignalRef=OBJ_VEH_TRACK_FLAG_053
          OBJ_ACCELERATION_LONG_053_oRDR_TRACKER_OBJ_053_oPCAN_RADAR_3395412a_Tx: ComBitPosition=193, ComBitSize=10, ComSignalType=UINT16, ComHandleId=11079, ComSystemTemplateSystemSignalRef=OBJ_ACCELERATION_LONG_053
          OBJ_CLS_TYPE3_053_oRDR_TRACKER_OBJ_053_oPCAN_RADAR_044f1635_Tx: ComBitPosition=279, ComBitSize=4, ComSignalType=UINT8, ComHandleId=11087, ComSystemTemplateSystemSignalRef=OBJ_CLS_TYPE3_053
          OBJ_CLS_TYPE6_053_oRDR_TRACKER_OBJ_053_oPCAN_RADAR_d277169c_Tx: ComBitPosition=282, ComBitSize=4, ComSignalType=UINT8, ComHandleId=11093, ComSystemTemplateSystemSignalRef=OBJ_CLS_TYPE6_053
          OBJ_RCS_053_oRDR_TRACKER_OBJ_053_oPCAN_RADAR_d4fc784e_Tx: ComBitPosition=351, ComBitSize=7, ComSignalType=UINT8, ComHandleId=11111, ComSystemTemplateSystemSignalRef=OBJ_RCS_053
          OBJ_YAW_RATE_ERR_053_oRDR_TRACKER_OBJ_053_oPCAN_RADAR_44bb9db5_Tx: ComBitPosition=388, ComBitSize=5, ComSignalType=UINT8, ComHandleId=11125, ComSystemTemplateSystemSignalRef=OBJ_YAW_RATE_ERR_053
          OBJ_MEASUREMENT_STATUS_053_oRDR_TRACKER_OBJ_053_oPCAN_RADAR_ab4d8673_Tx: ComBitPosition=14, ComBitSize=3, ComSignalType=UINT8, ComHandleId=11102, ComSystemTemplateSystemSignalRef=OBJ_MEASUREMENT_STATUS_053
          OBJ_POS_ERR_CRR_COEF_053_oRDR_TRACKER_OBJ_053_oPCAN_RADAR_149cd305_Tx: ComBitPosition=415, ComBitSize=8, ComSignalType=UINT8, ComHandleId=11106, ComSystemTemplateSystemSignalRef=OBJ_POS_ERR_CRR_COEF_053
          OBJ_ACCELERATION_LAT_ERR_053_oRDR_TRACKER_OBJ_053_oPCAN_RADAR_94912274_Tx: ComBitPosition=223, ComBitSize=8, ComSignalType=UINT8, ComHandleId=11078, ComSystemTemplateSystemSignalRef=OBJ_ACCELERATION_LAT_ERR_053
          OBJ_DIMENSION_WIDTH_053_oRDR_TRACKER_OBJ_053_oPCAN_RADAR_a57f4f59_Tx: ComBitPosition=17, ComBitSize=10, ComSignalType=UINT16, ComHandleId=11097, ComSystemTemplateSystemSignalRef=OBJ_DIMENSION_WIDTH_053
          OBJ_VELOCITY_LONG_053_oRDR_TRACKER_OBJ_053_oPCAN_RADAR_e2dd13a8_Tx: ComBitPosition=110, ComBitSize=15, ComSignalType=UINT16, ComHandleId=11120, ComSystemTemplateSystemSignalRef=OBJ_VELOCITY_LONG_053
          OBJ_CLS_TYPE5_053_oRDR_TRACKER_OBJ_053_oPCAN_RADAR_9f9f16fb_Tx: ComBitPosition=287, ComBitSize=4, ComSignalType=UINT8, ComHandleId=11091, ComSystemTemplateSystemSignalRef=OBJ_CLS_TYPE5_053
          OBJ_GROUP_ID_053_oRDR_TRACKER_OBJ_053_oPCAN_RADAR_27b1dfc9_Tx: ComBitPosition=405, ComBitSize=6, ComSignalType=UINT8, ComHandleId=11100, ComSystemTemplateSystemSignalRef=OBJ_GROUP_ID_053
          OBJ_CLS_TYPE1_053_oRDR_TRACKER_OBJ_053_oPCAN_RADAR_c42febb0_Tx: ComBitPosition=271, ComBitSize=4, ComSignalType=UINT8, ComHandleId=11083, ComSystemTemplateSystemSignalRef=OBJ_CLS_TYPE1_053
          OBJ_VELOCITY_ERR_CRR_COEF_053_oRDR_TRACKER_OBJ_053_oPCAN_RADAR_bde6eee4_Tx: ComBitPosition=423, ComBitSize=8, ComSignalType=UINT8, ComHandleId=11117, ComSystemTemplateSystemSignalRef=OBJ_VELOCITY_ERR_CRR_COEF_053
          OBJ_TRACK_MOTION_MODEL_053_oRDR_TRACKER_OBJ_053_oPCAN_RADAR_185379c5_Tx: ComBitPosition=9, ComBitSize=2, ComSignalType=UINT8, ComHandleId=11115, ComSystemTemplateSystemSignalRef=OBJ_TRACK_MOTION_MODEL_053
          OBJ_CLS_TYPE1_PROB_053_oRDR_TRACKER_OBJ_053_oPCAN_RADAR_6c773c43_Tx: ComBitPosition=303, ComBitSize=8, ComSignalType=UINT8, ComHandleId=11084, ComSystemTemplateSystemSignalRef=OBJ_CLS_TYPE1_PROB_053
          OBJ_CLS_TYPE6_PROB_053_oRDR_TRACKER_OBJ_053_oPCAN_RADAR_627dfae3_Tx: ComBitPosition=343, ComBitSize=8, ComSignalType=UINT8, ComHandleId=11094, ComSystemTemplateSystemSignalRef=OBJ_CLS_TYPE6_PROB_053
          OBJ_CLS_TYPE4_PROB_053_oRDR_TRACKER_OBJ_053_oPCAN_RADAR_ec5a1715_Tx: ComBitPosition=327, ComBitSize=8, ComSignalType=UINT8, ComHandleId=11090, ComSystemTemplateSystemSignalRef=OBJ_CLS_TYPE4_PROB_053
          OBJ_CLS_TYPE5_PROB_053_oRDR_TRACKER_OBJ_053_oPCAN_RADAR_ab49e1ee_Tx: ComBitPosition=335, ComBitSize=8, ComSignalType=UINT8, ComHandleId=11092, ComSystemTemplateSystemSignalRef=OBJ_CLS_TYPE5_PROB_053
          OBJ_MH_CYCLE_COUNTER_053_oRDR_TRACKER_OBJ_053_oPCAN_RADAR_a6c96bae_Tx: ComBitPosition=487, ComBitSize=8, ComSignalType=UINT8, ComHandleId=11104, ComSystemTemplateSystemSignalRef=OBJ_MH_CYCLE_COUNTER_053
          OBJ_MH_CRC16_053_oRDR_TRACKER_OBJ_053_oPCAN_RADAR_d72d314f_Tx: ComBitPosition=495, ComBitSize=16, ComSignalType=UINT16, ComHandleId=11103, ComSystemTemplateSystemSignalRef=OBJ_MH_CRC16_053
      RDR_TRACKER_OBJ_014_oPCAN_RADAR_aea7a933_Tx (ComIPdu):
        ComIPduDirection = SEND
        ComIPduType = NORMAL
        ComIPduCancellationSupport = false
        ComIPduHandleId = 124
        ComIPduSignalProcessing = DEFERRED
        ComIPduChannelRef = CN_PCAN_RADAR_458ff0f1
        ComIPduGroupRef = RDR01_oPCAN_RADAR_Tx_b6bdb067 if post-build-variant-condition{matching-criterion=RDR_POS, value=0}
        ComIPduSignalGroupRef = SG_TrackerObject014_oRDR_TRACKER_OBJ_014_oPCAN_RADAR_5c8b2ede_Tx
        ComPduIdRef = RDR_TRACKER_OBJ_014_oPCAN_RADAR_aea7a933_Tx
        ComIPduMainFunctionRef = ComMainFunctionTx_Event
        ComIPduGroupRef = RDR02_oPCAN_RADAR_Tx_9f750495 if post-build-variant-condition{matching-criterion=RDR_POS, value=1}
        ComIPduGroupRef = RDR03_oPCAN_RADAR_Tx_311d9504 if post-build-variant-condition{matching-criterion=RDR_POS, value=2}
        ComIPduGroupRef = RDR04_oPCAN_RADAR_Tx_cce46d71 if post-build-variant-condition{matching-criterion=RDR_POS, value=3}
        ComIPduGroupRef = RDR05_oPCAN_RADAR_Tx_628cfce0 if post-build-variant-condition{matching-criterion=RDR_POS, value=4}
        ComIPduGroupRef = RDR06_oPCAN_RADAR_Tx_4b444812 if post-build-variant-condition{matching-criterion=RDR_POS, value=5}
        ComIPduGroupRef = RDR07_oPCAN_RADAR_Tx_e52cd983 if post-build-variant-condition{matching-criterion=RDR_POS, value=6}
        ComIPduGroupRef = RDR08_oPCAN_RADAR_Tx_6bc6beb9 if post-build-variant-condition{matching-criterion=RDR_POS, value=7}
        ComTxIPdu: ComMinimumDelayTime=0, ComTxIPduUnusedAreasDefault=0
          ComTxModeTrue
            ComTxMode: ComTxModeMode=DIRECT, ComTxModeNumberOfRepetitions=0
          ComTxModeFalse
            ComTxMode: ComTxModeMode=NONE
      SG_TrackerObject049_oRDR_TRACKER_OBJ_049_oPCAN_RADAR_91e8feb8_Tx (ComSignalGroup):
        ComTransferProperty = TRIGGERED
        ComSignalGroupAccess = ACCESS_NEEDED_BY_SWC_OR_COM
        ComHandleId = 158
        ComSignalGroupArrayAccess = true
        ComSystemTemplateSignalGroupRef = SG_TrackerObject049
        49 x ComGroupSignal, all with ComSignalEndianness=BIG_ENDIAN, ComSignalInitValue=0, ComTransferProperty=PENDING, ComSignalAccess=ACCESS_NEEDED_BY_SWC_OR_COM:
          OBJ_CLS_TYPE2_049_oRDR_TRACKER_OBJ_049_oPCAN_RADAR_576e56d2_Tx: ComBitPosition=267, ComBitSize=4, ComSignalType=UINT8, ComHandleId=10889, ComSystemTemplateSystemSignalRef=OBJ_CLS_TYPE2_049
          OBJ_CLS_TYPE6_049_oRDR_TRACKER_OBJ_049_oPCAN_RADAR_0cdeab99_Tx: ComBitPosition=282, ComBitSize=4, ComSignalType=UINT8, ComHandleId=10897, ComSystemTemplateSystemSignalRef=OBJ_CLS_TYPE6_049
          OBJ_ID_049_oRDR_TRACKER_OBJ_049_oPCAN_RADAR_0a3649cb_Tx: ComBitPosition=7, ComBitSize=8, ComSignalType=UINT8, ComHandleId=10905, ComSystemTemplateSystemSignalRef=OBJ_ID_049
          OBJ_CLS_TYPE1_049_oRDR_TRACKER_OBJ_049_oPCAN_RADAR_1a8656b5_Tx: ComBitPosition=271, ComBitSize=4, ComSignalType=UINT8, ComHandleId=10887, ComSystemTemplateSystemSignalRef=OBJ_CLS_TYPE1_049
          OBJ_CLS_TYPE6_PROB_049_oRDR_TRACKER_OBJ_049_oPCAN_RADAR_bcd447e6_Tx: ComBitPosition=343, ComBitSize=8, ComSignalType=UINT8, ComHandleId=10898, ComSystemTemplateSystemSignalRef=OBJ_CLS_TYPE6_PROB_049
          OBJ_RCS_049_oRDR_TRACKER_OBJ_049_oPCAN_RADAR_0a55c54b_Tx: ComBitPosition=351, ComBitSize=7, ComSignalType=UINT8, ComHandleId=10915, ComSystemTemplateSystemSignalRef=OBJ_RCS_049
          OBJ_ACCELERATION_LONG_ERR_049_oRDR_TRACKER_OBJ_049_oPCAN_RADAR_559d3adb_Tx: ComBitPosition=215, ComBitSize=8, ComSignalType=UINT8, ComHandleId=10884, ComSystemTemplateSystemSignalRef=OBJ_ACCELERATION_LONG_ERR_049
          OBJ_ALIVE_TIME_049_oRDR_TRACKER_OBJ_049_oPCAN_RADAR_8d5db793_Tx: ComBitPosition=255, ComBitSize=16, ComSignalType=UINT16, ComHandleId=10886, ComSystemTemplateSystemSignalRef=OBJ_ALIVE_TIME_049
          OBJ_CLS_TYPE4_049_oRDR_TRACKER_OBJ_049_oPCAN_RADAR_ccbe561c_Tx: ComBitPosition=275, ComBitSize=4, ComSignalType=UINT8, ComHandleId=10893, ComSystemTemplateSystemSignalRef=OBJ_CLS_TYPE4_049
          OBJ_VELOCITY_ERR_CRR_COEF_049_oRDR_TRACKER_OBJ_049_oPCAN_RADAR_634f53e1_Tx: ComBitPosition=423, ComBitSize=8, ComSignalType=UINT8, ComHandleId=10921, ComSystemTemplateSystemSignalRef=OBJ_VELOCITY_ERR_CRR_COEF_049
          OBJ_ACCELERATION_LONG_049_oRDR_TRACKER_OBJ_049_oPCAN_RADAR_ed3cfc2f_Tx: ComBitPosition=193, ComBitSize=10, ComSignalType=UINT16, ComHandleId=10883, ComSystemTemplateSystemSignalRef=OBJ_ACCELERATION_LONG_049
          OBJ_CLS_TYPE2_PROB_049_oRDR_TRACKER_OBJ_049_oPCAN_RADAR_7bea9a4b_Tx: ComBitPosition=311, ComBitSize=8, ComSignalType=UINT8, ComHandleId=10890, ComSystemTemplateSystemSignalRef=OBJ_CLS_TYPE2_PROB_049
          OBJ_DIMENSION_WIDTH_049_oRDR_TRACKER_OBJ_049_oPCAN_RADAR_7bd6f25c_Tx: ComBitPosition=17, ComBitSize=10, ComSignalType=UINT16, ComHandleId=10901, ComSystemTemplateSystemSignalRef=OBJ_DIMENSION_WIDTH_049
          OBJ_VEH_TRACK_FLAG_049_oRDR_TRACKER_OBJ_049_oPCAN_RADAR_44d0329d_Tx: ComBitPosition=10, ComBitSize=1, ComSignalType=BOOLEAN, ComHandleId=10920, ComSystemTemplateSystemSignalRef=OBJ_VEH_TRACK_FLAG_049
          OBJ_POS_LAT_049_oRDR_TRACKER_OBJ_049_oPCAN_RADAR_289a934c_Tx: ComBitPosition=79, ComBitSize=16, ComSignalType=UINT16, ComHandleId=10911, ComSystemTemplateSystemSignalRef=OBJ_POS_LAT_049
          OBJ_REF_PT_LONG_OFFSET_049_oRDR_TRACKER_OBJ_049_oPCAN_RADAR_b03a5e3d_Tx: ComBitPosition=357, ComBitSize=14, ComSignalType=UINT16, ComHandleId=10917, ComSystemTemplateSystemSignalRef=OBJ_REF_PT_LONG_OFFSET_049
          OBJ_POS_LAT_ERR_049_oRDR_TRACKER_OBJ_049_oPCAN_RADAR_2cd6c37b_Tx: ComBitPosition=103, ComBitSize=8, ComSignalType=UINT8, ComHandleId=10912, ComSystemTemplateSystemSignalRef=OBJ_POS_LAT_ERR_049
          OBJ_DIMENSION_LENGTH_ERR_049_oRDR_TRACKER_OBJ_049_oPCAN_RADAR_63e01a8b_Tx: ComBitPosition=41, ComBitSize=10, ComSignalType=UINT16, ComHandleId=10900, ComSystemTemplateSystemSignalRef=OBJ_DIMENSION_LENGTH_ERR_049
          OBJ_ACCEL_ERR_CRR_COEF_049_oRDR_TRACKER_OBJ_049_oPCAN_RADAR_f53e1bbd_Tx: ComBitPosition=431, ComBitSize=8, ComSignalType=UINT8, ComHandleId=10885, ComSystemTemplateSystemSignalRef=OBJ_ACCEL_ERR_CRR_COEF_049
          OBJ_CLS_TYPE4_PROB_049_oRDR_TRACKER_OBJ_049_oPCAN_RADAR_32f3aa10_Tx: ComBitPosition=327, ComBitSize=8, ComSignalType=UINT8, ComHandleId=10894, ComSystemTemplateSystemSignalRef=OBJ_CLS_TYPE4_PROB_049
          OBJ_CLS_TYPE5_049_oRDR_TRACKER_OBJ_049_oPCAN_RADAR_4136abfe_Tx: ComBitPosition=287, ComBitSize=4, ComSignalType=UINT8, ComHandleId=10895, ComSystemTemplateSystemSignalRef=OBJ_CLS_TYPE5_049
          OBJ_CLS_TYPE5_PROB_049_oRDR_TRACKER_OBJ_049_oPCAN_RADAR_75e05ceb_Tx: ComBitPosition=335, ComBitSize=8, ComSignalType=UINT8, ComHandleId=10896, ComSystemTemplateSystemSignalRef=OBJ_CLS_TYPE5_PROB_049
          OBJ_YAW_ANGLE_ERR_049_oRDR_TRACKER_OBJ_049_oPCAN_RADAR_554894fc_Tx: ComBitPosition=175, ComBitSize=7, ComSignalType=UINT8, ComHandleId=10927, ComSystemTemplateSystemSignalRef=OBJ_YAW_ANGLE_ERR_049
          OBJ_REF_PT_LAT_OFFSET_049_oRDR_TRACKER_OBJ_049_oPCAN_RADAR_ff68ae3e_Tx: ComBitPosition=370, ComBitSize=14, ComSignalType=UINT16, ComHandleId=10916, ComSystemTemplateSystemSignalRef=OBJ_REF_PT_LAT_OFFSET_049
          OBJ_YAW_ANGLE_049_oRDR_TRACKER_OBJ_049_oPCAN_RADAR_8045922b_Tx: ComBitPosition=155, ComBitSize=12, ComSignalType=UINT16, ComHandleId=10926, ComSystemTemplateSystemSignalRef=OBJ_YAW_ANGLE_049
          OBJ_ACCELERATION_LAT_049_oRDR_TRACKER_OBJ_049_oPCAN_RADAR_9fcca5cf_Tx: ComBitPosition=177, ComBitSize=10, ComSignalType=UINT16, ComHandleId=10881, ComSystemTemplateSystemSignalRef=OBJ_ACCELERATION_LAT_049
          OBJ_DIMENSION_LENGTH_049_oRDR_TRACKER_OBJ_049_oPCAN_RADAR_581805f1_Tx: ComBitPosition=37, ComBitSize=12, ComSignalType=UINT16, ComHandleId=10899, ComSystemTemplateSystemSignalRef=OBJ_DIMENSION_LENGTH_049
          OBJ_EXISTENCE_PROB_049_oRDR_TRACKER_OBJ_049_oPCAN_RADAR_706a7661_Tx: ComBitPosition=229, ComBitSize=14, ComSignalType=UINT16, ComHandleId=10903, ComSystemTemplateSystemSignalRef=OBJ_EXISTENCE_PROB_049
          OBJ_MOVEMENT_STATUS_049_oRDR_TRACKER_OBJ_049_oPCAN_RADAR_5a4aae3a_Tx: ComBitPosition=196, ComBitSize=3, ComSignalType=UINT8, ComHandleId=10909, ComSystemTemplateSystemSignalRef=OBJ_MOVEMENT_STATUS_049
          OBJ_TRACK_MOTION_MODEL_049_oRDR_TRACKER_OBJ_049_oPCAN_RADAR_c6fac4c0_Tx: ComBitPosition=9, ComBitSize=2, ComSignalType=UINT8, ComHandleId=10919, ComSystemTemplateSystemSignalRef=OBJ_TRACK_MOTION_MODEL_049
          OBJ_POS_LONG_049_oRDR_TRACKER_OBJ_049_oPCAN_RADAR_993a7883_Tx: ComBitPosition=63, ComBitSize=16, ComSignalType=UINT16, ComHandleId=10913, ComSystemTemplateSystemSignalRef=OBJ_POS_LONG_049
          OBJ_VELOCITY_LONG_ERR_049_oRDR_TRACKER_OBJ_049_oPCAN_RADAR_b48199fa_Tx: ComBitPosition=143, ComBitSize=8, ComSignalType=UINT8, ComHandleId=10925, ComSystemTemplateSystemSignalRef=OBJ_VELOCITY_LONG_ERR_049
          OBJ_POS_ERR_CRR_COEF_049_oRDR_TRACKER_OBJ_049_oPCAN_RADAR_ca356e00_Tx: ComBitPosition=415, ComBitSize=8, ComSignalType=UINT8, ComHandleId=10910, ComSystemTemplateSystemSignalRef=OBJ_POS_ERR_CRR_COEF_049
          OBJ_YAW_RATE_ERR_049_oRDR_TRACKER_OBJ_049_oPCAN_RADAR_9a1220b0_Tx: ComBitPosition=388, ComBitSize=5, ComSignalType=UINT8, ComHandleId=10929, ComSystemTemplateSystemSignalRef=OBJ_YAW_RATE_ERR_049
          OBJ_CLS_TYPE1_PROB_049_oRDR_TRACKER_OBJ_049_oPCAN_RADAR_b2de8146_Tx: ComBitPosition=303, ComBitSize=8, ComSignalType=UINT8, ComHandleId=10888, ComSystemTemplateSystemSignalRef=OBJ_CLS_TYPE1_PROB_049
          OBJ_TIMESTAMP_OFFSET_049_oRDR_TRACKER_OBJ_049_oPCAN_RADAR_0af9c51d_Tx: ComBitPosition=247, ComBitSize=8, ComSignalType=UINT8, ComHandleId=10918, ComSystemTemplateSystemSignalRef=OBJ_TIMESTAMP_OFFSET_049
          OBJ_GROUP_ID_049_oRDR_TRACKER_OBJ_049_oPCAN_RADAR_f91862cc_Tx: ComBitPosition=405, ComBitSize=6, ComSignalType=UINT8, ComHandleId=10904, ComSystemTemplateSystemSignalRef=OBJ_GROUP_ID_049
          OBJ_VELOCITY_LONG_049_oRDR_TRACKER_OBJ_049_oPCAN_RADAR_3c74aead_Tx: ComBitPosition=110, ComBitSize=15, ComSignalType=UINT16, ComHandleId=10924, ComSystemTemplateSystemSignalRef=OBJ_VELOCITY_LONG_049
          OBJ_YAW_RATE_049_oRDR_TRACKER_OBJ_049_oPCAN_RADAR_a5cab76c_Tx: ComBitPosition=399, ComBitSize=10, ComSignalType=UINT16, ComHandleId=10928, ComSystemTemplateSystemSignalRef=OBJ_YAW_RATE_049
          OBJ_ACCELERATION_LAT_ERR_049_oRDR_TRACKER_OBJ_049_oPCAN_RADAR_4a389f71_Tx: ComBitPosition=223, ComBitSize=8, ComSignalType=UINT8, ComHandleId=10882, ComSystemTemplateSystemSignalRef=OBJ_ACCELERATION_LAT_ERR_049
          OBJ_CLS_TYPE3_PROB_049_oRDR_TRACKER_OBJ_049_oPCAN_RADAR_3cf96cb0_Tx: ComBitPosition=319, ComBitSize=8, ComSignalType=UINT8, ComHandleId=10892, ComSystemTemplateSystemSignalRef=OBJ_CLS_TYPE3_PROB_049
          OBJ_MEASUREMENT_STATUS_049_oRDR_TRACKER_OBJ_049_oPCAN_RADAR_75e43b76_Tx: ComBitPosition=14, ComBitSize=3, ComSignalType=UINT8, ComHandleId=10906, ComSystemTemplateSystemSignalRef=OBJ_MEASUREMENT_STATUS_049
          OBJ_VELOCITY_LAT_049_oRDR_TRACKER_OBJ_049_oPCAN_RADAR_6cf9d66b_Tx: ComBitPosition=126, ComBitSize=15, ComSignalType=UINT16, ComHandleId=10922, ComSystemTemplateSystemSignalRef=OBJ_VELOCITY_LAT_049
          OBJ_DIMENSION_WIDTH_ERR_049_oRDR_TRACKER_OBJ_049_oPCAN_RADAR_9b7435b4_Tx: ComBitPosition=23, ComBitSize=6, ComSignalType=UINT8, ComHandleId=10902, ComSystemTemplateSystemSignalRef=OBJ_DIMENSION_WIDTH_ERR_049
          OBJ_POS_LONG_ERR_049_oRDR_TRACKER_OBJ_049_oPCAN_RADAR_b52e3d99_Tx: ComBitPosition=95, ComBitSize=8, ComSignalType=UINT8, ComHandleId=10914, ComSystemTemplateSystemSignalRef=OBJ_POS_LONG_ERR_049
          OBJ_CLS_TYPE3_049_oRDR_TRACKER_OBJ_049_oPCAN_RADAR_dae6ab30_Tx: ComBitPosition=279, ComBitSize=4, ComSignalType=UINT8, ComHandleId=10891, ComSystemTemplateSystemSignalRef=OBJ_CLS_TYPE3_049
          OBJ_VELOCITY_LAT_ERR_049_oRDR_TRACKER_OBJ_049_oPCAN_RADAR_5803a63a_Tx: ComBitPosition=151, ComBitSize=8, ComSignalType=UINT8, ComHandleId=10923, ComSystemTemplateSystemSignalRef=OBJ_VELOCITY_LAT_ERR_049
          OBJ_MH_CYCLE_COUNTER_049_oRDR_TRACKER_OBJ_049_oPCAN_RADAR_7860d6ab_Tx: ComBitPosition=487, ComBitSize=8, ComSignalType=UINT8, ComHandleId=10908, ComSystemTemplateSystemSignalRef=OBJ_MH_CYCLE_COUNTER_049
          OBJ_MH_CRC16_049_oRDR_TRACKER_OBJ_049_oPCAN_RADAR_09848c4a_Tx: ComBitPosition=495, ComBitSize=16, ComSignalType=UINT16, ComHandleId=10907, ComSystemTemplateSystemSignalRef=OBJ_MH_CRC16_049
      3 x ComIPdu, all with ComIPduDirection=SEND, ComIPduType=NORMAL, ComIPduCancellationSupport=false, ComIPduSignalProcessing=DEFERRED, ComIPduChannelRef=CN_PCAN_RADAR_458ff0f1, ComIPduGroupRef=RDR01_oPCAN_RADAR_Tx_b6bdb067 if post-build-variant-condition{matching-criterion=RDR_POS, value=0}, ComIPduMainFunctionRef=ComMainFunctionTx_Event, ComIPduGroupRef=RDR02_oPCAN_RADAR_Tx_9f750495 if post-build-variant-condition{matching-criterion=RDR_POS, value=1}, ComIPduGroupRef=RDR03_oPCAN_RADAR_Tx_311d9504 if post-build-variant-condition{matching-criterion=RDR_POS, value=2}, ComIPduGroupRef=RDR04_oPCAN_RADAR_Tx_cce46d71 if post-build-variant-condition{matching-criterion=RDR_POS, value=3}, ComIPduGroupRef=RDR05_oPCAN_RADAR_Tx_628cfce0 if post-build-variant-condition{matching-criterion=RDR_POS, value=4}, ComIPduGroupRef=RDR06_oPCAN_RADAR_Tx_4b444812 if post-build-variant-condition{matching-criterion=RDR_POS, value=5}, ComIPduGroupRef=RDR07_oPCAN_RADAR_Tx_e52cd983 if post-build-variant-condition{matching-criterion=RDR_POS, value=6}, ComIPduGroupRef=RDR08_oPCAN_RADAR_Tx_6bc6beb9 if post-build-variant-condition{matching-criterion=RDR_POS, value=7}:
        RDR_TRACKER_OBJ_023_oPCAN_RADAR_afb58ab0_Tx: ComIPduHandleId=133, ComIPduSignalGroupRef=SG_TrackerObject023_oRDR_TRACKER_OBJ_023_oPCAN_RADAR_29c584c6_Tx, ComPduIdRef=RDR_TRACKER_OBJ_023_oPCAN_RADAR_afb58ab0_Tx
          ComTxIPdu: ComMinimumDelayTime=0, ComTxIPduUnusedAreasDefault=0
            ComTxModeTrue
              ComTxMode: ComTxModeMode=DIRECT, ComTxModeNumberOfRepetitions=0
            ComTxModeFalse
              ComTxMode: ComTxModeMode=NONE
        RDR_TRACKER_OBJ_059_oPCAN_RADAR_f0274656_Tx: ComIPduHandleId=169, ComIPduSignalGroupRef=SG_TrackerObject059_oRDR_TRACKER_OBJ_059_oPCAN_RADAR_c3790806_Tx, ComPduIdRef=RDR_TRACKER_OBJ_059_oPCAN_RADAR_f0274656_Tx
          ComTxIPdu: ComMinimumDelayTime=0, ComTxIPduUnusedAreasDefault=0
            ComTxModeTrue
              ComTxMode: ComTxModeMode=DIRECT, ComTxModeNumberOfRepetitions=0
            ComTxModeFalse
              ComTxMode: ComTxModeMode=NONE
        RDR_DETECTION_041_044_oPCAN_RADAR_a246585d_Tx: ComIPduHandleId=16, ComIPduSignalGroupRef=SG_Detections_041_044_oRDR_DETECTION_041_044_oPCAN_RADAR_b5a3d501_Tx, ComPduIdRef=RDR_DETECTION_041_044_oPCAN_RADAR_a246585d_Tx
          ComTxIPdu: ComMinimumDelayTime=0, ComTxIPduUnusedAreasDefault=0
            ComTxModeTrue
              ComTxMode: ComTxModeMode=DIRECT, ComTxModeNumberOfRepetitions=0
            ComTxModeFalse
              ComTxMode: ComTxModeMode=NONE
      SG_TrackerObject056_oRDR_TRACKER_OBJ_056_oPCAN_RADAR_e4e5e540_Tx (ComSignalGroup):
        ComTransferProperty = TRIGGERED
        ComSignalGroupAccess = ACCESS_NEEDED_BY_SWC_OR_COM
        ComHandleId = 165
        ComSignalGroupArrayAccess = true
        ComSystemTemplateSignalGroupRef = SG_TrackerObject056
        49 x ComGroupSignal, all with ComSignalEndianness=BIG_ENDIAN, ComSignalInitValue=0, ComTransferProperty=PENDING, ComSignalAccess=ACCESS_NEEDED_BY_SWC_OR_COM:
          OBJ_DIMENSION_WIDTH_056_oRDR_TRACKER_OBJ_056_oPCAN_RADAR_0edbe9a4_Tx: ComBitPosition=17, ComBitSize=10, ComSignalType=UINT16, ComHandleId=11244, ComSystemTemplateSystemSignalRef=OBJ_DIMENSION_WIDTH_056
          OBJ_YAW_RATE_056_oRDR_TRACKER_OBJ_056_oPCAN_RADAR_d0c7ac94_Tx: ComBitPosition=399, ComBitSize=10, ComSignalType=UINT16, ComHandleId=11271, ComSystemTemplateSystemSignalRef=OBJ_YAW_RATE_056
          OBJ_MEASUREMENT_STATUS_056_oRDR_TRACKER_OBJ_056_oPCAN_RADAR_00e9208e_Tx: ComBitPosition=14, ComBitSize=3, ComSignalType=UINT8, ComHandleId=11249, ComSystemTemplateSystemSignalRef=OBJ_MEASUREMENT_STATUS_056
          OBJ_POS_LAT_056_oRDR_TRACKER_OBJ_056_oPCAN_RADAR_5d9788b4_Tx: ComBitPosition=79, ComBitSize=16, ComSignalType=UINT16, ComHandleId=11254, ComSystemTemplateSystemSignalRef=OBJ_POS_LAT_056
          OBJ_ACCELERATION_LAT_056_oRDR_TRACKER_OBJ_056_oPCAN_RADAR_eac1be37_Tx: ComBitPosition=177, ComBitSize=10, ComSignalType=UINT16, ComHandleId=11224, ComSystemTemplateSystemSignalRef=OBJ_ACCELERATION_LAT_056
          OBJ_ID_056_oRDR_TRACKER_OBJ_056_oPCAN_RADAR_7f3b5233_Tx: ComBitPosition=7, ComBitSize=8, ComSignalType=UINT8, ComHandleId=11248, ComSystemTemplateSystemSignalRef=OBJ_ID_056
          OBJ_ACCELERATION_LONG_056_oRDR_TRACKER_OBJ_056_oPCAN_RADAR_9831e7d7_Tx: ComBitPosition=193, ComBitSize=10, ComSignalType=UINT16, ComHandleId=11226, ComSystemTemplateSystemSignalRef=OBJ_ACCELERATION_LONG_056
          OBJ_POS_LONG_056_oRDR_TRACKER_OBJ_056_oPCAN_RADAR_ec37637b_Tx: ComBitPosition=63, ComBitSize=16, ComSignalType=UINT16, ComHandleId=11256, ComSystemTemplateSystemSignalRef=OBJ_POS_LONG_056
          OBJ_POS_LONG_ERR_056_oRDR_TRACKER_OBJ_056_oPCAN_RADAR_c0232661_Tx: ComBitPosition=95, ComBitSize=8, ComSignalType=UINT8, ComHandleId=11257, ComSystemTemplateSystemSignalRef=OBJ_POS_LONG_ERR_056
          OBJ_ACCELERATION_LONG_ERR_056_oRDR_TRACKER_OBJ_056_oPCAN_RADAR_20902123_Tx: ComBitPosition=215, ComBitSize=8, ComSignalType=UINT8, ComHandleId=11227, ComSystemTemplateSystemSignalRef=OBJ_ACCELERATION_LONG_ERR_056
          OBJ_REF_PT_LONG_OFFSET_056_oRDR_TRACKER_OBJ_056_oPCAN_RADAR_c53745c5_Tx: ComBitPosition=357, ComBitSize=14, ComSignalType=UINT16, ComHandleId=11260, ComSystemTemplateSystemSignalRef=OBJ_REF_PT_LONG_OFFSET_056
          OBJ_CLS_TYPE3_PROB_056_oRDR_TRACKER_OBJ_056_oPCAN_RADAR_49f47748_Tx: ComBitPosition=319, ComBitSize=8, ComSignalType=UINT8, ComHandleId=11235, ComSystemTemplateSystemSignalRef=OBJ_CLS_TYPE3_PROB_056
          OBJ_CLS_TYPE4_056_oRDR_TRACKER_OBJ_056_oPCAN_RADAR_b9b34de4_Tx: ComBitPosition=275, ComBitSize=4, ComSignalType=UINT8, ComHandleId=11236, ComSystemTemplateSystemSignalRef=OBJ_CLS_TYPE4_056
          OBJ_GROUP_ID_056_oRDR_TRACKER_OBJ_056_oPCAN_RADAR_8c157934_Tx: ComBitPosition=405, ComBitSize=6, ComSignalType=UINT8, ComHandleId=11247, ComSystemTemplateSystemSignalRef=OBJ_GROUP_ID_056
          OBJ_CLS_TYPE2_PROB_056_oRDR_TRACKER_OBJ_056_oPCAN_RADAR_0ee781b3_Tx: ComBitPosition=311, ComBitSize=8, ComSignalType=UINT8, ComHandleId=11233, ComSystemTemplateSystemSignalRef=OBJ_CLS_TYPE2_PROB_056
          OBJ_CLS_TYPE3_056_oRDR_TRACKER_OBJ_056_oPCAN_RADAR_afebb0c8_Tx: ComBitPosition=279, ComBitSize=4, ComSignalType=UINT8, ComHandleId=11234, ComSystemTemplateSystemSignalRef=OBJ_CLS_TYPE3_056
          OBJ_VELOCITY_ERR_CRR_COEF_056_oRDR_TRACKER_OBJ_056_oPCAN_RADAR_16424819_Tx: ComBitPosition=423, ComBitSize=8, ComSignalType=UINT8, ComHandleId=11264, ComSystemTemplateSystemSignalRef=OBJ_VELOCITY_ERR_CRR_COEF_056
          OBJ_REF_PT_LAT_OFFSET_056_oRDR_TRACKER_OBJ_056_oPCAN_RADAR_8a65b5c6_Tx: ComBitPosition=370, ComBitSize=14, ComSignalType=UINT16, ComHandleId=11259, ComSystemTemplateSystemSignalRef=OBJ_REF_PT_LAT_OFFSET_056
          OBJ_CLS_TYPE5_056_oRDR_TRACKER_OBJ_056_oPCAN_RADAR_343bb006_Tx: ComBitPosition=287, ComBitSize=4, ComSignalType=UINT8, ComHandleId=11238, ComSystemTemplateSystemSignalRef=OBJ_CLS_TYPE5_056
          OBJ_VELOCITY_LONG_ERR_056_oRDR_TRACKER_OBJ_056_oPCAN_RADAR_c18c8202_Tx: ComBitPosition=143, ComBitSize=8, ComSignalType=UINT8, ComHandleId=11268, ComSystemTemplateSystemSignalRef=OBJ_VELOCITY_LONG_ERR_056
          OBJ_EXISTENCE_PROB_056_oRDR_TRACKER_OBJ_056_oPCAN_RADAR_05676d99_Tx: ComBitPosition=229, ComBitSize=14, ComSignalType=UINT16, ComHandleId=11246, ComSystemTemplateSystemSignalRef=OBJ_EXISTENCE_PROB_056
          OBJ_ACCEL_ERR_CRR_COEF_056_oRDR_TRACKER_OBJ_056_oPCAN_RADAR_80330045_Tx: ComBitPosition=431, ComBitSize=8, ComSignalType=UINT8, ComHandleId=11228, ComSystemTemplateSystemSignalRef=OBJ_ACCEL_ERR_CRR_COEF_056
          OBJ_ALIVE_TIME_056_oRDR_TRACKER_OBJ_056_oPCAN_RADAR_f850ac6b_Tx: ComBitPosition=255, ComBitSize=16, ComSignalType=UINT16, ComHandleId=11229, ComSystemTemplateSystemSignalRef=OBJ_ALIVE_TIME_056
          OBJ_TIMESTAMP_OFFSET_056_oRDR_TRACKER_OBJ_056_oPCAN_RADAR_7ff4dee5_Tx: ComBitPosition=247, ComBitSize=8, ComSignalType=UINT8, ComHandleId=11261, ComSystemTemplateSystemSignalRef=OBJ_TIMESTAMP_OFFSET_056
          OBJ_POS_LAT_ERR_056_oRDR_TRACKER_OBJ_056_oPCAN_RADAR_59dbd883_Tx: ComBitPosition=103, ComBitSize=8, ComSignalType=UINT8, ComHandleId=11255, ComSystemTemplateSystemSignalRef=OBJ_POS_LAT_ERR_056
          OBJ_CLS_TYPE6_056_oRDR_TRACKER_OBJ_056_oPCAN_RADAR_79d3b061_Tx: ComBitPosition=282, ComBitSize=4, ComSignalType=UINT8, ComHandleId=11240, ComSystemTemplateSystemSignalRef=OBJ_CLS_TYPE6_056
          OBJ_CLS_TYPE1_056_oRDR_TRACKER_OBJ_056_oPCAN_RADAR_6f8b4d4d_Tx: ComBitPosition=271, ComBitSize=4, ComSignalType=UINT8, ComHandleId=11230, ComSystemTemplateSystemSignalRef=OBJ_CLS_TYPE1_056
          OBJ_MOVEMENT_STATUS_056_oRDR_TRACKER_OBJ_056_oPCAN_RADAR_2f47b5c2_Tx: ComBitPosition=196, ComBitSize=3, ComSignalType=UINT8, ComHandleId=11252, ComSystemTemplateSystemSignalRef=OBJ_MOVEMENT_STATUS_056
          OBJ_VELOCITY_LONG_056_oRDR_TRACKER_OBJ_056_oPCAN_RADAR_4979b555_Tx: ComBitPosition=110, ComBitSize=15, ComSignalType=UINT16, ComHandleId=11267, ComSystemTemplateSystemSignalRef=OBJ_VELOCITY_LONG_056
          OBJ_CLS_TYPE4_PROB_056_oRDR_TRACKER_OBJ_056_oPCAN_RADAR_47feb1e8_Tx: ComBitPosition=327, ComBitSize=8, ComSignalType=UINT8, ComHandleId=11237, ComSystemTemplateSystemSignalRef=OBJ_CLS_TYPE4_PROB_056
          OBJ_VELOCITY_LAT_056_oRDR_TRACKER_OBJ_056_oPCAN_RADAR_19f4cd93_Tx: ComBitPosition=126, ComBitSize=15, ComSignalType=UINT16, ComHandleId=11265, ComSystemTemplateSystemSignalRef=OBJ_VELOCITY_LAT_056
          OBJ_RCS_056_oRDR_TRACKER_OBJ_056_oPCAN_RADAR_7f58deb3_Tx: ComBitPosition=351, ComBitSize=7, ComSignalType=UINT8, ComHandleId=11258, ComSystemTemplateSystemSignalRef=OBJ_RCS_056
          OBJ_CLS_TYPE1_PROB_056_oRDR_TRACKER_OBJ_056_oPCAN_RADAR_c7d39abe_Tx: ComBitPosition=303, ComBitSize=8, ComSignalType=UINT8, ComHandleId=11231, ComSystemTemplateSystemSignalRef=OBJ_CLS_TYPE1_PROB_056
          OBJ_VEH_TRACK_FLAG_056_oRDR_TRACKER_OBJ_056_oPCAN_RADAR_31dd2965_Tx: ComBitPosition=10, ComBitSize=1, ComSignalType=BOOLEAN, ComHandleId=11263, ComSystemTemplateSystemSignalRef=OBJ_VEH_TRACK_FLAG_056
          OBJ_VELOCITY_LAT_ERR_056_oRDR_TRACKER_OBJ_056_oPCAN_RADAR_2d0ebdc2_Tx: ComBitPosition=151, ComBitSize=8, ComSignalType=UINT8, ComHandleId=11266, ComSystemTemplateSystemSignalRef=OBJ_VELOCITY_LAT_ERR_056
          OBJ_DIMENSION_WIDTH_ERR_056_oRDR_TRACKER_OBJ_056_oPCAN_RADAR_ee792e4c_Tx: ComBitPosition=23, ComBitSize=6, ComSignalType=UINT8, ComHandleId=11245, ComSystemTemplateSystemSignalRef=OBJ_DIMENSION_WIDTH_ERR_056
          OBJ_POS_ERR_CRR_COEF_056_oRDR_TRACKER_OBJ_056_oPCAN_RADAR_bf3875f8_Tx: ComBitPosition=415, ComBitSize=8, ComSignalType=UINT8, ComHandleId=11253, ComSystemTemplateSystemSignalRef=OBJ_POS_ERR_CRR_COEF_056
          OBJ_ACCELERATION_LAT_ERR_056_oRDR_TRACKER_OBJ_056_oPCAN_RADAR_3f358489_Tx: ComBitPosition=223, ComBitSize=8, ComSignalType=UINT8, ComHandleId=11225, ComSystemTemplateSystemSignalRef=OBJ_ACCELERATION_LAT_ERR_056
          OBJ_CLS_TYPE5_PROB_056_oRDR_TRACKER_OBJ_056_oPCAN_RADAR_00ed4713_Tx: ComBitPosition=335, ComBitSize=8, ComSignalType=UINT8, ComHandleId=11239, ComSystemTemplateSystemSignalRef=OBJ_CLS_TYPE5_PROB_056
          OBJ_YAW_RATE_ERR_056_oRDR_TRACKER_OBJ_056_oPCAN_RADAR_ef1f3b48_Tx: ComBitPosition=388, ComBitSize=5, ComSignalType=UINT8, ComHandleId=11272, ComSystemTemplateSystemSignalRef=OBJ_YAW_RATE_ERR_056
          OBJ_CLS_TYPE2_056_oRDR_TRACKER_OBJ_056_oPCAN_RADAR_22634d2a_Tx: ComBitPosition=267, ComBitSize=4, ComSignalType=UINT8, ComHandleId=11232, ComSystemTemplateSystemSignalRef=OBJ_CLS_TYPE2_056
          OBJ_CLS_TYPE6_PROB_056_oRDR_TRACKER_OBJ_056_oPCAN_RADAR_c9d95c1e_Tx: ComBitPosition=343, ComBitSize=8, ComSignalType=UINT8, ComHandleId=11241, ComSystemTemplateSystemSignalRef=OBJ_CLS_TYPE6_PROB_056
          OBJ_DIMENSION_LENGTH_ERR_056_oRDR_TRACKER_OBJ_056_oPCAN_RADAR_16ed0173_Tx: ComBitPosition=41, ComBitSize=10, ComSignalType=UINT16, ComHandleId=11243, ComSystemTemplateSystemSignalRef=OBJ_DIMENSION_LENGTH_ERR_056
          OBJ_TRACK_MOTION_MODEL_056_oRDR_TRACKER_OBJ_056_oPCAN_RADAR_b3f7df38_Tx: ComBitPosition=9, ComBitSize=2, ComSignalType=UINT8, ComHandleId=11262, ComSystemTemplateSystemSignalRef=OBJ_TRACK_MOTION_MODEL_056
          OBJ_YAW_ANGLE_ERR_056_oRDR_TRACKER_OBJ_056_oPCAN_RADAR_20458f04_Tx: ComBitPosition=175, ComBitSize=7, ComSignalType=UINT8, ComHandleId=11270, ComSystemTemplateSystemSignalRef=OBJ_YAW_ANGLE_ERR_056
          OBJ_YAW_ANGLE_056_oRDR_TRACKER_OBJ_056_oPCAN_RADAR_f54889d3_Tx: ComBitPosition=155, ComBitSize=12, ComSignalType=UINT16, ComHandleId=11269, ComSystemTemplateSystemSignalRef=OBJ_YAW_ANGLE_056
          OBJ_DIMENSION_LENGTH_056_oRDR_TRACKER_OBJ_056_oPCAN_RADAR_2d151e09_Tx: ComBitPosition=37, ComBitSize=12, ComSignalType=UINT16, ComHandleId=11242, ComSystemTemplateSystemSignalRef=OBJ_DIMENSION_LENGTH_056
          OBJ_MH_CRC16_056_oRDR_TRACKER_OBJ_056_oPCAN_RADAR_7c8997b2_Tx: ComBitPosition=495, ComBitSize=16, ComSignalType=UINT16, ComHandleId=11250, ComSystemTemplateSystemSignalRef=OBJ_MH_CRC16_056
          OBJ_MH_CYCLE_COUNTER_056_oRDR_TRACKER_OBJ_056_oPCAN_RADAR_0d6dcd53_Tx: ComBitPosition=487, ComBitSize=8, ComSignalType=UINT8, ComHandleId=11251, ComSystemTemplateSystemSignalRef=OBJ_MH_CYCLE_COUNTER_056
      RDR_TRACKER_OBJ_030_oPCAN_RADAR_8f700708_Tx (ComIPdu):
        ComIPduDirection = SEND
        ComIPduType = NORMAL
        ComIPduCancellationSupport = false
        ComIPduHandleId = 140
        ComIPduSignalProcessing = DEFERRED
        ComIPduChannelRef = CN_PCAN_RADAR_458ff0f1
        ComIPduGroupRef = RDR01_oPCAN_RADAR_Tx_b6bdb067 if post-build-variant-condition{matching-criterion=RDR_POS, value=0}
        ComIPduSignalGroupRef = SG_TrackerObject030_oRDR_TRACKER_OBJ_030_oPCAN_RADAR_ab18edec_Tx
        ComPduIdRef = RDR_TRACKER_OBJ_030_oPCAN_RADAR_8f700708_Tx
        ComIPduMainFunctionRef = ComMainFunctionTx_Event
        ComIPduGroupRef = RDR02_oPCAN_RADAR_Tx_9f750495 if post-build-variant-condition{matching-criterion=RDR_POS, value=1}
        ComIPduGroupRef = RDR03_oPCAN_RADAR_Tx_311d9504 if post-build-variant-condition{matching-criterion=RDR_POS, value=2}
        ComIPduGroupRef = RDR04_oPCAN_RADAR_Tx_cce46d71 if post-build-variant-condition{matching-criterion=RDR_POS, value=3}
        ComIPduGroupRef = RDR05_oPCAN_RADAR_Tx_628cfce0 if post-build-variant-condition{matching-criterion=RDR_POS, value=4}
        ComIPduGroupRef = RDR06_oPCAN_RADAR_Tx_4b444812 if post-build-variant-condition{matching-criterion=RDR_POS, value=5}
        ComIPduGroupRef = RDR07_oPCAN_RADAR_Tx_e52cd983 if post-build-variant-condition{matching-criterion=RDR_POS, value=6}
        ComIPduGroupRef = RDR08_oPCAN_RADAR_Tx_6bc6beb9 if post-build-variant-condition{matching-criterion=RDR_POS, value=7}
        ComTxIPdu: ComMinimumDelayTime=0, ComTxIPduUnusedAreasDefault=0
          ComTxModeTrue
            ComTxMode: ComTxModeMode=DIRECT, ComTxModeNumberOfRepetitions=0
          ComTxModeFalse
            ComTxMode: ComTxModeMode=NONE
      RDR_DETECTION_313_316_oPCAN_RADAR_c4549e8b_Tx (ComIPdu):
        ComIPduDirection = SEND
        ComIPduType = NORMAL
        ComIPduCancellationSupport = false
        ComIPduHandleId = 84
        ComIPduSignalProcessing = DEFERRED
        ComIPduChannelRef = CN_PCAN_RADAR_458ff0f1
        ComIPduGroupRef = RDR01_oPCAN_RADAR_Tx_b6bdb067 if post-build-variant-condition{matching-criterion=RDR_POS, value=0}
        ComIPduSignalGroupRef = SG_Detections_313_316_oRDR_DETECTION_313_316_oPCAN_RADAR_c2028a60_Tx
        ComPduIdRef = RDR_DETECTION_313_316_oPCAN_RADAR_c4549e8b_Tx
        ComIPduMainFunctionRef = ComMainFunctionTx_Event
        ComIPduGroupRef = RDR02_oPCAN_RADAR_Tx_9f750495 if post-build-variant-condition{matching-criterion=RDR_POS, value=1}
        ComIPduGroupRef = RDR03_oPCAN_RADAR_Tx_311d9504 if post-build-variant-condition{matching-criterion=RDR_POS, value=2}
        ComIPduGroupRef = RDR04_oPCAN_RADAR_Tx_cce46d71 if post-build-variant-condition{matching-criterion=RDR_POS, value=3}
        ComIPduGroupRef = RDR05_oPCAN_RADAR_Tx_628cfce0 if post-build-variant-condition{matching-criterion=RDR_POS, value=4}
        ComIPduGroupRef = RDR06_oPCAN_RADAR_Tx_4b444812 if post-build-variant-condition{matching-criterion=RDR_POS, value=5}
        ComIPduGroupRef = RDR07_oPCAN_RADAR_Tx_e52cd983 if post-build-variant-condition{matching-criterion=RDR_POS, value=6}
        ComIPduGroupRef = RDR08_oPCAN_RADAR_Tx_6bc6beb9 if post-build-variant-condition{matching-criterion=RDR_POS, value=7}
        ComTxIPdu: ComMinimumDelayTime=0, ComTxIPduUnusedAreasDefault=0
          ComTxModeTrue
            ComTxMode: ComTxModeMode=DIRECT, ComTxModeNumberOfRepetitions=0
          ComTxModeFalse
            ComTxMode: ComTxModeMode=NONE
      SG_TrackerObject026_oRDR_TRACKER_OBJ_026_oPCAN_RADAR_8261223b_Tx (ComSignalGroup):
        ComTransferProperty = TRIGGERED
        ComSignalGroupAccess = ACCESS_NEEDED_BY_SWC_OR_COM
        ComHandleId = 135
        ComSignalGroupArrayAccess = true
        ComSystemTemplateSignalGroupRef = SG_TrackerObject026
        49 x ComGroupSignal, all with ComSignalEndianness=BIG_ENDIAN, ComSignalInitValue=0, ComTransferProperty=PENDING, ComSignalAccess=ACCESS_NEEDED_BY_SWC_OR_COM:
          OBJ_POS_LAT_ERR_026_oRDR_TRACKER_OBJ_026_oPCAN_RADAR_3f5f1ff8_Tx: ComBitPosition=103, ComBitSize=8, ComSignalType=UINT8, ComHandleId=9785, ComSystemTemplateSystemSignalRef=OBJ_POS_LAT_ERR_026
          OBJ_TIMESTAMP_OFFSET_026_oRDR_TRACKER_OBJ_026_oPCAN_RADAR_1970199e_Tx: ComBitPosition=247, ComBitSize=8, ComSignalType=UINT8, ComHandleId=9791, ComSystemTemplateSystemSignalRef=OBJ_TIMESTAMP_OFFSET_026
          OBJ_MOVEMENT_STATUS_026_oRDR_TRACKER_OBJ_026_oPCAN_RADAR_49c372b9_Tx: ComBitPosition=196, ComBitSize=3, ComSignalType=UINT8, ComHandleId=9782, ComSystemTemplateSystemSignalRef=OBJ_MOVEMENT_STATUS_026
          OBJ_EXISTENCE_PROB_026_oRDR_TRACKER_OBJ_026_oPCAN_RADAR_63e3aae2_Tx: ComBitPosition=229, ComBitSize=14, ComSignalType=UINT16, ComHandleId=9776, ComSystemTemplateSystemSignalRef=OBJ_EXISTENCE_PROB_026
          OBJ_RCS_026_oRDR_TRACKER_OBJ_026_oPCAN_RADAR_19dc19c8_Tx: ComBitPosition=351, ComBitSize=7, ComSignalType=UINT8, ComHandleId=9788, ComSystemTemplateSystemSignalRef=OBJ_RCS_026
          OBJ_CLS_TYPE3_026_oRDR_TRACKER_OBJ_026_oPCAN_RADAR_c96f77b3_Tx: ComBitPosition=279, ComBitSize=4, ComSignalType=UINT8, ComHandleId=9764, ComSystemTemplateSystemSignalRef=OBJ_CLS_TYPE3_026
          OBJ_CLS_TYPE5_026_oRDR_TRACKER_OBJ_026_oPCAN_RADAR_52bf777d_Tx: ComBitPosition=287, ComBitSize=4, ComSignalType=UINT8, ComHandleId=9768, ComSystemTemplateSystemSignalRef=OBJ_CLS_TYPE5_026
          OBJ_VELOCITY_LONG_ERR_026_oRDR_TRACKER_OBJ_026_oPCAN_RADAR_a7084579_Tx: ComBitPosition=143, ComBitSize=8, ComSignalType=UINT8, ComHandleId=9798, ComSystemTemplateSystemSignalRef=OBJ_VELOCITY_LONG_ERR_026
          OBJ_DIMENSION_WIDTH_ERR_026_oRDR_TRACKER_OBJ_026_oPCAN_RADAR_88fde937_Tx: ComBitPosition=23, ComBitSize=6, ComSignalType=UINT8, ComHandleId=9775, ComSystemTemplateSystemSignalRef=OBJ_DIMENSION_WIDTH_ERR_026
          OBJ_ALIVE_TIME_026_oRDR_TRACKER_OBJ_026_oPCAN_RADAR_9ed46b10_Tx: ComBitPosition=255, ComBitSize=16, ComSignalType=UINT16, ComHandleId=9759, ComSystemTemplateSystemSignalRef=OBJ_ALIVE_TIME_026
          OBJ_CLS_TYPE2_026_oRDR_TRACKER_OBJ_026_oPCAN_RADAR_44e78a51_Tx: ComBitPosition=267, ComBitSize=4, ComSignalType=UINT8, ComHandleId=9762, ComSystemTemplateSystemSignalRef=OBJ_CLS_TYPE2_026
          OBJ_POS_LONG_ERR_026_oRDR_TRACKER_OBJ_026_oPCAN_RADAR_a6a7e11a_Tx: ComBitPosition=95, ComBitSize=8, ComSignalType=UINT8, ComHandleId=9787, ComSystemTemplateSystemSignalRef=OBJ_POS_LONG_ERR_026
          OBJ_CLS_TYPE4_026_oRDR_TRACKER_OBJ_026_oPCAN_RADAR_df378a9f_Tx: ComBitPosition=275, ComBitSize=4, ComSignalType=UINT8, ComHandleId=9766, ComSystemTemplateSystemSignalRef=OBJ_CLS_TYPE4_026
          OBJ_GROUP_ID_026_oRDR_TRACKER_OBJ_026_oPCAN_RADAR_ea91be4f_Tx: ComBitPosition=405, ComBitSize=6, ComSignalType=UINT8, ComHandleId=9777, ComSystemTemplateSystemSignalRef=OBJ_GROUP_ID_026
          OBJ_VELOCITY_LAT_026_oRDR_TRACKER_OBJ_026_oPCAN_RADAR_7f700ae8_Tx: ComBitPosition=126, ComBitSize=15, ComSignalType=UINT16, ComHandleId=9795, ComSystemTemplateSystemSignalRef=OBJ_VELOCITY_LAT_026
          OBJ_CLS_TYPE6_PROB_026_oRDR_TRACKER_OBJ_026_oPCAN_RADAR_af5d9b65_Tx: ComBitPosition=343, ComBitSize=8, ComSignalType=UINT8, ComHandleId=9771, ComSystemTemplateSystemSignalRef=OBJ_CLS_TYPE6_PROB_026
          OBJ_POS_LONG_026_oRDR_TRACKER_OBJ_026_oPCAN_RADAR_8ab3a400_Tx: ComBitPosition=63, ComBitSize=16, ComSignalType=UINT16, ComHandleId=9786, ComSystemTemplateSystemSignalRef=OBJ_POS_LONG_026
          OBJ_REF_PT_LAT_OFFSET_026_oRDR_TRACKER_OBJ_026_oPCAN_RADAR_ece172bd_Tx: ComBitPosition=370, ComBitSize=14, ComSignalType=UINT16, ComHandleId=9789, ComSystemTemplateSystemSignalRef=OBJ_REF_PT_LAT_OFFSET_026
          OBJ_REF_PT_LONG_OFFSET_026_oRDR_TRACKER_OBJ_026_oPCAN_RADAR_a3b382be_Tx: ComBitPosition=357, ComBitSize=14, ComSignalType=UINT16, ComHandleId=9790, ComSystemTemplateSystemSignalRef=OBJ_REF_PT_LONG_OFFSET_026
          OBJ_ACCELERATION_LAT_026_oRDR_TRACKER_OBJ_026_oPCAN_RADAR_8c45794c_Tx: ComBitPosition=177, ComBitSize=10, ComSignalType=UINT16, ComHandleId=9754, ComSystemTemplateSystemSignalRef=OBJ_ACCELERATION_LAT_026
          OBJ_TRACK_MOTION_MODEL_026_oRDR_TRACKER_OBJ_026_oPCAN_RADAR_d5731843_Tx: ComBitPosition=9, ComBitSize=2, ComSignalType=UINT8, ComHandleId=9792, ComSystemTemplateSystemSignalRef=OBJ_TRACK_MOTION_MODEL_026
          OBJ_CLS_TYPE2_PROB_026_oRDR_TRACKER_OBJ_026_oPCAN_RADAR_686346c8_Tx: ComBitPosition=311, ComBitSize=8, ComSignalType=UINT8, ComHandleId=9763, ComSystemTemplateSystemSignalRef=OBJ_CLS_TYPE2_PROB_026
          OBJ_VELOCITY_LAT_ERR_026_oRDR_TRACKER_OBJ_026_oPCAN_RADAR_4b8a7ab9_Tx: ComBitPosition=151, ComBitSize=8, ComSignalType=UINT8, ComHandleId=9796, ComSystemTemplateSystemSignalRef=OBJ_VELOCITY_LAT_ERR_026
          OBJ_VELOCITY_LONG_026_oRDR_TRACKER_OBJ_026_oPCAN_RADAR_2ffd722e_Tx: ComBitPosition=110, ComBitSize=15, ComSignalType=UINT16, ComHandleId=9797, ComSystemTemplateSystemSignalRef=OBJ_VELOCITY_LONG_026
          OBJ_ACCELERATION_LONG_026_oRDR_TRACKER_OBJ_026_oPCAN_RADAR_feb520ac_Tx: ComBitPosition=193, ComBitSize=10, ComSignalType=UINT16, ComHandleId=9756, ComSystemTemplateSystemSignalRef=OBJ_ACCELERATION_LONG_026
          OBJ_CLS_TYPE4_PROB_026_oRDR_TRACKER_OBJ_026_oPCAN_RADAR_217a7693_Tx: ComBitPosition=327, ComBitSize=8, ComSignalType=UINT8, ComHandleId=9767, ComSystemTemplateSystemSignalRef=OBJ_CLS_TYPE4_PROB_026
          OBJ_CLS_TYPE5_PROB_026_oRDR_TRACKER_OBJ_026_oPCAN_RADAR_66698068_Tx: ComBitPosition=335, ComBitSize=8, ComSignalType=UINT8, ComHandleId=9769, ComSystemTemplateSystemSignalRef=OBJ_CLS_TYPE5_PROB_026
          OBJ_POS_LAT_026_oRDR_TRACKER_OBJ_026_oPCAN_RADAR_3b134fcf_Tx: ComBitPosition=79, ComBitSize=16, ComSignalType=UINT16, ComHandleId=9784, ComSystemTemplateSystemSignalRef=OBJ_POS_LAT_026
          OBJ_VELOCITY_ERR_CRR_COEF_026_oRDR_TRACKER_OBJ_026_oPCAN_RADAR_70c68f62_Tx: ComBitPosition=423, ComBitSize=8, ComSignalType=UINT8, ComHandleId=9794, ComSystemTemplateSystemSignalRef=OBJ_VELOCITY_ERR_CRR_COEF_026
          OBJ_YAW_ANGLE_026_oRDR_TRACKER_OBJ_026_oPCAN_RADAR_93cc4ea8_Tx: ComBitPosition=155, ComBitSize=12, ComSignalType=UINT16, ComHandleId=9799, ComSystemTemplateSystemSignalRef=OBJ_YAW_ANGLE_026
          OBJ_DIMENSION_WIDTH_026_oRDR_TRACKER_OBJ_026_oPCAN_RADAR_685f2edf_Tx: ComBitPosition=17, ComBitSize=10, ComSignalType=UINT16, ComHandleId=9774, ComSystemTemplateSystemSignalRef=OBJ_DIMENSION_WIDTH_026
          OBJ_CLS_TYPE1_PROB_026_oRDR_TRACKER_OBJ_026_oPCAN_RADAR_a1575dc5_Tx: ComBitPosition=303, ComBitSize=8, ComSignalType=UINT8, ComHandleId=9761, ComSystemTemplateSystemSignalRef=OBJ_CLS_TYPE1_PROB_026
          OBJ_POS_ERR_CRR_COEF_026_oRDR_TRACKER_OBJ_026_oPCAN_RADAR_d9bcb283_Tx: ComBitPosition=415, ComBitSize=8, ComSignalType=UINT8, ComHandleId=9783, ComSystemTemplateSystemSignalRef=OBJ_POS_ERR_CRR_COEF_026
          OBJ_CLS_TYPE3_PROB_026_oRDR_TRACKER_OBJ_026_oPCAN_RADAR_2f70b033_Tx: ComBitPosition=319, ComBitSize=8, ComSignalType=UINT8, ComHandleId=9765, ComSystemTemplateSystemSignalRef=OBJ_CLS_TYPE3_PROB_026
          OBJ_MEASUREMENT_STATUS_026_oRDR_TRACKER_OBJ_026_oPCAN_RADAR_666de7f5_Tx: ComBitPosition=14, ComBitSize=3, ComSignalType=UINT8, ComHandleId=9779, ComSystemTemplateSystemSignalRef=OBJ_MEASUREMENT_STATUS_026
          OBJ_YAW_ANGLE_ERR_026_oRDR_TRACKER_OBJ_026_oPCAN_RADAR_46c1487f_Tx: ComBitPosition=175, ComBitSize=7, ComSignalType=UINT8, ComHandleId=9800, ComSystemTemplateSystemSignalRef=OBJ_YAW_ANGLE_ERR_026
          OBJ_ACCELERATION_LONG_ERR_026_oRDR_TRACKER_OBJ_026_oPCAN_RADAR_4614e658_Tx: ComBitPosition=215, ComBitSize=8, ComSignalType=UINT8, ComHandleId=9757, ComSystemTemplateSystemSignalRef=OBJ_ACCELERATION_LONG_ERR_026
          OBJ_ACCEL_ERR_CRR_COEF_026_oRDR_TRACKER_OBJ_026_oPCAN_RADAR_e6b7c73e_Tx: ComBitPosition=431, ComBitSize=8, ComSignalType=UINT8, ComHandleId=9758, ComSystemTemplateSystemSignalRef=OBJ_ACCEL_ERR_CRR_COEF_026
          OBJ_ID_026_oRDR_TRACKER_OBJ_026_oPCAN_RADAR_19bf9548_Tx: ComBitPosition=7, ComBitSize=8, ComSignalType=UINT8, ComHandleId=9778, ComSystemTemplateSystemSignalRef=OBJ_ID_026
          OBJ_DIMENSION_LENGTH_ERR_026_oRDR_TRACKER_OBJ_026_oPCAN_RADAR_7069c608_Tx: ComBitPosition=41, ComBitSize=10, ComSignalType=UINT16, ComHandleId=9773, ComSystemTemplateSystemSignalRef=OBJ_DIMENSION_LENGTH_ERR_026
          OBJ_ACCELERATION_LAT_ERR_026_oRDR_TRACKER_OBJ_026_oPCAN_RADAR_59b143f2_Tx: ComBitPosition=223, ComBitSize=8, ComSignalType=UINT8, ComHandleId=9755, ComSystemTemplateSystemSignalRef=OBJ_ACCELERATION_LAT_ERR_026
          OBJ_YAW_RATE_026_oRDR_TRACKER_OBJ_026_oPCAN_RADAR_b6436bef_Tx: ComBitPosition=399, ComBitSize=10, ComSignalType=UINT16, ComHandleId=9801, ComSystemTemplateSystemSignalRef=OBJ_YAW_RATE_026
          OBJ_CLS_TYPE1_026_oRDR_TRACKER_OBJ_026_oPCAN_RADAR_090f8a36_Tx: ComBitPosition=271, ComBitSize=4, ComSignalType=UINT8, ComHandleId=9760, ComSystemTemplateSystemSignalRef=OBJ_CLS_TYPE1_026
          OBJ_CLS_TYPE6_026_oRDR_TRACKER_OBJ_026_oPCAN_RADAR_1f57771a_Tx: ComBitPosition=282, ComBitSize=4, ComSignalType=UINT8, ComHandleId=9770, ComSystemTemplateSystemSignalRef=OBJ_CLS_TYPE6_026
          OBJ_YAW_RATE_ERR_026_oRDR_TRACKER_OBJ_026_oPCAN_RADAR_899bfc33_Tx: ComBitPosition=388, ComBitSize=5, ComSignalType=UINT8, ComHandleId=9802, ComSystemTemplateSystemSignalRef=OBJ_YAW_RATE_ERR_026
          OBJ_DIMENSION_LENGTH_026_oRDR_TRACKER_OBJ_026_oPCAN_RADAR_4b91d972_Tx: ComBitPosition=37, ComBitSize=12, ComSignalType=UINT16, ComHandleId=9772, ComSystemTemplateSystemSignalRef=OBJ_DIMENSION_LENGTH_026
          OBJ_VEH_TRACK_FLAG_026_oRDR_TRACKER_OBJ_026_oPCAN_RADAR_5759ee1e_Tx: ComBitPosition=10, ComBitSize=1, ComSignalType=BOOLEAN, ComHandleId=9793, ComSystemTemplateSystemSignalRef=OBJ_VEH_TRACK_FLAG_026
          OBJ_MH_CYCLE_COUNTER_026_oRDR_TRACKER_OBJ_026_oPCAN_RADAR_6be90a28_Tx: ComBitPosition=487, ComBitSize=8, ComSignalType=UINT8, ComHandleId=9781, ComSystemTemplateSystemSignalRef=OBJ_MH_CYCLE_COUNTER_026
          OBJ_MH_CRC16_026_oRDR_TRACKER_OBJ_026_oPCAN_RADAR_1a0d50c9_Tx: ComBitPosition=495, ComBitSize=16, ComSignalType=UINT16, ComHandleId=9780, ComSystemTemplateSystemSignalRef=OBJ_MH_CRC16_026
      5 x ComIPdu, all with ComIPduDirection=SEND, ComIPduType=NORMAL, ComIPduCancellationSupport=false, ComIPduSignalProcessing=DEFERRED, ComIPduChannelRef=CN_PCAN_RADAR_458ff0f1, ComIPduGroupRef=RDR01_oPCAN_RADAR_Tx_b6bdb067 if post-build-variant-condition{matching-criterion=RDR_POS, value=0}, ComIPduMainFunctionRef=ComMainFunctionTx_Event, ComIPduGroupRef=RDR02_oPCAN_RADAR_Tx_9f750495 if post-build-variant-condition{matching-criterion=RDR_POS, value=1}, ComIPduGroupRef=RDR03_oPCAN_RADAR_Tx_311d9504 if post-build-variant-condition{matching-criterion=RDR_POS, value=2}, ComIPduGroupRef=RDR04_oPCAN_RADAR_Tx_cce46d71 if post-build-variant-condition{matching-criterion=RDR_POS, value=3}, ComIPduGroupRef=RDR05_oPCAN_RADAR_Tx_628cfce0 if post-build-variant-condition{matching-criterion=RDR_POS, value=4}, ComIPduGroupRef=RDR06_oPCAN_RADAR_Tx_4b444812 if post-build-variant-condition{matching-criterion=RDR_POS, value=5}, ComIPduGroupRef=RDR07_oPCAN_RADAR_Tx_e52cd983 if post-build-variant-condition{matching-criterion=RDR_POS, value=6}, ComIPduGroupRef=RDR08_oPCAN_RADAR_Tx_6bc6beb9 if post-build-variant-condition{matching-criterion=RDR_POS, value=7}:
        RDR_TRACKER_OBJ_044_oPCAN_RADAR_2a04c75e_Tx: ComIPduHandleId=154, ComIPduSignalGroupRef=SG_TrackerObject044_oRDR_TRACKER_OBJ_044_oPCAN_RADAR_9f2c04d9_Tx, ComPduIdRef=RDR_TRACKER_OBJ_044_oPCAN_RADAR_2a04c75e_Tx
          ComTxIPdu: ComMinimumDelayTime=0, ComTxIPduUnusedAreasDefault=0
            ComTxModeTrue
              ComTxMode: ComTxModeMode=DIRECT, ComTxModeNumberOfRepetitions=0
            ComTxModeFalse
              ComTxMode: ComTxModeMode=NONE
        RDR_DETECTION_157_160_oPCAN_RADAR_a5eeac3f_Tx: ComIPduHandleId=45, ComIPduSignalGroupRef=SG_Detections_157_160_oRDR_DETECTION_157_160_oPCAN_RADAR_c115d936_Tx, ComPduIdRef=RDR_DETECTION_157_160_oPCAN_RADAR_a5eeac3f_Tx
          ComTxIPdu: ComMinimumDelayTime=0, ComTxIPduUnusedAreasDefault=0
            ComTxModeTrue
              ComTxMode: ComTxModeMode=DIRECT, ComTxModeNumberOfRepetitions=0
            ComTxModeFalse
              ComTxMode: ComTxModeMode=NONE
        RDR_TRACKER_OBJ_034_oPCAN_RADAR_4fc96d9e_Tx: ComIPduHandleId=144, ComIPduSignalGroupRef=SG_TrackerObject034_oRDR_TRACKER_OBJ_034_oPCAN_RADAR_f9a8c3a2_Tx, ComPduIdRef=RDR_TRACKER_OBJ_034_oPCAN_RADAR_4fc96d9e_Tx
          ComTxIPdu: ComMinimumDelayTime=0, ComTxIPduUnusedAreasDefault=0
            ComTxModeTrue
              ComTxMode: ComTxModeMode=DIRECT, ComTxModeNumberOfRepetitions=0
            ComTxModeFalse
              ComTxMode: ComTxModeMode=NONE
        RDR_TRACKER_OBJ_021_oPCAN_RADAR_cfe93ffb_Tx: ComIPduHandleId=131, ComIPduSignalGroupRef=SG_TrackerObject021_oRDR_TRACKER_OBJ_021_oPCAN_RADAR_009d93e1_Tx, ComPduIdRef=RDR_TRACKER_OBJ_021_oPCAN_RADAR_cfe93ffb_Tx
          ComTxIPdu: ComMinimumDelayTime=0, ComTxIPduUnusedAreasDefault=0
            ComTxModeTrue
              ComTxMode: ComTxModeMode=DIRECT, ComTxModeNumberOfRepetitions=0
            ComTxModeFalse
              ComTxMode: ComTxModeMode=NONE
        RDR_TRACKER_OBJ_053_oPCAN_RADAR_ca782070_Tx: ComIPduHandleId=163, ComIPduSignalGroupRef=SG_TrackerObject053_oRDR_TRACKER_OBJ_053_oPCAN_RADAR_4f4143bd_Tx, ComPduIdRef=RDR_TRACKER_OBJ_053_oPCAN_RADAR_ca782070_Tx
          ComTxIPdu: ComMinimumDelayTime=0, ComTxIPduUnusedAreasDefault=0
            ComTxModeTrue
              ComTxMode: ComTxModeMode=DIRECT, ComTxModeNumberOfRepetitions=0
            ComTxModeFalse
              ComTxMode: ComTxModeMode=NONE
      3 x ComSignalGroup, all with ComTransferProperty=TRIGGERED, ComSignalGroupAccess=ACCESS_NEEDED_BY_SWC_OR_COM, ComSignalGroupArrayAccess=true:
        SG_TrackerObject035_oRDR_TRACKER_OBJ_035_oPCAN_RADAR_00bc4b11_Tx: ComHandleId=144, ComSystemTemplateSignalGroupRef=SG_TrackerObject035
          49 x ComGroupSignal, all with ComSignalEndianness=BIG_ENDIAN, ComSignalInitValue=0, ComTransferProperty=PENDING, ComSignalAccess=ACCESS_NEEDED_BY_SWC_OR_COM:
            OBJ_POS_ERR_CRR_COEF_035_oRDR_TRACKER_OBJ_035_oPCAN_RADAR_5b61dba9_Tx: ComBitPosition=415, ComBitSize=8, ComSignalType=UINT8, ComHandleId=10224, ComSystemTemplateSystemSignalRef=OBJ_POS_ERR_CRR_COEF_035
            OBJ_VELOCITY_LAT_ERR_035_oRDR_TRACKER_OBJ_035_oPCAN_RADAR_c9571393_Tx: ComBitPosition=151, ComBitSize=8, ComSignalType=UINT8, ComHandleId=10237, ComSystemTemplateSystemSignalRef=OBJ_VELOCITY_LAT_ERR_035
            OBJ_ACCELERATION_LONG_ERR_035_oRDR_TRACKER_OBJ_035_oPCAN_RADAR_c4c98f72_Tx: ComBitPosition=215, ComBitSize=8, ComSignalType=UINT8, ComHandleId=10198, ComSystemTemplateSystemSignalRef=OBJ_ACCELERATION_LONG_ERR_035
            OBJ_CLS_TYPE3_035_oRDR_TRACKER_OBJ_035_oPCAN_RADAR_4bb21e99_Tx: ComBitPosition=279, ComBitSize=4, ComSignalType=UINT8, ComHandleId=10205, ComSystemTemplateSystemSignalRef=OBJ_CLS_TYPE3_035
            OBJ_CLS_TYPE1_PROB_035_oRDR_TRACKER_OBJ_035_oPCAN_RADAR_238a34ef_Tx: ComBitPosition=303, ComBitSize=8, ComSignalType=UINT8, ComHandleId=10202, ComSystemTemplateSystemSignalRef=OBJ_CLS_TYPE1_PROB_035
            OBJ_POS_LONG_035_oRDR_TRACKER_OBJ_035_oPCAN_RADAR_086ecd2a_Tx: ComBitPosition=63, ComBitSize=16, ComSignalType=UINT16, ComHandleId=10227, ComSystemTemplateSystemSignalRef=OBJ_POS_LONG_035
            OBJ_ACCEL_ERR_CRR_COEF_035_oRDR_TRACKER_OBJ_035_oPCAN_RADAR_646aae14_Tx: ComBitPosition=431, ComBitSize=8, ComSignalType=UINT8, ComHandleId=10199, ComSystemTemplateSystemSignalRef=OBJ_ACCEL_ERR_CRR_COEF_035
            OBJ_CLS_TYPE4_PROB_035_oRDR_TRACKER_OBJ_035_oPCAN_RADAR_a3a71fb9_Tx: ComBitPosition=327, ComBitSize=8, ComSignalType=UINT8, ComHandleId=10208, ComSystemTemplateSystemSignalRef=OBJ_CLS_TYPE4_PROB_035
            OBJ_DIMENSION_LENGTH_ERR_035_oRDR_TRACKER_OBJ_035_oPCAN_RADAR_f2b4af22_Tx: ComBitPosition=41, ComBitSize=10, ComSignalType=UINT16, ComHandleId=10214, ComSystemTemplateSystemSignalRef=OBJ_DIMENSION_LENGTH_ERR_035
            OBJ_CLS_TYPE5_PROB_035_oRDR_TRACKER_OBJ_035_oPCAN_RADAR_e4b4e942_Tx: ComBitPosition=335, ComBitSize=8, ComSignalType=UINT8, ComHandleId=10210, ComSystemTemplateSystemSignalRef=OBJ_CLS_TYPE5_PROB_035
            OBJ_REF_PT_LAT_OFFSET_035_oRDR_TRACKER_OBJ_035_oPCAN_RADAR_6e3c1b97_Tx: ComBitPosition=370, ComBitSize=14, ComSignalType=UINT16, ComHandleId=10230, ComSystemTemplateSystemSignalRef=OBJ_REF_PT_LAT_OFFSET_035
            OBJ_CLS_TYPE5_035_oRDR_TRACKER_OBJ_035_oPCAN_RADAR_d0621e57_Tx: ComBitPosition=287, ComBitSize=4, ComSignalType=UINT8, ComHandleId=10209, ComSystemTemplateSystemSignalRef=OBJ_CLS_TYPE5_035
            OBJ_CLS_TYPE4_035_oRDR_TRACKER_OBJ_035_oPCAN_RADAR_5deae3b5_Tx: ComBitPosition=275, ComBitSize=4, ComSignalType=UINT8, ComHandleId=10207, ComSystemTemplateSystemSignalRef=OBJ_CLS_TYPE4_035
            OBJ_VELOCITY_LONG_035_oRDR_TRACKER_OBJ_035_oPCAN_RADAR_ad201b04_Tx: ComBitPosition=110, ComBitSize=15, ComSignalType=UINT16, ComHandleId=10238, ComSystemTemplateSystemSignalRef=OBJ_VELOCITY_LONG_035
            OBJ_DIMENSION_LENGTH_035_oRDR_TRACKER_OBJ_035_oPCAN_RADAR_c94cb058_Tx: ComBitPosition=37, ComBitSize=12, ComSignalType=UINT16, ComHandleId=10213, ComSystemTemplateSystemSignalRef=OBJ_DIMENSION_LENGTH_035
            OBJ_CLS_TYPE6_035_oRDR_TRACKER_OBJ_035_oPCAN_RADAR_9d8a1e30_Tx: ComBitPosition=282, ComBitSize=4, ComSignalType=UINT8, ComHandleId=10211, ComSystemTemplateSystemSignalRef=OBJ_CLS_TYPE6_035
            OBJ_CLS_TYPE1_035_oRDR_TRACKER_OBJ_035_oPCAN_RADAR_8bd2e31c_Tx: ComBitPosition=271, ComBitSize=4, ComSignalType=UINT8, ComHandleId=10201, ComSystemTemplateSystemSignalRef=OBJ_CLS_TYPE1_035
            OBJ_CLS_TYPE2_PROB_035_oRDR_TRACKER_OBJ_035_oPCAN_RADAR_eabe2fe2_Tx: ComBitPosition=311, ComBitSize=8, ComSignalType=UINT8, ComHandleId=10204, ComSystemTemplateSystemSignalRef=OBJ_CLS_TYPE2_PROB_035
            OBJ_VEH_TRACK_FLAG_035_oRDR_TRACKER_OBJ_035_oPCAN_RADAR_d5848734_Tx: ComBitPosition=10, ComBitSize=1, ComSignalType=BOOLEAN, ComHandleId=10234, ComSystemTemplateSystemSignalRef=OBJ_VEH_TRACK_FLAG_035
            OBJ_VELOCITY_LAT_035_oRDR_TRACKER_OBJ_035_oPCAN_RADAR_fdad63c2_Tx: ComBitPosition=126, ComBitSize=15, ComSignalType=UINT16, ComHandleId=10236, ComSystemTemplateSystemSignalRef=OBJ_VELOCITY_LAT_035
            OBJ_DIMENSION_WIDTH_035_oRDR_TRACKER_OBJ_035_oPCAN_RADAR_ea8247f5_Tx: ComBitPosition=17, ComBitSize=10, ComSignalType=UINT16, ComHandleId=10215, ComSystemTemplateSystemSignalRef=OBJ_DIMENSION_WIDTH_035
            OBJ_ACCELERATION_LONG_035_oRDR_TRACKER_OBJ_035_oPCAN_RADAR_7c684986_Tx: ComBitPosition=193, ComBitSize=10, ComSignalType=UINT16, ComHandleId=10197, ComSystemTemplateSystemSignalRef=OBJ_ACCELERATION_LONG_035
            OBJ_TIMESTAMP_OFFSET_035_oRDR_TRACKER_OBJ_035_oPCAN_RADAR_9bad70b4_Tx: ComBitPosition=247, ComBitSize=8, ComSignalType=UINT8, ComHandleId=10232, ComSystemTemplateSystemSignalRef=OBJ_TIMESTAMP_OFFSET_035
            OBJ_ID_035_oRDR_TRACKER_OBJ_035_oPCAN_RADAR_9b62fc62_Tx: ComBitPosition=7, ComBitSize=8, ComSignalType=UINT8, ComHandleId=10219, ComSystemTemplateSystemSignalRef=OBJ_ID_035
            OBJ_POS_LONG_ERR_035_oRDR_TRACKER_OBJ_035_oPCAN_RADAR_247a8830_Tx: ComBitPosition=95, ComBitSize=8, ComSignalType=UINT8, ComHandleId=10228, ComSystemTemplateSystemSignalRef=OBJ_POS_LONG_ERR_035
            OBJ_VELOCITY_LONG_ERR_035_oRDR_TRACKER_OBJ_035_oPCAN_RADAR_25d52c53_Tx: ComBitPosition=143, ComBitSize=8, ComSignalType=UINT8, ComHandleId=10239, ComSystemTemplateSystemSignalRef=OBJ_VELOCITY_LONG_ERR_035
            OBJ_MOVEMENT_STATUS_035_oRDR_TRACKER_OBJ_035_oPCAN_RADAR_cb1e1b93_Tx: ComBitPosition=196, ComBitSize=3, ComSignalType=UINT8, ComHandleId=10223, ComSystemTemplateSystemSignalRef=OBJ_MOVEMENT_STATUS_035
            OBJ_POS_LAT_035_oRDR_TRACKER_OBJ_035_oPCAN_RADAR_b9ce26e5_Tx: ComBitPosition=79, ComBitSize=16, ComSignalType=UINT16, ComHandleId=10225, ComSystemTemplateSystemSignalRef=OBJ_POS_LAT_035
            OBJ_DIMENSION_WIDTH_ERR_035_oRDR_TRACKER_OBJ_035_oPCAN_RADAR_0a20801d_Tx: ComBitPosition=23, ComBitSize=6, ComSignalType=UINT8, ComHandleId=10216, ComSystemTemplateSystemSignalRef=OBJ_DIMENSION_WIDTH_ERR_035
            OBJ_REF_PT_LONG_OFFSET_035_oRDR_TRACKER_OBJ_035_oPCAN_RADAR_216eeb94_Tx: ComBitPosition=357, ComBitSize=14, ComSignalType=UINT16, ComHandleId=10231, ComSystemTemplateSystemSignalRef=OBJ_REF_PT_LONG_OFFSET_035
            OBJ_CLS_TYPE6_PROB_035_oRDR_TRACKER_OBJ_035_oPCAN_RADAR_2d80f24f_Tx: ComBitPosition=343, ComBitSize=8, ComSignalType=UINT8, ComHandleId=10212, ComSystemTemplateSystemSignalRef=OBJ_CLS_TYPE6_PROB_035
            OBJ_POS_LAT_ERR_035_oRDR_TRACKER_OBJ_035_oPCAN_RADAR_bd8276d2_Tx: ComBitPosition=103, ComBitSize=8, ComSignalType=UINT8, ComHandleId=10226, ComSystemTemplateSystemSignalRef=OBJ_POS_LAT_ERR_035
            OBJ_ACCELERATION_LAT_035_oRDR_TRACKER_OBJ_035_oPCAN_RADAR_0e981066_Tx: ComBitPosition=177, ComBitSize=10, ComSignalType=UINT16, ComHandleId=10195, ComSystemTemplateSystemSignalRef=OBJ_ACCELERATION_LAT_035
            OBJ_EXISTENCE_PROB_035_oRDR_TRACKER_OBJ_035_oPCAN_RADAR_e13ec3c8_Tx: ComBitPosition=229, ComBitSize=14, ComSignalType=UINT16, ComHandleId=10217, ComSystemTemplateSystemSignalRef=OBJ_EXISTENCE_PROB_035
            OBJ_YAW_RATE_035_oRDR_TRACKER_OBJ_035_oPCAN_RADAR_349e02c5_Tx: ComBitPosition=399, ComBitSize=10, ComSignalType=UINT16, ComHandleId=10242, ComSystemTemplateSystemSignalRef=OBJ_YAW_RATE_035
            OBJ_CLS_TYPE3_PROB_035_oRDR_TRACKER_OBJ_035_oPCAN_RADAR_adadd919_Tx: ComBitPosition=319, ComBitSize=8, ComSignalType=UINT8, ComHandleId=10206, ComSystemTemplateSystemSignalRef=OBJ_CLS_TYPE3_PROB_035
            OBJ_TRACK_MOTION_MODEL_035_oRDR_TRACKER_OBJ_035_oPCAN_RADAR_57ae7169_Tx: ComBitPosition=9, ComBitSize=2, ComSignalType=UINT8, ComHandleId=10233, ComSystemTemplateSystemSignalRef=OBJ_TRACK_MOTION_MODEL_035
            OBJ_GROUP_ID_035_oRDR_TRACKER_OBJ_035_oPCAN_RADAR_684cd765_Tx: ComBitPosition=405, ComBitSize=6, ComSignalType=UINT8, ComHandleId=10218, ComSystemTemplateSystemSignalRef=OBJ_GROUP_ID_035
            OBJ_CLS_TYPE2_035_oRDR_TRACKER_OBJ_035_oPCAN_RADAR_c63ae37b_Tx: ComBitPosition=267, ComBitSize=4, ComSignalType=UINT8, ComHandleId=10203, ComSystemTemplateSystemSignalRef=OBJ_CLS_TYPE2_035
            OBJ_MEASUREMENT_STATUS_035_oRDR_TRACKER_OBJ_035_oPCAN_RADAR_e4b08edf_Tx: ComBitPosition=14, ComBitSize=3, ComSignalType=UINT8, ComHandleId=10220, ComSystemTemplateSystemSignalRef=OBJ_MEASUREMENT_STATUS_035
            OBJ_YAW_ANGLE_ERR_035_oRDR_TRACKER_OBJ_035_oPCAN_RADAR_c41c2155_Tx: ComBitPosition=175, ComBitSize=7, ComSignalType=UINT8, ComHandleId=10241, ComSystemTemplateSystemSignalRef=OBJ_YAW_ANGLE_ERR_035
            OBJ_VELOCITY_ERR_CRR_COEF_035_oRDR_TRACKER_OBJ_035_oPCAN_RADAR_f21be648_Tx: ComBitPosition=423, ComBitSize=8, ComSignalType=UINT8, ComHandleId=10235, ComSystemTemplateSystemSignalRef=OBJ_VELOCITY_ERR_CRR_COEF_035
            OBJ_RCS_035_oRDR_TRACKER_OBJ_035_oPCAN_RADAR_9b0170e2_Tx: ComBitPosition=351, ComBitSize=7, ComSignalType=UINT8, ComHandleId=10229, ComSystemTemplateSystemSignalRef=OBJ_RCS_035
            OBJ_ACCELERATION_LAT_ERR_035_oRDR_TRACKER_OBJ_035_oPCAN_RADAR_db6c2ad8_Tx: ComBitPosition=223, ComBitSize=8, ComSignalType=UINT8, ComHandleId=10196, ComSystemTemplateSystemSignalRef=OBJ_ACCELERATION_LAT_ERR_035
            OBJ_ALIVE_TIME_035_oRDR_TRACKER_OBJ_035_oPCAN_RADAR_1c09023a_Tx: ComBitPosition=255, ComBitSize=16, ComSignalType=UINT16, ComHandleId=10200, ComSystemTemplateSystemSignalRef=OBJ_ALIVE_TIME_035
            OBJ_YAW_ANGLE_035_oRDR_TRACKER_OBJ_035_oPCAN_RADAR_11112782_Tx: ComBitPosition=155, ComBitSize=12, ComSignalType=UINT16, ComHandleId=10240, ComSystemTemplateSystemSignalRef=OBJ_YAW_ANGLE_035
            OBJ_YAW_RATE_ERR_035_oRDR_TRACKER_OBJ_035_oPCAN_RADAR_0b469519_Tx: ComBitPosition=388, ComBitSize=5, ComSignalType=UINT8, ComHandleId=10243, ComSystemTemplateSystemSignalRef=OBJ_YAW_RATE_ERR_035
            OBJ_MH_CRC16_035_oRDR_TRACKER_OBJ_035_oPCAN_RADAR_98d039e3_Tx: ComBitPosition=495, ComBitSize=16, ComSignalType=UINT16, ComHandleId=10221, ComSystemTemplateSystemSignalRef=OBJ_MH_CRC16_035
            OBJ_MH_CYCLE_COUNTER_035_oRDR_TRACKER_OBJ_035_oPCAN_RADAR_e9346302_Tx: ComBitPosition=487, ComBitSize=8, ComSignalType=UINT8, ComHandleId=10222, ComSystemTemplateSystemSignalRef=OBJ_MH_CYCLE_COUNTER_035
        SG_TrackerObject023_oRDR_TRACKER_OBJ_023_oPCAN_RADAR_29c584c6_Tx: ComHandleId=132, ComSystemTemplateSignalGroupRef=SG_TrackerObject023
          49 x ComGroupSignal, all with ComSignalEndianness=BIG_ENDIAN, ComSignalInitValue=0, ComTransferProperty=PENDING, ComSignalAccess=ACCESS_NEEDED_BY_SWC_OR_COM:
            OBJ_ACCELERATION_LONG_ERR_023_oRDR_TRACKER_OBJ_023_oPCAN_RADAR_edb040a5_Tx: ComBitPosition=215, ComBitSize=8, ComSignalType=UINT8, ComHandleId=9610, ComSystemTemplateSystemSignalRef=OBJ_ACCELERATION_LONG_ERR_023
            OBJ_VELOCITY_LONG_023_oRDR_TRACKER_OBJ_023_oPCAN_RADAR_8459d4d3_Tx: ComBitPosition=110, ComBitSize=15, ComSignalType=UINT16, ComHandleId=9650, ComSystemTemplateSystemSignalRef=OBJ_VELOCITY_LONG_023
            OBJ_CLS_TYPE5_PROB_023_oRDR_TRACKER_OBJ_023_oPCAN_RADAR_cdcd2695_Tx: ComBitPosition=335, ComBitSize=8, ComSignalType=UINT8, ComHandleId=9622, ComSystemTemplateSystemSignalRef=OBJ_CLS_TYPE5_PROB_023
            OBJ_POS_LAT_023_oRDR_TRACKER_OBJ_023_oPCAN_RADAR_90b7e932_Tx: ComBitPosition=79, ComBitSize=16, ComSignalType=UINT16, ComHandleId=9637, ComSystemTemplateSystemSignalRef=OBJ_POS_LAT_023
            OBJ_RCS_023_oRDR_TRACKER_OBJ_023_oPCAN_RADAR_b278bf35_Tx: ComBitPosition=351, ComBitSize=7, ComSignalType=UINT8, ComHandleId=9641, ComSystemTemplateSystemSignalRef=OBJ_RCS_023
            OBJ_TIMESTAMP_OFFSET_023_oRDR_TRACKER_OBJ_023_oPCAN_RADAR_b2d4bf63_Tx: ComBitPosition=247, ComBitSize=8, ComSignalType=UINT8, ComHandleId=9644, ComSystemTemplateSystemSignalRef=OBJ_TIMESTAMP_OFFSET_023
            OBJ_ACCELERATION_LAT_023_oRDR_TRACKER_OBJ_023_oPCAN_RADAR_27e1dfb1_Tx: ComBitPosition=177, ComBitSize=10, ComSignalType=UINT16, ComHandleId=9607, ComSystemTemplateSystemSignalRef=OBJ_ACCELERATION_LAT_023
            OBJ_CLS_TYPE5_023_oRDR_TRACKER_OBJ_023_oPCAN_RADAR_f91bd180_Tx: ComBitPosition=287, ComBitSize=4, ComSignalType=UINT8, ComHandleId=9621, ComSystemTemplateSystemSignalRef=OBJ_CLS_TYPE5_023
            OBJ_POS_LAT_ERR_023_oRDR_TRACKER_OBJ_023_oPCAN_RADAR_94fbb905_Tx: ComBitPosition=103, ComBitSize=8, ComSignalType=UINT8, ComHandleId=9638, ComSystemTemplateSystemSignalRef=OBJ_POS_LAT_ERR_023
            OBJ_VEH_TRACK_FLAG_023_oRDR_TRACKER_OBJ_023_oPCAN_RADAR_fcfd48e3_Tx: ComBitPosition=10, ComBitSize=1, ComSignalType=BOOLEAN, ComHandleId=9646, ComSystemTemplateSystemSignalRef=OBJ_VEH_TRACK_FLAG_023
            OBJ_CLS_TYPE3_023_oRDR_TRACKER_OBJ_023_oPCAN_RADAR_62cbd14e_Tx: ComBitPosition=279, ComBitSize=4, ComSignalType=UINT8, ComHandleId=9617, ComSystemTemplateSystemSignalRef=OBJ_CLS_TYPE3_023
            OBJ_MOVEMENT_STATUS_023_oRDR_TRACKER_OBJ_023_oPCAN_RADAR_e267d444_Tx: ComBitPosition=196, ComBitSize=3, ComSignalType=UINT8, ComHandleId=9635, ComSystemTemplateSystemSignalRef=OBJ_MOVEMENT_STATUS_023
            OBJ_POS_LONG_023_oRDR_TRACKER_OBJ_023_oPCAN_RADAR_211702fd_Tx: ComBitPosition=63, ComBitSize=16, ComSignalType=UINT16, ComHandleId=9639, ComSystemTemplateSystemSignalRef=OBJ_POS_LONG_023
            OBJ_EXISTENCE_PROB_023_oRDR_TRACKER_OBJ_023_oPCAN_RADAR_c8470c1f_Tx: ComBitPosition=229, ComBitSize=14, ComSignalType=UINT16, ComHandleId=9629, ComSystemTemplateSystemSignalRef=OBJ_EXISTENCE_PROB_023
            OBJ_YAW_ANGLE_ERR_023_oRDR_TRACKER_OBJ_023_oPCAN_RADAR_ed65ee82_Tx: ComBitPosition=175, ComBitSize=7, ComSignalType=UINT8, ComHandleId=9653, ComSystemTemplateSystemSignalRef=OBJ_YAW_ANGLE_ERR_023
            OBJ_CLS_TYPE6_023_oRDR_TRACKER_OBJ_023_oPCAN_RADAR_b4f3d1e7_Tx: ComBitPosition=282, ComBitSize=4, ComSignalType=UINT8, ComHandleId=9623, ComSystemTemplateSystemSignalRef=OBJ_CLS_TYPE6_023
            OBJ_VELOCITY_LAT_023_oRDR_TRACKER_OBJ_023_oPCAN_RADAR_d4d4ac15_Tx: ComBitPosition=126, ComBitSize=15, ComSignalType=UINT16, ComHandleId=9648, ComSystemTemplateSystemSignalRef=OBJ_VELOCITY_LAT_023
            OBJ_ACCELERATION_LAT_ERR_023_oRDR_TRACKER_OBJ_023_oPCAN_RADAR_f215e50f_Tx: ComBitPosition=223, ComBitSize=8, ComSignalType=UINT8, ComHandleId=9608, ComSystemTemplateSystemSignalRef=OBJ_ACCELERATION_LAT_ERR_023
            OBJ_CLS_TYPE4_023_oRDR_TRACKER_OBJ_023_oPCAN_RADAR_74932c62_Tx: ComBitPosition=275, ComBitSize=4, ComSignalType=UINT8, ComHandleId=9619, ComSystemTemplateSystemSignalRef=OBJ_CLS_TYPE4_023
            OBJ_REF_PT_LONG_OFFSET_023_oRDR_TRACKER_OBJ_023_oPCAN_RADAR_08172443_Tx: ComBitPosition=357, ComBitSize=14, ComSignalType=UINT16, ComHandleId=9643, ComSystemTemplateSystemSignalRef=OBJ_REF_PT_LONG_OFFSET_023
            OBJ_VELOCITY_LONG_ERR_023_oRDR_TRACKER_OBJ_023_oPCAN_RADAR_0cace384_Tx: ComBitPosition=143, ComBitSize=8, ComSignalType=UINT8, ComHandleId=9651, ComSystemTemplateSystemSignalRef=OBJ_VELOCITY_LONG_ERR_023
            OBJ_CLS_TYPE4_PROB_023_oRDR_TRACKER_OBJ_023_oPCAN_RADAR_8aded06e_Tx: ComBitPosition=327, ComBitSize=8, ComSignalType=UINT8, ComHandleId=9620, ComSystemTemplateSystemSignalRef=OBJ_CLS_TYPE4_PROB_023
            OBJ_YAW_RATE_ERR_023_oRDR_TRACKER_OBJ_023_oPCAN_RADAR_223f5ace_Tx: ComBitPosition=388, ComBitSize=5, ComSignalType=UINT8, ComHandleId=9655, ComSystemTemplateSystemSignalRef=OBJ_YAW_RATE_ERR_023
            OBJ_ALIVE_TIME_023_oRDR_TRACKER_OBJ_023_oPCAN_RADAR_3570cded_Tx: ComBitPosition=255, ComBitSize=16, ComSignalType=UINT16, ComHandleId=9612, ComSystemTemplateSystemSignalRef=OBJ_ALIVE_TIME_023
            OBJ_DIMENSION_WIDTH_023_oRDR_TRACKER_OBJ_023_oPCAN_RADAR_c3fb8822_Tx: ComBitPosition=17, ComBitSize=10, ComSignalType=UINT16, ComHandleId=9627, ComSystemTemplateSystemSignalRef=OBJ_DIMENSION_WIDTH_023
            OBJ_YAW_RATE_023_oRDR_TRACKER_OBJ_023_oPCAN_RADAR_1de7cd12_Tx: ComBitPosition=399, ComBitSize=10, ComSignalType=UINT16, ComHandleId=9654, ComSystemTemplateSystemSignalRef=OBJ_YAW_RATE_023
            OBJ_DIMENSION_LENGTH_023_oRDR_TRACKER_OBJ_023_oPCAN_RADAR_e0357f8f_Tx: ComBitPosition=37, ComBitSize=12, ComSignalType=UINT16, ComHandleId=9625, ComSystemTemplateSystemSignalRef=OBJ_DIMENSION_LENGTH_023
            OBJ_DIMENSION_LENGTH_ERR_023_oRDR_TRACKER_OBJ_023_oPCAN_RADAR_dbcd60f5_Tx: ComBitPosition=41, ComBitSize=10, ComSignalType=UINT16, ComHandleId=9626, ComSystemTemplateSystemSignalRef=OBJ_DIMENSION_LENGTH_ERR_023
            OBJ_YAW_ANGLE_023_oRDR_TRACKER_OBJ_023_oPCAN_RADAR_3868e855_Tx: ComBitPosition=155, ComBitSize=12, ComSignalType=UINT16, ComHandleId=9652, ComSystemTemplateSystemSignalRef=OBJ_YAW_ANGLE_023
            OBJ_CLS_TYPE2_023_oRDR_TRACKER_OBJ_023_oPCAN_RADAR_ef432cac_Tx: ComBitPosition=267, ComBitSize=4, ComSignalType=UINT8, ComHandleId=9615, ComSystemTemplateSystemSignalRef=OBJ_CLS_TYPE2_023
            OBJ_POS_LONG_ERR_023_oRDR_TRACKER_OBJ_023_oPCAN_RADAR_0d0347e7_Tx: ComBitPosition=95, ComBitSize=8, ComSignalType=UINT8, ComHandleId=9640, ComSystemTemplateSystemSignalRef=OBJ_POS_LONG_ERR_023
            OBJ_ACCELERATION_LONG_023_oRDR_TRACKER_OBJ_023_oPCAN_RADAR_55118651_Tx: ComBitPosition=193, ComBitSize=10, ComSignalType=UINT16, ComHandleId=9609, ComSystemTemplateSystemSignalRef=OBJ_ACCELERATION_LONG_023
            OBJ_CLS_TYPE1_PROB_023_oRDR_TRACKER_OBJ_023_oPCAN_RADAR_0af3fb38_Tx: ComBitPosition=303, ComBitSize=8, ComSignalType=UINT8, ComHandleId=9614, ComSystemTemplateSystemSignalRef=OBJ_CLS_TYPE1_PROB_023
            OBJ_CLS_TYPE2_PROB_023_oRDR_TRACKER_OBJ_023_oPCAN_RADAR_c3c7e035_Tx: ComBitPosition=311, ComBitSize=8, ComSignalType=UINT8, ComHandleId=9616, ComSystemTemplateSystemSignalRef=OBJ_CLS_TYPE2_PROB_023
            OBJ_GROUP_ID_023_oRDR_TRACKER_OBJ_023_oPCAN_RADAR_413518b2_Tx: ComBitPosition=405, ComBitSize=6, ComSignalType=UINT8, ComHandleId=9630, ComSystemTemplateSystemSignalRef=OBJ_GROUP_ID_023
            OBJ_CLS_TYPE1_023_oRDR_TRACKER_OBJ_023_oPCAN_RADAR_a2ab2ccb_Tx: ComBitPosition=271, ComBitSize=4, ComSignalType=UINT8, ComHandleId=9613, ComSystemTemplateSystemSignalRef=OBJ_CLS_TYPE1_023
            OBJ_CLS_TYPE6_PROB_023_oRDR_TRACKER_OBJ_023_oPCAN_RADAR_04f93d98_Tx: ComBitPosition=343, ComBitSize=8, ComSignalType=UINT8, ComHandleId=9624, ComSystemTemplateSystemSignalRef=OBJ_CLS_TYPE6_PROB_023
            OBJ_MEASUREMENT_STATUS_023_oRDR_TRACKER_OBJ_023_oPCAN_RADAR_cdc94108_Tx: ComBitPosition=14, ComBitSize=3, ComSignalType=UINT8, ComHandleId=9632, ComSystemTemplateSystemSignalRef=OBJ_MEASUREMENT_STATUS_023
            OBJ_REF_PT_LAT_OFFSET_023_oRDR_TRACKER_OBJ_023_oPCAN_RADAR_4745d440_Tx: ComBitPosition=370, ComBitSize=14, ComSignalType=UINT16, ComHandleId=9642, ComSystemTemplateSystemSignalRef=OBJ_REF_PT_LAT_OFFSET_023
            OBJ_VELOCITY_ERR_CRR_COEF_023_oRDR_TRACKER_OBJ_023_oPCAN_RADAR_db62299f_Tx: ComBitPosition=423, ComBitSize=8, ComSignalType=UINT8, ComHandleId=9647, ComSystemTemplateSystemSignalRef=OBJ_VELOCITY_ERR_CRR_COEF_023
            OBJ_DIMENSION_WIDTH_ERR_023_oRDR_TRACKER_OBJ_023_oPCAN_RADAR_23594fca_Tx: ComBitPosition=23, ComBitSize=6, ComSignalType=UINT8, ComHandleId=9628, ComSystemTemplateSystemSignalRef=OBJ_DIMENSION_WIDTH_ERR_023
            OBJ_ACCEL_ERR_CRR_COEF_023_oRDR_TRACKER_OBJ_023_oPCAN_RADAR_4d1361c3_Tx: ComBitPosition=431, ComBitSize=8, ComSignalType=UINT8, ComHandleId=9611, ComSystemTemplateSystemSignalRef=OBJ_ACCEL_ERR_CRR_COEF_023
            OBJ_POS_ERR_CRR_COEF_023_oRDR_TRACKER_OBJ_023_oPCAN_RADAR_7218147e_Tx: ComBitPosition=415, ComBitSize=8, ComSignalType=UINT8, ComHandleId=9636, ComSystemTemplateSystemSignalRef=OBJ_POS_ERR_CRR_COEF_023
            OBJ_TRACK_MOTION_MODEL_023_oRDR_TRACKER_OBJ_023_oPCAN_RADAR_7ed7bebe_Tx: ComBitPosition=9, ComBitSize=2, ComSignalType=UINT8, ComHandleId=9645, ComSystemTemplateSystemSignalRef=OBJ_TRACK_MOTION_MODEL_023
            OBJ_ID_023_oRDR_TRACKER_OBJ_023_oPCAN_RADAR_b21b33b5_Tx: ComBitPosition=7, ComBitSize=8, ComSignalType=UINT8, ComHandleId=9631, ComSystemTemplateSystemSignalRef=OBJ_ID_023
            OBJ_VELOCITY_LAT_ERR_023_oRDR_TRACKER_OBJ_023_oPCAN_RADAR_e02edc44_Tx: ComBitPosition=151, ComBitSize=8, ComSignalType=UINT8, ComHandleId=9649, ComSystemTemplateSystemSignalRef=OBJ_VELOCITY_LAT_ERR_023
            OBJ_CLS_TYPE3_PROB_023_oRDR_TRACKER_OBJ_023_oPCAN_RADAR_84d416ce_Tx: ComBitPosition=319, ComBitSize=8, ComSignalType=UINT8, ComHandleId=9618, ComSystemTemplateSystemSignalRef=OBJ_CLS_TYPE3_PROB_023
            OBJ_MH_CYCLE_COUNTER_023_oRDR_TRACKER_OBJ_023_oPCAN_RADAR_c04dacd5_Tx: ComBitPosition=487, ComBitSize=8, ComSignalType=UINT8, ComHandleId=9634, ComSystemTemplateSystemSignalRef=OBJ_MH_CYCLE_COUNTER_023
            OBJ_MH_CRC16_023_oRDR_TRACKER_OBJ_023_oPCAN_RADAR_b1a9f634_Tx: ComBitPosition=495, ComBitSize=16, ComSignalType=UINT16, ComHandleId=9633, ComSystemTemplateSystemSignalRef=OBJ_MH_CRC16_023
        SG_TrackerObject020_oRDR_TRACKER_OBJ_020_oPCAN_RADAR_f9891b52_Tx: ComHandleId=129, ComSystemTemplateSignalGroupRef=SG_TrackerObject020
          49 x ComGroupSignal, all with ComSignalEndianness=BIG_ENDIAN, ComSignalInitValue=0, ComTransferProperty=PENDING, ComSignalAccess=ACCESS_NEEDED_BY_SWC_OR_COM:
            OBJ_ACCELERATION_LAT_020_oRDR_TRACKER_OBJ_020_oPCAN_RADAR_f7ad4025_Tx: ComBitPosition=177, ComBitSize=10, ComSignalType=UINT16, ComHandleId=9460, ComSystemTemplateSystemSignalRef=OBJ_ACCELERATION_LAT_020
            OBJ_DIMENSION_WIDTH_020_oRDR_TRACKER_OBJ_020_oPCAN_RADAR_13b717b6_Tx: ComBitPosition=17, ComBitSize=10, ComSignalType=UINT16, ComHandleId=9480, ComSystemTemplateSystemSignalRef=OBJ_DIMENSION_WIDTH_020
            OBJ_YAW_ANGLE_020_oRDR_TRACKER_OBJ_020_oPCAN_RADAR_e82477c1_Tx: ComBitPosition=155, ComBitSize=12, ComSignalType=UINT16, ComHandleId=9505, ComSystemTemplateSystemSignalRef=OBJ_YAW_ANGLE_020
            OBJ_CLS_TYPE5_020_oRDR_TRACKER_OBJ_020_oPCAN_RADAR_29574e14_Tx: ComBitPosition=287, ComBitSize=4, ComSignalType=UINT8, ComHandleId=9474, ComSystemTemplateSystemSignalRef=OBJ_CLS_TYPE5_020
            OBJ_REF_PT_LONG_OFFSET_020_oRDR_TRACKER_OBJ_020_oPCAN_RADAR_d85bbbd7_Tx: ComBitPosition=357, ComBitSize=14, ComSignalType=UINT16, ComHandleId=9496, ComSystemTemplateSystemSignalRef=OBJ_REF_PT_LONG_OFFSET_020
            OBJ_POS_LAT_ERR_020_oRDR_TRACKER_OBJ_020_oPCAN_RADAR_44b72691_Tx: ComBitPosition=103, ComBitSize=8, ComSignalType=UINT8, ComHandleId=9491, ComSystemTemplateSystemSignalRef=OBJ_POS_LAT_ERR_020
            OBJ_ACCELERATION_LAT_ERR_020_oRDR_TRACKER_OBJ_020_oPCAN_RADAR_22597a9b_Tx: ComBitPosition=223, ComBitSize=8, ComSignalType=UINT8, ComHandleId=9461, ComSystemTemplateSystemSignalRef=OBJ_ACCELERATION_LAT_ERR_020
            OBJ_CLS_TYPE1_PROB_020_oRDR_TRACKER_OBJ_020_oPCAN_RADAR_dabf64ac_Tx: ComBitPosition=303, ComBitSize=8, ComSignalType=UINT8, ComHandleId=9467, ComSystemTemplateSystemSignalRef=OBJ_CLS_TYPE1_PROB_020
            OBJ_VELOCITY_LAT_ERR_020_oRDR_TRACKER_OBJ_020_oPCAN_RADAR_306243d0_Tx: ComBitPosition=151, ComBitSize=8, ComSignalType=UINT8, ComHandleId=9502, ComSystemTemplateSystemSignalRef=OBJ_VELOCITY_LAT_ERR_020
            OBJ_DIMENSION_WIDTH_ERR_020_oRDR_TRACKER_OBJ_020_oPCAN_RADAR_f315d05e_Tx: ComBitPosition=23, ComBitSize=6, ComSignalType=UINT8, ComHandleId=9481, ComSystemTemplateSystemSignalRef=OBJ_DIMENSION_WIDTH_ERR_020
            OBJ_GROUP_ID_020_oRDR_TRACKER_OBJ_020_oPCAN_RADAR_91798726_Tx: ComBitPosition=405, ComBitSize=6, ComSignalType=UINT8, ComHandleId=9483, ComSystemTemplateSystemSignalRef=OBJ_GROUP_ID_020
            OBJ_CLS_TYPE3_020_oRDR_TRACKER_OBJ_020_oPCAN_RADAR_b2874eda_Tx: ComBitPosition=279, ComBitSize=4, ComSignalType=UINT8, ComHandleId=9470, ComSystemTemplateSystemSignalRef=OBJ_CLS_TYPE3_020
            OBJ_POS_LONG_ERR_020_oRDR_TRACKER_OBJ_020_oPCAN_RADAR_dd4fd873_Tx: ComBitPosition=95, ComBitSize=8, ComSignalType=UINT8, ComHandleId=9493, ComSystemTemplateSystemSignalRef=OBJ_POS_LONG_ERR_020
            OBJ_DIMENSION_LENGTH_ERR_020_oRDR_TRACKER_OBJ_020_oPCAN_RADAR_0b81ff61_Tx: ComBitPosition=41, ComBitSize=10, ComSignalType=UINT16, ComHandleId=9479, ComSystemTemplateSystemSignalRef=OBJ_DIMENSION_LENGTH_ERR_020
            OBJ_CLS_TYPE2_PROB_020_oRDR_TRACKER_OBJ_020_oPCAN_RADAR_138b7fa1_Tx: ComBitPosition=311, ComBitSize=8, ComSignalType=UINT8, ComHandleId=9469, ComSystemTemplateSystemSignalRef=OBJ_CLS_TYPE2_PROB_020
            OBJ_CLS_TYPE6_PROB_020_oRDR_TRACKER_OBJ_020_oPCAN_RADAR_d4b5a20c_Tx: ComBitPosition=343, ComBitSize=8, ComSignalType=UINT8, ComHandleId=9477, ComSystemTemplateSystemSignalRef=OBJ_CLS_TYPE6_PROB_020
            OBJ_YAW_RATE_ERR_020_oRDR_TRACKER_OBJ_020_oPCAN_RADAR_f273c55a_Tx: ComBitPosition=388, ComBitSize=5, ComSignalType=UINT8, ComHandleId=9508, ComSystemTemplateSystemSignalRef=OBJ_YAW_RATE_ERR_020
            OBJ_ACCEL_ERR_CRR_COEF_020_oRDR_TRACKER_OBJ_020_oPCAN_RADAR_9d5ffe57_Tx: ComBitPosition=431, ComBitSize=8, ComSignalType=UINT8, ComHandleId=9464, ComSystemTemplateSystemSignalRef=OBJ_ACCEL_ERR_CRR_COEF_020
            OBJ_MOVEMENT_STATUS_020_oRDR_TRACKER_OBJ_020_oPCAN_RADAR_322b4bd0_Tx: ComBitPosition=196, ComBitSize=3, ComSignalType=UINT8, ComHandleId=9488, ComSystemTemplateSystemSignalRef=OBJ_MOVEMENT_STATUS_020
            OBJ_CLS_TYPE3_PROB_020_oRDR_TRACKER_OBJ_020_oPCAN_RADAR_5498895a_Tx: ComBitPosition=319, ComBitSize=8, ComSignalType=UINT8, ComHandleId=9471, ComSystemTemplateSystemSignalRef=OBJ_CLS_TYPE3_PROB_020
            OBJ_CLS_TYPE4_PROB_020_oRDR_TRACKER_OBJ_020_oPCAN_RADAR_5a924ffa_Tx: ComBitPosition=327, ComBitSize=8, ComSignalType=UINT8, ComHandleId=9473, ComSystemTemplateSystemSignalRef=OBJ_CLS_TYPE4_PROB_020
            OBJ_ID_020_oRDR_TRACKER_OBJ_020_oPCAN_RADAR_6257ac21_Tx: ComBitPosition=7, ComBitSize=8, ComSignalType=UINT8, ComHandleId=9484, ComSystemTemplateSystemSignalRef=OBJ_ID_020
            OBJ_ACCELERATION_LONG_ERR_020_oRDR_TRACKER_OBJ_020_oPCAN_RADAR_3dfcdf31_Tx: ComBitPosition=215, ComBitSize=8, ComSignalType=UINT8, ComHandleId=9463, ComSystemTemplateSystemSignalRef=OBJ_ACCELERATION_LONG_ERR_020
            OBJ_CLS_TYPE1_020_oRDR_TRACKER_OBJ_020_oPCAN_RADAR_72e7b35f_Tx: ComBitPosition=271, ComBitSize=4, ComSignalType=UINT8, ComHandleId=9466, ComSystemTemplateSystemSignalRef=OBJ_CLS_TYPE1_020
            OBJ_VELOCITY_LAT_020_oRDR_TRACKER_OBJ_020_oPCAN_RADAR_04983381_Tx: ComBitPosition=126, ComBitSize=15, ComSignalType=UINT16, ComHandleId=9501, ComSystemTemplateSystemSignalRef=OBJ_VELOCITY_LAT_020
            OBJ_YAW_ANGLE_ERR_020_oRDR_TRACKER_OBJ_020_oPCAN_RADAR_3d297116_Tx: ComBitPosition=175, ComBitSize=7, ComSignalType=UINT8, ComHandleId=9506, ComSystemTemplateSystemSignalRef=OBJ_YAW_ANGLE_ERR_020
            OBJ_YAW_RATE_020_oRDR_TRACKER_OBJ_020_oPCAN_RADAR_cdab5286_Tx: ComBitPosition=399, ComBitSize=10, ComSignalType=UINT16, ComHandleId=9507, ComSystemTemplateSystemSignalRef=OBJ_YAW_RATE_020
            OBJ_ALIVE_TIME_020_oRDR_TRACKER_OBJ_020_oPCAN_RADAR_e53c5279_Tx: ComBitPosition=255, ComBitSize=16, ComSignalType=UINT16, ComHandleId=9465, ComSystemTemplateSystemSignalRef=OBJ_ALIVE_TIME_020
            OBJ_POS_ERR_CRR_COEF_020_oRDR_TRACKER_OBJ_020_oPCAN_RADAR_a2548bea_Tx: ComBitPosition=415, ComBitSize=8, ComSignalType=UINT8, ComHandleId=9489, ComSystemTemplateSystemSignalRef=OBJ_POS_ERR_CRR_COEF_020
            OBJ_CLS_TYPE4_020_oRDR_TRACKER_OBJ_020_oPCAN_RADAR_a4dfb3f6_Tx: ComBitPosition=275, ComBitSize=4, ComSignalType=UINT8, ComHandleId=9472, ComSystemTemplateSystemSignalRef=OBJ_CLS_TYPE4_020
            OBJ_TIMESTAMP_OFFSET_020_oRDR_TRACKER_OBJ_020_oPCAN_RADAR_629820f7_Tx: ComBitPosition=247, ComBitSize=8, ComSignalType=UINT8, ComHandleId=9497, ComSystemTemplateSystemSignalRef=OBJ_TIMESTAMP_OFFSET_020
            OBJ_DIMENSION_LENGTH_020_oRDR_TRACKER_OBJ_020_oPCAN_RADAR_3079e01b_Tx: ComBitPosition=37, ComBitSize=12, ComSignalType=UINT16, ComHandleId=9478, ComSystemTemplateSystemSignalRef=OBJ_DIMENSION_LENGTH_020
            OBJ_RCS_020_oRDR_TRACKER_OBJ_020_oPCAN_RADAR_623420a1_Tx: ComBitPosition=351, ComBitSize=7, ComSignalType=UINT8, ComHandleId=9494, ComSystemTemplateSystemSignalRef=OBJ_RCS_020
            OBJ_MEASUREMENT_STATUS_020_oRDR_TRACKER_OBJ_020_oPCAN_RADAR_1d85de9c_Tx: ComBitPosition=14, ComBitSize=3, ComSignalType=UINT8, ComHandleId=9485, ComSystemTemplateSystemSignalRef=OBJ_MEASUREMENT_STATUS_020
            OBJ_CLS_TYPE6_020_oRDR_TRACKER_OBJ_020_oPCAN_RADAR_64bf4e73_Tx: ComBitPosition=282, ComBitSize=4, ComSignalType=UINT8, ComHandleId=9476, ComSystemTemplateSystemSignalRef=OBJ_CLS_TYPE6_020
            OBJ_CLS_TYPE5_PROB_020_oRDR_TRACKER_OBJ_020_oPCAN_RADAR_1d81b901_Tx: ComBitPosition=335, ComBitSize=8, ComSignalType=UINT8, ComHandleId=9475, ComSystemTemplateSystemSignalRef=OBJ_CLS_TYPE5_PROB_020
            OBJ_TRACK_MOTION_MODEL_020_oRDR_TRACKER_OBJ_020_oPCAN_RADAR_ae9b212a_Tx: ComBitPosition=9, ComBitSize=2, ComSignalType=UINT8, ComHandleId=9498, ComSystemTemplateSystemSignalRef=OBJ_TRACK_MOTION_MODEL_020
            OBJ_VELOCITY_LONG_020_oRDR_TRACKER_OBJ_020_oPCAN_RADAR_54154b47_Tx: ComBitPosition=110, ComBitSize=15, ComSignalType=UINT16, ComHandleId=9503, ComSystemTemplateSystemSignalRef=OBJ_VELOCITY_LONG_020
            OBJ_ACCELERATION_LONG_020_oRDR_TRACKER_OBJ_020_oPCAN_RADAR_855d19c5_Tx: ComBitPosition=193, ComBitSize=10, ComSignalType=UINT16, ComHandleId=9462, ComSystemTemplateSystemSignalRef=OBJ_ACCELERATION_LONG_020
            OBJ_CLS_TYPE2_020_oRDR_TRACKER_OBJ_020_oPCAN_RADAR_3f0fb338_Tx: ComBitPosition=267, ComBitSize=4, ComSignalType=UINT8, ComHandleId=9468, ComSystemTemplateSystemSignalRef=OBJ_CLS_TYPE2_020
            OBJ_EXISTENCE_PROB_020_oRDR_TRACKER_OBJ_020_oPCAN_RADAR_180b938b_Tx: ComBitPosition=229, ComBitSize=14, ComSignalType=UINT16, ComHandleId=9482, ComSystemTemplateSystemSignalRef=OBJ_EXISTENCE_PROB_020
            OBJ_POS_LONG_020_oRDR_TRACKER_OBJ_020_oPCAN_RADAR_f15b9d69_Tx: ComBitPosition=63, ComBitSize=16, ComSignalType=UINT16, ComHandleId=9492, ComSystemTemplateSystemSignalRef=OBJ_POS_LONG_020
            OBJ_VEH_TRACK_FLAG_020_oRDR_TRACKER_OBJ_020_oPCAN_RADAR_2cb1d777_Tx: ComBitPosition=10, ComBitSize=1, ComSignalType=BOOLEAN, ComHandleId=9499, ComSystemTemplateSystemSignalRef=OBJ_VEH_TRACK_FLAG_020
            OBJ_VELOCITY_ERR_CRR_COEF_020_oRDR_TRACKER_OBJ_020_oPCAN_RADAR_0b2eb60b_Tx: ComBitPosition=423, ComBitSize=8, ComSignalType=UINT8, ComHandleId=9500, ComSystemTemplateSystemSignalRef=OBJ_VELOCITY_ERR_CRR_COEF_020
            OBJ_VELOCITY_LONG_ERR_020_oRDR_TRACKER_OBJ_020_oPCAN_RADAR_dce07c10_Tx: ComBitPosition=143, ComBitSize=8, ComSignalType=UINT8, ComHandleId=9504, ComSystemTemplateSystemSignalRef=OBJ_VELOCITY_LONG_ERR_020
            OBJ_POS_LAT_020_oRDR_TRACKER_OBJ_020_oPCAN_RADAR_40fb76a6_Tx: ComBitPosition=79, ComBitSize=16, ComSignalType=UINT16, ComHandleId=9490, ComSystemTemplateSystemSignalRef=OBJ_POS_LAT_020
            OBJ_REF_PT_LAT_OFFSET_020_oRDR_TRACKER_OBJ_020_oPCAN_RADAR_97094bd4_Tx: ComBitPosition=370, ComBitSize=14, ComSignalType=UINT16, ComHandleId=9495, ComSystemTemplateSystemSignalRef=OBJ_REF_PT_LAT_OFFSET_020
            OBJ_MH_CRC16_020_oRDR_TRACKER_OBJ_020_oPCAN_RADAR_61e569a0_Tx: ComBitPosition=495, ComBitSize=16, ComSignalType=UINT16, ComHandleId=9486, ComSystemTemplateSystemSignalRef=OBJ_MH_CRC16_020
            OBJ_MH_CYCLE_COUNTER_020_oRDR_TRACKER_OBJ_020_oPCAN_RADAR_10013341_Tx: ComBitPosition=487, ComBitSize=8, ComSignalType=UINT8, ComHandleId=9487, ComSystemTemplateSystemSignalRef=OBJ_MH_CYCLE_COUNTER_020
      4 x ComIPdu, all with ComIPduDirection=SEND, ComIPduType=NORMAL, ComIPduCancellationSupport=false, ComIPduSignalProcessing=DEFERRED, ComIPduChannelRef=CN_PCAN_RADAR_458ff0f1, ComIPduGroupRef=RDR01_oPCAN_RADAR_Tx_b6bdb067 if post-build-variant-condition{matching-criterion=RDR_POS, value=0}, ComIPduMainFunctionRef=ComMainFunctionTx_Event, ComIPduGroupRef=RDR02_oPCAN_RADAR_Tx_9f750495 if post-build-variant-condition{matching-criterion=RDR_POS, value=1}, ComIPduGroupRef=RDR03_oPCAN_RADAR_Tx_311d9504 if post-build-variant-condition{matching-criterion=RDR_POS, value=2}, ComIPduGroupRef=RDR04_oPCAN_RADAR_Tx_cce46d71 if post-build-variant-condition{matching-criterion=RDR_POS, value=3}, ComIPduGroupRef=RDR05_oPCAN_RADAR_Tx_628cfce0 if post-build-variant-condition{matching-criterion=RDR_POS, value=4}, ComIPduGroupRef=RDR06_oPCAN_RADAR_Tx_4b444812 if post-build-variant-condition{matching-criterion=RDR_POS, value=5}, ComIPduGroupRef=RDR07_oPCAN_RADAR_Tx_e52cd983 if post-build-variant-condition{matching-criterion=RDR_POS, value=6}, ComIPduGroupRef=RDR08_oPCAN_RADAR_Tx_6bc6beb9 if post-build-variant-condition{matching-criterion=RDR_POS, value=7}:
        RDR_DETECTION_373_376_oPCAN_RADAR_32ea69b8_Tx: ComIPduHandleId=99, ComIPduSignalGroupRef=SG_Detections_373_376_oRDR_DETECTION_373_376_oPCAN_RADAR_9d9c6a96_Tx, ComPduIdRef=RDR_DETECTION_373_376_oPCAN_RADAR_32ea69b8_Tx
          ComTxIPdu: ComMinimumDelayTime=0, ComTxIPduUnusedAreasDefault=0
            ComTxModeTrue
              ComTxMode: ComTxModeMode=DIRECT, ComTxModeNumberOfRepetitions=0
            ComTxModeFalse
              ComTxMode: ComTxModeMode=NONE
        RDR_DETECTION_337_340_oPCAN_RADAR_96ce6377_Tx: ComIPduHandleId=90, ComIPduSignalGroupRef=SG_Detections_337_340_oRDR_DETECTION_337_340_oPCAN_RADAR_6c24a51c_Tx, ComPduIdRef=RDR_DETECTION_337_340_oPCAN_RADAR_96ce6377_Tx
          ComTxIPdu: ComMinimumDelayTime=0, ComTxIPduUnusedAreasDefault=0
            ComTxModeTrue
              ComTxMode: ComTxModeMode=DIRECT, ComTxModeNumberOfRepetitions=0
            ComTxModeFalse
              ComTxMode: ComTxModeMode=NONE
        RDR_DETECTION_033_036_oPCAN_RADAR_92c5dd75_Tx: ComIPduHandleId=14, ComIPduSignalGroupRef=SG_Detections_033_036_oRDR_DETECTION_033_036_oPCAN_RADAR_308f4df6_Tx, ComPduIdRef=RDR_DETECTION_033_036_oPCAN_RADAR_92c5dd75_Tx
          ComTxIPdu: ComMinimumDelayTime=0, ComTxIPduUnusedAreasDefault=0
            ComTxModeTrue
              ComTxMode: ComTxModeMode=DIRECT, ComTxModeNumberOfRepetitions=0
            ComTxModeFalse
              ComTxMode: ComTxModeMode=NONE
        RDR_DETECTION_269_272_oPCAN_RADAR_41343126_Tx: ComIPduHandleId=73, ComIPduSignalGroupRef=SG_Detections_269_272_oRDR_DETECTION_269_272_oPCAN_RADAR_ed3f2002_Tx, ComPduIdRef=RDR_DETECTION_269_272_oPCAN_RADAR_41343126_Tx
          ComTxIPdu: ComMinimumDelayTime=0, ComTxIPduUnusedAreasDefault=0
            ComTxModeTrue
              ComTxMode: ComTxModeMode=DIRECT, ComTxModeNumberOfRepetitions=0
            ComTxModeFalse
              ComTxMode: ComTxModeMode=NONE
      SG_TrackerObject048_oRDR_TRACKER_OBJ_048_oPCAN_RADAR_68fc760b_Tx (ComSignalGroup):
        ComTransferProperty = TRIGGERED
        ComSignalGroupAccess = ACCESS_NEEDED_BY_SWC_OR_COM
        ComHandleId = 157
        ComSignalGroupArrayAccess = true
        ComSystemTemplateSignalGroupRef = SG_TrackerObject048
        49 x ComGroupSignal, all with ComSignalEndianness=BIG_ENDIAN, ComSignalInitValue=0, ComTransferProperty=PENDING, ComSignalAccess=ACCESS_NEEDED_BY_SWC_OR_COM:
          OBJ_VELOCITY_LONG_ERR_048_oRDR_TRACKER_OBJ_048_oPCAN_RADAR_4d951149_Tx: ComBitPosition=143, ComBitSize=8, ComSignalType=UINT8, ComHandleId=10876, ComSystemTemplateSystemSignalRef=OBJ_VELOCITY_LONG_ERR_048
          OBJ_YAW_ANGLE_ERR_048_oRDR_TRACKER_OBJ_048_oPCAN_RADAR_ac5c1c4f_Tx: ComBitPosition=175, ComBitSize=7, ComSignalType=UINT8, ComHandleId=10878, ComSystemTemplateSystemSignalRef=OBJ_YAW_ANGLE_ERR_048
          OBJ_VELOCITY_LONG_048_oRDR_TRACKER_OBJ_048_oPCAN_RADAR_c560261e_Tx: ComBitPosition=110, ComBitSize=15, ComSignalType=UINT16, ComHandleId=10875, ComSystemTemplateSystemSignalRef=OBJ_VELOCITY_LONG_048
          OBJ_CLS_TYPE4_PROB_048_oRDR_TRACKER_OBJ_048_oPCAN_RADAR_cbe722a3_Tx: ComBitPosition=327, ComBitSize=8, ComSignalType=UINT8, ComHandleId=10845, ComSystemTemplateSystemSignalRef=OBJ_CLS_TYPE4_PROB_048
          OBJ_CLS_TYPE4_048_oRDR_TRACKER_OBJ_048_oPCAN_RADAR_35aadeaf_Tx: ComBitPosition=275, ComBitSize=4, ComSignalType=UINT8, ComHandleId=10844, ComSystemTemplateSystemSignalRef=OBJ_CLS_TYPE4_048
          OBJ_ID_048_oRDR_TRACKER_OBJ_048_oPCAN_RADAR_f322c178_Tx: ComBitPosition=7, ComBitSize=8, ComSignalType=UINT8, ComHandleId=10856, ComSystemTemplateSystemSignalRef=OBJ_ID_048
          OBJ_MOVEMENT_STATUS_048_oRDR_TRACKER_OBJ_048_oPCAN_RADAR_a35e2689_Tx: ComBitPosition=196, ComBitSize=3, ComSignalType=UINT8, ComHandleId=10860, ComSystemTemplateSystemSignalRef=OBJ_MOVEMENT_STATUS_048
          OBJ_YAW_RATE_048_oRDR_TRACKER_OBJ_048_oPCAN_RADAR_5cde3fdf_Tx: ComBitPosition=399, ComBitSize=10, ComSignalType=UINT16, ComHandleId=10879, ComSystemTemplateSystemSignalRef=OBJ_YAW_RATE_048
          OBJ_MEASUREMENT_STATUS_048_oRDR_TRACKER_OBJ_048_oPCAN_RADAR_8cf0b3c5_Tx: ComBitPosition=14, ComBitSize=3, ComSignalType=UINT8, ComHandleId=10857, ComSystemTemplateSystemSignalRef=OBJ_MEASUREMENT_STATUS_048
          OBJ_REF_PT_LAT_OFFSET_048_oRDR_TRACKER_OBJ_048_oPCAN_RADAR_067c268d_Tx: ComBitPosition=370, ComBitSize=14, ComSignalType=UINT16, ComHandleId=10867, ComSystemTemplateSystemSignalRef=OBJ_REF_PT_LAT_OFFSET_048
          OBJ_EXISTENCE_PROB_048_oRDR_TRACKER_OBJ_048_oPCAN_RADAR_897efed2_Tx: ComBitPosition=229, ComBitSize=14, ComSignalType=UINT16, ComHandleId=10854, ComSystemTemplateSystemSignalRef=OBJ_EXISTENCE_PROB_048
          OBJ_ACCELERATION_LAT_ERR_048_oRDR_TRACKER_OBJ_048_oPCAN_RADAR_b32c17c2_Tx: ComBitPosition=223, ComBitSize=8, ComSignalType=UINT8, ComHandleId=10833, ComSystemTemplateSystemSignalRef=OBJ_ACCELERATION_LAT_ERR_048
          OBJ_CLS_TYPE2_PROB_048_oRDR_TRACKER_OBJ_048_oPCAN_RADAR_82fe12f8_Tx: ComBitPosition=311, ComBitSize=8, ComSignalType=UINT8, ComHandleId=10841, ComSystemTemplateSystemSignalRef=OBJ_CLS_TYPE2_PROB_048
          OBJ_VELOCITY_LAT_ERR_048_oRDR_TRACKER_OBJ_048_oPCAN_RADAR_a1172e89_Tx: ComBitPosition=151, ComBitSize=8, ComSignalType=UINT8, ComHandleId=10874, ComSystemTemplateSystemSignalRef=OBJ_VELOCITY_LAT_ERR_048
          OBJ_CLS_TYPE5_PROB_048_oRDR_TRACKER_OBJ_048_oPCAN_RADAR_8cf4d458_Tx: ComBitPosition=335, ComBitSize=8, ComSignalType=UINT8, ComHandleId=10847, ComSystemTemplateSystemSignalRef=OBJ_CLS_TYPE5_PROB_048
          OBJ_CLS_TYPE2_048_oRDR_TRACKER_OBJ_048_oPCAN_RADAR_ae7ade61_Tx: ComBitPosition=267, ComBitSize=4, ComSignalType=UINT8, ComHandleId=10840, ComSystemTemplateSystemSignalRef=OBJ_CLS_TYPE2_048
          OBJ_DIMENSION_LENGTH_048_oRDR_TRACKER_OBJ_048_oPCAN_RADAR_a10c8d42_Tx: ComBitPosition=37, ComBitSize=12, ComSignalType=UINT16, ComHandleId=10850, ComSystemTemplateSystemSignalRef=OBJ_DIMENSION_LENGTH_048
          OBJ_RCS_048_oRDR_TRACKER_OBJ_048_oPCAN_RADAR_f3414df8_Tx: ComBitPosition=351, ComBitSize=7, ComSignalType=UINT8, ComHandleId=10866, ComSystemTemplateSystemSignalRef=OBJ_RCS_048
          OBJ_TIMESTAMP_OFFSET_048_oRDR_TRACKER_OBJ_048_oPCAN_RADAR_f3ed4dae_Tx: ComBitPosition=247, ComBitSize=8, ComSignalType=UINT8, ComHandleId=10869, ComSystemTemplateSystemSignalRef=OBJ_TIMESTAMP_OFFSET_048
          OBJ_CLS_TYPE1_048_oRDR_TRACKER_OBJ_048_oPCAN_RADAR_e392de06_Tx: ComBitPosition=271, ComBitSize=4, ComSignalType=UINT8, ComHandleId=10838, ComSystemTemplateSystemSignalRef=OBJ_CLS_TYPE1_048
          OBJ_ACCEL_ERR_CRR_COEF_048_oRDR_TRACKER_OBJ_048_oPCAN_RADAR_0c2a930e_Tx: ComBitPosition=431, ComBitSize=8, ComSignalType=UINT8, ComHandleId=10836, ComSystemTemplateSystemSignalRef=OBJ_ACCEL_ERR_CRR_COEF_048
          OBJ_VELOCITY_LAT_048_oRDR_TRACKER_OBJ_048_oPCAN_RADAR_95ed5ed8_Tx: ComBitPosition=126, ComBitSize=15, ComSignalType=UINT16, ComHandleId=10873, ComSystemTemplateSystemSignalRef=OBJ_VELOCITY_LAT_048
          OBJ_CLS_TYPE6_PROB_048_oRDR_TRACKER_OBJ_048_oPCAN_RADAR_45c0cf55_Tx: ComBitPosition=343, ComBitSize=8, ComSignalType=UINT8, ComHandleId=10849, ComSystemTemplateSystemSignalRef=OBJ_CLS_TYPE6_PROB_048
          OBJ_DIMENSION_WIDTH_ERR_048_oRDR_TRACKER_OBJ_048_oPCAN_RADAR_6260bd07_Tx: ComBitPosition=23, ComBitSize=6, ComSignalType=UINT8, ComHandleId=10853, ComSystemTemplateSystemSignalRef=OBJ_DIMENSION_WIDTH_ERR_048
          OBJ_POS_LAT_048_oRDR_TRACKER_OBJ_048_oPCAN_RADAR_d18e1bff_Tx: ComBitPosition=79, ComBitSize=16, ComSignalType=UINT16, ComHandleId=10862, ComSystemTemplateSystemSignalRef=OBJ_POS_LAT_048
          OBJ_YAW_ANGLE_048_oRDR_TRACKER_OBJ_048_oPCAN_RADAR_79511a98_Tx: ComBitPosition=155, ComBitSize=12, ComSignalType=UINT16, ComHandleId=10877, ComSystemTemplateSystemSignalRef=OBJ_YAW_ANGLE_048
          OBJ_ALIVE_TIME_048_oRDR_TRACKER_OBJ_048_oPCAN_RADAR_74493f20_Tx: ComBitPosition=255, ComBitSize=16, ComSignalType=UINT16, ComHandleId=10837, ComSystemTemplateSystemSignalRef=OBJ_ALIVE_TIME_048
          OBJ_ACCELERATION_LAT_048_oRDR_TRACKER_OBJ_048_oPCAN_RADAR_66d82d7c_Tx: ComBitPosition=177, ComBitSize=10, ComSignalType=UINT16, ComHandleId=10832, ComSystemTemplateSystemSignalRef=OBJ_ACCELERATION_LAT_048
          OBJ_YAW_RATE_ERR_048_oRDR_TRACKER_OBJ_048_oPCAN_RADAR_6306a803_Tx: ComBitPosition=388, ComBitSize=5, ComSignalType=UINT8, ComHandleId=10880, ComSystemTemplateSystemSignalRef=OBJ_YAW_RATE_ERR_048
          OBJ_ACCELERATION_LONG_ERR_048_oRDR_TRACKER_OBJ_048_oPCAN_RADAR_ac89b268_Tx: ComBitPosition=215, ComBitSize=8, ComSignalType=UINT8, ComHandleId=10835, ComSystemTemplateSystemSignalRef=OBJ_ACCELERATION_LONG_ERR_048
          OBJ_CLS_TYPE1_PROB_048_oRDR_TRACKER_OBJ_048_oPCAN_RADAR_4bca09f5_Tx: ComBitPosition=303, ComBitSize=8, ComSignalType=UINT8, ComHandleId=10839, ComSystemTemplateSystemSignalRef=OBJ_CLS_TYPE1_PROB_048
          OBJ_POS_LONG_048_oRDR_TRACKER_OBJ_048_oPCAN_RADAR_602ef030_Tx: ComBitPosition=63, ComBitSize=16, ComSignalType=UINT16, ComHandleId=10864, ComSystemTemplateSystemSignalRef=OBJ_POS_LONG_048
          OBJ_POS_LONG_ERR_048_oRDR_TRACKER_OBJ_048_oPCAN_RADAR_4c3ab52a_Tx: ComBitPosition=95, ComBitSize=8, ComSignalType=UINT8, ComHandleId=10865, ComSystemTemplateSystemSignalRef=OBJ_POS_LONG_ERR_048
          OBJ_CLS_TYPE3_048_oRDR_TRACKER_OBJ_048_oPCAN_RADAR_23f22383_Tx: ComBitPosition=279, ComBitSize=4, ComSignalType=UINT8, ComHandleId=10842, ComSystemTemplateSystemSignalRef=OBJ_CLS_TYPE3_048
          OBJ_DIMENSION_LENGTH_ERR_048_oRDR_TRACKER_OBJ_048_oPCAN_RADAR_9af49238_Tx: ComBitPosition=41, ComBitSize=10, ComSignalType=UINT16, ComHandleId=10851, ComSystemTemplateSystemSignalRef=OBJ_DIMENSION_LENGTH_ERR_048
          OBJ_ACCELERATION_LONG_048_oRDR_TRACKER_OBJ_048_oPCAN_RADAR_1428749c_Tx: ComBitPosition=193, ComBitSize=10, ComSignalType=UINT16, ComHandleId=10834, ComSystemTemplateSystemSignalRef=OBJ_ACCELERATION_LONG_048
          OBJ_CLS_TYPE5_048_oRDR_TRACKER_OBJ_048_oPCAN_RADAR_b822234d_Tx: ComBitPosition=287, ComBitSize=4, ComSignalType=UINT8, ComHandleId=10846, ComSystemTemplateSystemSignalRef=OBJ_CLS_TYPE5_048
          OBJ_POS_ERR_CRR_COEF_048_oRDR_TRACKER_OBJ_048_oPCAN_RADAR_3321e6b3_Tx: ComBitPosition=415, ComBitSize=8, ComSignalType=UINT8, ComHandleId=10861, ComSystemTemplateSystemSignalRef=OBJ_POS_ERR_CRR_COEF_048
          OBJ_REF_PT_LONG_OFFSET_048_oRDR_TRACKER_OBJ_048_oPCAN_RADAR_492ed68e_Tx: ComBitPosition=357, ComBitSize=14, ComSignalType=UINT16, ComHandleId=10868, ComSystemTemplateSystemSignalRef=OBJ_REF_PT_LONG_OFFSET_048
          OBJ_VELOCITY_ERR_CRR_COEF_048_oRDR_TRACKER_OBJ_048_oPCAN_RADAR_9a5bdb52_Tx: ComBitPosition=423, ComBitSize=8, ComSignalType=UINT8, ComHandleId=10872, ComSystemTemplateSystemSignalRef=OBJ_VELOCITY_ERR_CRR_COEF_048
          OBJ_POS_LAT_ERR_048_oRDR_TRACKER_OBJ_048_oPCAN_RADAR_d5c24bc8_Tx: ComBitPosition=103, ComBitSize=8, ComSignalType=UINT8, ComHandleId=10863, ComSystemTemplateSystemSignalRef=OBJ_POS_LAT_ERR_048
          OBJ_VEH_TRACK_FLAG_048_oRDR_TRACKER_OBJ_048_oPCAN_RADAR_bdc4ba2e_Tx: ComBitPosition=10, ComBitSize=1, ComSignalType=BOOLEAN, ComHandleId=10871, ComSystemTemplateSystemSignalRef=OBJ_VEH_TRACK_FLAG_048
          OBJ_CLS_TYPE3_PROB_048_oRDR_TRACKER_OBJ_048_oPCAN_RADAR_c5ede403_Tx: ComBitPosition=319, ComBitSize=8, ComSignalType=UINT8, ComHandleId=10843, ComSystemTemplateSystemSignalRef=OBJ_CLS_TYPE3_PROB_048
          OBJ_CLS_TYPE6_048_oRDR_TRACKER_OBJ_048_oPCAN_RADAR_f5ca232a_Tx: ComBitPosition=282, ComBitSize=4, ComSignalType=UINT8, ComHandleId=10848, ComSystemTemplateSystemSignalRef=OBJ_CLS_TYPE6_048
          OBJ_GROUP_ID_048_oRDR_TRACKER_OBJ_048_oPCAN_RADAR_000cea7f_Tx: ComBitPosition=405, ComBitSize=6, ComSignalType=UINT8, ComHandleId=10855, ComSystemTemplateSystemSignalRef=OBJ_GROUP_ID_048
          OBJ_DIMENSION_WIDTH_048_oRDR_TRACKER_OBJ_048_oPCAN_RADAR_82c27aef_Tx: ComBitPosition=17, ComBitSize=10, ComSignalType=UINT16, ComHandleId=10852, ComSystemTemplateSystemSignalRef=OBJ_DIMENSION_WIDTH_048
          OBJ_TRACK_MOTION_MODEL_048_oRDR_TRACKER_OBJ_048_oPCAN_RADAR_3fee4c73_Tx: ComBitPosition=9, ComBitSize=2, ComSignalType=UINT8, ComHandleId=10870, ComSystemTemplateSystemSignalRef=OBJ_TRACK_MOTION_MODEL_048
          OBJ_MH_CRC16_048_oRDR_TRACKER_OBJ_048_oPCAN_RADAR_f09004f9_Tx: ComBitPosition=495, ComBitSize=16, ComSignalType=UINT16, ComHandleId=10858, ComSystemTemplateSystemSignalRef=OBJ_MH_CRC16_048
          OBJ_MH_CYCLE_COUNTER_048_oRDR_TRACKER_OBJ_048_oPCAN_RADAR_81745e18_Tx: ComBitPosition=487, ComBitSize=8, ComSignalType=UINT8, ComHandleId=10859, ComSystemTemplateSystemSignalRef=OBJ_MH_CYCLE_COUNTER_048
      3 x ComIPdu, all with ComIPduDirection=SEND, ComIPduType=NORMAL, ComIPduCancellationSupport=false, ComIPduSignalProcessing=DEFERRED, ComIPduChannelRef=CN_PCAN_RADAR_458ff0f1, ComIPduGroupRef=RDR01_oPCAN_RADAR_Tx_b6bdb067 if post-build-variant-condition{matching-criterion=RDR_POS, value=0}, ComIPduMainFunctionRef=ComMainFunctionTx_Event, ComIPduGroupRef=RDR02_oPCAN_RADAR_Tx_9f750495 if post-build-variant-condition{matching-criterion=RDR_POS, value=1}, ComIPduGroupRef=RDR03_oPCAN_RADAR_Tx_311d9504 if post-build-variant-condition{matching-criterion=RDR_POS, value=2}, ComIPduGroupRef=RDR04_oPCAN_RADAR_Tx_cce46d71 if post-build-variant-condition{matching-criterion=RDR_POS, value=3}, ComIPduGroupRef=RDR05_oPCAN_RADAR_Tx_628cfce0 if post-build-variant-condition{matching-criterion=RDR_POS, value=4}, ComIPduGroupRef=RDR06_oPCAN_RADAR_Tx_4b444812 if post-build-variant-condition{matching-criterion=RDR_POS, value=5}, ComIPduGroupRef=RDR07_oPCAN_RADAR_Tx_e52cd983 if post-build-variant-condition{matching-criterion=RDR_POS, value=6}, ComIPduGroupRef=RDR08_oPCAN_RADAR_Tx_6bc6beb9 if post-build-variant-condition{matching-criterion=RDR_POS, value=7}:
        RDR_DETECTION_237_240_oPCAN_RADAR_f8d738c7_Tx: ComIPduHandleId=65, ComIPduSignalGroupRef=SG_Detections_237_240_oRDR_DETECTION_237_240_oPCAN_RADAR_2e8c87a0_Tx, ComPduIdRef=RDR_DETECTION_237_240_oPCAN_RADAR_f8d738c7_Tx
          ComTxIPdu: ComMinimumDelayTime=0, ComTxIPduUnusedAreasDefault=0
            ComTxModeTrue
              ComTxMode: ComTxModeMode=DIRECT, ComTxModeNumberOfRepetitions=0
            ComTxModeFalse
              ComTxMode: ComTxModeMode=NONE
        RDR_TRACKER_OBJ_006_oPCAN_RADAR_53f4fd0e_Tx: ComIPduHandleId=116, ComIPduSignalGroupRef=SG_TrackerObject006_oRDR_TRACKER_OBJ_006_oPCAN_RADAR_2742cf47_Tx, ComPduIdRef=RDR_TRACKER_OBJ_006_oPCAN_RADAR_53f4fd0e_Tx
          ComTxIPdu: ComMinimumDelayTime=0, ComTxIPduUnusedAreasDefault=0
            ComTxModeTrue
              ComTxMode: ComTxModeMode=DIRECT, ComTxModeNumberOfRepetitions=0
            ComTxModeFalse
              ComTxMode: ComTxModeMode=NONE
        RDR_TRACKER_OBJ_033_oPCAN_RADAR_32ba6bc6_Tx: ComIPduHandleId=143, ComIPduSignalGroupRef=SG_TrackerObject033_oRDR_TRACKER_OBJ_033_oPCAN_RADAR_7b547278_Tx, ComPduIdRef=RDR_TRACKER_OBJ_033_oPCAN_RADAR_32ba6bc6_Tx
          ComTxIPdu: ComMinimumDelayTime=0, ComTxIPduUnusedAreasDefault=0
            ComTxModeTrue
              ComTxMode: ComTxModeMode=DIRECT, ComTxModeNumberOfRepetitions=0
            ComTxModeFalse
              ComTxMode: ComTxModeMode=NONE
      SG_TrackerObject047_oRDR_TRACKER_OBJ_047_oPCAN_RADAR_4f609b4d_Tx (ComSignalGroup):
        ComTransferProperty = TRIGGERED
        ComSignalGroupAccess = ACCESS_NEEDED_BY_SWC_OR_COM
        ComHandleId = 156
        ComSignalGroupArrayAccess = true
        ComSystemTemplateSignalGroupRef = SG_TrackerObject047
        49 x ComGroupSignal, all with ComSignalEndianness=BIG_ENDIAN, ComSignalInitValue=0, ComTransferProperty=PENDING, ComSignalAccess=ACCESS_NEEDED_BY_SWC_OR_COM:
          OBJ_TRACK_MOTION_MODEL_047_oRDR_TRACKER_OBJ_047_oPCAN_RADAR_1872a135_Tx: ComBitPosition=9, ComBitSize=2, ComSignalType=UINT8, ComHandleId=10821, ComSystemTemplateSystemSignalRef=OBJ_TRACK_MOTION_MODEL_047
          OBJ_POS_ERR_CRR_COEF_047_oRDR_TRACKER_OBJ_047_oPCAN_RADAR_14bd0bf5_Tx: ComBitPosition=415, ComBitSize=8, ComSignalType=UINT8, ComHandleId=10812, ComSystemTemplateSystemSignalRef=OBJ_POS_ERR_CRR_COEF_047
          OBJ_VELOCITY_LAT_ERR_047_oRDR_TRACKER_OBJ_047_oPCAN_RADAR_868bc3cf_Tx: ComBitPosition=151, ComBitSize=8, ComSignalType=UINT8, ComHandleId=10825, ComSystemTemplateSystemSignalRef=OBJ_VELOCITY_LAT_ERR_047
          OBJ_CLS_TYPE2_047_oRDR_TRACKER_OBJ_047_oPCAN_RADAR_89e63327_Tx: ComBitPosition=267, ComBitSize=4, ComSignalType=UINT8, ComHandleId=10791, ComSystemTemplateSystemSignalRef=OBJ_CLS_TYPE2_047
          OBJ_CLS_TYPE2_PROB_047_oRDR_TRACKER_OBJ_047_oPCAN_RADAR_a562ffbe_Tx: ComBitPosition=311, ComBitSize=8, ComSignalType=UINT8, ComHandleId=10792, ComSystemTemplateSystemSignalRef=OBJ_CLS_TYPE2_PROB_047
          OBJ_ID_047_oRDR_TRACKER_OBJ_047_oPCAN_RADAR_d4be2c3e_Tx: ComBitPosition=7, ComBitSize=8, ComSignalType=UINT8, ComHandleId=10807, ComSystemTemplateSystemSignalRef=OBJ_ID_047
          OBJ_ACCELERATION_LAT_047_oRDR_TRACKER_OBJ_047_oPCAN_RADAR_4144c03a_Tx: ComBitPosition=177, ComBitSize=10, ComSignalType=UINT16, ComHandleId=10783, ComSystemTemplateSystemSignalRef=OBJ_ACCELERATION_LAT_047
          OBJ_VELOCITY_LAT_047_oRDR_TRACKER_OBJ_047_oPCAN_RADAR_b271b39e_Tx: ComBitPosition=126, ComBitSize=15, ComSignalType=UINT16, ComHandleId=10824, ComSystemTemplateSystemSignalRef=OBJ_VELOCITY_LAT_047
          OBJ_DIMENSION_LENGTH_ERR_047_oRDR_TRACKER_OBJ_047_oPCAN_RADAR_bd687f7e_Tx: ComBitPosition=41, ComBitSize=10, ComSignalType=UINT16, ComHandleId=10802, ComSystemTemplateSystemSignalRef=OBJ_DIMENSION_LENGTH_ERR_047
          OBJ_VELOCITY_LONG_ERR_047_oRDR_TRACKER_OBJ_047_oPCAN_RADAR_6a09fc0f_Tx: ComBitPosition=143, ComBitSize=8, ComSignalType=UINT8, ComHandleId=10827, ComSystemTemplateSystemSignalRef=OBJ_VELOCITY_LONG_ERR_047
          OBJ_CLS_TYPE5_PROB_047_oRDR_TRACKER_OBJ_047_oPCAN_RADAR_ab68391e_Tx: ComBitPosition=335, ComBitSize=8, ComSignalType=UINT8, ComHandleId=10798, ComSystemTemplateSystemSignalRef=OBJ_CLS_TYPE5_PROB_047
          OBJ_CLS_TYPE4_PROB_047_oRDR_TRACKER_OBJ_047_oPCAN_RADAR_ec7bcfe5_Tx: ComBitPosition=327, ComBitSize=8, ComSignalType=UINT8, ComHandleId=10796, ComSystemTemplateSystemSignalRef=OBJ_CLS_TYPE4_PROB_047
          OBJ_CLS_TYPE6_047_oRDR_TRACKER_OBJ_047_oPCAN_RADAR_d256ce6c_Tx: ComBitPosition=282, ComBitSize=4, ComSignalType=UINT8, ComHandleId=10799, ComSystemTemplateSystemSignalRef=OBJ_CLS_TYPE6_047
          OBJ_POS_LAT_047_oRDR_TRACKER_OBJ_047_oPCAN_RADAR_f612f6b9_Tx: ComBitPosition=79, ComBitSize=16, ComSignalType=UINT16, ComHandleId=10813, ComSystemTemplateSystemSignalRef=OBJ_POS_LAT_047
          OBJ_POS_LAT_ERR_047_oRDR_TRACKER_OBJ_047_oPCAN_RADAR_f25ea68e_Tx: ComBitPosition=103, ComBitSize=8, ComSignalType=UINT8, ComHandleId=10814, ComSystemTemplateSystemSignalRef=OBJ_POS_LAT_ERR_047
          OBJ_POS_LONG_047_oRDR_TRACKER_OBJ_047_oPCAN_RADAR_47b21d76_Tx: ComBitPosition=63, ComBitSize=16, ComSignalType=UINT16, ComHandleId=10815, ComSystemTemplateSystemSignalRef=OBJ_POS_LONG_047
          OBJ_ACCELERATION_LONG_047_oRDR_TRACKER_OBJ_047_oPCAN_RADAR_33b499da_Tx: ComBitPosition=193, ComBitSize=10, ComSignalType=UINT16, ComHandleId=10785, ComSystemTemplateSystemSignalRef=OBJ_ACCELERATION_LONG_047
          OBJ_DIMENSION_LENGTH_047_oRDR_TRACKER_OBJ_047_oPCAN_RADAR_86906004_Tx: ComBitPosition=37, ComBitSize=12, ComSignalType=UINT16, ComHandleId=10801, ComSystemTemplateSystemSignalRef=OBJ_DIMENSION_LENGTH_047
          OBJ_CLS_TYPE1_047_oRDR_TRACKER_OBJ_047_oPCAN_RADAR_c40e3340_Tx: ComBitPosition=271, ComBitSize=4, ComSignalType=UINT8, ComHandleId=10789, ComSystemTemplateSystemSignalRef=OBJ_CLS_TYPE1_047
          OBJ_VELOCITY_LONG_047_oRDR_TRACKER_OBJ_047_oPCAN_RADAR_e2fccb58_Tx: ComBitPosition=110, ComBitSize=15, ComSignalType=UINT16, ComHandleId=10826, ComSystemTemplateSystemSignalRef=OBJ_VELOCITY_LONG_047
          OBJ_GROUP_ID_047_oRDR_TRACKER_OBJ_047_oPCAN_RADAR_27900739_Tx: ComBitPosition=405, ComBitSize=6, ComSignalType=UINT8, ComHandleId=10806, ComSystemTemplateSystemSignalRef=OBJ_GROUP_ID_047
          OBJ_YAW_RATE_ERR_047_oRDR_TRACKER_OBJ_047_oPCAN_RADAR_449a4545_Tx: ComBitPosition=388, ComBitSize=5, ComSignalType=UINT8, ComHandleId=10831, ComSystemTemplateSystemSignalRef=OBJ_YAW_RATE_ERR_047
          OBJ_REF_PT_LONG_OFFSET_047_oRDR_TRACKER_OBJ_047_oPCAN_RADAR_6eb23bc8_Tx: ComBitPosition=357, ComBitSize=14, ComSignalType=UINT16, ComHandleId=10819, ComSystemTemplateSystemSignalRef=OBJ_REF_PT_LONG_OFFSET_047
          OBJ_YAW_ANGLE_047_oRDR_TRACKER_OBJ_047_oPCAN_RADAR_5ecdf7de_Tx: ComBitPosition=155, ComBitSize=12, ComSignalType=UINT16, ComHandleId=10828, ComSystemTemplateSystemSignalRef=OBJ_YAW_ANGLE_047
          OBJ_YAW_ANGLE_ERR_047_oRDR_TRACKER_OBJ_047_oPCAN_RADAR_8bc0f109_Tx: ComBitPosition=175, ComBitSize=7, ComSignalType=UINT8, ComHandleId=10829, ComSystemTemplateSystemSignalRef=OBJ_YAW_ANGLE_ERR_047
          OBJ_CLS_TYPE4_047_oRDR_TRACKER_OBJ_047_oPCAN_RADAR_123633e9_Tx: ComBitPosition=275, ComBitSize=4, ComSignalType=UINT8, ComHandleId=10795, ComSystemTemplateSystemSignalRef=OBJ_CLS_TYPE4_047
          OBJ_CLS_TYPE1_PROB_047_oRDR_TRACKER_OBJ_047_oPCAN_RADAR_6c56e4b3_Tx: ComBitPosition=303, ComBitSize=8, ComSignalType=UINT8, ComHandleId=10790, ComSystemTemplateSystemSignalRef=OBJ_CLS_TYPE1_PROB_047
          OBJ_POS_LONG_ERR_047_oRDR_TRACKER_OBJ_047_oPCAN_RADAR_6ba6586c_Tx: ComBitPosition=95, ComBitSize=8, ComSignalType=UINT8, ComHandleId=10816, ComSystemTemplateSystemSignalRef=OBJ_POS_LONG_ERR_047
          OBJ_MOVEMENT_STATUS_047_oRDR_TRACKER_OBJ_047_oPCAN_RADAR_84c2cbcf_Tx: ComBitPosition=196, ComBitSize=3, ComSignalType=UINT8, ComHandleId=10811, ComSystemTemplateSystemSignalRef=OBJ_MOVEMENT_STATUS_047
          OBJ_ALIVE_TIME_047_oRDR_TRACKER_OBJ_047_oPCAN_RADAR_53d5d266_Tx: ComBitPosition=255, ComBitSize=16, ComSignalType=UINT16, ComHandleId=10788, ComSystemTemplateSystemSignalRef=OBJ_ALIVE_TIME_047
          OBJ_CLS_TYPE3_047_oRDR_TRACKER_OBJ_047_oPCAN_RADAR_046ecec5_Tx: ComBitPosition=279, ComBitSize=4, ComSignalType=UINT8, ComHandleId=10793, ComSystemTemplateSystemSignalRef=OBJ_CLS_TYPE3_047
          OBJ_CLS_TYPE6_PROB_047_oRDR_TRACKER_OBJ_047_oPCAN_RADAR_625c2213_Tx: ComBitPosition=343, ComBitSize=8, ComSignalType=UINT8, ComHandleId=10800, ComSystemTemplateSystemSignalRef=OBJ_CLS_TYPE6_PROB_047
          OBJ_DIMENSION_WIDTH_047_oRDR_TRACKER_OBJ_047_oPCAN_RADAR_a55e97a9_Tx: ComBitPosition=17, ComBitSize=10, ComSignalType=UINT16, ComHandleId=10803, ComSystemTemplateSystemSignalRef=OBJ_DIMENSION_WIDTH_047
          OBJ_CLS_TYPE5_047_oRDR_TRACKER_OBJ_047_oPCAN_RADAR_9fbece0b_Tx: ComBitPosition=287, ComBitSize=4, ComSignalType=UINT8, ComHandleId=10797, ComSystemTemplateSystemSignalRef=OBJ_CLS_TYPE5_047
          OBJ_EXISTENCE_PROB_047_oRDR_TRACKER_OBJ_047_oPCAN_RADAR_aee21394_Tx: ComBitPosition=229, ComBitSize=14, ComSignalType=UINT16, ComHandleId=10805, ComSystemTemplateSystemSignalRef=OBJ_EXISTENCE_PROB_047
          OBJ_REF_PT_LAT_OFFSET_047_oRDR_TRACKER_OBJ_047_oPCAN_RADAR_21e0cbcb_Tx: ComBitPosition=370, ComBitSize=14, ComSignalType=UINT16, ComHandleId=10818, ComSystemTemplateSystemSignalRef=OBJ_REF_PT_LAT_OFFSET_047
          OBJ_TIMESTAMP_OFFSET_047_oRDR_TRACKER_OBJ_047_oPCAN_RADAR_d471a0e8_Tx: ComBitPosition=247, ComBitSize=8, ComSignalType=UINT8, ComHandleId=10820, ComSystemTemplateSystemSignalRef=OBJ_TIMESTAMP_OFFSET_047
          OBJ_YAW_RATE_047_oRDR_TRACKER_OBJ_047_oPCAN_RADAR_7b42d299_Tx: ComBitPosition=399, ComBitSize=10, ComSignalType=UINT16, ComHandleId=10830, ComSystemTemplateSystemSignalRef=OBJ_YAW_RATE_047
          OBJ_DIMENSION_WIDTH_ERR_047_oRDR_TRACKER_OBJ_047_oPCAN_RADAR_45fc5041_Tx: ComBitPosition=23, ComBitSize=6, ComSignalType=UINT8, ComHandleId=10804, ComSystemTemplateSystemSignalRef=OBJ_DIMENSION_WIDTH_ERR_047
          OBJ_RCS_047_oRDR_TRACKER_OBJ_047_oPCAN_RADAR_d4dda0be_Tx: ComBitPosition=351, ComBitSize=7, ComSignalType=UINT8, ComHandleId=10817, ComSystemTemplateSystemSignalRef=OBJ_RCS_047
          OBJ_ACCELERATION_LONG_ERR_047_oRDR_TRACKER_OBJ_047_oPCAN_RADAR_8b155f2e_Tx: ComBitPosition=215, ComBitSize=8, ComSignalType=UINT8, ComHandleId=10786, ComSystemTemplateSystemSignalRef=OBJ_ACCELERATION_LONG_ERR_047
          OBJ_CLS_TYPE3_PROB_047_oRDR_TRACKER_OBJ_047_oPCAN_RADAR_e2710945_Tx: ComBitPosition=319, ComBitSize=8, ComSignalType=UINT8, ComHandleId=10794, ComSystemTemplateSystemSignalRef=OBJ_CLS_TYPE3_PROB_047
          OBJ_ACCELERATION_LAT_ERR_047_oRDR_TRACKER_OBJ_047_oPCAN_RADAR_94b0fa84_Tx: ComBitPosition=223, ComBitSize=8, ComSignalType=UINT8, ComHandleId=10784, ComSystemTemplateSystemSignalRef=OBJ_ACCELERATION_LAT_ERR_047
          OBJ_ACCEL_ERR_CRR_COEF_047_oRDR_TRACKER_OBJ_047_oPCAN_RADAR_2bb67e48_Tx: ComBitPosition=431, ComBitSize=8, ComSignalType=UINT8, ComHandleId=10787, ComSystemTemplateSystemSignalRef=OBJ_ACCEL_ERR_CRR_COEF_047
          OBJ_MEASUREMENT_STATUS_047_oRDR_TRACKER_OBJ_047_oPCAN_RADAR_ab6c5e83_Tx: ComBitPosition=14, ComBitSize=3, ComSignalType=UINT8, ComHandleId=10808, ComSystemTemplateSystemSignalRef=OBJ_MEASUREMENT_STATUS_047
          OBJ_VEH_TRACK_FLAG_047_oRDR_TRACKER_OBJ_047_oPCAN_RADAR_9a585768_Tx: ComBitPosition=10, ComBitSize=1, ComSignalType=BOOLEAN, ComHandleId=10822, ComSystemTemplateSystemSignalRef=OBJ_VEH_TRACK_FLAG_047
          OBJ_VELOCITY_ERR_CRR_COEF_047_oRDR_TRACKER_OBJ_047_oPCAN_RADAR_bdc73614_Tx: ComBitPosition=423, ComBitSize=8, ComSignalType=UINT8, ComHandleId=10823, ComSystemTemplateSystemSignalRef=OBJ_VELOCITY_ERR_CRR_COEF_047
          OBJ_MH_CRC16_047_oRDR_TRACKER_OBJ_047_oPCAN_RADAR_d70ce9bf_Tx: ComBitPosition=495, ComBitSize=16, ComSignalType=UINT16, ComHandleId=10809, ComSystemTemplateSystemSignalRef=OBJ_MH_CRC16_047
          OBJ_MH_CYCLE_COUNTER_047_oRDR_TRACKER_OBJ_047_oPCAN_RADAR_a6e8b35e_Tx: ComBitPosition=487, ComBitSize=8, ComSignalType=UINT8, ComHandleId=10810, ComSystemTemplateSystemSignalRef=OBJ_MH_CYCLE_COUNTER_047
      9 x ComIPdu, all with ComIPduDirection=SEND, ComIPduType=NORMAL, ComIPduCancellationSupport=false, ComIPduSignalProcessing=DEFERRED, ComIPduChannelRef=CN_PCAN_RADAR_458ff0f1, ComIPduGroupRef=RDR01_oPCAN_RADAR_Tx_b6bdb067 if post-build-variant-condition{matching-criterion=RDR_POS, value=0}, ComIPduMainFunctionRef=ComMainFunctionTx_Event, ComIPduGroupRef=RDR02_oPCAN_RADAR_Tx_9f750495 if post-build-variant-condition{matching-criterion=RDR_POS, value=1}, ComIPduGroupRef=RDR03_oPCAN_RADAR_Tx_311d9504 if post-build-variant-condition{matching-criterion=RDR_POS, value=2}, ComIPduGroupRef=RDR04_oPCAN_RADAR_Tx_cce46d71 if post-build-variant-condition{matching-criterion=RDR_POS, value=3}, ComIPduGroupRef=RDR05_oPCAN_RADAR_Tx_628cfce0 if post-build-variant-condition{matching-criterion=RDR_POS, value=4}, ComIPduGroupRef=RDR06_oPCAN_RADAR_Tx_4b444812 if post-build-variant-condition{matching-criterion=RDR_POS, value=5}, ComIPduGroupRef=RDR07_oPCAN_RADAR_Tx_e52cd983 if post-build-variant-condition{matching-criterion=RDR_POS, value=6}, ComIPduGroupRef=RDR08_oPCAN_RADAR_Tx_6bc6beb9 if post-build-variant-condition{matching-criterion=RDR_POS, value=7}:
        RDR_DETECTION_381_384_oPCAN_RADAR_26615caa_Tx: ComIPduHandleId=101, ComIPduSignalGroupRef=SG_Detections_381_384_oRDR_DETECTION_381_384_oPCAN_RADAR_cd667329_Tx, ComPduIdRef=RDR_DETECTION_381_384_oPCAN_RADAR_26615caa_Tx
          ComTxIPdu: ComMinimumDelayTime=0, ComTxIPduUnusedAreasDefault=0
            ComTxModeTrue
              ComTxMode: ComTxModeMode=DIRECT, ComTxModeNumberOfRepetitions=0
            ComTxModeFalse
              ComTxMode: ComTxModeMode=NONE
        RDR_TRACKER_OBJ_016_oPCAN_RADAR_cefb1c78_Tx: ComIPduHandleId=126, ComIPduSignalGroupRef=SG_TrackerObject016_oRDR_TRACKER_OBJ_016_oPCAN_RADAR_75d339f9_Tx, ComPduIdRef=RDR_TRACKER_OBJ_016_oPCAN_RADAR_cefb1c78_Tx
          ComTxIPdu: ComMinimumDelayTime=0, ComTxIPduUnusedAreasDefault=0
            ComTxModeTrue
              ComTxMode: ComTxModeMode=DIRECT, ComTxModeNumberOfRepetitions=0
            ComTxModeFalse
              ComTxMode: ComTxModeMode=NONE
        RDR_TRACKER_OBJ_022_oPCAN_RADAR_72235335_Tx: ComIPduHandleId=132, ComIPduSignalGroupRef=SG_TrackerObject022_oRDR_TRACKER_OBJ_022_oPCAN_RADAR_d0d10c75_Tx, ComPduIdRef=RDR_TRACKER_OBJ_022_oPCAN_RADAR_72235335_Tx
          ComTxIPdu: ComMinimumDelayTime=0, ComTxIPduUnusedAreasDefault=0
            ComTxModeTrue
              ComTxMode: ComTxModeMode=DIRECT, ComTxModeNumberOfRepetitions=0
            ComTxModeFalse
              ComTxMode: ComTxModeMode=NONE
        RDR_DETECTION_017_020_oPCAN_RADAR_d9f3af92_Tx: ComIPduHandleId=10, ComIPduSignalGroupRef=SG_Detections_017_020_oRDR_DETECTION_017_020_oPCAN_RADAR_e956bb2e_Tx, ComPduIdRef=RDR_DETECTION_017_020_oPCAN_RADAR_d9f3af92_Tx
          ComTxIPdu: ComMinimumDelayTime=0, ComTxIPduUnusedAreasDefault=0
            ComTxModeTrue
              ComTxMode: ComTxModeMode=DIRECT, ComTxModeNumberOfRepetitions=0
            ComTxModeFalse
              ComTxMode: ComTxModeMode=NONE
        RDR_DETECTION_321_324_oPCAN_RADAR_e6d343be_Tx: ComIPduHandleId=86, ComIPduSignalGroupRef=SG_Detections_321_324_oRDR_DETECTION_321_324_oPCAN_RADAR_2dc55233_Tx, ComPduIdRef=RDR_DETECTION_321_324_oPCAN_RADAR_e6d343be_Tx
          ComTxIPdu: ComMinimumDelayTime=0, ComTxIPduUnusedAreasDefault=0
            ComTxModeTrue
              ComTxMode: ComTxModeMode=DIRECT, ComTxModeNumberOfRepetitions=0
            ComTxModeFalse
              ComTxMode: ComTxModeMode=NONE
        RDR_TRACKER_OBJ_055_oPCAN_RADAR_6a9dffad_Tx: ComIPduHandleId=165, ComIPduSignalGroupRef=SG_TrackerObject055_oRDR_TRACKER_OBJ_055_oPCAN_RADAR_34a97ad4_Tx, ComPduIdRef=RDR_TRACKER_OBJ_055_oPCAN_RADAR_6a9dffad_Tx
          ComTxIPdu: ComMinimumDelayTime=0, ComTxIPduUnusedAreasDefault=0
            ComTxModeTrue
              ComTxMode: ComTxModeMode=DIRECT, ComTxModeNumberOfRepetitions=0
            ComTxModeFalse
              ComTxMode: ComTxModeMode=NONE
        RDR_TRACKER_OBJ_007_oPCAN_RADAR_8e62248b_Tx: ComIPduHandleId=117, ComIPduSignalGroupRef=SG_TrackerObject007_oRDR_TRACKER_OBJ_007_oPCAN_RADAR_de5647f4_Tx, ComPduIdRef=RDR_TRACKER_OBJ_007_oPCAN_RADAR_8e62248b_Tx
          ComTxIPdu: ComMinimumDelayTime=0, ComTxIPduUnusedAreasDefault=0
            ComTxModeTrue
              ComTxMode: ComTxModeMode=DIRECT, ComTxModeNumberOfRepetitions=0
            ComTxModeFalse
              ComTxMode: ComTxModeMode=NONE
        RDR_DETECTION_261_264_oPCAN_RADAR_9ace4013_Tx: ComIPduHandleId=71, ComIPduSignalGroupRef=SG_Detections_261_264_oRDR_DETECTION_261_264_oPCAN_RADAR_0586302b_Tx, ComPduIdRef=RDR_DETECTION_261_264_oPCAN_RADAR_9ace4013_Tx
          ComTxIPdu: ComMinimumDelayTime=0, ComTxIPduUnusedAreasDefault=0
            ComTxModeTrue
              ComTxMode: ComTxModeMode=DIRECT, ComTxModeNumberOfRepetitions=0
            ComTxModeFalse
              ComTxMode: ComTxModeMode=NONE
        RDR_OBJ_HEADER_002_oPCAN_RADAR_1ea433e3_Tx: ComIPduHandleId=107, ComIPduSignalGroupRef=SG_TrackerHeader_oRDR_OBJ_HEADER_002_oPCAN_RADAR_563ddea3_Tx, ComPduIdRef=RDR_OBJ_HEADER_002_oPCAN_RADAR_1ea433e3_Tx
          ComTxIPdu: ComMinimumDelayTime=0, ComTxIPduUnusedAreasDefault=0
            ComTxModeTrue
              ComTxMode: ComTxModeMode=DIRECT, ComTxModeNumberOfRepetitions=0
            ComTxModeFalse
              ComTxMode: ComTxModeMode=NONE
      SG_TrackerObject060_oRDR_TRACKER_OBJ_060_oPCAN_RADAR_68bfc7eb_Tx (ComSignalGroup):
        ComTransferProperty = TRIGGERED
        ComSignalGroupAccess = ACCESS_NEEDED_BY_SWC_OR_COM
        ComHandleId = 169
        ComSignalGroupArrayAccess = true
        ComSystemTemplateSignalGroupRef = SG_TrackerObject060
        49 x ComGroupSignal, all with ComSignalEndianness=BIG_ENDIAN, ComSignalInitValue=0, ComTransferProperty=PENDING, ComSignalAccess=ACCESS_NEEDED_BY_SWC_OR_COM:
          OBJ_YAW_ANGLE_ERR_060_oRDR_TRACKER_OBJ_060_oPCAN_RADAR_ac1fadaf_Tx: ComBitPosition=175, ComBitSize=7, ComSignalType=UINT8, ComHandleId=11466, ComSystemTemplateSystemSignalRef=OBJ_YAW_ANGLE_ERR_060
          OBJ_VELOCITY_LAT_ERR_060_oRDR_TRACKER_OBJ_060_oPCAN_RADAR_a1549f69_Tx: ComBitPosition=151, ComBitSize=8, ComSignalType=UINT8, ComHandleId=11462, ComSystemTemplateSystemSignalRef=OBJ_VELOCITY_LAT_ERR_060
          OBJ_VELOCITY_ERR_CRR_COEF_060_oRDR_TRACKER_OBJ_060_oPCAN_RADAR_9a186ab2_Tx: ComBitPosition=423, ComBitSize=8, ComSignalType=UINT8, ComHandleId=11460, ComSystemTemplateSystemSignalRef=OBJ_VELOCITY_ERR_CRR_COEF_060
          OBJ_CLS_TYPE6_PROB_060_oRDR_TRACKER_OBJ_060_oPCAN_RADAR_45837eb5_Tx: ComBitPosition=343, ComBitSize=8, ComSignalType=UINT8, ComHandleId=11437, ComSystemTemplateSystemSignalRef=OBJ_CLS_TYPE6_PROB_060
          OBJ_ID_060_oRDR_TRACKER_OBJ_060_oPCAN_RADAR_f3617098_Tx: ComBitPosition=7, ComBitSize=8, ComSignalType=UINT8, ComHandleId=11444, ComSystemTemplateSystemSignalRef=OBJ_ID_060
          OBJ_ACCEL_ERR_CRR_COEF_060_oRDR_TRACKER_OBJ_060_oPCAN_RADAR_0c6922ee_Tx: ComBitPosition=431, ComBitSize=8, ComSignalType=UINT8, ComHandleId=11424, ComSystemTemplateSystemSignalRef=OBJ_ACCEL_ERR_CRR_COEF_060
          OBJ_TRACK_MOTION_MODEL_060_oRDR_TRACKER_OBJ_060_oPCAN_RADAR_3fadfd93_Tx: ComBitPosition=9, ComBitSize=2, ComSignalType=UINT8, ComHandleId=11458, ComSystemTemplateSystemSignalRef=OBJ_TRACK_MOTION_MODEL_060
          OBJ_CLS_TYPE2_PROB_060_oRDR_TRACKER_OBJ_060_oPCAN_RADAR_82bda318_Tx: ComBitPosition=311, ComBitSize=8, ComSignalType=UINT8, ComHandleId=11429, ComSystemTemplateSystemSignalRef=OBJ_CLS_TYPE2_PROB_060
          OBJ_POS_LAT_060_oRDR_TRACKER_OBJ_060_oPCAN_RADAR_d1cdaa1f_Tx: ComBitPosition=79, ComBitSize=16, ComSignalType=UINT16, ComHandleId=11450, ComSystemTemplateSystemSignalRef=OBJ_POS_LAT_060
          OBJ_CLS_TYPE4_060_oRDR_TRACKER_OBJ_060_oPCAN_RADAR_35e96f4f_Tx: ComBitPosition=275, ComBitSize=4, ComSignalType=UINT8, ComHandleId=11432, ComSystemTemplateSystemSignalRef=OBJ_CLS_TYPE4_060
          OBJ_MEASUREMENT_STATUS_060_oRDR_TRACKER_OBJ_060_oPCAN_RADAR_8cb30225_Tx: ComBitPosition=14, ComBitSize=3, ComSignalType=UINT8, ComHandleId=11445, ComSystemTemplateSystemSignalRef=OBJ_MEASUREMENT_STATUS_060
          OBJ_TIMESTAMP_OFFSET_060_oRDR_TRACKER_OBJ_060_oPCAN_RADAR_f3aefc4e_Tx: ComBitPosition=247, ComBitSize=8, ComSignalType=UINT8, ComHandleId=11457, ComSystemTemplateSystemSignalRef=OBJ_TIMESTAMP_OFFSET_060
          OBJ_CLS_TYPE1_PROB_060_oRDR_TRACKER_OBJ_060_oPCAN_RADAR_4b89b815_Tx: ComBitPosition=303, ComBitSize=8, ComSignalType=UINT8, ComHandleId=11427, ComSystemTemplateSystemSignalRef=OBJ_CLS_TYPE1_PROB_060
          OBJ_ALIVE_TIME_060_oRDR_TRACKER_OBJ_060_oPCAN_RADAR_740a8ec0_Tx: ComBitPosition=255, ComBitSize=16, ComSignalType=UINT16, ComHandleId=11425, ComSystemTemplateSystemSignalRef=OBJ_ALIVE_TIME_060
          OBJ_YAW_ANGLE_060_oRDR_TRACKER_OBJ_060_oPCAN_RADAR_7912ab78_Tx: ComBitPosition=155, ComBitSize=12, ComSignalType=UINT16, ComHandleId=11465, ComSystemTemplateSystemSignalRef=OBJ_YAW_ANGLE_060
          OBJ_DIMENSION_LENGTH_060_oRDR_TRACKER_OBJ_060_oPCAN_RADAR_a14f3ca2_Tx: ComBitPosition=37, ComBitSize=12, ComSignalType=UINT16, ComHandleId=11438, ComSystemTemplateSystemSignalRef=OBJ_DIMENSION_LENGTH_060
          OBJ_DIMENSION_LENGTH_ERR_060_oRDR_TRACKER_OBJ_060_oPCAN_RADAR_9ab723d8_Tx: ComBitPosition=41, ComBitSize=10, ComSignalType=UINT16, ComHandleId=11439, ComSystemTemplateSystemSignalRef=OBJ_DIMENSION_LENGTH_ERR_060
          OBJ_POS_LONG_ERR_060_oRDR_TRACKER_OBJ_060_oPCAN_RADAR_4c7904ca_Tx: ComBitPosition=95, ComBitSize=8, ComSignalType=UINT8, ComHandleId=11453, ComSystemTemplateSystemSignalRef=OBJ_POS_LONG_ERR_060
          OBJ_REF_PT_LONG_OFFSET_060_oRDR_TRACKER_OBJ_060_oPCAN_RADAR_496d676e_Tx: ComBitPosition=357, ComBitSize=14, ComSignalType=UINT16, ComHandleId=11456, ComSystemTemplateSystemSignalRef=OBJ_REF_PT_LONG_OFFSET_060
          OBJ_YAW_RATE_060_oRDR_TRACKER_OBJ_060_oPCAN_RADAR_5c9d8e3f_Tx: ComBitPosition=399, ComBitSize=10, ComSignalType=UINT16, ComHandleId=11467, ComSystemTemplateSystemSignalRef=OBJ_YAW_RATE_060
          OBJ_CLS_TYPE6_060_oRDR_TRACKER_OBJ_060_oPCAN_RADAR_f58992ca_Tx: ComBitPosition=282, ComBitSize=4, ComSignalType=UINT8, ComHandleId=11436, ComSystemTemplateSystemSignalRef=OBJ_CLS_TYPE6_060
          OBJ_CLS_TYPE2_060_oRDR_TRACKER_OBJ_060_oPCAN_RADAR_ae396f81_Tx: ComBitPosition=267, ComBitSize=4, ComSignalType=UINT8, ComHandleId=11428, ComSystemTemplateSystemSignalRef=OBJ_CLS_TYPE2_060
          OBJ_ACCELERATION_LAT_060_oRDR_TRACKER_OBJ_060_oPCAN_RADAR_669b9c9c_Tx: ComBitPosition=177, ComBitSize=10, ComSignalType=UINT16, ComHandleId=11420, ComSystemTemplateSystemSignalRef=OBJ_ACCELERATION_LAT_060
          OBJ_CLS_TYPE3_060_oRDR_TRACKER_OBJ_060_oPCAN_RADAR_23b19263_Tx: ComBitPosition=279, ComBitSize=4, ComSignalType=UINT8, ComHandleId=11430, ComSystemTemplateSystemSignalRef=OBJ_CLS_TYPE3_060
          OBJ_CLS_TYPE5_PROB_060_oRDR_TRACKER_OBJ_060_oPCAN_RADAR_8cb765b8_Tx: ComBitPosition=335, ComBitSize=8, ComSignalType=UINT8, ComHandleId=11435, ComSystemTemplateSystemSignalRef=OBJ_CLS_TYPE5_PROB_060
          OBJ_MOVEMENT_STATUS_060_oRDR_TRACKER_OBJ_060_oPCAN_RADAR_a31d9769_Tx: ComBitPosition=196, ComBitSize=3, ComSignalType=UINT8, ComHandleId=11448, ComSystemTemplateSystemSignalRef=OBJ_MOVEMENT_STATUS_060
          OBJ_CLS_TYPE5_060_oRDR_TRACKER_OBJ_060_oPCAN_RADAR_b86192ad_Tx: ComBitPosition=287, ComBitSize=4, ComSignalType=UINT8, ComHandleId=11434, ComSystemTemplateSystemSignalRef=OBJ_CLS_TYPE5_060
          OBJ_CLS_TYPE4_PROB_060_oRDR_TRACKER_OBJ_060_oPCAN_RADAR_cba49343_Tx: ComBitPosition=327, ComBitSize=8, ComSignalType=UINT8, ComHandleId=11433, ComSystemTemplateSystemSignalRef=OBJ_CLS_TYPE4_PROB_060
          OBJ_DIMENSION_WIDTH_ERR_060_oRDR_TRACKER_OBJ_060_oPCAN_RADAR_62230ce7_Tx: ComBitPosition=23, ComBitSize=6, ComSignalType=UINT8, ComHandleId=11441, ComSystemTemplateSystemSignalRef=OBJ_DIMENSION_WIDTH_ERR_060
          OBJ_REF_PT_LAT_OFFSET_060_oRDR_TRACKER_OBJ_060_oPCAN_RADAR_063f976d_Tx: ComBitPosition=370, ComBitSize=14, ComSignalType=UINT16, ComHandleId=11455, ComSystemTemplateSystemSignalRef=OBJ_REF_PT_LAT_OFFSET_060
          OBJ_ACCELERATION_LONG_060_oRDR_TRACKER_OBJ_060_oPCAN_RADAR_146bc57c_Tx: ComBitPosition=193, ComBitSize=10, ComSignalType=UINT16, ComHandleId=11422, ComSystemTemplateSystemSignalRef=OBJ_ACCELERATION_LONG_060
          OBJ_GROUP_ID_060_oRDR_TRACKER_OBJ_060_oPCAN_RADAR_004f5b9f_Tx: ComBitPosition=405, ComBitSize=6, ComSignalType=UINT8, ComHandleId=11443, ComSystemTemplateSystemSignalRef=OBJ_GROUP_ID_060
          OBJ_CLS_TYPE3_PROB_060_oRDR_TRACKER_OBJ_060_oPCAN_RADAR_c5ae55e3_Tx: ComBitPosition=319, ComBitSize=8, ComSignalType=UINT8, ComHandleId=11431, ComSystemTemplateSystemSignalRef=OBJ_CLS_TYPE3_PROB_060
          OBJ_RCS_060_oRDR_TRACKER_OBJ_060_oPCAN_RADAR_f302fc18_Tx: ComBitPosition=351, ComBitSize=7, ComSignalType=UINT8, ComHandleId=11454, ComSystemTemplateSystemSignalRef=OBJ_RCS_060
          OBJ_ACCELERATION_LAT_ERR_060_oRDR_TRACKER_OBJ_060_oPCAN_RADAR_b36fa622_Tx: ComBitPosition=223, ComBitSize=8, ComSignalType=UINT8, ComHandleId=11421, ComSystemTemplateSystemSignalRef=OBJ_ACCELERATION_LAT_ERR_060
          OBJ_ACCELERATION_LONG_ERR_060_oRDR_TRACKER_OBJ_060_oPCAN_RADAR_acca0388_Tx: ComBitPosition=215, ComBitSize=8, ComSignalType=UINT8, ComHandleId=11423, ComSystemTemplateSystemSignalRef=OBJ_ACCELERATION_LONG_ERR_060
          OBJ_CLS_TYPE1_060_oRDR_TRACKER_OBJ_060_oPCAN_RADAR_e3d16fe6_Tx: ComBitPosition=271, ComBitSize=4, ComSignalType=UINT8, ComHandleId=11426, ComSystemTemplateSystemSignalRef=OBJ_CLS_TYPE1_060
          OBJ_YAW_RATE_ERR_060_oRDR_TRACKER_OBJ_060_oPCAN_RADAR_634519e3_Tx: ComBitPosition=388, ComBitSize=5, ComSignalType=UINT8, ComHandleId=11468, ComSystemTemplateSystemSignalRef=OBJ_YAW_RATE_ERR_060
          OBJ_DIMENSION_WIDTH_060_oRDR_TRACKER_OBJ_060_oPCAN_RADAR_8281cb0f_Tx: ComBitPosition=17, ComBitSize=10, ComSignalType=UINT16, ComHandleId=11440, ComSystemTemplateSystemSignalRef=OBJ_DIMENSION_WIDTH_060
          OBJ_POS_LONG_060_oRDR_TRACKER_OBJ_060_oPCAN_RADAR_606d41d0_Tx: ComBitPosition=63, ComBitSize=16, ComSignalType=UINT16, ComHandleId=11452, ComSystemTemplateSystemSignalRef=OBJ_POS_LONG_060
          OBJ_VELOCITY_LONG_ERR_060_oRDR_TRACKER_OBJ_060_oPCAN_RADAR_4dd6a0a9_Tx: ComBitPosition=143, ComBitSize=8, ComSignalType=UINT8, ComHandleId=11464, ComSystemTemplateSystemSignalRef=OBJ_VELOCITY_LONG_ERR_060
          OBJ_VELOCITY_LONG_060_oRDR_TRACKER_OBJ_060_oPCAN_RADAR_c52397fe_Tx: ComBitPosition=110, ComBitSize=15, ComSignalType=UINT16, ComHandleId=11463, ComSystemTemplateSystemSignalRef=OBJ_VELOCITY_LONG_060
          OBJ_POS_LAT_ERR_060_oRDR_TRACKER_OBJ_060_oPCAN_RADAR_d581fa28_Tx: ComBitPosition=103, ComBitSize=8, ComSignalType=UINT8, ComHandleId=11451, ComSystemTemplateSystemSignalRef=OBJ_POS_LAT_ERR_060
          OBJ_EXISTENCE_PROB_060_oRDR_TRACKER_OBJ_060_oPCAN_RADAR_893d4f32_Tx: ComBitPosition=229, ComBitSize=14, ComSignalType=UINT16, ComHandleId=11442, ComSystemTemplateSystemSignalRef=OBJ_EXISTENCE_PROB_060
          OBJ_VELOCITY_LAT_060_oRDR_TRACKER_OBJ_060_oPCAN_RADAR_95aeef38_Tx: ComBitPosition=126, ComBitSize=15, ComSignalType=UINT16, ComHandleId=11461, ComSystemTemplateSystemSignalRef=OBJ_VELOCITY_LAT_060
          OBJ_POS_ERR_CRR_COEF_060_oRDR_TRACKER_OBJ_060_oPCAN_RADAR_33625753_Tx: ComBitPosition=415, ComBitSize=8, ComSignalType=UINT8, ComHandleId=11449, ComSystemTemplateSystemSignalRef=OBJ_POS_ERR_CRR_COEF_060
          OBJ_VEH_TRACK_FLAG_060_oRDR_TRACKER_OBJ_060_oPCAN_RADAR_bd870bce_Tx: ComBitPosition=10, ComBitSize=1, ComSignalType=BOOLEAN, ComHandleId=11459, ComSystemTemplateSystemSignalRef=OBJ_VEH_TRACK_FLAG_060
          OBJ_MH_CRC16_060_oRDR_TRACKER_OBJ_060_oPCAN_RADAR_f0d3b519_Tx: ComBitPosition=495, ComBitSize=16, ComSignalType=UINT16, ComHandleId=11446, ComSystemTemplateSystemSignalRef=OBJ_MH_CRC16_060
          OBJ_MH_CYCLE_COUNTER_060_oRDR_TRACKER_OBJ_060_oPCAN_RADAR_8137eff8_Tx: ComBitPosition=487, ComBitSize=8, ComSignalType=UINT8, ComHandleId=11447, ComSystemTemplateSystemSignalRef=OBJ_MH_CYCLE_COUNTER_060
      SG_TrackerObject037_oRDR_TRACKER_OBJ_037_oPCAN_RADAR_29e45c36_Tx (ComSignalGroup):
        ComTransferProperty = TRIGGERED
        ComSignalGroupAccess = ACCESS_NEEDED_BY_SWC_OR_COM
        ComHandleId = 146
        ComSignalGroupArrayAccess = true
        ComSystemTemplateSignalGroupRef = SG_TrackerObject037
        49 x ComGroupSignal, all with ComSignalEndianness=BIG_ENDIAN, ComSignalInitValue=0, ComTransferProperty=PENDING, ComSignalAccess=ACCESS_NEEDED_BY_SWC_OR_COM:
          OBJ_CLS_TYPE2_037_oRDR_TRACKER_OBJ_037_oPCAN_RADAR_ef62f45c_Tx: ComBitPosition=267, ComBitSize=4, ComSignalType=UINT8, ComHandleId=10301, ComSystemTemplateSystemSignalRef=OBJ_CLS_TYPE2_037
          OBJ_CLS_TYPE5_PROB_037_oRDR_TRACKER_OBJ_037_oPCAN_RADAR_cdecfe65_Tx: ComBitPosition=335, ComBitSize=8, ComSignalType=UINT8, ComHandleId=10308, ComSystemTemplateSystemSignalRef=OBJ_CLS_TYPE5_PROB_037
          OBJ_TRACK_MOTION_MODEL_037_oRDR_TRACKER_OBJ_037_oPCAN_RADAR_7ef6664e_Tx: ComBitPosition=9, ComBitSize=2, ComSignalType=UINT8, ComHandleId=10331, ComSystemTemplateSystemSignalRef=OBJ_TRACK_MOTION_MODEL_037
          OBJ_POS_ERR_CRR_COEF_037_oRDR_TRACKER_OBJ_037_oPCAN_RADAR_7239cc8e_Tx: ComBitPosition=415, ComBitSize=8, ComSignalType=UINT8, ComHandleId=10322, ComSystemTemplateSystemSignalRef=OBJ_POS_ERR_CRR_COEF_037
          OBJ_YAW_ANGLE_037_oRDR_TRACKER_OBJ_037_oPCAN_RADAR_384930a5_Tx: ComBitPosition=155, ComBitSize=12, ComSignalType=UINT16, ComHandleId=10338, ComSystemTemplateSystemSignalRef=OBJ_YAW_ANGLE_037
          OBJ_POS_LAT_037_oRDR_TRACKER_OBJ_037_oPCAN_RADAR_909631c2_Tx: ComBitPosition=79, ComBitSize=16, ComSignalType=UINT16, ComHandleId=10323, ComSystemTemplateSystemSignalRef=OBJ_POS_LAT_037
          OBJ_CLS_TYPE4_037_oRDR_TRACKER_OBJ_037_oPCAN_RADAR_74b2f492_Tx: ComBitPosition=275, ComBitSize=4, ComSignalType=UINT8, ComHandleId=10305, ComSystemTemplateSystemSignalRef=OBJ_CLS_TYPE4_037
          OBJ_REF_PT_LAT_OFFSET_037_oRDR_TRACKER_OBJ_037_oPCAN_RADAR_47640cb0_Tx: ComBitPosition=370, ComBitSize=14, ComSignalType=UINT16, ComHandleId=10328, ComSystemTemplateSystemSignalRef=OBJ_REF_PT_LAT_OFFSET_037
          OBJ_CLS_TYPE1_PROB_037_oRDR_TRACKER_OBJ_037_oPCAN_RADAR_0ad223c8_Tx: ComBitPosition=303, ComBitSize=8, ComSignalType=UINT8, ComHandleId=10300, ComSystemTemplateSystemSignalRef=OBJ_CLS_TYPE1_PROB_037
          OBJ_ACCELERATION_LONG_037_oRDR_TRACKER_OBJ_037_oPCAN_RADAR_55305ea1_Tx: ComBitPosition=193, ComBitSize=10, ComSignalType=UINT16, ComHandleId=10295, ComSystemTemplateSystemSignalRef=OBJ_ACCELERATION_LONG_037
          OBJ_CLS_TYPE3_037_oRDR_TRACKER_OBJ_037_oPCAN_RADAR_62ea09be_Tx: ComBitPosition=279, ComBitSize=4, ComSignalType=UINT8, ComHandleId=10303, ComSystemTemplateSystemSignalRef=OBJ_CLS_TYPE3_037
          OBJ_VELOCITY_LONG_037_oRDR_TRACKER_OBJ_037_oPCAN_RADAR_84780c23_Tx: ComBitPosition=110, ComBitSize=15, ComSignalType=UINT16, ComHandleId=10336, ComSystemTemplateSystemSignalRef=OBJ_VELOCITY_LONG_037
          OBJ_POS_LAT_ERR_037_oRDR_TRACKER_OBJ_037_oPCAN_RADAR_94da61f5_Tx: ComBitPosition=103, ComBitSize=8, ComSignalType=UINT8, ComHandleId=10324, ComSystemTemplateSystemSignalRef=OBJ_POS_LAT_ERR_037
          OBJ_ACCEL_ERR_CRR_COEF_037_oRDR_TRACKER_OBJ_037_oPCAN_RADAR_4d32b933_Tx: ComBitPosition=431, ComBitSize=8, ComSignalType=UINT8, ComHandleId=10297, ComSystemTemplateSystemSignalRef=OBJ_ACCEL_ERR_CRR_COEF_037
          OBJ_MOVEMENT_STATUS_037_oRDR_TRACKER_OBJ_037_oPCAN_RADAR_e2460cb4_Tx: ComBitPosition=196, ComBitSize=3, ComSignalType=UINT8, ComHandleId=10321, ComSystemTemplateSystemSignalRef=OBJ_MOVEMENT_STATUS_037
          OBJ_VELOCITY_ERR_CRR_COEF_037_oRDR_TRACKER_OBJ_037_oPCAN_RADAR_db43f16f_Tx: ComBitPosition=423, ComBitSize=8, ComSignalType=UINT8, ComHandleId=10333, ComSystemTemplateSystemSignalRef=OBJ_VELOCITY_ERR_CRR_COEF_037
          OBJ_YAW_RATE_037_oRDR_TRACKER_OBJ_037_oPCAN_RADAR_1dc615e2_Tx: ComBitPosition=399, ComBitSize=10, ComSignalType=UINT16, ComHandleId=10340, ComSystemTemplateSystemSignalRef=OBJ_YAW_RATE_037
          OBJ_CLS_TYPE3_PROB_037_oRDR_TRACKER_OBJ_037_oPCAN_RADAR_84f5ce3e_Tx: ComBitPosition=319, ComBitSize=8, ComSignalType=UINT8, ComHandleId=10304, ComSystemTemplateSystemSignalRef=OBJ_CLS_TYPE3_PROB_037
          OBJ_DIMENSION_LENGTH_037_oRDR_TRACKER_OBJ_037_oPCAN_RADAR_e014a77f_Tx: ComBitPosition=37, ComBitSize=12, ComSignalType=UINT16, ComHandleId=10311, ComSystemTemplateSystemSignalRef=OBJ_DIMENSION_LENGTH_037
          OBJ_CLS_TYPE6_PROB_037_oRDR_TRACKER_OBJ_037_oPCAN_RADAR_04d8e568_Tx: ComBitPosition=343, ComBitSize=8, ComSignalType=UINT8, ComHandleId=10310, ComSystemTemplateSystemSignalRef=OBJ_CLS_TYPE6_PROB_037
          OBJ_ACCELERATION_LAT_ERR_037_oRDR_TRACKER_OBJ_037_oPCAN_RADAR_f2343dff_Tx: ComBitPosition=223, ComBitSize=8, ComSignalType=UINT8, ComHandleId=10294, ComSystemTemplateSystemSignalRef=OBJ_ACCELERATION_LAT_ERR_037
          OBJ_YAW_RATE_ERR_037_oRDR_TRACKER_OBJ_037_oPCAN_RADAR_221e823e_Tx: ComBitPosition=388, ComBitSize=5, ComSignalType=UINT8, ComHandleId=10341, ComSystemTemplateSystemSignalRef=OBJ_YAW_RATE_ERR_037
          OBJ_CLS_TYPE4_PROB_037_oRDR_TRACKER_OBJ_037_oPCAN_RADAR_8aff089e_Tx: ComBitPosition=327, ComBitSize=8, ComSignalType=UINT8, ComHandleId=10306, ComSystemTemplateSystemSignalRef=OBJ_CLS_TYPE4_PROB_037
          OBJ_DIMENSION_WIDTH_ERR_037_oRDR_TRACKER_OBJ_037_oPCAN_RADAR_2378973a_Tx: ComBitPosition=23, ComBitSize=6, ComSignalType=UINT8, ComHandleId=10314, ComSystemTemplateSystemSignalRef=OBJ_DIMENSION_WIDTH_ERR_037
          OBJ_POS_LONG_ERR_037_oRDR_TRACKER_OBJ_037_oPCAN_RADAR_0d229f17_Tx: ComBitPosition=95, ComBitSize=8, ComSignalType=UINT8, ComHandleId=10326, ComSystemTemplateSystemSignalRef=OBJ_POS_LONG_ERR_037
          OBJ_MEASUREMENT_STATUS_037_oRDR_TRACKER_OBJ_037_oPCAN_RADAR_cde899f8_Tx: ComBitPosition=14, ComBitSize=3, ComSignalType=UINT8, ComHandleId=10318, ComSystemTemplateSystemSignalRef=OBJ_MEASUREMENT_STATUS_037
          OBJ_EXISTENCE_PROB_037_oRDR_TRACKER_OBJ_037_oPCAN_RADAR_c866d4ef_Tx: ComBitPosition=229, ComBitSize=14, ComSignalType=UINT16, ComHandleId=10315, ComSystemTemplateSystemSignalRef=OBJ_EXISTENCE_PROB_037
          OBJ_VELOCITY_LAT_ERR_037_oRDR_TRACKER_OBJ_037_oPCAN_RADAR_e00f04b4_Tx: ComBitPosition=151, ComBitSize=8, ComSignalType=UINT8, ComHandleId=10335, ComSystemTemplateSystemSignalRef=OBJ_VELOCITY_LAT_ERR_037
          OBJ_GROUP_ID_037_oRDR_TRACKER_OBJ_037_oPCAN_RADAR_4114c042_Tx: ComBitPosition=405, ComBitSize=6, ComSignalType=UINT8, ComHandleId=10316, ComSystemTemplateSystemSignalRef=OBJ_GROUP_ID_037
          OBJ_DIMENSION_LENGTH_ERR_037_oRDR_TRACKER_OBJ_037_oPCAN_RADAR_dbecb805_Tx: ComBitPosition=41, ComBitSize=10, ComSignalType=UINT16, ComHandleId=10312, ComSystemTemplateSystemSignalRef=OBJ_DIMENSION_LENGTH_ERR_037
          OBJ_ACCELERATION_LAT_037_oRDR_TRACKER_OBJ_037_oPCAN_RADAR_27c00741_Tx: ComBitPosition=177, ComBitSize=10, ComSignalType=UINT16, ComHandleId=10293, ComSystemTemplateSystemSignalRef=OBJ_ACCELERATION_LAT_037
          OBJ_REF_PT_LONG_OFFSET_037_oRDR_TRACKER_OBJ_037_oPCAN_RADAR_0836fcb3_Tx: ComBitPosition=357, ComBitSize=14, ComSignalType=UINT16, ComHandleId=10329, ComSystemTemplateSystemSignalRef=OBJ_REF_PT_LONG_OFFSET_037
          OBJ_CLS_TYPE5_037_oRDR_TRACKER_OBJ_037_oPCAN_RADAR_f93a0970_Tx: ComBitPosition=287, ComBitSize=4, ComSignalType=UINT8, ComHandleId=10307, ComSystemTemplateSystemSignalRef=OBJ_CLS_TYPE5_037
          OBJ_TIMESTAMP_OFFSET_037_oRDR_TRACKER_OBJ_037_oPCAN_RADAR_b2f56793_Tx: ComBitPosition=247, ComBitSize=8, ComSignalType=UINT8, ComHandleId=10330, ComSystemTemplateSystemSignalRef=OBJ_TIMESTAMP_OFFSET_037
          OBJ_YAW_ANGLE_ERR_037_oRDR_TRACKER_OBJ_037_oPCAN_RADAR_ed443672_Tx: ComBitPosition=175, ComBitSize=7, ComSignalType=UINT8, ComHandleId=10339, ComSystemTemplateSystemSignalRef=OBJ_YAW_ANGLE_ERR_037
          OBJ_ID_037_oRDR_TRACKER_OBJ_037_oPCAN_RADAR_b23aeb45_Tx: ComBitPosition=7, ComBitSize=8, ComSignalType=UINT8, ComHandleId=10317, ComSystemTemplateSystemSignalRef=OBJ_ID_037
          OBJ_VEH_TRACK_FLAG_037_oRDR_TRACKER_OBJ_037_oPCAN_RADAR_fcdc9013_Tx: ComBitPosition=10, ComBitSize=1, ComSignalType=BOOLEAN, ComHandleId=10332, ComSystemTemplateSystemSignalRef=OBJ_VEH_TRACK_FLAG_037
          OBJ_POS_LONG_037_oRDR_TRACKER_OBJ_037_oPCAN_RADAR_2136da0d_Tx: ComBitPosition=63, ComBitSize=16, ComSignalType=UINT16, ComHandleId=10325, ComSystemTemplateSystemSignalRef=OBJ_POS_LONG_037
          OBJ_ACCELERATION_LONG_ERR_037_oRDR_TRACKER_OBJ_037_oPCAN_RADAR_ed919855_Tx: ComBitPosition=215, ComBitSize=8, ComSignalType=UINT8, ComHandleId=10296, ComSystemTemplateSystemSignalRef=OBJ_ACCELERATION_LONG_ERR_037
          OBJ_CLS_TYPE2_PROB_037_oRDR_TRACKER_OBJ_037_oPCAN_RADAR_c3e638c5_Tx: ComBitPosition=311, ComBitSize=8, ComSignalType=UINT8, ComHandleId=10302, ComSystemTemplateSystemSignalRef=OBJ_CLS_TYPE2_PROB_037
          OBJ_ALIVE_TIME_037_oRDR_TRACKER_OBJ_037_oPCAN_RADAR_3551151d_Tx: ComBitPosition=255, ComBitSize=16, ComSignalType=UINT16, ComHandleId=10298, ComSystemTemplateSystemSignalRef=OBJ_ALIVE_TIME_037
          OBJ_CLS_TYPE6_037_oRDR_TRACKER_OBJ_037_oPCAN_RADAR_b4d20917_Tx: ComBitPosition=282, ComBitSize=4, ComSignalType=UINT8, ComHandleId=10309, ComSystemTemplateSystemSignalRef=OBJ_CLS_TYPE6_037
          OBJ_CLS_TYPE1_037_oRDR_TRACKER_OBJ_037_oPCAN_RADAR_a28af43b_Tx: ComBitPosition=271, ComBitSize=4, ComSignalType=UINT8, ComHandleId=10299, ComSystemTemplateSystemSignalRef=OBJ_CLS_TYPE1_037
          OBJ_VELOCITY_LAT_037_oRDR_TRACKER_OBJ_037_oPCAN_RADAR_d4f574e5_Tx: ComBitPosition=126, ComBitSize=15, ComSignalType=UINT16, ComHandleId=10334, ComSystemTemplateSystemSignalRef=OBJ_VELOCITY_LAT_037
          OBJ_VELOCITY_LONG_ERR_037_oRDR_TRACKER_OBJ_037_oPCAN_RADAR_0c8d3b74_Tx: ComBitPosition=143, ComBitSize=8, ComSignalType=UINT8, ComHandleId=10337, ComSystemTemplateSystemSignalRef=OBJ_VELOCITY_LONG_ERR_037
          OBJ_DIMENSION_WIDTH_037_oRDR_TRACKER_OBJ_037_oPCAN_RADAR_c3da50d2_Tx: ComBitPosition=17, ComBitSize=10, ComSignalType=UINT16, ComHandleId=10313, ComSystemTemplateSystemSignalRef=OBJ_DIMENSION_WIDTH_037
          OBJ_RCS_037_oRDR_TRACKER_OBJ_037_oPCAN_RADAR_b25967c5_Tx: ComBitPosition=351, ComBitSize=7, ComSignalType=UINT8, ComHandleId=10327, ComSystemTemplateSystemSignalRef=OBJ_RCS_037
          OBJ_MH_CRC16_037_oRDR_TRACKER_OBJ_037_oPCAN_RADAR_b1882ec4_Tx: ComBitPosition=495, ComBitSize=16, ComSignalType=UINT16, ComHandleId=10319, ComSystemTemplateSystemSignalRef=OBJ_MH_CRC16_037
          OBJ_MH_CYCLE_COUNTER_037_oRDR_TRACKER_OBJ_037_oPCAN_RADAR_c06c7425_Tx: ComBitPosition=487, ComBitSize=8, ComSignalType=UINT8, ComHandleId=10320, ComSystemTemplateSystemSignalRef=OBJ_MH_CYCLE_COUNTER_037
      9 x ComIPdu, all with ComIPduDirection=SEND, ComIPduType=NORMAL, ComIPduCancellationSupport=false, ComIPduSignalProcessing=DEFERRED, ComIPduChannelRef=CN_PCAN_RADAR_458ff0f1, ComIPduGroupRef=RDR01_oPCAN_RADAR_Tx_b6bdb067 if post-build-variant-condition{matching-criterion=RDR_POS, value=0}, ComIPduMainFunctionRef=ComMainFunctionTx_Event, ComIPduGroupRef=RDR02_oPCAN_RADAR_Tx_9f750495 if post-build-variant-condition{matching-criterion=RDR_POS, value=1}, ComIPduGroupRef=RDR03_oPCAN_RADAR_Tx_311d9504 if post-build-variant-condition{matching-criterion=RDR_POS, value=2}, ComIPduGroupRef=RDR04_oPCAN_RADAR_Tx_cce46d71 if post-build-variant-condition{matching-criterion=RDR_POS, value=3}, ComIPduGroupRef=RDR05_oPCAN_RADAR_Tx_628cfce0 if post-build-variant-condition{matching-criterion=RDR_POS, value=4}, ComIPduGroupRef=RDR06_oPCAN_RADAR_Tx_4b444812 if post-build-variant-condition{matching-criterion=RDR_POS, value=5}, ComIPduGroupRef=RDR07_oPCAN_RADAR_Tx_e52cd983 if post-build-variant-condition{matching-criterion=RDR_POS, value=6}, ComIPduGroupRef=RDR08_oPCAN_RADAR_Tx_6bc6beb9 if post-build-variant-condition{matching-criterion=RDR_POS, value=7}:
        RDR_TRACKER_OBJ_029_oPCAN_RADAR_95eaec96_Tx: ComIPduHandleId=139, ComIPduSignalGroupRef=SG_TrackerObject029_oRDR_TRACKER_OBJ_029_oPCAN_RADAR_a5fdcf7d_Tx, ComPduIdRef=RDR_TRACKER_OBJ_029_oPCAN_RADAR_95eaec96_Tx
          ComTxIPdu: ComMinimumDelayTime=0, ComTxIPduUnusedAreasDefault=0
            ComTxModeTrue
              ComTxMode: ComTxModeMode=DIRECT, ComTxModeNumberOfRepetitions=0
            ComTxModeFalse
              ComTxMode: ComTxModeMode=NONE
        RDR_DETECTION_393_396_oPCAN_RADAR_e05c2eb1_Tx: ComIPduHandleId=104, ComIPduSignalGroupRef=SG_Detections_393_396_oRDR_DETECTION_393_396_oPCAN_RADAR_17d40b28_Tx, ComPduIdRef=RDR_DETECTION_393_396_oPCAN_RADAR_e05c2eb1_Tx
          ComTxIPdu: ComMinimumDelayTime=0, ComTxIPduUnusedAreasDefault=0
            ComTxModeTrue
              ComTxMode: ComTxModeMode=DIRECT, ComTxModeNumberOfRepetitions=0
            ComTxModeFalse
              ComTxMode: ComTxModeMode=NONE
        RDR_DETECTION_309_312_oPCAN_RADAR_d9939da5_Tx: ComIPduHandleId=83, ComIPduSignalGroupRef=SG_Detections_309_312_oRDR_DETECTION_309_312_oPCAN_RADAR_f009e248_Tx, ComPduIdRef=RDR_DETECTION_309_312_oPCAN_RADAR_d9939da5_Tx
          ComTxIPdu: ComMinimumDelayTime=0, ComTxIPduUnusedAreasDefault=0
            ComTxModeTrue
              ComTxMode: ComTxModeMode=DIRECT, ComTxModeNumberOfRepetitions=0
            ComTxModeFalse
              ComTxMode: ComTxModeMode=NONE
        RDR_TRACKER_OBJ_011_oPCAN_RADAR_b3881a20_Tx: ComIPduHandleId=121, ComIPduSignalGroupRef=SG_TrackerObject011_oRDR_TRACKER_OBJ_011_oPCAN_RADAR_f72f8823_Tx, ComPduIdRef=RDR_TRACKER_OBJ_011_oPCAN_RADAR_b3881a20_Tx
          ComTxIPdu: ComMinimumDelayTime=0, ComTxIPduUnusedAreasDefault=0
            ComTxModeTrue
              ComTxMode: ComTxModeMode=DIRECT, ComTxModeNumberOfRepetitions=0
            ComTxModeFalse
              ComTxMode: ComTxModeMode=NONE
        RDR_DETECTION_377_380_oPCAN_RADAR_b793255c_Tx: ComIPduHandleId=100, ComIPduSignalGroupRef=SG_Detections_377_380_oRDR_DETECTION_377_380_oPCAN_RADAR_e93056f0_Tx, ComPduIdRef=RDR_DETECTION_377_380_oPCAN_RADAR_b793255c_Tx
          ComTxIPdu: ComMinimumDelayTime=0, ComTxIPduUnusedAreasDefault=0
            ComTxModeTrue
              ComTxMode: ComTxModeMode=DIRECT, ComTxModeNumberOfRepetitions=0
            ComTxModeFalse
              ComTxMode: ComTxModeMode=NONE
        RDR_TRACKER_OBJ_028_oPCAN_RADAR_487c3513_Tx: ComIPduHandleId=138, ComIPduSignalGroupRef=SG_TrackerObject028_oRDR_TRACKER_OBJ_028_oPCAN_RADAR_5ce947ce_Tx, ComPduIdRef=RDR_TRACKER_OBJ_028_oPCAN_RADAR_487c3513_Tx
          ComTxIPdu: ComMinimumDelayTime=0, ComTxIPduUnusedAreasDefault=0
            ComTxModeTrue
              ComTxMode: ComTxModeMode=DIRECT, ComTxModeNumberOfRepetitions=0
            ComTxModeFalse
              ComTxMode: ComTxModeMode=NONE
        RDR_TRACKER_OBJ_010_oPCAN_RADAR_6e1ec3a5_Tx: ComIPduHandleId=120, ComIPduSignalGroupRef=SG_TrackerObject010_oRDR_TRACKER_OBJ_010_oPCAN_RADAR_0e3b0090_Tx, ComPduIdRef=RDR_TRACKER_OBJ_010_oPCAN_RADAR_6e1ec3a5_Tx
          ComTxIPdu: ComMinimumDelayTime=0, ComTxIPduUnusedAreasDefault=0
            ComTxModeTrue
              ComTxMode: ComTxModeMode=DIRECT, ComTxModeNumberOfRepetitions=0
            ComTxModeFalse
              ComTxMode: ComTxModeMode=NONE
        RDR_DETECTION_161_164_oPCAN_RADAR_28e5acc3_Tx: ComIPduHandleId=46, ComIPduSignalGroupRef=SG_Detections_161_164_oRDR_DETECTION_161_164_oPCAN_RADAR_c27e57ef_Tx, ComPduIdRef=RDR_DETECTION_161_164_oPCAN_RADAR_28e5acc3_Tx
          ComTxIPdu: ComMinimumDelayTime=0, ComTxIPduUnusedAreasDefault=0
            ComTxModeTrue
              ComTxMode: ComTxModeMode=DIRECT, ComTxModeNumberOfRepetitions=0
            ComTxModeFalse
              ComTxMode: ComTxModeMode=NONE
        RDR_DETECTION_357_360_oPCAN_RADAR_79dc1b5f_Tx: ComIPduHandleId=95, ComIPduSignalGroupRef=SG_Detections_357_360_oRDR_DETECTION_357_360_oPCAN_RADAR_44459c4e_Tx, ComPduIdRef=RDR_DETECTION_357_360_oPCAN_RADAR_79dc1b5f_Tx
          ComTxIPdu: ComMinimumDelayTime=0, ComTxIPduUnusedAreasDefault=0
            ComTxModeTrue
              ComTxMode: ComTxModeMode=DIRECT, ComTxModeNumberOfRepetitions=0
            ComTxModeFalse
              ComTxMode: ComTxModeMode=NONE
