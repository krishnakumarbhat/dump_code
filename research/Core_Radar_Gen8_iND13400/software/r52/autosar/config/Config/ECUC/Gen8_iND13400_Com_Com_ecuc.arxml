[part 9 of 20: package /ActiveEcuC]
AUTOSAR XML (schema 00053)
package /ActiveEcuC  (continued)
  module config Com: implementation-config-variant=VARIANT-PRE-COMPILE, module-description=Com_Impl  (continued)
    ComConfig: ComConfigurationId=0, ComRxImmediateNotificationCacheSize=0, ComRxDeferredNotificationCacheSize=1  (continued)
      109 x ComSignalGroup, all with ComSignalGroupAccess=ACCESS_NEEDED_BY_SWC_OR_COM, ComSignalGroupArrayAccess=true:  (continued)
        SG_Detections_201_204_oRDR_DETECTION_201_204_oPCAN_RADAR_5a18d0dd_Tx: ComTransferProperty=TRIGGERED, ComHandleId=52, ComSystemTemplateSignalGroupRef=SG_Detections_201_204
          83 x ComGroupSignal, all with ComSignalEndianness=LITTLE_ENDIAN, ComTransferProperty=PENDING, ComSignalAccess=ACCESS_NEEDED_BY_SWC_OR_COM:
            DET_RANGE_201_oRDR_DETECTION_201_204_oPCAN_RADAR_c854fc19_Tx: ComBitPosition=24, ComBitSize=15, ComSignalInitValue=0, ComSignalType=UINT16, ComHandleId=4266, ComSystemTemplateSystemSignalRef=DET_RANGE_201
            DET_RCS_203_oRDR_DETECTION_201_204_oPCAN_RADAR_cbe2a60d_Tx: ComBitPosition=352, ComBitSize=8, ComSignalInitValue=128, ComSignalType=UINT8, ComHandleId=4284, ComSystemTemplateSystemSignalRef=DET_RCS_203
            DET_AZIMUTH_ERR_203_oRDR_DETECTION_201_204_oPCAN_RADAR_8deab53c_Tx: ComBitPosition=329, ComBitSize=7, ComSignalInitValue=0, ComSignalType=UINT8, ComHandleId=4217, ComSystemTemplateSystemSignalRef=DET_AZIMUTH_ERR_203
            DET_SNR_201_oRDR_DETECTION_201_204_oPCAN_RADAR_e7dc5d64_Tx: ComBitPosition=120, ComBitSize=8, ComSignalInitValue=0, ComSignalType=UINT8, ComHandleId=4286, ComSystemTemplateSystemSignalRef=DET_SNR_201
            DET_CONFD_ELEVATION_201_oRDR_DETECTION_201_204_oPCAN_RADAR_d8bc8492_Tx: ComBitPosition=101, ComBitSize=2, ComSignalInitValue=0, ComSignalType=UINT8, ComHandleId=4231, ComSystemTemplateSystemSignalRef=DET_CONFD_ELEVATION_201
            DET_RANGE_202_oRDR_DETECTION_201_204_oPCAN_RADAR_acb487e7_Tx: ComBitPosition=136, ComBitSize=15, ComSignalInitValue=0, ComSignalType=UINT16, ComHandleId=4267, ComSystemTemplateSystemSignalRef=DET_RANGE_202
            DET_HVC_FLAG_204_oRDR_DETECTION_201_204_oPCAN_RADAR_108e72c6_Tx: ComBitPosition=422, ComBitSize=1, ComSignalInitValue=0, ComSignalType=BOOLEAN, ComHandleId=4250, ComSystemTemplateSystemSignalRef=DET_HVC_FLAG_204
            DET_MH_CRC16_201_204_oRDR_DETECTION_201_204_oPCAN_RADAR_de9002d6_Tx: ComBitPosition=0, ComBitSize=16, ComSignalInitValue=0, ComSignalType=UINT16, ComHandleId=4255, ComSystemTemplateSystemSignalRef=DET_MH_CRC16_201_204
            DET_ELEVATION_ERR_203_oRDR_DETECTION_201_204_oPCAN_RADAR_7fd567b0_Tx: ComBitPosition=304, ComBitSize=6, ComSignalInitValue=0, ComSignalType=UINT8, ComHandleId=4241, ComSystemTemplateSystemSignalRef=DET_ELEVATION_ERR_203
            DET_ELEVATION_ERR_202_oRDR_DETECTION_201_204_oPCAN_RADAR_eaa5b325_Tx: ComBitPosition=192, ComBitSize=6, ComSignalInitValue=0, ComSignalType=UINT8, ComHandleId=4240, ComSystemTemplateSystemSignalRef=DET_ELEVATION_ERR_202
            DET_EXISTENCE_PROB_201_oRDR_DETECTION_201_204_oPCAN_RADAR_5cdabdbb_Tx: ComBitPosition=112, ComBitSize=6, ComSignalInitValue=0, ComSignalType=UINT8, ComHandleId=4243, ComSystemTemplateSystemSignalRef=DET_EXISTENCE_PROB_201
            DET_MH_SCAN_INDEX_4LSB_201_204_oRDR_DETECTION_201_204_oPCAN_RADAR_96cf866d_Tx: ComBitPosition=476, ComBitSize=4, ComSignalInitValue=0, ComSignalType=UINT8, ComHandleId=4257, ComSystemTemplateSystemSignalRef=DET_MH_SCAN_INDEX_4LSB_201_204
            DET_HVC_FLAG_201_oRDR_DETECTION_201_204_oPCAN_RADAR_bdaefec4_Tx: ComBitPosition=86, ComBitSize=1, ComSignalInitValue=0, ComSignalType=BOOLEAN, ComHandleId=4247, ComSystemTemplateSystemSignalRef=DET_HVC_FLAG_201
            DET_RANGE_ERR_202_oRDR_DETECTION_201_204_oPCAN_RADAR_0b5c3d8e_Tx: ComBitPosition=152, ComBitSize=7, ComSignalInitValue=0, ComSignalType=UINT8, ComHandleId=4271, ComSystemTemplateSystemSignalRef=DET_RANGE_ERR_202
            DET_RANGE_VELOCITY_ERR_202_oRDR_DETECTION_201_204_oPCAN_RADAR_d6a9be70_Tx: ComBitPosition=176, ComBitSize=8, ComSignalInitValue=0, ComSignalType=UINT8, ComHandleId=4279, ComSystemTemplateSystemSignalRef=DET_RANGE_VELOCITY_ERR_202
            DET_ELEVATION_202_oRDR_DETECTION_201_204_oPCAN_RADAR_6d9c2b50_Tx: ComBitPosition=184, ComBitSize=8, ComSignalInitValue=0, ComSignalType=UINT8, ComHandleId=4236, ComSystemTemplateSystemSignalRef=DET_ELEVATION_202
            DET_SUPER_RES_TARGET_204_oRDR_DETECTION_201_204_oPCAN_RADAR_7b65f903_Tx: ComBitPosition=423, ComBitSize=1, ComSignalInitValue=0, ComSignalType=BOOLEAN, ComHandleId=4293, ComSystemTemplateSystemSignalRef=DET_SUPER_RES_TARGET_204
            DET_CONFD_AZIMUTH_204_oRDR_DETECTION_201_204_oPCAN_RADAR_7709096a_Tx: ComBitPosition=454, ComBitSize=2, ComSignalInitValue=0, ComSignalType=UINT8, ComHandleId=4230, ComSystemTemplateSystemSignalRef=DET_CONFD_AZIMUTH_204
            DET_ELEVATION_ERR_204_oRDR_DETECTION_201_204_oPCAN_RADAR_236544d9_Tx: ComBitPosition=416, ComBitSize=6, ComSignalInitValue=0, ComSignalType=UINT8, ComHandleId=4242, ComSystemTemplateSystemSignalRef=DET_ELEVATION_ERR_204
            DET_SUPER_RES_TARGET_201_oRDR_DETECTION_201_204_oPCAN_RADAR_d6457501_Tx: ComBitPosition=87, ComBitSize=1, ComSignalInitValue=0, ComSignalType=BOOLEAN, ComHandleId=4290, ComSystemTemplateSystemSignalRef=DET_SUPER_RES_TARGET_201
            DET_CONFD_ELEVATION_204_oRDR_DETECTION_201_204_oPCAN_RADAR_759c0890_Tx: ComBitPosition=437, ComBitSize=2, ComSignalInitValue=0, ComSignalType=UINT8, ComHandleId=4234, ComSystemTemplateSystemSignalRef=DET_CONFD_ELEVATION_204
            DET_MH_CYCLE_COUNTER_201_204_oRDR_DETECTION_201_204_oPCAN_RADAR_5ae5a3e1_Tx: ComBitPosition=16, ComBitSize=8, ComSignalInitValue=0, ComSignalType=UINT8, ComHandleId=4256, ComSystemTemplateSystemSignalRef=DET_MH_CYCLE_COUNTER_201_204
            DET_RANGE_203_oRDR_DETECTION_201_204_oPCAN_RADAR_39c45372_Tx: ComBitPosition=248, ComBitSize=15, ComSignalInitValue=0, ComSignalType=UINT16, ComHandleId=4268, ComSystemTemplateSystemSignalRef=DET_RANGE_203
            DET_RANGE_204_oRDR_DETECTION_201_204_oPCAN_RADAR_6574701b_Tx: ComBitPosition=360, ComBitSize=15, ComSignalInitValue=0, ComSignalType=UINT16, ComHandleId=4269, ComSystemTemplateSystemSignalRef=DET_RANGE_204
            DET_RANGE_ERR_204_oRDR_DETECTION_201_204_oPCAN_RADAR_c29cca72_Tx: ComBitPosition=376, ComBitSize=7, ComSignalInitValue=0, ComSignalType=UINT8, ComHandleId=4273, ComSystemTemplateSystemSignalRef=DET_RANGE_ERR_204
            DET_RANGE_VELOCITY_ERR_201_oRDR_DETECTION_201_204_oPCAN_RADAR_b249c58e_Tx: ComBitPosition=64, ComBitSize=8, ComSignalInitValue=0, ComSignalType=UINT8, ComHandleId=4278, ComSystemTemplateSystemSignalRef=DET_RANGE_VELOCITY_ERR_201
            DET_CONFD_AZIMUTH_201_oRDR_DETECTION_201_204_oPCAN_RADAR_da298568_Tx: ComBitPosition=118, ComBitSize=2, ComSignalInitValue=0, ComSignalType=UINT8, ComHandleId=4227, ComSystemTemplateSystemSignalRef=DET_CONFD_AZIMUTH_201
            DET_ELEVATION_203_oRDR_DETECTION_201_204_oPCAN_RADAR_f8ecffc5_Tx: ComBitPosition=296, ComBitSize=8, ComSignalInitValue=0, ComSignalType=UINT8, ComHandleId=4237, ComSystemTemplateSystemSignalRef=DET_ELEVATION_203
            DET_CONFD_AZIMUTH_202_oRDR_DETECTION_201_204_oPCAN_RADAR_bec9fe96_Tx: ComBitPosition=230, ComBitSize=2, ComSignalInitValue=0, ComSignalType=UINT8, ComHandleId=4228, ComSystemTemplateSystemSignalRef=DET_CONFD_AZIMUTH_202
            DET_RANGE_VELOCITY_203_oRDR_DETECTION_201_204_oPCAN_RADAR_4c629157_Tx: ComBitPosition=272, ComBitSize=15, ComSignalInitValue=16384, ComSignalType=UINT16, ComHandleId=4276, ComSystemTemplateSystemSignalRef=DET_RANGE_VELOCITY_203
            DET_EXISTENCE_PROB_204_oRDR_DETECTION_201_204_oPCAN_RADAR_f1fa31b9_Tx: ComBitPosition=448, ComBitSize=6, ComSignalInitValue=0, ComSignalType=UINT8, ComHandleId=4246, ComSystemTemplateSystemSignalRef=DET_EXISTENCE_PROB_204
            DET_RANGE_VELOCITY_204_oRDR_DETECTION_201_204_oPCAN_RADAR_10d2b23e_Tx: ComBitPosition=384, ComBitSize=15, ComSignalInitValue=16384, ComSignalType=UINT16, ComHandleId=4277, ComSystemTemplateSystemSignalRef=DET_RANGE_VELOCITY_204
            DET_EXISTENCE_PROB_202_oRDR_DETECTION_201_204_oPCAN_RADAR_383ac645_Tx: ComBitPosition=224, ComBitSize=6, ComSignalInitValue=0, ComSignalType=UINT8, ComHandleId=4244, ComSystemTemplateSystemSignalRef=DET_EXISTENCE_PROB_202
            DET_RANGE_VELOCITY_ERR_204_oRDR_DETECTION_201_204_oPCAN_RADAR_1f69498c_Tx: ComBitPosition=400, ComBitSize=8, ComSignalInitValue=0, ComSignalType=UINT8, ComHandleId=4281, ComSystemTemplateSystemSignalRef=DET_RANGE_VELOCITY_ERR_204
            DET_AZIMUTH_ERR_201_oRDR_DETECTION_201_204_oPCAN_RADAR_7c7a1a57_Tx: ComBitPosition=105, ComBitSize=7, ComSignalInitValue=0, ComSignalType=UINT8, ComHandleId=4215, ComSystemTemplateSystemSignalRef=DET_AZIMUTH_ERR_201
            DET_ELEVATION_204_oRDR_DETECTION_201_204_oPCAN_RADAR_a45cdcac_Tx: ComBitPosition=408, ComBitSize=8, ComSignalInitValue=0, ComSignalType=UINT8, ComHandleId=4238, ComSystemTemplateSystemSignalRef=DET_ELEVATION_204
            DET_ELEVATION_ERR_201_oRDR_DETECTION_201_204_oPCAN_RADAR_8e45c8db_Tx: ComBitPosition=80, ComBitSize=6, ComSignalInitValue=0, ComSignalType=UINT8, ComHandleId=4239, ComSystemTemplateSystemSignalRef=DET_ELEVATION_ERR_201
            DET_RANGE_VELOCITY_202_oRDR_DETECTION_201_204_oPCAN_RADAR_d91245c2_Tx: ComBitPosition=160, ComBitSize=15, ComSignalInitValue=16384, ComSignalType=UINT16, ComHandleId=4275, ComSystemTemplateSystemSignalRef=DET_RANGE_VELOCITY_202
            DET_HVC_FLAG_202_oRDR_DETECTION_201_204_oPCAN_RADAR_d94e853a_Tx: ComBitPosition=198, ComBitSize=1, ComSignalInitValue=0, ComSignalType=BOOLEAN, ComHandleId=4248, ComSystemTemplateSystemSignalRef=DET_HVC_FLAG_202
            DET_BI_STATIC_FLAG_201_oRDR_DETECTION_201_204_oPCAN_RADAR_8ee3cf27_Tx: ComBitPosition=104, ComBitSize=1, ComSignalInitValue=0, ComSignalType=BOOLEAN, ComHandleId=4223, ComSystemTemplateSystemSignalRef=DET_BI_STATIC_FLAG_201
            DET_CONFD_ELEVATION_203_oRDR_DETECTION_201_204_oPCAN_RADAR_292c2bf9_Tx: ComBitPosition=325, ComBitSize=2, ComSignalInitValue=0, ComSignalType=UINT8, ComHandleId=4233, ComSystemTemplateSystemSignalRef=DET_CONFD_ELEVATION_203
            DET_SUPER_RES_TARGET_202_oRDR_DETECTION_201_204_oPCAN_RADAR_b2a50eff_Tx: ComBitPosition=199, ComBitSize=1, ComSignalInitValue=0, ComSignalType=BOOLEAN, ComHandleId=4291, ComSystemTemplateSystemSignalRef=DET_SUPER_RES_TARGET_202
            DET_AZIMUTH_ERR_204_oRDR_DETECTION_201_204_oPCAN_RADAR_d15a9655_Tx: ComBitPosition=441, ComBitSize=7, ComSignalInitValue=0, ComSignalType=UINT8, ComHandleId=4218, ComSystemTemplateSystemSignalRef=DET_AZIMUTH_ERR_204
            DET_SNR_204_oRDR_DETECTION_201_204_oPCAN_RADAR_4afcd166_Tx: ComBitPosition=456, ComBitSize=8, ComSignalInitValue=0, ComSignalType=UINT8, ComHandleId=4289, ComSystemTemplateSystemSignalRef=DET_SNR_204
            DET_BI_STATIC_FLAG_202_oRDR_DETECTION_201_204_oPCAN_RADAR_ea03b4d9_Tx: ComBitPosition=216, ComBitSize=1, ComSignalInitValue=0, ComSignalType=BOOLEAN, ComHandleId=4224, ComSystemTemplateSystemSignalRef=DET_BI_STATIC_FLAG_202
            DET_SUPER_RES_TARGET_203_oRDR_DETECTION_201_204_oPCAN_RADAR_27d5da6a_Tx: ComBitPosition=311, ComBitSize=1, ComSignalInitValue=0, ComSignalType=BOOLEAN, ComHandleId=4292, ComSystemTemplateSystemSignalRef=DET_SUPER_RES_TARGET_203
            DET_RCS_204_oRDR_DETECTION_201_204_oPCAN_RADAR_97528564_Tx: ComBitPosition=464, ComBitSize=8, ComSignalInitValue=128, ComSignalType=UINT8, ComHandleId=4285, ComSystemTemplateSystemSignalRef=DET_RCS_204
            DET_EXISTENCE_PROB_203_oRDR_DETECTION_201_204_oPCAN_RADAR_ad4a12d0_Tx: ComBitPosition=336, ComBitSize=6, ComSignalInitValue=0, ComSignalType=UINT8, ComHandleId=4245, ComSystemTemplateSystemSignalRef=DET_EXISTENCE_PROB_203
            DET_RANGE_ERR_203_oRDR_DETECTION_201_204_oPCAN_RADAR_9e2ce91b_Tx: ComBitPosition=264, ComBitSize=7, ComSignalInitValue=0, ComSignalType=UINT8, ComHandleId=4272, ComSystemTemplateSystemSignalRef=DET_RANGE_ERR_203
            DET_RCS_202_oRDR_DETECTION_201_204_oPCAN_RADAR_5e927298_Tx: ComBitPosition=240, ComBitSize=8, ComSignalInitValue=128, ComSignalType=UINT8, ComHandleId=4283, ComSystemTemplateSystemSignalRef=DET_RCS_202
            DET_RCS_201_oRDR_DETECTION_201_204_oPCAN_RADAR_3a720966_Tx: ComBitPosition=128, ComBitSize=8, ComSignalInitValue=128, ComSignalType=UINT8, ComHandleId=4282, ComSystemTemplateSystemSignalRef=DET_RCS_201
            DET_HVC_FLAG_203_oRDR_DETECTION_201_204_oPCAN_RADAR_4c3e51af_Tx: ComBitPosition=310, ComBitSize=1, ComSignalInitValue=0, ComSignalType=BOOLEAN, ComHandleId=4249, ComSystemTemplateSystemSignalRef=DET_HVC_FLAG_203
            DET_AZIMUTH_203_oRDR_DETECTION_201_204_oPCAN_RADAR_295f20c9_Tx: ComBitPosition=312, ComBitSize=13, ComSignalInitValue=0, ComSignalType=UINT16, ComHandleId=4213, ComSystemTemplateSystemSignalRef=DET_AZIMUTH_203
            DET_BI_STATIC_FLAG_204_oRDR_DETECTION_201_204_oPCAN_RADAR_23c34325_Tx: ComBitPosition=440, ComBitSize=1, ComSignalInitValue=0, ComSignalType=BOOLEAN, ComHandleId=4226, ComSystemTemplateSystemSignalRef=DET_BI_STATIC_FLAG_204
            DET_AZIMUTH_ERR_202_oRDR_DETECTION_201_204_oPCAN_RADAR_189a61a9_Tx: ComBitPosition=217, ComBitSize=7, ComSignalInitValue=0, ComSignalType=UINT8, ComHandleId=4216, ComSystemTemplateSystemSignalRef=DET_AZIMUTH_ERR_202
            DET_SNR_203_oRDR_DETECTION_201_204_oPCAN_RADAR_164cf20f_Tx: ComBitPosition=344, ComBitSize=8, ComSignalInitValue=0, ComSignalType=UINT8, ComHandleId=4288, ComSystemTemplateSystemSignalRef=DET_SNR_203
            DET_AZIMUTH_204_oRDR_DETECTION_201_204_oPCAN_RADAR_75ef03a0_Tx: ComBitPosition=424, ComBitSize=13, ComSignalInitValue=0, ComSignalType=UINT16, ComHandleId=4214, ComSystemTemplateSystemSignalRef=DET_AZIMUTH_204
            DET_AZIMUTH_202_oRDR_DETECTION_201_204_oPCAN_RADAR_bc2ff45c_Tx: ComBitPosition=200, ComBitSize=13, ComSignalInitValue=0, ComSignalType=UINT16, ComHandleId=4212, ComSystemTemplateSystemSignalRef=DET_AZIMUTH_202
            DET_AZIMUTH_201_oRDR_DETECTION_201_204_oPCAN_RADAR_d8cf8fa2_Tx: ComBitPosition=88, ComBitSize=13, ComSignalInitValue=0, ComSignalType=UINT16, ComHandleId=4211, ComSystemTemplateSystemSignalRef=DET_AZIMUTH_201
            DET_RANGE_VELOCITY_ERR_203_oRDR_DETECTION_201_204_oPCAN_RADAR_43d96ae5_Tx: ComBitPosition=288, ComBitSize=8, ComSignalInitValue=0, ComSignalType=UINT8, ComHandleId=4280, ComSystemTemplateSystemSignalRef=DET_RANGE_VELOCITY_ERR_203
            DET_CONFD_AZIMUTH_203_oRDR_DETECTION_201_204_oPCAN_RADAR_2bb92a03_Tx: ComBitPosition=342, ComBitSize=2, ComSignalInitValue=0, ComSignalType=UINT8, ComHandleId=4229, ComSystemTemplateSystemSignalRef=DET_CONFD_AZIMUTH_203
            DET_RANGE_VELOCITY_201_oRDR_DETECTION_201_204_oPCAN_RADAR_bdf23e3c_Tx: ComBitPosition=48, ComBitSize=15, ComSignalInitValue=16384, ComSignalType=UINT16, ComHandleId=4274, ComSystemTemplateSystemSignalRef=DET_RANGE_VELOCITY_201
            DET_ELEVATION_201_oRDR_DETECTION_201_204_oPCAN_RADAR_097c50ae_Tx: ComBitPosition=72, ComBitSize=8, ComSignalInitValue=0, ComSignalType=UINT8, ComHandleId=4235, ComSystemTemplateSystemSignalRef=DET_ELEVATION_201
            DET_CONFD_ELEVATION_202_oRDR_DETECTION_201_204_oPCAN_RADAR_bc5cff6c_Tx: ComBitPosition=213, ComBitSize=2, ComSignalInitValue=0, ComSignalType=UINT8, ComHandleId=4232, ComSystemTemplateSystemSignalRef=DET_CONFD_ELEVATION_202
            DET_SNR_202_oRDR_DETECTION_201_204_oPCAN_RADAR_833c269a_Tx: ComBitPosition=232, ComBitSize=8, ComSignalInitValue=0, ComSignalType=UINT8, ComHandleId=4287, ComSystemTemplateSystemSignalRef=DET_SNR_202
            DET_BI_STATIC_FLAG_203_oRDR_DETECTION_201_204_oPCAN_RADAR_7f73604c_Tx: ComBitPosition=328, ComBitSize=1, ComSignalInitValue=0, ComSignalType=BOOLEAN, ComHandleId=4225, ComSystemTemplateSystemSignalRef=DET_BI_STATIC_FLAG_203
            DET_RANGE_ERR_201_oRDR_DETECTION_201_204_oPCAN_RADAR_6fbc4670_Tx: ComBitPosition=40, ComBitSize=7, ComSignalInitValue=0, ComSignalType=UINT8, ComHandleId=4270, ComSystemTemplateSystemSignalRef=DET_RANGE_ERR_201
            DET_BELOW_RAIN_THOLD_204_oRDR_DETECTION_201_204_oPCAN_RADAR_a0ee9060_Tx: ComBitPosition=375, ComBitSize=1, ComSignalInitValue=0, ComSignalType=UINT8, ComHandleId=4222, ComSystemTemplateSystemSignalRef=DET_BELOW_RAIN_THOLD_204
            DET_BELOW_RAIN_THOLD_201_oRDR_DETECTION_201_204_oPCAN_RADAR_0dce1c62_Tx: ComBitPosition=39, ComBitSize=1, ComSignalInitValue=0, ComSignalType=UINT8, ComHandleId=4219, ComSystemTemplateSystemSignalRef=DET_BELOW_RAIN_THOLD_201
            DET_PROB_1STAZHYPO_201_oRDR_DETECTION_201_204_oPCAN_RADAR_c3fb1f6f_Tx: ComBitPosition=103, ComBitSize=1, ComSignalInitValue=0, ComSignalType=BOOLEAN, ComHandleId=4262, ComSystemTemplateSystemSignalRef=DET_PROB_1STAZHYPO_201
            DET_PROB_1STAZHYPO_204_oRDR_DETECTION_201_204_oPCAN_RADAR_6edb936d_Tx: ComBitPosition=439, ComBitSize=1, ComSignalInitValue=0, ComSignalType=BOOLEAN, ComHandleId=4265, ComSystemTemplateSystemSignalRef=DET_PROB_1STAZHYPO_204
            DET_MTD_201_oRDR_DETECTION_201_204_oPCAN_RADAR_504ff7a2_Tx: ComBitPosition=47, ComBitSize=1, ComSignalInitValue=0, ComSignalType=UINT8, ComHandleId=4258, ComSystemTemplateSystemSignalRef=DET_MTD_201
            DET_PROB_1STAZHYPO_202_oRDR_DETECTION_201_204_oPCAN_RADAR_a71b6491_Tx: ComBitPosition=215, ComBitSize=1, ComSignalInitValue=0, ComSignalType=BOOLEAN, ComHandleId=4263, ComSystemTemplateSystemSignalRef=DET_PROB_1STAZHYPO_202
            DET_IDM_204_oRDR_DETECTION_201_204_oPCAN_RADAR_9bdc497b_Tx: ComBitPosition=399, ComBitSize=1, ComSignalInitValue=0, ComSignalType=UINT8, ComHandleId=4254, ComSystemTemplateSystemSignalRef=DET_IDM_204
            DET_BELOW_RAIN_THOLD_202_oRDR_DETECTION_201_204_oPCAN_RADAR_692e679c_Tx: ComBitPosition=151, ComBitSize=1, ComSignalInitValue=0, ComSignalType=UINT8, ComHandleId=4220, ComSystemTemplateSystemSignalRef=DET_BELOW_RAIN_THOLD_202
            DET_IDM_201_oRDR_DETECTION_201_204_oPCAN_RADAR_36fcc579_Tx: ComBitPosition=63, ComBitSize=1, ComSignalInitValue=0, ComSignalType=UINT8, ComHandleId=4251, ComSystemTemplateSystemSignalRef=DET_IDM_201
            DET_IDM_202_oRDR_DETECTION_201_204_oPCAN_RADAR_521cbe87_Tx: ComBitPosition=175, ComBitSize=1, ComSignalInitValue=0, ComSignalType=UINT8, ComHandleId=4252, ComSystemTemplateSystemSignalRef=DET_IDM_202
            DET_MTD_204_oRDR_DETECTION_201_204_oPCAN_RADAR_fd6f7ba0_Tx: ComBitPosition=383, ComBitSize=1, ComSignalInitValue=0, ComSignalType=UINT8, ComHandleId=4261, ComSystemTemplateSystemSignalRef=DET_MTD_204
            DET_IDM_203_oRDR_DETECTION_201_204_oPCAN_RADAR_c76c6a12_Tx: ComBitPosition=287, ComBitSize=1, ComSignalInitValue=0, ComSignalType=UINT8, ComHandleId=4253, ComSystemTemplateSystemSignalRef=DET_IDM_203
            DET_MTD_203_oRDR_DETECTION_201_204_oPCAN_RADAR_a1df58c9_Tx: ComBitPosition=271, ComBitSize=1, ComSignalInitValue=0, ComSignalType=UINT8, ComHandleId=4260, ComSystemTemplateSystemSignalRef=DET_MTD_203
            DET_PROB_1STAZHYPO_203_oRDR_DETECTION_201_204_oPCAN_RADAR_326bb004_Tx: ComBitPosition=327, ComBitSize=1, ComSignalInitValue=0, ComSignalType=BOOLEAN, ComHandleId=4264, ComSystemTemplateSystemSignalRef=DET_PROB_1STAZHYPO_203
            DET_MTD_202_oRDR_DETECTION_201_204_oPCAN_RADAR_34af8c5c_Tx: ComBitPosition=159, ComBitSize=1, ComSignalInitValue=0, ComSignalType=UINT8, ComHandleId=4259, ComSystemTemplateSystemSignalRef=DET_MTD_202
            DET_BELOW_RAIN_THOLD_203_oRDR_DETECTION_201_204_oPCAN_RADAR_fc5eb309_Tx: ComBitPosition=263, ComBitSize=1, ComSignalInitValue=0, ComSignalType=UINT8, ComHandleId=4221, ComSystemTemplateSystemSignalRef=DET_BELOW_RAIN_THOLD_203
        SG_Detections_109_112_oRDR_DETECTION_109_112_oPCAN_RADAR_7559a730_Tx: ComTransferProperty=TRIGGERED, ComHandleId=29, ComSystemTemplateSignalGroupRef=SG_Detections_109_112
          83 x ComGroupSignal, all with ComSignalEndianness=LITTLE_ENDIAN, ComTransferProperty=PENDING, ComSignalAccess=ACCESS_NEEDED_BY_SWC_OR_COM:
            DET_RANGE_VELOCITY_ERR_112_oRDR_DETECTION_109_112_oPCAN_RADAR_726034ed_Tx: ComBitPosition=400, ComBitSize=8, ComSignalInitValue=0, ComSignalType=UINT8, ComHandleId=2372, ComSystemTemplateSystemSignalRef=DET_RANGE_VELOCITY_ERR_112
            DET_AZIMUTH_ERR_112_oRDR_DETECTION_109_112_oPCAN_RADAR_bc53eb34_Tx: ComBitPosition=441, ComBitSize=7, ComSignalInitValue=0, ComSignalType=UINT8, ComHandleId=2309, ComSystemTemplateSystemSignalRef=DET_AZIMUTH_ERR_112
            DET_RANGE_ERR_109_oRDR_DETECTION_109_112_oPCAN_RADAR_3b256adc_Tx: ComBitPosition=40, ComBitSize=7, ComSignalInitValue=0, ComSignalType=UINT8, ComHandleId=2361, ComSystemTemplateSystemSignalRef=DET_RANGE_ERR_109
            DET_RCS_109_oRDR_DETECTION_109_112_oPCAN_RADAR_6eeb25ca_Tx: ComBitPosition=128, ComBitSize=8, ComSignalInitValue=128, ComSignalType=UINT8, ComHandleId=2373, ComSystemTemplateSystemSignalRef=DET_RCS_109
            DET_SNR_112_oRDR_DETECTION_109_112_oPCAN_RADAR_27f5ac07_Tx: ComBitPosition=456, ComBitSize=8, ComSignalInitValue=0, ComSignalType=UINT8, ComHandleId=2380, ComSystemTemplateSystemSignalRef=DET_SNR_112
            DET_SUPER_RES_TARGET_112_oRDR_DETECTION_109_112_oPCAN_RADAR_166c8462_Tx: ComBitPosition=423, ComBitSize=1, ComSignalInitValue=0, ComSignalType=BOOLEAN, ComHandleId=2384, ComSystemTemplateSystemSignalRef=DET_SUPER_RES_TARGET_112
            DET_MH_SCAN_INDEX_4LSB_109_112_oRDR_DETECTION_109_112_oPCAN_RADAR_b98ef180_Tx: ComBitPosition=476, ComBitSize=4, ComSignalInitValue=0, ComSignalType=UINT8, ComHandleId=2348, ComSystemTemplateSystemSignalRef=DET_MH_SCAN_INDEX_4LSB_109_112
            DET_RCS_112_oRDR_DETECTION_109_112_oPCAN_RADAR_fa5bf805_Tx: ComBitPosition=464, ComBitSize=8, ComSignalInitValue=128, ComSignalType=UINT8, ComHandleId=2376, ComSystemTemplateSystemSignalRef=DET_RCS_112
            DET_HVC_FLAG_111_oRDR_DETECTION_109_112_oPCAN_RADAR_19677459_Tx: ComBitPosition=310, ComBitSize=1, ComSignalInitValue=0, ComSignalType=BOOLEAN, ComHandleId=2340, ComSystemTemplateSystemSignalRef=DET_HVC_FLAG_111
            DET_RANGE_111_oRDR_DETECTION_109_112_oPCAN_RADAR_6c9d7684_Tx: ComBitPosition=248, ComBitSize=15, ComSignalInitValue=0, ComSignalType=UINT16, ComHandleId=2359, ComSystemTemplateSystemSignalRef=DET_RANGE_111
            DET_CONFD_AZIMUTH_109_oRDR_DETECTION_109_112_oPCAN_RADAR_8eb0a9c4_Tx: ComBitPosition=118, ComBitSize=2, ComSignalInitValue=0, ComSignalType=UINT8, ComHandleId=2318, ComSystemTemplateSystemSignalRef=DET_CONFD_AZIMUTH_109
            DET_CONFD_AZIMUTH_112_oRDR_DETECTION_109_112_oPCAN_RADAR_1a00740b_Tx: ComBitPosition=454, ComBitSize=2, ComSignalInitValue=0, ComSignalType=UINT8, ComHandleId=2321, ComSystemTemplateSystemSignalRef=DET_CONFD_AZIMUTH_112
            DET_RANGE_VELOCITY_112_oRDR_DETECTION_109_112_oPCAN_RADAR_7ddbcf5f_Tx: ComBitPosition=384, ComBitSize=15, ComSignalInitValue=16384, ComSignalType=UINT16, ComHandleId=2368, ComSystemTemplateSystemSignalRef=DET_RANGE_VELOCITY_112
            DET_SUPER_RES_TARGET_109_oRDR_DETECTION_109_112_oPCAN_RADAR_82dc59ad_Tx: ComBitPosition=87, ComBitSize=1, ComSignalInitValue=0, ComSignalType=BOOLEAN, ComHandleId=2381, ComSystemTemplateSystemSignalRef=DET_SUPER_RES_TARGET_109
            DET_RANGE_VELOCITY_109_oRDR_DETECTION_109_112_oPCAN_RADAR_e96b1290_Tx: ComBitPosition=48, ComBitSize=15, ComSignalInitValue=16384, ComSignalType=UINT16, ComHandleId=2365, ComSystemTemplateSystemSignalRef=DET_RANGE_VELOCITY_109
            DET_AZIMUTH_109_oRDR_DETECTION_109_112_oPCAN_RADAR_8c56a30e_Tx: ComBitPosition=88, ComBitSize=13, ComSignalInitValue=0, ComSignalType=UINT16, ComHandleId=2302, ComSystemTemplateSystemSignalRef=DET_AZIMUTH_109
            DET_RANGE_ERR_112_oRDR_DETECTION_109_112_oPCAN_RADAR_af95b713_Tx: ComBitPosition=376, ComBitSize=7, ComSignalInitValue=0, ComSignalType=UINT8, ComHandleId=2364, ComSystemTemplateSystemSignalRef=DET_RANGE_ERR_112
            DET_CONFD_ELEVATION_111_oRDR_DETECTION_109_112_oPCAN_RADAR_7c750e0f_Tx: ComBitPosition=325, ComBitSize=2, ComSignalInitValue=0, ComSignalType=UINT8, ComHandleId=2324, ComSystemTemplateSystemSignalRef=DET_CONFD_ELEVATION_111
            DET_ELEVATION_ERR_112_oRDR_DETECTION_109_112_oPCAN_RADAR_4e6c39b8_Tx: ComBitPosition=416, ComBitSize=6, ComSignalInitValue=0, ComSignalType=UINT8, ComHandleId=2333, ComSystemTemplateSystemSignalRef=DET_ELEVATION_ERR_112
            DET_MH_CRC16_109_112_oRDR_DETECTION_109_112_oPCAN_RADAR_f1d1753b_Tx: ComBitPosition=0, ComBitSize=16, ComSignalInitValue=0, ComSignalType=UINT16, ComHandleId=2346, ComSystemTemplateSystemSignalRef=DET_MH_CRC16_109_112
            DET_RANGE_110_oRDR_DETECTION_109_112_oPCAN_RADAR_f9eda211_Tx: ComBitPosition=136, ComBitSize=15, ComSignalInitValue=0, ComSignalType=UINT16, ComHandleId=2358, ComSystemTemplateSystemSignalRef=DET_RANGE_110
            DET_RANGE_112_oRDR_DETECTION_109_112_oPCAN_RADAR_087d0d7a_Tx: ComBitPosition=360, ComBitSize=15, ComSignalInitValue=0, ComSignalType=UINT16, ComHandleId=2360, ComSystemTemplateSystemSignalRef=DET_RANGE_112
            DET_ELEVATION_ERR_110_oRDR_DETECTION_109_112_oPCAN_RADAR_bffc96d3_Tx: ComBitPosition=192, ComBitSize=6, ComSignalInitValue=0, ComSignalType=UINT8, ComHandleId=2331, ComSystemTemplateSystemSignalRef=DET_ELEVATION_ERR_110
            DET_RANGE_VELOCITY_111_oRDR_DETECTION_109_112_oPCAN_RADAR_193bb4a1_Tx: ComBitPosition=272, ComBitSize=15, ComSignalInitValue=16384, ComSignalType=UINT16, ComHandleId=2367, ComSystemTemplateSystemSignalRef=DET_RANGE_VELOCITY_111
            DET_EXISTENCE_PROB_109_oRDR_DETECTION_109_112_oPCAN_RADAR_08439117_Tx: ComBitPosition=112, ComBitSize=6, ComSignalInitValue=0, ComSignalType=UINT8, ComHandleId=2334, ComSystemTemplateSystemSignalRef=DET_EXISTENCE_PROB_109
            DET_RANGE_109_oRDR_DETECTION_109_112_oPCAN_RADAR_9ccdd0b5_Tx: ComBitPosition=24, ComBitSize=15, ComSignalInitValue=0, ComSignalType=UINT16, ComHandleId=2357, ComSystemTemplateSystemSignalRef=DET_RANGE_109
            DET_RANGE_VELOCITY_ERR_109_oRDR_DETECTION_109_112_oPCAN_RADAR_e6d0e922_Tx: ComBitPosition=64, ComBitSize=8, ComSignalInitValue=0, ComSignalType=UINT8, ComHandleId=2369, ComSystemTemplateSystemSignalRef=DET_RANGE_VELOCITY_ERR_109
            DET_BI_STATIC_FLAG_110_oRDR_DETECTION_109_112_oPCAN_RADAR_bf5a912f_Tx: ComBitPosition=216, ComBitSize=1, ComSignalInitValue=0, ComSignalType=BOOLEAN, ComHandleId=2315, ComSystemTemplateSystemSignalRef=DET_BI_STATIC_FLAG_110
            DET_SUPER_RES_TARGET_110_oRDR_DETECTION_109_112_oPCAN_RADAR_e7fc2b09_Tx: ComBitPosition=199, ComBitSize=1, ComSignalInitValue=0, ComSignalType=BOOLEAN, ComHandleId=2382, ComSystemTemplateSystemSignalRef=DET_SUPER_RES_TARGET_110
            DET_CONFD_ELEVATION_110_oRDR_DETECTION_109_112_oPCAN_RADAR_e905da9a_Tx: ComBitPosition=213, ComBitSize=2, ComSignalInitValue=0, ComSignalType=UINT8, ComHandleId=2323, ComSystemTemplateSystemSignalRef=DET_CONFD_ELEVATION_110
            DET_ELEVATION_109_oRDR_DETECTION_109_112_oPCAN_RADAR_5de57c02_Tx: ComBitPosition=72, ComBitSize=8, ComSignalInitValue=0, ComSignalType=UINT8, ComHandleId=2326, ComSystemTemplateSystemSignalRef=DET_ELEVATION_109
            DET_CONFD_AZIMUTH_111_oRDR_DETECTION_109_112_oPCAN_RADAR_7ee00ff5_Tx: ComBitPosition=342, ComBitSize=2, ComSignalInitValue=0, ComSignalType=UINT8, ComHandleId=2320, ComSystemTemplateSystemSignalRef=DET_CONFD_AZIMUTH_111
            DET_RCS_110_oRDR_DETECTION_109_112_oPCAN_RADAR_0bcb576e_Tx: ComBitPosition=240, ComBitSize=8, ComSignalInitValue=128, ComSignalType=UINT8, ComHandleId=2374, ComSystemTemplateSystemSignalRef=DET_RCS_110
            DET_SUPER_RES_TARGET_111_oRDR_DETECTION_109_112_oPCAN_RADAR_728cff9c_Tx: ComBitPosition=311, ComBitSize=1, ComSignalInitValue=0, ComSignalType=BOOLEAN, ComHandleId=2383, ComSystemTemplateSystemSignalRef=DET_SUPER_RES_TARGET_111
            DET_AZIMUTH_ERR_111_oRDR_DETECTION_109_112_oPCAN_RADAR_d8b390ca_Tx: ComBitPosition=329, ComBitSize=7, ComSignalInitValue=0, ComSignalType=UINT8, ComHandleId=2308, ComSystemTemplateSystemSignalRef=DET_AZIMUTH_ERR_111
            DET_BI_STATIC_FLAG_109_oRDR_DETECTION_109_112_oPCAN_RADAR_da7ae38b_Tx: ComBitPosition=104, ComBitSize=1, ComSignalInitValue=0, ComSignalType=BOOLEAN, ComHandleId=2314, ComSystemTemplateSystemSignalRef=DET_BI_STATIC_FLAG_109
            DET_MH_CYCLE_COUNTER_109_112_oRDR_DETECTION_109_112_oPCAN_RADAR_75a4d40c_Tx: ComBitPosition=16, ComBitSize=8, ComSignalInitValue=0, ComSignalType=UINT8, ComHandleId=2347, ComSystemTemplateSystemSignalRef=DET_MH_CYCLE_COUNTER_109_112
            DET_HVC_FLAG_112_oRDR_DETECTION_109_112_oPCAN_RADAR_7d870fa7_Tx: ComBitPosition=422, ComBitSize=1, ComSignalInitValue=0, ComSignalType=BOOLEAN, ComHandleId=2341, ComSystemTemplateSystemSignalRef=DET_HVC_FLAG_112
            DET_CONFD_AZIMUTH_110_oRDR_DETECTION_109_112_oPCAN_RADAR_eb90db60_Tx: ComBitPosition=230, ComBitSize=2, ComSignalInitValue=0, ComSignalType=UINT8, ComHandleId=2319, ComSystemTemplateSystemSignalRef=DET_CONFD_AZIMUTH_110
            DET_ELEVATION_111_oRDR_DETECTION_109_112_oPCAN_RADAR_adb5da33_Tx: ComBitPosition=296, ComBitSize=8, ComSignalInitValue=0, ComSignalType=UINT8, ComHandleId=2328, ComSystemTemplateSystemSignalRef=DET_ELEVATION_111
            DET_RANGE_VELOCITY_110_oRDR_DETECTION_109_112_oPCAN_RADAR_8c4b6034_Tx: ComBitPosition=160, ComBitSize=15, ComSignalInitValue=16384, ComSignalType=UINT16, ComHandleId=2366, ComSystemTemplateSystemSignalRef=DET_RANGE_VELOCITY_110
            DET_ELEVATION_112_oRDR_DETECTION_109_112_oPCAN_RADAR_c955a1cd_Tx: ComBitPosition=408, ComBitSize=8, ComSignalInitValue=0, ComSignalType=UINT8, ComHandleId=2329, ComSystemTemplateSystemSignalRef=DET_ELEVATION_112
            DET_AZIMUTH_ERR_109_oRDR_DETECTION_109_112_oPCAN_RADAR_28e336fb_Tx: ComBitPosition=105, ComBitSize=7, ComSignalInitValue=0, ComSignalType=UINT8, ComHandleId=2306, ComSystemTemplateSystemSignalRef=DET_AZIMUTH_ERR_109
            DET_RCS_111_oRDR_DETECTION_109_112_oPCAN_RADAR_9ebb83fb_Tx: ComBitPosition=352, ComBitSize=8, ComSignalInitValue=128, ComSignalType=UINT8, ComHandleId=2375, ComSystemTemplateSystemSignalRef=DET_RCS_111
            DET_ELEVATION_ERR_111_oRDR_DETECTION_109_112_oPCAN_RADAR_2a8c4246_Tx: ComBitPosition=304, ComBitSize=6, ComSignalInitValue=0, ComSignalType=UINT8, ComHandleId=2332, ComSystemTemplateSystemSignalRef=DET_ELEVATION_ERR_111
            DET_EXISTENCE_PROB_111_oRDR_DETECTION_109_112_oPCAN_RADAR_f8133726_Tx: ComBitPosition=336, ComBitSize=6, ComSignalInitValue=0, ComSignalType=UINT8, ComHandleId=2336, ComSystemTemplateSystemSignalRef=DET_EXISTENCE_PROB_111
            DET_ELEVATION_ERR_109_oRDR_DETECTION_109_112_oPCAN_RADAR_dadce477_Tx: ComBitPosition=80, ComBitSize=6, ComSignalInitValue=0, ComSignalType=UINT8, ComHandleId=2330, ComSystemTemplateSystemSignalRef=DET_ELEVATION_ERR_109
            DET_SNR_110_oRDR_DETECTION_109_112_oPCAN_RADAR_d665036c_Tx: ComBitPosition=232, ComBitSize=8, ComSignalInitValue=0, ComSignalType=UINT8, ComHandleId=2378, ComSystemTemplateSystemSignalRef=DET_SNR_110
            DET_EXISTENCE_PROB_110_oRDR_DETECTION_109_112_oPCAN_RADAR_6d63e3b3_Tx: ComBitPosition=224, ComBitSize=6, ComSignalInitValue=0, ComSignalType=UINT8, ComHandleId=2335, ComSystemTemplateSystemSignalRef=DET_EXISTENCE_PROB_110
            DET_CONFD_ELEVATION_112_oRDR_DETECTION_109_112_oPCAN_RADAR_189575f1_Tx: ComBitPosition=437, ComBitSize=2, ComSignalInitValue=0, ComSignalType=UINT8, ComHandleId=2325, ComSystemTemplateSystemSignalRef=DET_CONFD_ELEVATION_112
            DET_RANGE_ERR_111_oRDR_DETECTION_109_112_oPCAN_RADAR_cb75cced_Tx: ComBitPosition=264, ComBitSize=7, ComSignalInitValue=0, ComSignalType=UINT8, ComHandleId=2363, ComSystemTemplateSystemSignalRef=DET_RANGE_ERR_111
            DET_SNR_109_oRDR_DETECTION_109_112_oPCAN_RADAR_b34571c8_Tx: ComBitPosition=120, ComBitSize=8, ComSignalInitValue=0, ComSignalType=UINT8, ComHandleId=2377, ComSystemTemplateSystemSignalRef=DET_SNR_109
            DET_EXISTENCE_PROB_112_oRDR_DETECTION_109_112_oPCAN_RADAR_9cf34cd8_Tx: ComBitPosition=448, ComBitSize=6, ComSignalInitValue=0, ComSignalType=UINT8, ComHandleId=2337, ComSystemTemplateSystemSignalRef=DET_EXISTENCE_PROB_112
            DET_AZIMUTH_110_oRDR_DETECTION_109_112_oPCAN_RADAR_e976d1aa_Tx: ComBitPosition=200, ComBitSize=13, ComSignalInitValue=0, ComSignalType=UINT16, ComHandleId=2303, ComSystemTemplateSystemSignalRef=DET_AZIMUTH_110
            DET_HVC_FLAG_109_oRDR_DETECTION_109_112_oPCAN_RADAR_e937d268_Tx: ComBitPosition=86, ComBitSize=1, ComSignalInitValue=0, ComSignalType=BOOLEAN, ComHandleId=2338, ComSystemTemplateSystemSignalRef=DET_HVC_FLAG_109
            DET_RANGE_VELOCITY_ERR_110_oRDR_DETECTION_109_112_oPCAN_RADAR_83f09b86_Tx: ComBitPosition=176, ComBitSize=8, ComSignalInitValue=0, ComSignalType=UINT8, ComHandleId=2370, ComSystemTemplateSystemSignalRef=DET_RANGE_VELOCITY_ERR_110
            DET_AZIMUTH_ERR_110_oRDR_DETECTION_109_112_oPCAN_RADAR_4dc3445f_Tx: ComBitPosition=217, ComBitSize=7, ComSignalInitValue=0, ComSignalType=UINT8, ComHandleId=2307, ComSystemTemplateSystemSignalRef=DET_AZIMUTH_ERR_110
            DET_AZIMUTH_111_oRDR_DETECTION_109_112_oPCAN_RADAR_7c06053f_Tx: ComBitPosition=312, ComBitSize=13, ComSignalInitValue=0, ComSignalType=UINT16, ComHandleId=2304, ComSystemTemplateSystemSignalRef=DET_AZIMUTH_111
            DET_HVC_FLAG_110_oRDR_DETECTION_109_112_oPCAN_RADAR_8c17a0cc_Tx: ComBitPosition=198, ComBitSize=1, ComSignalInitValue=0, ComSignalType=BOOLEAN, ComHandleId=2339, ComSystemTemplateSystemSignalRef=DET_HVC_FLAG_110
            DET_AZIMUTH_112_oRDR_DETECTION_109_112_oPCAN_RADAR_18e67ec1_Tx: ComBitPosition=424, ComBitSize=13, ComSignalInitValue=0, ComSignalType=UINT16, ComHandleId=2305, ComSystemTemplateSystemSignalRef=DET_AZIMUTH_112
            DET_BI_STATIC_FLAG_112_oRDR_DETECTION_109_112_oPCAN_RADAR_4eca3e44_Tx: ComBitPosition=440, ComBitSize=1, ComSignalInitValue=0, ComSignalType=BOOLEAN, ComHandleId=2317, ComSystemTemplateSystemSignalRef=DET_BI_STATIC_FLAG_112
            DET_CONFD_ELEVATION_109_oRDR_DETECTION_109_112_oPCAN_RADAR_8c25a83e_Tx: ComBitPosition=101, ComBitSize=2, ComSignalInitValue=0, ComSignalType=UINT8, ComHandleId=2322, ComSystemTemplateSystemSignalRef=DET_CONFD_ELEVATION_109
            DET_RANGE_VELOCITY_ERR_111_oRDR_DETECTION_109_112_oPCAN_RADAR_16804f13_Tx: ComBitPosition=288, ComBitSize=8, ComSignalInitValue=0, ComSignalType=UINT8, ComHandleId=2371, ComSystemTemplateSystemSignalRef=DET_RANGE_VELOCITY_ERR_111
            DET_SNR_111_oRDR_DETECTION_109_112_oPCAN_RADAR_4315d7f9_Tx: ComBitPosition=344, ComBitSize=8, ComSignalInitValue=0, ComSignalType=UINT8, ComHandleId=2379, ComSystemTemplateSystemSignalRef=DET_SNR_111
            DET_ELEVATION_110_oRDR_DETECTION_109_112_oPCAN_RADAR_38c50ea6_Tx: ComBitPosition=184, ComBitSize=8, ComSignalInitValue=0, ComSignalType=UINT8, ComHandleId=2327, ComSystemTemplateSystemSignalRef=DET_ELEVATION_110
            DET_BI_STATIC_FLAG_111_oRDR_DETECTION_109_112_oPCAN_RADAR_2a2a45ba_Tx: ComBitPosition=328, ComBitSize=1, ComSignalInitValue=0, ComSignalType=BOOLEAN, ComHandleId=2316, ComSystemTemplateSystemSignalRef=DET_BI_STATIC_FLAG_111
            DET_RANGE_ERR_110_oRDR_DETECTION_109_112_oPCAN_RADAR_5e051878_Tx: ComBitPosition=152, ComBitSize=7, ComSignalInitValue=0, ComSignalType=UINT8, ComHandleId=2362, ComSystemTemplateSystemSignalRef=DET_RANGE_ERR_110
            DET_BELOW_RAIN_THOLD_111_oRDR_DETECTION_109_112_oPCAN_RADAR_a90796ff_Tx: ComBitPosition=263, ComBitSize=1, ComSignalInitValue=0, ComSignalType=UINT8, ComHandleId=2312, ComSystemTemplateSystemSignalRef=DET_BELOW_RAIN_THOLD_111
            DET_IDM_112_oRDR_DETECTION_109_112_oPCAN_RADAR_f6d5341a_Tx: ComBitPosition=399, ComBitSize=1, ComSignalInitValue=0, ComSignalType=UINT8, ComHandleId=2345, ComSystemTemplateSystemSignalRef=DET_IDM_112
            DET_PROB_1STAZHYPO_110_oRDR_DETECTION_109_112_oPCAN_RADAR_f2424167_Tx: ComBitPosition=215, ComBitSize=1, ComSignalInitValue=0, ComSignalType=BOOLEAN, ComHandleId=2354, ComSystemTemplateSystemSignalRef=DET_PROB_1STAZHYPO_110
            DET_PROB_1STAZHYPO_112_oRDR_DETECTION_109_112_oPCAN_RADAR_03d2ee0c_Tx: ComBitPosition=439, ComBitSize=1, ComSignalInitValue=0, ComSignalType=BOOLEAN, ComHandleId=2356, ComSystemTemplateSystemSignalRef=DET_PROB_1STAZHYPO_112
            DET_MTD_110_oRDR_DETECTION_109_112_oPCAN_RADAR_61f6a9aa_Tx: ComBitPosition=159, ComBitSize=1, ComSignalInitValue=0, ComSignalType=UINT8, ComHandleId=2350, ComSystemTemplateSystemSignalRef=DET_MTD_110
            DET_PROB_1STAZHYPO_111_oRDR_DETECTION_109_112_oPCAN_RADAR_673295f2_Tx: ComBitPosition=327, ComBitSize=1, ComSignalInitValue=0, ComSignalType=BOOLEAN, ComHandleId=2355, ComSystemTemplateSystemSignalRef=DET_PROB_1STAZHYPO_111
            DET_IDM_110_oRDR_DETECTION_109_112_oPCAN_RADAR_07459b71_Tx: ComBitPosition=175, ComBitSize=1, ComSignalInitValue=0, ComSignalType=UINT8, ComHandleId=2343, ComSystemTemplateSystemSignalRef=DET_IDM_110
            DET_MTD_111_oRDR_DETECTION_109_112_oPCAN_RADAR_f4867d3f_Tx: ComBitPosition=271, ComBitSize=1, ComSignalInitValue=0, ComSignalType=UINT8, ComHandleId=2351, ComSystemTemplateSystemSignalRef=DET_MTD_111
            DET_MTD_109_oRDR_DETECTION_109_112_oPCAN_RADAR_04d6db0e_Tx: ComBitPosition=47, ComBitSize=1, ComSignalInitValue=0, ComSignalType=UINT8, ComHandleId=2349, ComSystemTemplateSystemSignalRef=DET_MTD_109
            DET_IDM_111_oRDR_DETECTION_109_112_oPCAN_RADAR_92354fe4_Tx: ComBitPosition=287, ComBitSize=1, ComSignalInitValue=0, ComSignalType=UINT8, ComHandleId=2344, ComSystemTemplateSystemSignalRef=DET_IDM_111
            DET_MTD_112_oRDR_DETECTION_109_112_oPCAN_RADAR_906606c1_Tx: ComBitPosition=383, ComBitSize=1, ComSignalInitValue=0, ComSignalType=UINT8, ComHandleId=2352, ComSystemTemplateSystemSignalRef=DET_MTD_112
            DET_PROB_1STAZHYPO_109_oRDR_DETECTION_109_112_oPCAN_RADAR_976233c3_Tx: ComBitPosition=103, ComBitSize=1, ComSignalInitValue=0, ComSignalType=BOOLEAN, ComHandleId=2353, ComSystemTemplateSystemSignalRef=DET_PROB_1STAZHYPO_109
            DET_IDM_109_oRDR_DETECTION_109_112_oPCAN_RADAR_6265e9d5_Tx: ComBitPosition=63, ComBitSize=1, ComSignalInitValue=0, ComSignalType=UINT8, ComHandleId=2342, ComSystemTemplateSystemSignalRef=DET_IDM_109
            DET_BELOW_RAIN_THOLD_109_oRDR_DETECTION_109_112_oPCAN_RADAR_595730ce_Tx: ComBitPosition=39, ComBitSize=1, ComSignalInitValue=0, ComSignalType=UINT8, ComHandleId=2310, ComSystemTemplateSystemSignalRef=DET_BELOW_RAIN_THOLD_109
            DET_BELOW_RAIN_THOLD_112_oRDR_DETECTION_109_112_oPCAN_RADAR_cde7ed01_Tx: ComBitPosition=375, ComBitSize=1, ComSignalInitValue=0, ComSignalType=UINT8, ComHandleId=2313, ComSystemTemplateSystemSignalRef=DET_BELOW_RAIN_THOLD_112
            DET_BELOW_RAIN_THOLD_110_oRDR_DETECTION_109_112_oPCAN_RADAR_3c77426a_Tx: ComBitPosition=151, ComBitSize=1, ComSignalInitValue=0, ComSignalType=UINT8, ComHandleId=2311, ComSystemTemplateSystemSignalRef=DET_BELOW_RAIN_THOLD_110
        SG_Detections_257_260_oRDR_DETECTION_257_260_oPCAN_RADAR_06edbef2_Tx: ComTransferProperty=TRIGGERED, ComHandleId=66, ComSystemTemplateSignalGroupRef=SG_Detections_257_260
          83 x ComGroupSignal, all with ComSignalEndianness=LITTLE_ENDIAN, ComTransferProperty=PENDING, ComSignalAccess=ACCESS_NEEDED_BY_SWC_OR_COM:
            DET_CONFD_AZIMUTH_259_oRDR_DETECTION_257_260_oPCAN_RADAR_3f9f8229_Tx: ComBitPosition=342, ComBitSize=2, ComSignalInitValue=0, ComSignalType=UINT8, ComHandleId=5391, ComSystemTemplateSystemSignalRef=DET_CONFD_AZIMUTH_259
            DET_RANGE_VELOCITY_ERR_258_oRDR_DETECTION_257_260_oPCAN_RADAR_c28f165a_Tx: ComBitPosition=176, ComBitSize=8, ComSignalInitValue=0, ComSignalType=UINT8, ComHandleId=5441, ComSystemTemplateSystemSignalRef=DET_RANGE_VELOCITY_ERR_258
            DET_ELEVATION_ERR_259_oRDR_DETECTION_257_260_oPCAN_RADAR_6bf3cf9a_Tx: ComBitPosition=304, ComBitSize=6, ComSignalInitValue=0, ComSignalType=UINT8, ComHandleId=5403, ComSystemTemplateSystemSignalRef=DET_ELEVATION_ERR_259
            DET_EXISTENCE_PROB_258_oRDR_DETECTION_257_260_oPCAN_RADAR_2c1c6e6f_Tx: ComBitPosition=224, ComBitSize=6, ComSignalInitValue=0, ComSignalType=UINT8, ComHandleId=5406, ComSystemTemplateSystemSignalRef=DET_EXISTENCE_PROB_258
            DET_RANGE_ERR_257_oRDR_DETECTION_257_260_oPCAN_RADAR_336a07e3_Tx: ComBitPosition=40, ComBitSize=7, ComSignalInitValue=0, ComSignalType=UINT8, ComHandleId=5432, ComSystemTemplateSystemSignalRef=DET_RANGE_ERR_257
            DET_HVC_FLAG_260_oRDR_DETECTION_257_260_oPCAN_RADAR_e7a9a35e_Tx: ComBitPosition=422, ComBitSize=1, ComSignalInitValue=0, ComSignalType=BOOLEAN, ComHandleId=5412, ComSystemTemplateSystemSignalRef=DET_HVC_FLAG_260
            DET_BI_STATIC_FLAG_260_oRDR_DETECTION_257_260_oPCAN_RADAR_d4e492bd_Tx: ComBitPosition=440, ComBitSize=1, ComSignalInitValue=0, ComSignalType=BOOLEAN, ComHandleId=5388, ComSystemTemplateSystemSignalRef=DET_BI_STATIC_FLAG_260
            DET_SUPER_RES_TARGET_259_oRDR_DETECTION_257_260_oPCAN_RADAR_33f37240_Tx: ComBitPosition=311, ComBitSize=1, ComSignalInitValue=0, ComSignalType=BOOLEAN, ComHandleId=5454, ComSystemTemplateSystemSignalRef=DET_SUPER_RES_TARGET_259
            DET_ELEVATION_ERR_257_oRDR_DETECTION_257_260_oPCAN_RADAR_d2938948_Tx: ComBitPosition=80, ComBitSize=6, ComSignalInitValue=0, ComSignalType=UINT8, ComHandleId=5401, ComSystemTemplateSystemSignalRef=DET_ELEVATION_ERR_257
            DET_MH_SCAN_INDEX_4LSB_257_260_oRDR_DETECTION_257_260_oPCAN_RADAR_ca3ae842_Tx: ComBitPosition=476, ComBitSize=4, ComSignalInitValue=0, ComSignalType=UINT8, ComHandleId=5419, ComSystemTemplateSystemSignalRef=DET_MH_SCAN_INDEX_4LSB_257_260
            DET_EXISTENCE_PROB_260_oRDR_DETECTION_257_260_oPCAN_RADAR_06dde021_Tx: ComBitPosition=448, ComBitSize=6, ComSignalInitValue=0, ComSignalType=UINT8, ComHandleId=5408, ComSystemTemplateSystemSignalRef=DET_EXISTENCE_PROB_260
            DET_SUPER_RES_TARGET_258_oRDR_DETECTION_257_260_oPCAN_RADAR_a683a6d5_Tx: ComBitPosition=199, ComBitSize=1, ComSignalInitValue=0, ComSignalType=BOOLEAN, ComHandleId=5453, ComSystemTemplateSystemSignalRef=DET_SUPER_RES_TARGET_258
            DET_SNR_259_oRDR_DETECTION_257_260_oPCAN_RADAR_026a5a25_Tx: ComBitPosition=344, ComBitSize=8, ComSignalInitValue=0, ComSignalType=UINT8, ComHandleId=5450, ComSystemTemplateSystemSignalRef=DET_SNR_259
            DET_RANGE_258_oRDR_DETECTION_257_260_oPCAN_RADAR_b8922fcd_Tx: ComBitPosition=136, ComBitSize=15, ComSignalInitValue=0, ComSignalType=UINT16, ComHandleId=5429, ComSystemTemplateSystemSignalRef=DET_RANGE_258
            DET_RCS_259_oRDR_DETECTION_257_260_oPCAN_RADAR_dfc40e27_Tx: ComBitPosition=352, ComBitSize=8, ComSignalInitValue=128, ComSignalType=UINT8, ComHandleId=5446, ComSystemTemplateSystemSignalRef=DET_RCS_259
            DET_CONFD_AZIMUTH_258_oRDR_DETECTION_257_260_oPCAN_RADAR_aaef56bc_Tx: ComBitPosition=230, ComBitSize=2, ComSignalInitValue=0, ComSignalType=UINT8, ComHandleId=5390, ComSystemTemplateSystemSignalRef=DET_CONFD_AZIMUTH_258
            DET_RCS_258_oRDR_DETECTION_257_260_oPCAN_RADAR_4ab4dab2_Tx: ComBitPosition=240, ComBitSize=8, ComSignalInitValue=128, ComSignalType=UINT8, ComHandleId=5445, ComSystemTemplateSystemSignalRef=DET_RCS_258
            DET_SUPER_RES_TARGET_260_oRDR_DETECTION_257_260_oPCAN_RADAR_8c42289b_Tx: ComBitPosition=423, ComBitSize=1, ComSignalInitValue=0, ComSignalType=BOOLEAN, ComHandleId=5455, ComSystemTemplateSystemSignalRef=DET_SUPER_RES_TARGET_260
            DET_AZIMUTH_257_oRDR_DETECTION_257_260_oPCAN_RADAR_8419ce31_Tx: ComBitPosition=88, ComBitSize=13, ComSignalInitValue=0, ComSignalType=UINT16, ComHandleId=5373, ComSystemTemplateSystemSignalRef=DET_AZIMUTH_257
            DET_SNR_258_oRDR_DETECTION_257_260_oPCAN_RADAR_971a8eb0_Tx: ComBitPosition=232, ComBitSize=8, ComSignalInitValue=0, ComSignalType=UINT8, ComHandleId=5449, ComSystemTemplateSystemSignalRef=DET_SNR_258
            DET_RANGE_ERR_258_oRDR_DETECTION_257_260_oPCAN_RADAR_1f7a95a4_Tx: ComBitPosition=152, ComBitSize=7, ComSignalInitValue=0, ComSignalType=UINT8, ComHandleId=5433, ComSystemTemplateSystemSignalRef=DET_RANGE_ERR_258
            DET_CONFD_ELEVATION_260_oRDR_DETECTION_257_260_oPCAN_RADAR_82bbd908_Tx: ComBitPosition=437, ComBitSize=2, ComSignalInitValue=0, ComSignalType=UINT8, ComHandleId=5396, ComSystemTemplateSystemSignalRef=DET_CONFD_ELEVATION_260
            DET_ELEVATION_259_oRDR_DETECTION_257_260_oPCAN_RADAR_ecca57ef_Tx: ComBitPosition=296, ComBitSize=8, ComSignalInitValue=0, ComSignalType=UINT8, ComHandleId=5399, ComSystemTemplateSystemSignalRef=DET_ELEVATION_259
            DET_AZIMUTH_ERR_260_oRDR_DETECTION_257_260_oPCAN_RADAR_267d47cd_Tx: ComBitPosition=441, ComBitSize=7, ComSignalInitValue=0, ComSignalType=UINT8, ComHandleId=5380, ComSystemTemplateSystemSignalRef=DET_AZIMUTH_ERR_260
            DET_RANGE_ERR_260_oRDR_DETECTION_257_260_oPCAN_RADAR_35bb1bea_Tx: ComBitPosition=376, ComBitSize=7, ComSignalInitValue=0, ComSignalType=UINT8, ComHandleId=5435, ComSystemTemplateSystemSignalRef=DET_RANGE_ERR_260
            DET_AZIMUTH_ERR_259_oRDR_DETECTION_257_260_oPCAN_RADAR_99cc1d16_Tx: ComBitPosition=329, ComBitSize=7, ComSignalInitValue=0, ComSignalType=UINT8, ComHandleId=5379, ComSystemTemplateSystemSignalRef=DET_AZIMUTH_ERR_259
            DET_MH_CRC16_257_260_oRDR_DETECTION_257_260_oPCAN_RADAR_82656cf9_Tx: ComBitPosition=0, ComBitSize=16, ComSignalInitValue=0, ComSignalType=UINT16, ComHandleId=5417, ComSystemTemplateSystemSignalRef=DET_MH_CRC16_257_260
            DET_ELEVATION_257_oRDR_DETECTION_257_260_oPCAN_RADAR_55aa113d_Tx: ComBitPosition=72, ComBitSize=8, ComSignalInitValue=0, ComSignalType=UINT8, ComHandleId=5397, ComSystemTemplateSystemSignalRef=DET_ELEVATION_257
            DET_AZIMUTH_258_oRDR_DETECTION_257_260_oPCAN_RADAR_a8095c76_Tx: ComBitPosition=200, ComBitSize=13, ComSignalInitValue=0, ComSignalType=UINT16, ComHandleId=5374, ComSystemTemplateSystemSignalRef=DET_AZIMUTH_258
            DET_AZIMUTH_260_oRDR_DETECTION_257_260_oPCAN_RADAR_82c8d238_Tx: ComBitPosition=424, ComBitSize=13, ComSignalInitValue=0, ComSignalType=UINT16, ComHandleId=5376, ComSystemTemplateSystemSignalRef=DET_AZIMUTH_260
            DET_RCS_257_oRDR_DETECTION_257_260_oPCAN_RADAR_66a448f5_Tx: ComBitPosition=128, ComBitSize=8, ComSignalInitValue=128, ComSignalType=UINT8, ComHandleId=5444, ComSystemTemplateSystemSignalRef=DET_RCS_257
            DET_RANGE_257_oRDR_DETECTION_257_260_oPCAN_RADAR_9482bd8a_Tx: ComBitPosition=24, ComBitSize=15, ComSignalInitValue=0, ComSignalType=UINT16, ComHandleId=5428, ComSystemTemplateSystemSignalRef=DET_RANGE_257
            DET_RANGE_VELOCITY_258_oRDR_DETECTION_257_260_oPCAN_RADAR_cd34ede8_Tx: ComBitPosition=160, ComBitSize=15, ComSignalInitValue=16384, ComSignalType=UINT16, ComHandleId=5437, ComSystemTemplateSystemSignalRef=DET_RANGE_VELOCITY_258
            DET_AZIMUTH_ERR_257_oRDR_DETECTION_257_260_oPCAN_RADAR_20ac5bc4_Tx: ComBitPosition=105, ComBitSize=7, ComSignalInitValue=0, ComSignalType=UINT8, ComHandleId=5377, ComSystemTemplateSystemSignalRef=DET_AZIMUTH_ERR_257
            DET_ELEVATION_260_oRDR_DETECTION_257_260_oPCAN_RADAR_537b0d34_Tx: ComBitPosition=408, ComBitSize=8, ComSignalInitValue=0, ComSignalType=UINT8, ComHandleId=5400, ComSystemTemplateSystemSignalRef=DET_ELEVATION_260
            DET_CONFD_ELEVATION_258_oRDR_DETECTION_257_260_oPCAN_RADAR_a87a5746_Tx: ComBitPosition=213, ComBitSize=2, ComSignalInitValue=0, ComSignalType=UINT8, ComHandleId=5394, ComSystemTemplateSystemSignalRef=DET_CONFD_ELEVATION_258
            DET_SNR_260_oRDR_DETECTION_257_260_oPCAN_RADAR_bddb00fe_Tx: ComBitPosition=456, ComBitSize=8, ComSignalInitValue=0, ComSignalType=UINT8, ComHandleId=5451, ComSystemTemplateSystemSignalRef=DET_SNR_260
            DET_ELEVATION_ERR_258_oRDR_DETECTION_257_260_oPCAN_RADAR_fe831b0f_Tx: ComBitPosition=192, ComBitSize=6, ComSignalInitValue=0, ComSignalType=UINT8, ComHandleId=5402, ComSystemTemplateSystemSignalRef=DET_ELEVATION_ERR_258
            DET_ELEVATION_258_oRDR_DETECTION_257_260_oPCAN_RADAR_79ba837a_Tx: ComBitPosition=184, ComBitSize=8, ComSignalInitValue=0, ComSignalType=UINT8, ComHandleId=5398, ComSystemTemplateSystemSignalRef=DET_ELEVATION_258
            DET_RANGE_260_oRDR_DETECTION_257_260_oPCAN_RADAR_9253a183_Tx: ComBitPosition=360, ComBitSize=15, ComSignalInitValue=0, ComSignalType=UINT16, ComHandleId=5431, ComSystemTemplateSystemSignalRef=DET_RANGE_260
            DET_HVC_FLAG_259_oRDR_DETECTION_257_260_oPCAN_RADAR_5818f985_Tx: ComBitPosition=310, ComBitSize=1, ComSignalInitValue=0, ComSignalType=BOOLEAN, ComHandleId=5411, ComSystemTemplateSystemSignalRef=DET_HVC_FLAG_259
            DET_MH_CYCLE_COUNTER_257_260_oRDR_DETECTION_257_260_oPCAN_RADAR_0610cdce_Tx: ComBitPosition=16, ComBitSize=8, ComSignalInitValue=0, ComSignalType=UINT8, ComHandleId=5418, ComSystemTemplateSystemSignalRef=DET_MH_CYCLE_COUNTER_257_260
            DET_CONFD_ELEVATION_257_oRDR_DETECTION_257_260_oPCAN_RADAR_846ac501_Tx: ComBitPosition=101, ComBitSize=2, ComSignalInitValue=0, ComSignalType=UINT8, ComHandleId=5393, ComSystemTemplateSystemSignalRef=DET_CONFD_ELEVATION_257
            DET_RANGE_VELOCITY_257_oRDR_DETECTION_257_260_oPCAN_RADAR_e1247faf_Tx: ComBitPosition=48, ComBitSize=15, ComSignalInitValue=16384, ComSignalType=UINT16, ComHandleId=5436, ComSystemTemplateSystemSignalRef=DET_RANGE_VELOCITY_257
            DET_CONFD_AZIMUTH_260_oRDR_DETECTION_257_260_oPCAN_RADAR_802ed8f2_Tx: ComBitPosition=454, ComBitSize=2, ComSignalInitValue=0, ComSignalType=UINT8, ComHandleId=5392, ComSystemTemplateSystemSignalRef=DET_CONFD_AZIMUTH_260
            DET_RANGE_VELOCITY_260_oRDR_DETECTION_257_260_oPCAN_RADAR_e7f563a6_Tx: ComBitPosition=384, ComBitSize=15, ComSignalInitValue=16384, ComSignalType=UINT16, ComHandleId=5439, ComSystemTemplateSystemSignalRef=DET_RANGE_VELOCITY_260
            DET_BI_STATIC_FLAG_259_oRDR_DETECTION_257_260_oPCAN_RADAR_6b55c866_Tx: ComBitPosition=328, ComBitSize=1, ComSignalInitValue=0, ComSignalType=BOOLEAN, ComHandleId=5387, ComSystemTemplateSystemSignalRef=DET_BI_STATIC_FLAG_259
            DET_RANGE_259_oRDR_DETECTION_257_260_oPCAN_RADAR_2de2fb58_Tx: ComBitPosition=248, ComBitSize=15, ComSignalInitValue=0, ComSignalType=UINT16, ComHandleId=5430, ComSystemTemplateSystemSignalRef=DET_RANGE_259
            DET_SUPER_RES_TARGET_257_oRDR_DETECTION_257_260_oPCAN_RADAR_8a933492_Tx: ComBitPosition=87, ComBitSize=1, ComSignalInitValue=0, ComSignalType=BOOLEAN, ComHandleId=5452, ComSystemTemplateSystemSignalRef=DET_SUPER_RES_TARGET_257
            DET_EXISTENCE_PROB_257_oRDR_DETECTION_257_260_oPCAN_RADAR_000cfc28_Tx: ComBitPosition=112, ComBitSize=6, ComSignalInitValue=0, ComSignalType=UINT8, ComHandleId=5405, ComSystemTemplateSystemSignalRef=DET_EXISTENCE_PROB_257
            DET_RANGE_ERR_259_oRDR_DETECTION_257_260_oPCAN_RADAR_8a0a4131_Tx: ComBitPosition=264, ComBitSize=7, ComSignalInitValue=0, ComSignalType=UINT8, ComHandleId=5434, ComSystemTemplateSystemSignalRef=DET_RANGE_ERR_259
            DET_RANGE_VELOCITY_ERR_260_oRDR_DETECTION_257_260_oPCAN_RADAR_e84e9814_Tx: ComBitPosition=400, ComBitSize=8, ComSignalInitValue=0, ComSignalType=UINT8, ComHandleId=5443, ComSystemTemplateSystemSignalRef=DET_RANGE_VELOCITY_ERR_260
            DET_RANGE_VELOCITY_ERR_257_oRDR_DETECTION_257_260_oPCAN_RADAR_ee9f841d_Tx: ComBitPosition=64, ComBitSize=8, ComSignalInitValue=0, ComSignalType=UINT8, ComHandleId=5440, ComSystemTemplateSystemSignalRef=DET_RANGE_VELOCITY_ERR_257
            DET_BI_STATIC_FLAG_257_oRDR_DETECTION_257_260_oPCAN_RADAR_d2358eb4_Tx: ComBitPosition=104, ComBitSize=1, ComSignalInitValue=0, ComSignalType=BOOLEAN, ComHandleId=5385, ComSystemTemplateSystemSignalRef=DET_BI_STATIC_FLAG_257
            DET_HVC_FLAG_257_oRDR_DETECTION_257_260_oPCAN_RADAR_e178bf57_Tx: ComBitPosition=86, ComBitSize=1, ComSignalInitValue=0, ComSignalType=BOOLEAN, ComHandleId=5409, ComSystemTemplateSystemSignalRef=DET_HVC_FLAG_257
            DET_RANGE_VELOCITY_ERR_259_oRDR_DETECTION_257_260_oPCAN_RADAR_57ffc2cf_Tx: ComBitPosition=288, ComBitSize=8, ComSignalInitValue=0, ComSignalType=UINT8, ComHandleId=5442, ComSystemTemplateSystemSignalRef=DET_RANGE_VELOCITY_ERR_259
            DET_BI_STATIC_FLAG_258_oRDR_DETECTION_257_260_oPCAN_RADAR_fe251cf3_Tx: ComBitPosition=216, ComBitSize=1, ComSignalInitValue=0, ComSignalType=BOOLEAN, ComHandleId=5386, ComSystemTemplateSystemSignalRef=DET_BI_STATIC_FLAG_258
            DET_SNR_257_oRDR_DETECTION_257_260_oPCAN_RADAR_bb0a1cf7_Tx: ComBitPosition=120, ComBitSize=8, ComSignalInitValue=0, ComSignalType=UINT8, ComHandleId=5448, ComSystemTemplateSystemSignalRef=DET_SNR_257
            DET_HVC_FLAG_258_oRDR_DETECTION_257_260_oPCAN_RADAR_cd682d10_Tx: ComBitPosition=198, ComBitSize=1, ComSignalInitValue=0, ComSignalType=BOOLEAN, ComHandleId=5410, ComSystemTemplateSystemSignalRef=DET_HVC_FLAG_258
            DET_EXISTENCE_PROB_259_oRDR_DETECTION_257_260_oPCAN_RADAR_b96cbafa_Tx: ComBitPosition=336, ComBitSize=6, ComSignalInitValue=0, ComSignalType=UINT8, ComHandleId=5407, ComSystemTemplateSystemSignalRef=DET_EXISTENCE_PROB_259
            DET_CONFD_AZIMUTH_257_oRDR_DETECTION_257_260_oPCAN_RADAR_86ffc4fb_Tx: ComBitPosition=118, ComBitSize=2, ComSignalInitValue=0, ComSignalType=UINT8, ComHandleId=5389, ComSystemTemplateSystemSignalRef=DET_CONFD_AZIMUTH_257
            DET_AZIMUTH_259_oRDR_DETECTION_257_260_oPCAN_RADAR_3d7988e3_Tx: ComBitPosition=312, ComBitSize=13, ComSignalInitValue=0, ComSignalType=UINT16, ComHandleId=5375, ComSystemTemplateSystemSignalRef=DET_AZIMUTH_259
            DET_CONFD_ELEVATION_259_oRDR_DETECTION_257_260_oPCAN_RADAR_3d0a83d3_Tx: ComBitPosition=325, ComBitSize=2, ComSignalInitValue=0, ComSignalType=UINT8, ComHandleId=5395, ComSystemTemplateSystemSignalRef=DET_CONFD_ELEVATION_259
            DET_AZIMUTH_ERR_258_oRDR_DETECTION_257_260_oPCAN_RADAR_0cbcc983_Tx: ComBitPosition=217, ComBitSize=7, ComSignalInitValue=0, ComSignalType=UINT8, ComHandleId=5378, ComSystemTemplateSystemSignalRef=DET_AZIMUTH_ERR_258
            DET_RCS_260_oRDR_DETECTION_257_260_oPCAN_RADAR_607554fc_Tx: ComBitPosition=464, ComBitSize=8, ComSignalInitValue=128, ComSignalType=UINT8, ComHandleId=5447, ComSystemTemplateSystemSignalRef=DET_RCS_260
            DET_ELEVATION_ERR_260_oRDR_DETECTION_257_260_oPCAN_RADAR_d4429541_Tx: ComBitPosition=416, ComBitSize=6, ComSignalInitValue=0, ComSignalType=UINT8, ComHandleId=5404, ComSystemTemplateSystemSignalRef=DET_ELEVATION_ERR_260
            DET_RANGE_VELOCITY_259_oRDR_DETECTION_257_260_oPCAN_RADAR_5844397d_Tx: ComBitPosition=272, ComBitSize=15, ComSignalInitValue=16384, ComSignalType=UINT16, ComHandleId=5438, ComSystemTemplateSystemSignalRef=DET_RANGE_VELOCITY_259
            DET_BELOW_RAIN_THOLD_257_oRDR_DETECTION_257_260_oPCAN_RADAR_51185df1_Tx: ComBitPosition=39, ComBitSize=1, ComSignalInitValue=0, ComSignalType=UINT8, ComHandleId=5381, ComSystemTemplateSystemSignalRef=DET_BELOW_RAIN_THOLD_257
            DET_IDM_260_oRDR_DETECTION_257_260_oPCAN_RADAR_6cfb98e3_Tx: ComBitPosition=399, ComBitSize=1, ComSignalInitValue=0, ComSignalType=UINT8, ComHandleId=5416, ComSystemTemplateSystemSignalRef=DET_IDM_260
            DET_IDM_258_oRDR_DETECTION_257_260_oPCAN_RADAR_463a16ad_Tx: ComBitPosition=175, ComBitSize=1, ComSignalInitValue=0, ComSignalType=UINT8, ComHandleId=5414, ComSystemTemplateSystemSignalRef=DET_IDM_258
            DET_IDM_259_oRDR_DETECTION_257_260_oPCAN_RADAR_d34ac238_Tx: ComBitPosition=287, ComBitSize=1, ComSignalInitValue=0, ComSignalType=UINT8, ComHandleId=5415, ComSystemTemplateSystemSignalRef=DET_IDM_259
            DET_IDM_257_oRDR_DETECTION_257_260_oPCAN_RADAR_6a2a84ea_Tx: ComBitPosition=63, ComBitSize=1, ComSignalInitValue=0, ComSignalType=UINT8, ComHandleId=5413, ComSystemTemplateSystemSignalRef=DET_IDM_257
            DET_BELOW_RAIN_THOLD_260_oRDR_DETECTION_257_260_oPCAN_RADAR_57c941f8_Tx: ComBitPosition=375, ComBitSize=1, ComSignalInitValue=0, ComSignalType=UINT8, ComHandleId=5384, ComSystemTemplateSystemSignalRef=DET_BELOW_RAIN_THOLD_260
            DET_BELOW_RAIN_THOLD_258_oRDR_DETECTION_257_260_oPCAN_RADAR_7d08cfb6_Tx: ComBitPosition=151, ComBitSize=1, ComSignalInitValue=0, ComSignalType=UINT8, ComHandleId=5382, ComSystemTemplateSystemSignalRef=DET_BELOW_RAIN_THOLD_258
            DET_PROB_1STAZHYPO_260_oRDR_DETECTION_257_260_oPCAN_RADAR_99fc42f5_Tx: ComBitPosition=439, ComBitSize=1, ComSignalInitValue=0, ComSignalType=BOOLEAN, ComHandleId=5427, ComSystemTemplateSystemSignalRef=DET_PROB_1STAZHYPO_260
            DET_BELOW_RAIN_THOLD_259_oRDR_DETECTION_257_260_oPCAN_RADAR_e8781b23_Tx: ComBitPosition=263, ComBitSize=1, ComSignalInitValue=0, ComSignalType=UINT8, ComHandleId=5383, ComSystemTemplateSystemSignalRef=DET_BELOW_RAIN_THOLD_259
            DET_PROB_1STAZHYPO_258_oRDR_DETECTION_257_260_oPCAN_RADAR_b33dccbb_Tx: ComBitPosition=215, ComBitSize=1, ComSignalInitValue=0, ComSignalType=BOOLEAN, ComHandleId=5425, ComSystemTemplateSystemSignalRef=DET_PROB_1STAZHYPO_258
            DET_MTD_260_oRDR_DETECTION_257_260_oPCAN_RADAR_0a48aa38_Tx: ComBitPosition=383, ComBitSize=1, ComSignalInitValue=0, ComSignalType=UINT8, ComHandleId=5423, ComSystemTemplateSystemSignalRef=DET_MTD_260
            DET_PROB_1STAZHYPO_259_oRDR_DETECTION_257_260_oPCAN_RADAR_264d182e_Tx: ComBitPosition=327, ComBitSize=1, ComSignalInitValue=0, ComSignalType=BOOLEAN, ComHandleId=5426, ComSystemTemplateSystemSignalRef=DET_PROB_1STAZHYPO_259
            DET_MTD_257_oRDR_DETECTION_257_260_oPCAN_RADAR_0c99b631_Tx: ComBitPosition=47, ComBitSize=1, ComSignalInitValue=0, ComSignalType=UINT8, ComHandleId=5420, ComSystemTemplateSystemSignalRef=DET_MTD_257
            DET_PROB_1STAZHYPO_257_oRDR_DETECTION_257_260_oPCAN_RADAR_9f2d5efc_Tx: ComBitPosition=103, ComBitSize=1, ComSignalInitValue=0, ComSignalType=BOOLEAN, ComHandleId=5424, ComSystemTemplateSystemSignalRef=DET_PROB_1STAZHYPO_257
            DET_MTD_259_oRDR_DETECTION_257_260_oPCAN_RADAR_b5f9f0e3_Tx: ComBitPosition=271, ComBitSize=1, ComSignalInitValue=0, ComSignalType=UINT8, ComHandleId=5422, ComSystemTemplateSystemSignalRef=DET_MTD_259
            DET_MTD_258_oRDR_DETECTION_257_260_oPCAN_RADAR_20892476_Tx: ComBitPosition=159, ComBitSize=1, ComSignalInitValue=0, ComSignalType=UINT8, ComHandleId=5421, ComSystemTemplateSystemSignalRef=DET_MTD_258
        SG_Detections_305_308_oRDR_DETECTION_305_308_oPCAN_RADAR_6973c633_Tx: ComTransferProperty=TRIGGERED, ComHandleId=78, ComSystemTemplateSignalGroupRef=SG_Detections_305_308
          83 x ComGroupSignal, all with ComSignalEndianness=LITTLE_ENDIAN, ComTransferProperty=PENDING, ComSignalAccess=ACCESS_NEEDED_BY_SWC_OR_COM:
            DET_HVC_FLAG_308_oRDR_DETECTION_305_308_oPCAN_RADAR_525da319_Tx: ComBitPosition=422, ComBitSize=1, ComSignalInitValue=0, ComSignalType=BOOLEAN, ComHandleId=6408, ComSystemTemplateSystemSignalRef=DET_HVC_FLAG_308
            DET_CONFD_ELEVATION_307_oRDR_DETECTION_305_308_oPCAN_RADAR_1b5f4b08_Tx: ComBitPosition=325, ComBitSize=2, ComSignalInitValue=0, ComSignalType=UINT8, ComHandleId=6391, ComSystemTemplateSystemSignalRef=DET_CONFD_ELEVATION_307
            DET_ELEVATION_306_oRDR_DETECTION_305_308_oPCAN_RADAR_5fef4ba1_Tx: ComBitPosition=184, ComBitSize=8, ComSignalInitValue=0, ComSignalType=UINT8, ComHandleId=6394, ComSystemTemplateSystemSignalRef=DET_ELEVATION_306
            DET_RANGE_VELOCITY_307_oRDR_DETECTION_305_308_oPCAN_RADAR_7e11f1a6_Tx: ComBitPosition=272, ComBitSize=15, ComSignalInitValue=16384, ComSignalType=UINT16, ComHandleId=6434, ComSystemTemplateSystemSignalRef=DET_RANGE_VELOCITY_307
            DET_ELEVATION_305_oRDR_DETECTION_305_308_oPCAN_RADAR_3b0f305f_Tx: ComBitPosition=72, ComBitSize=8, ComSignalInitValue=0, ComSignalType=UINT8, ComHandleId=6393, ComSystemTemplateSystemSignalRef=DET_ELEVATION_305
            DET_CONFD_ELEVATION_306_oRDR_DETECTION_305_308_oPCAN_RADAR_8e2f9f9d_Tx: ComBitPosition=213, ComBitSize=2, ComSignalInitValue=0, ComSignalType=UINT8, ComHandleId=6390, ComSystemTemplateSystemSignalRef=DET_CONFD_ELEVATION_306
            DET_ELEVATION_308_oRDR_DETECTION_305_308_oPCAN_RADAR_e68f0d73_Tx: ComBitPosition=408, ComBitSize=8, ComSignalInitValue=0, ComSignalType=UINT8, ComHandleId=6396, ComSystemTemplateSystemSignalRef=DET_ELEVATION_308
            DET_RANGE_ERR_308_oRDR_DETECTION_305_308_oPCAN_RADAR_804f1bad_Tx: ComBitPosition=376, ComBitSize=7, ComSignalInitValue=0, ComSignalType=UINT8, ComHandleId=6431, ComSystemTemplateSystemSignalRef=DET_RANGE_ERR_308
            DET_CONFD_AZIMUTH_305_oRDR_DETECTION_305_308_oPCAN_RADAR_e85ae599_Tx: ComBitPosition=118, ComBitSize=2, ComSignalInitValue=0, ComSignalType=UINT8, ComHandleId=6385, ComSystemTemplateSystemSignalRef=DET_CONFD_AZIMUTH_305
            DET_EXISTENCE_PROB_308_oRDR_DETECTION_305_308_oPCAN_RADAR_b329e066_Tx: ComBitPosition=448, ComBitSize=6, ComSignalInitValue=0, ComSignalType=UINT8, ComHandleId=6404, ComSystemTemplateSystemSignalRef=DET_EXISTENCE_PROB_308
            DET_AZIMUTH_ERR_307_oRDR_DETECTION_305_308_oPCAN_RADAR_bf99d5cd_Tx: ComBitPosition=329, ComBitSize=7, ComSignalInitValue=0, ComSignalType=UINT8, ComHandleId=6375, ComSystemTemplateSystemSignalRef=DET_AZIMUTH_ERR_307
            DET_BI_STATIC_FLAG_306_oRDR_DETECTION_305_308_oPCAN_RADAR_d870d428_Tx: ComBitPosition=216, ComBitSize=1, ComSignalInitValue=0, ComSignalType=BOOLEAN, ComHandleId=6382, ComSystemTemplateSystemSignalRef=DET_BI_STATIC_FLAG_306
            DET_SNR_308_oRDR_DETECTION_305_308_oPCAN_RADAR_082f00b9_Tx: ComBitPosition=456, ComBitSize=8, ComSignalInitValue=0, ComSignalType=UINT8, ComHandleId=6447, ComSystemTemplateSystemSignalRef=DET_SNR_308
            DET_RANGE_307_oRDR_DETECTION_305_308_oPCAN_RADAR_0bb73383_Tx: ComBitPosition=248, ComBitSize=15, ComSignalInitValue=0, ComSignalType=UINT16, ComHandleId=6426, ComSystemTemplateSystemSignalRef=DET_RANGE_307
            DET_ELEVATION_ERR_306_oRDR_DETECTION_305_308_oPCAN_RADAR_d8d6d3d4_Tx: ComBitPosition=192, ComBitSize=6, ComSignalInitValue=0, ComSignalType=UINT8, ComHandleId=6398, ComSystemTemplateSystemSignalRef=DET_ELEVATION_ERR_306
            DET_RANGE_ERR_305_oRDR_DETECTION_305_308_oPCAN_RADAR_5dcf2681_Tx: ComBitPosition=40, ComBitSize=7, ComSignalInitValue=0, ComSignalType=UINT8, ComHandleId=6428, ComSystemTemplateSystemSignalRef=DET_RANGE_ERR_305
            DET_AZIMUTH_308_oRDR_DETECTION_305_308_oPCAN_RADAR_373cd27f_Tx: ComBitPosition=424, ComBitSize=13, ComSignalInitValue=0, ComSignalType=UINT16, ComHandleId=6372, ComSystemTemplateSystemSignalRef=DET_AZIMUTH_308
            DET_CONFD_ELEVATION_308_oRDR_DETECTION_305_308_oPCAN_RADAR_374fd94f_Tx: ComBitPosition=437, ComBitSize=2, ComSignalInitValue=0, ComSignalType=UINT8, ComHandleId=6392, ComSystemTemplateSystemSignalRef=DET_CONFD_ELEVATION_308
            DET_MH_SCAN_INDEX_4LSB_305_308_oRDR_DETECTION_305_308_oPCAN_RADAR_a5a49083_Tx: ComBitPosition=476, ComBitSize=4, ComSignalInitValue=0, ComSignalType=UINT8, ComHandleId=6415, ComSystemTemplateSystemSignalRef=DET_MH_SCAN_INDEX_4LSB_305_308
            DET_HVC_FLAG_306_oRDR_DETECTION_305_308_oPCAN_RADAR_eb3de5cb_Tx: ComBitPosition=198, ComBitSize=1, ComSignalInitValue=0, ComSignalType=BOOLEAN, ComHandleId=6406, ComSystemTemplateSystemSignalRef=DET_HVC_FLAG_306
            DET_AZIMUTH_ERR_305_oRDR_DETECTION_305_308_oPCAN_RADAR_4e097aa6_Tx: ComBitPosition=105, ComBitSize=7, ComSignalInitValue=0, ComSignalType=UINT8, ComHandleId=6373, ComSystemTemplateSystemSignalRef=DET_AZIMUTH_ERR_305
            DET_HVC_FLAG_307_oRDR_DETECTION_305_308_oPCAN_RADAR_7e4d315e_Tx: ComBitPosition=310, ComBitSize=1, ComSignalInitValue=0, ComSignalType=BOOLEAN, ComHandleId=6407, ComSystemTemplateSystemSignalRef=DET_HVC_FLAG_307
            DET_ELEVATION_ERR_308_oRDR_DETECTION_305_308_oPCAN_RADAR_61b69506_Tx: ComBitPosition=416, ComBitSize=6, ComSignalInitValue=0, ComSignalType=UINT8, ComHandleId=6400, ComSystemTemplateSystemSignalRef=DET_ELEVATION_ERR_308
            DET_EXISTENCE_PROB_305_oRDR_DETECTION_305_308_oPCAN_RADAR_6ea9dd4a_Tx: ComBitPosition=112, ComBitSize=6, ComSignalInitValue=0, ComSignalType=UINT8, ComHandleId=6401, ComSystemTemplateSystemSignalRef=DET_EXISTENCE_PROB_305
            DET_RCS_308_oRDR_DETECTION_305_308_oPCAN_RADAR_d58154bb_Tx: ComBitPosition=464, ComBitSize=8, ComSignalInitValue=128, ComSignalType=UINT8, ComHandleId=6443, ComSystemTemplateSystemSignalRef=DET_RCS_308
            DET_RANGE_VELOCITY_308_oRDR_DETECTION_305_308_oPCAN_RADAR_520163e1_Tx: ComBitPosition=384, ComBitSize=15, ComSignalInitValue=16384, ComSignalType=UINT16, ComHandleId=6435, ComSystemTemplateSystemSignalRef=DET_RANGE_VELOCITY_308
            DET_AZIMUTH_305_oRDR_DETECTION_305_308_oPCAN_RADAR_eabcef53_Tx: ComBitPosition=88, ComBitSize=13, ComSignalInitValue=0, ComSignalType=UINT16, ComHandleId=6369, ComSystemTemplateSystemSignalRef=DET_AZIMUTH_305
            DET_CONFD_AZIMUTH_307_oRDR_DETECTION_305_308_oPCAN_RADAR_19ca4af2_Tx: ComBitPosition=342, ComBitSize=2, ComSignalInitValue=0, ComSignalType=UINT8, ComHandleId=6387, ComSystemTemplateSystemSignalRef=DET_CONFD_AZIMUTH_307
            DET_ELEVATION_ERR_305_oRDR_DETECTION_305_308_oPCAN_RADAR_bc36a82a_Tx: ComBitPosition=80, ComBitSize=6, ComSignalInitValue=0, ComSignalType=UINT8, ComHandleId=6397, ComSystemTemplateSystemSignalRef=DET_ELEVATION_ERR_305
            DET_RANGE_ERR_307_oRDR_DETECTION_305_308_oPCAN_RADAR_ac5f89ea_Tx: ComBitPosition=264, ComBitSize=7, ComSignalInitValue=0, ComSignalType=UINT8, ComHandleId=6430, ComSystemTemplateSystemSignalRef=DET_RANGE_ERR_307
            DET_AZIMUTH_307_oRDR_DETECTION_305_308_oPCAN_RADAR_1b2c4038_Tx: ComBitPosition=312, ComBitSize=13, ComSignalInitValue=0, ComSignalType=UINT16, ComHandleId=6371, ComSystemTemplateSystemSignalRef=DET_AZIMUTH_307
            DET_RANGE_VELOCITY_ERR_307_oRDR_DETECTION_305_308_oPCAN_RADAR_71aa0a14_Tx: ComBitPosition=288, ComBitSize=8, ComSignalInitValue=0, ComSignalType=UINT8, ComHandleId=6438, ComSystemTemplateSystemSignalRef=DET_RANGE_VELOCITY_ERR_307
            DET_RANGE_306_oRDR_DETECTION_305_308_oPCAN_RADAR_9ec7e716_Tx: ComBitPosition=136, ComBitSize=15, ComSignalInitValue=0, ComSignalType=UINT16, ComHandleId=6425, ComSystemTemplateSystemSignalRef=DET_RANGE_306
            DET_MH_CYCLE_COUNTER_305_308_oRDR_DETECTION_305_308_oPCAN_RADAR_698eb50f_Tx: ComBitPosition=16, ComBitSize=8, ComSignalInitValue=0, ComSignalType=UINT8, ComHandleId=6414, ComSystemTemplateSystemSignalRef=DET_MH_CYCLE_COUNTER_305_308
            DET_RANGE_VELOCITY_ERR_305_oRDR_DETECTION_305_308_oPCAN_RADAR_803aa57f_Tx: ComBitPosition=64, ComBitSize=8, ComSignalInitValue=0, ComSignalType=UINT8, ComHandleId=6436, ComSystemTemplateSystemSignalRef=DET_RANGE_VELOCITY_ERR_305
            DET_RANGE_305_oRDR_DETECTION_305_308_oPCAN_RADAR_fa279ce8_Tx: ComBitPosition=24, ComBitSize=15, ComSignalInitValue=0, ComSignalType=UINT16, ComHandleId=6424, ComSystemTemplateSystemSignalRef=DET_RANGE_305
            DET_ELEVATION_ERR_307_oRDR_DETECTION_305_308_oPCAN_RADAR_4da60741_Tx: ComBitPosition=304, ComBitSize=6, ComSignalInitValue=0, ComSignalType=UINT8, ComHandleId=6399, ComSystemTemplateSystemSignalRef=DET_ELEVATION_ERR_307
            DET_RANGE_ERR_306_oRDR_DETECTION_305_308_oPCAN_RADAR_392f5d7f_Tx: ComBitPosition=152, ComBitSize=7, ComSignalInitValue=0, ComSignalType=UINT8, ComHandleId=6429, ComSystemTemplateSystemSignalRef=DET_RANGE_ERR_306
            DET_SNR_306_oRDR_DETECTION_305_308_oPCAN_RADAR_b14f466b_Tx: ComBitPosition=232, ComBitSize=8, ComSignalInitValue=0, ComSignalType=UINT8, ComHandleId=6445, ComSystemTemplateSystemSignalRef=DET_SNR_306
            DET_EXISTENCE_PROB_307_oRDR_DETECTION_305_308_oPCAN_RADAR_9f397221_Tx: ComBitPosition=336, ComBitSize=6, ComSignalInitValue=0, ComSignalType=UINT8, ComHandleId=6403, ComSystemTemplateSystemSignalRef=DET_EXISTENCE_PROB_307
            DET_SUPER_RES_TARGET_306_oRDR_DETECTION_305_308_oPCAN_RADAR_80d66e0e_Tx: ComBitPosition=199, ComBitSize=1, ComSignalInitValue=0, ComSignalType=BOOLEAN, ComHandleId=6449, ComSystemTemplateSystemSignalRef=DET_SUPER_RES_TARGET_306
            DET_RANGE_308_oRDR_DETECTION_305_308_oPCAN_RADAR_27a7a1c4_Tx: ComBitPosition=360, ComBitSize=15, ComSignalInitValue=0, ComSignalType=UINT16, ComHandleId=6427, ComSystemTemplateSystemSignalRef=DET_RANGE_308
            DET_SNR_305_oRDR_DETECTION_305_308_oPCAN_RADAR_d5af3d95_Tx: ComBitPosition=120, ComBitSize=8, ComSignalInitValue=0, ComSignalType=UINT8, ComHandleId=6444, ComSystemTemplateSystemSignalRef=DET_SNR_305
            DET_AZIMUTH_306_oRDR_DETECTION_305_308_oPCAN_RADAR_8e5c94ad_Tx: ComBitPosition=200, ComBitSize=13, ComSignalInitValue=0, ComSignalType=UINT16, ComHandleId=6370, ComSystemTemplateSystemSignalRef=DET_AZIMUTH_306
            DET_MH_CRC16_305_308_oRDR_DETECTION_305_308_oPCAN_RADAR_edfb1438_Tx: ComBitPosition=0, ComBitSize=16, ComSignalInitValue=0, ComSignalType=UINT16, ComHandleId=6413, ComSystemTemplateSystemSignalRef=DET_MH_CRC16_305_308
            DET_BI_STATIC_FLAG_305_oRDR_DETECTION_305_308_oPCAN_RADAR_bc90afd6_Tx: ComBitPosition=104, ComBitSize=1, ComSignalInitValue=0, ComSignalType=BOOLEAN, ComHandleId=6381, ComSystemTemplateSystemSignalRef=DET_BI_STATIC_FLAG_305
            DET_RANGE_VELOCITY_305_oRDR_DETECTION_305_308_oPCAN_RADAR_8f815ecd_Tx: ComBitPosition=48, ComBitSize=15, ComSignalInitValue=16384, ComSignalType=UINT16, ComHandleId=6432, ComSystemTemplateSystemSignalRef=DET_RANGE_VELOCITY_305
            DET_AZIMUTH_ERR_306_oRDR_DETECTION_305_308_oPCAN_RADAR_2ae90158_Tx: ComBitPosition=217, ComBitSize=7, ComSignalInitValue=0, ComSignalType=UINT8, ComHandleId=6374, ComSystemTemplateSystemSignalRef=DET_AZIMUTH_ERR_306
            DET_RCS_306_oRDR_DETECTION_305_308_oPCAN_RADAR_6ce11269_Tx: ComBitPosition=240, ComBitSize=8, ComSignalInitValue=128, ComSignalType=UINT8, ComHandleId=6441, ComSystemTemplateSystemSignalRef=DET_RCS_306
            DET_HVC_FLAG_305_oRDR_DETECTION_305_308_oPCAN_RADAR_8fdd9e35_Tx: ComBitPosition=86, ComBitSize=1, ComSignalInitValue=0, ComSignalType=BOOLEAN, ComHandleId=6405, ComSystemTemplateSystemSignalRef=DET_HVC_FLAG_305
            DET_RCS_305_oRDR_DETECTION_305_308_oPCAN_RADAR_08016997_Tx: ComBitPosition=128, ComBitSize=8, ComSignalInitValue=128, ComSignalType=UINT8, ComHandleId=6440, ComSystemTemplateSystemSignalRef=DET_RCS_305
            DET_RCS_307_oRDR_DETECTION_305_308_oPCAN_RADAR_f991c6fc_Tx: ComBitPosition=352, ComBitSize=8, ComSignalInitValue=128, ComSignalType=UINT8, ComHandleId=6442, ComSystemTemplateSystemSignalRef=DET_RCS_307
            DET_CONFD_AZIMUTH_308_oRDR_DETECTION_305_308_oPCAN_RADAR_35dad8b5_Tx: ComBitPosition=454, ComBitSize=2, ComSignalInitValue=0, ComSignalType=UINT8, ComHandleId=6388, ComSystemTemplateSystemSignalRef=DET_CONFD_AZIMUTH_308
            DET_BI_STATIC_FLAG_308_oRDR_DETECTION_305_308_oPCAN_RADAR_611092fa_Tx: ComBitPosition=440, ComBitSize=1, ComSignalInitValue=0, ComSignalType=BOOLEAN, ComHandleId=6384, ComSystemTemplateSystemSignalRef=DET_BI_STATIC_FLAG_308
            DET_AZIMUTH_ERR_308_oRDR_DETECTION_305_308_oPCAN_RADAR_9389478a_Tx: ComBitPosition=441, ComBitSize=7, ComSignalInitValue=0, ComSignalType=UINT8, ComHandleId=6376, ComSystemTemplateSystemSignalRef=DET_AZIMUTH_ERR_308
            DET_SUPER_RES_TARGET_305_oRDR_DETECTION_305_308_oPCAN_RADAR_e43615f0_Tx: ComBitPosition=87, ComBitSize=1, ComSignalInitValue=0, ComSignalType=BOOLEAN, ComHandleId=6448, ComSystemTemplateSystemSignalRef=DET_SUPER_RES_TARGET_305
            DET_RANGE_VELOCITY_ERR_306_oRDR_DETECTION_305_308_oPCAN_RADAR_e4dade81_Tx: ComBitPosition=176, ComBitSize=8, ComSignalInitValue=0, ComSignalType=UINT8, ComHandleId=6437, ComSystemTemplateSystemSignalRef=DET_RANGE_VELOCITY_ERR_306
            DET_BI_STATIC_FLAG_307_oRDR_DETECTION_305_308_oPCAN_RADAR_4d0000bd_Tx: ComBitPosition=328, ComBitSize=1, ComSignalInitValue=0, ComSignalType=BOOLEAN, ComHandleId=6383, ComSystemTemplateSystemSignalRef=DET_BI_STATIC_FLAG_307
            DET_ELEVATION_307_oRDR_DETECTION_305_308_oPCAN_RADAR_ca9f9f34_Tx: ComBitPosition=296, ComBitSize=8, ComSignalInitValue=0, ComSignalType=UINT8, ComHandleId=6395, ComSystemTemplateSystemSignalRef=DET_ELEVATION_307
            DET_RANGE_VELOCITY_306_oRDR_DETECTION_305_308_oPCAN_RADAR_eb612533_Tx: ComBitPosition=160, ComBitSize=15, ComSignalInitValue=16384, ComSignalType=UINT16, ComHandleId=6433, ComSystemTemplateSystemSignalRef=DET_RANGE_VELOCITY_306
            DET_CONFD_AZIMUTH_306_oRDR_DETECTION_305_308_oPCAN_RADAR_8cba9e67_Tx: ComBitPosition=230, ComBitSize=2, ComSignalInitValue=0, ComSignalType=UINT8, ComHandleId=6386, ComSystemTemplateSystemSignalRef=DET_CONFD_AZIMUTH_306
            DET_SNR_307_oRDR_DETECTION_305_308_oPCAN_RADAR_243f92fe_Tx: ComBitPosition=344, ComBitSize=8, ComSignalInitValue=0, ComSignalType=UINT8, ComHandleId=6446, ComSystemTemplateSystemSignalRef=DET_SNR_307
            DET_EXISTENCE_PROB_306_oRDR_DETECTION_305_308_oPCAN_RADAR_0a49a6b4_Tx: ComBitPosition=224, ComBitSize=6, ComSignalInitValue=0, ComSignalType=UINT8, ComHandleId=6402, ComSystemTemplateSystemSignalRef=DET_EXISTENCE_PROB_306
            DET_SUPER_RES_TARGET_307_oRDR_DETECTION_305_308_oPCAN_RADAR_15a6ba9b_Tx: ComBitPosition=311, ComBitSize=1, ComSignalInitValue=0, ComSignalType=BOOLEAN, ComHandleId=6450, ComSystemTemplateSystemSignalRef=DET_SUPER_RES_TARGET_307
            DET_RANGE_VELOCITY_ERR_308_oRDR_DETECTION_305_308_oPCAN_RADAR_5dba9853_Tx: ComBitPosition=400, ComBitSize=8, ComSignalInitValue=0, ComSignalType=UINT8, ComHandleId=6439, ComSystemTemplateSystemSignalRef=DET_RANGE_VELOCITY_ERR_308
            DET_SUPER_RES_TARGET_308_oRDR_DETECTION_305_308_oPCAN_RADAR_39b628dc_Tx: ComBitPosition=423, ComBitSize=1, ComSignalInitValue=0, ComSignalType=BOOLEAN, ComHandleId=6451, ComSystemTemplateSystemSignalRef=DET_SUPER_RES_TARGET_308
            DET_CONFD_ELEVATION_305_oRDR_DETECTION_305_308_oPCAN_RADAR_eacfe463_Tx: ComBitPosition=101, ComBitSize=2, ComSignalInitValue=0, ComSignalType=UINT8, ComHandleId=6389, ComSystemTemplateSystemSignalRef=DET_CONFD_ELEVATION_305
            DET_BELOW_RAIN_THOLD_305_oRDR_DETECTION_305_308_oPCAN_RADAR_3fbd7c93_Tx: ComBitPosition=39, ComBitSize=1, ComSignalInitValue=0, ComSignalType=UINT8, ComHandleId=6377, ComSystemTemplateSystemSignalRef=DET_BELOW_RAIN_THOLD_305
            DET_MTD_305_oRDR_DETECTION_305_308_oPCAN_RADAR_623c9753_Tx: ComBitPosition=47, ComBitSize=1, ComSignalInitValue=0, ComSignalType=UINT8, ComHandleId=6416, ComSystemTemplateSystemSignalRef=DET_MTD_305
            DET_IDM_307_oRDR_DETECTION_305_308_oPCAN_RADAR_f51f0ae3_Tx: ComBitPosition=287, ComBitSize=1, ComSignalInitValue=0, ComSignalType=UINT8, ComHandleId=6411, ComSystemTemplateSystemSignalRef=DET_IDM_307
            DET_IDM_305_oRDR_DETECTION_305_308_oPCAN_RADAR_048fa588_Tx: ComBitPosition=63, ComBitSize=1, ComSignalInitValue=0, ComSignalType=UINT8, ComHandleId=6409, ComSystemTemplateSystemSignalRef=DET_IDM_305
            DET_PROB_1STAZHYPO_305_oRDR_DETECTION_305_308_oPCAN_RADAR_f1887f9e_Tx: ComBitPosition=103, ComBitSize=1, ComSignalInitValue=0, ComSignalType=BOOLEAN, ComHandleId=6420, ComSystemTemplateSystemSignalRef=DET_PROB_1STAZHYPO_305
            DET_PROB_1STAZHYPO_306_oRDR_DETECTION_305_308_oPCAN_RADAR_95680460_Tx: ComBitPosition=215, ComBitSize=1, ComSignalInitValue=0, ComSignalType=BOOLEAN, ComHandleId=6421, ComSystemTemplateSystemSignalRef=DET_PROB_1STAZHYPO_306
            DET_BELOW_RAIN_THOLD_306_oRDR_DETECTION_305_308_oPCAN_RADAR_5b5d076d_Tx: ComBitPosition=151, ComBitSize=1, ComSignalInitValue=0, ComSignalType=UINT8, ComHandleId=6378, ComSystemTemplateSystemSignalRef=DET_BELOW_RAIN_THOLD_306
            DET_MTD_308_oRDR_DETECTION_305_308_oPCAN_RADAR_bfbcaa7f_Tx: ComBitPosition=383, ComBitSize=1, ComSignalInitValue=0, ComSignalType=UINT8, ComHandleId=6419, ComSystemTemplateSystemSignalRef=DET_MTD_308
            DET_IDM_308_oRDR_DETECTION_305_308_oPCAN_RADAR_d90f98a4_Tx: ComBitPosition=399, ComBitSize=1, ComSignalInitValue=0, ComSignalType=UINT8, ComHandleId=6412, ComSystemTemplateSystemSignalRef=DET_IDM_308
            DET_PROB_1STAZHYPO_307_oRDR_DETECTION_305_308_oPCAN_RADAR_0018d0f5_Tx: ComBitPosition=327, ComBitSize=1, ComSignalInitValue=0, ComSignalType=BOOLEAN, ComHandleId=6422, ComSystemTemplateSystemSignalRef=DET_PROB_1STAZHYPO_307
            DET_BELOW_RAIN_THOLD_308_oRDR_DETECTION_305_308_oPCAN_RADAR_e23d41bf_Tx: ComBitPosition=375, ComBitSize=1, ComSignalInitValue=0, ComSignalType=UINT8, ComHandleId=6380, ComSystemTemplateSystemSignalRef=DET_BELOW_RAIN_THOLD_308
            DET_IDM_306_oRDR_DETECTION_305_308_oPCAN_RADAR_606fde76_Tx: ComBitPosition=175, ComBitSize=1, ComSignalInitValue=0, ComSignalType=UINT8, ComHandleId=6410, ComSystemTemplateSystemSignalRef=DET_IDM_306
            DET_PROB_1STAZHYPO_308_oRDR_DETECTION_305_308_oPCAN_RADAR_2c0842b2_Tx: ComBitPosition=439, ComBitSize=1, ComSignalInitValue=0, ComSignalType=BOOLEAN, ComHandleId=6423, ComSystemTemplateSystemSignalRef=DET_PROB_1STAZHYPO_308
            DET_BELOW_RAIN_THOLD_307_oRDR_DETECTION_305_308_oPCAN_RADAR_ce2dd3f8_Tx: ComBitPosition=263, ComBitSize=1, ComSignalInitValue=0, ComSignalType=UINT8, ComHandleId=6379, ComSystemTemplateSystemSignalRef=DET_BELOW_RAIN_THOLD_307
            DET_MTD_307_oRDR_DETECTION_305_308_oPCAN_RADAR_93ac3838_Tx: ComBitPosition=271, ComBitSize=1, ComSignalInitValue=0, ComSignalType=UINT8, ComHandleId=6418, ComSystemTemplateSystemSignalRef=DET_MTD_307
            DET_MTD_306_oRDR_DETECTION_305_308_oPCAN_RADAR_06dcecad_Tx: ComBitPosition=159, ComBitSize=1, ComSignalInitValue=0, ComSignalType=UINT8, ComHandleId=6417, ComSystemTemplateSystemSignalRef=DET_MTD_306
        SG_Detections_273_276_oRDR_DETECTION_273_276_oPCAN_RADAR_df34482a_Tx: ComTransferProperty=TRIGGERED, ComHandleId=70, ComSystemTemplateSignalGroupRef=SG_Detections_273_276
          83 x ComGroupSignal, all with ComSignalEndianness=LITTLE_ENDIAN, ComTransferProperty=PENDING, ComSignalAccess=ACCESS_NEEDED_BY_SWC_OR_COM:
            DET_RANGE_ERR_276_oRDR_DETECTION_273_276_oPCAN_RADAR_37bd89ee_Tx: ComBitPosition=376, ComBitSize=7, ComSignalInitValue=0, ComSignalType=UINT8, ComHandleId=5767, ComSystemTemplateSystemSignalRef=DET_RANGE_ERR_276
            DET_AZIMUTH_ERR_275_oRDR_DETECTION_273_276_oPCAN_RADAR_409bae37_Tx: ComBitPosition=329, ComBitSize=7, ComSignalInitValue=0, ComSignalType=UINT8, ComHandleId=5711, ComSystemTemplateSystemSignalRef=DET_AZIMUTH_ERR_275
            DET_EXISTENCE_PROB_276_oRDR_DETECTION_273_276_oPCAN_RADAR_04db7225_Tx: ComBitPosition=448, ComBitSize=6, ComSignalInitValue=0, ComSignalType=UINT8, ComHandleId=5740, ComSystemTemplateSystemSignalRef=DET_EXISTENCE_PROB_276
            DET_ELEVATION_ERR_275_oRDR_DETECTION_273_276_oPCAN_RADAR_b2a47cbb_Tx: ComBitPosition=304, ComBitSize=6, ComSignalInitValue=0, ComSignalType=UINT8, ComHandleId=5735, ComSystemTemplateSystemSignalRef=DET_ELEVATION_ERR_275
            DET_SUPER_RES_TARGET_275_oRDR_DETECTION_273_276_oPCAN_RADAR_eaa4c161_Tx: ComBitPosition=311, ComBitSize=1, ComSignalInitValue=0, ComSignalType=BOOLEAN, ComHandleId=5786, ComSystemTemplateSystemSignalRef=DET_SUPER_RES_TARGET_275
            DET_SNR_275_oRDR_DETECTION_273_276_oPCAN_RADAR_db3de904_Tx: ComBitPosition=344, ComBitSize=8, ComSignalInitValue=0, ComSignalType=UINT8, ComHandleId=5782, ComSystemTemplateSystemSignalRef=DET_SNR_275
            DET_HVC_FLAG_276_oRDR_DETECTION_273_276_oPCAN_RADAR_e5af315a_Tx: ComBitPosition=422, ComBitSize=1, ComSignalInitValue=0, ComSignalType=BOOLEAN, ComHandleId=5744, ComSystemTemplateSystemSignalRef=DET_HVC_FLAG_276
            DET_BI_STATIC_FLAG_276_oRDR_DETECTION_273_276_oPCAN_RADAR_d6e200b9_Tx: ComBitPosition=440, ComBitSize=1, ComSignalInitValue=0, ComSignalType=BOOLEAN, ComHandleId=5720, ComSystemTemplateSystemSignalRef=DET_BI_STATIC_FLAG_276
            DET_ELEVATION_ERR_276_oRDR_DETECTION_273_276_oPCAN_RADAR_d6440745_Tx: ComBitPosition=416, ComBitSize=6, ComSignalInitValue=0, ComSignalType=UINT8, ComHandleId=5736, ComSystemTemplateSystemSignalRef=DET_ELEVATION_ERR_276
            DET_RANGE_VELOCITY_ERR_276_oRDR_DETECTION_273_276_oPCAN_RADAR_ea480a10_Tx: ComBitPosition=400, ComBitSize=8, ComSignalInitValue=0, ComSignalType=UINT8, ComHandleId=5775, ComSystemTemplateSystemSignalRef=DET_RANGE_VELOCITY_ERR_276
            DET_RANGE_ERR_273_oRDR_DETECTION_273_276_oPCAN_RADAR_9a9d05ec_Tx: ComBitPosition=40, ComBitSize=7, ComSignalInitValue=0, ComSignalType=UINT8, ComHandleId=5764, ComSystemTemplateSystemSignalRef=DET_RANGE_ERR_273
            DET_SNR_273_oRDR_DETECTION_273_276_oPCAN_RADAR_12fd1ef8_Tx: ComBitPosition=120, ComBitSize=8, ComSignalInitValue=0, ComSignalType=UINT8, ComHandleId=5780, ComSystemTemplateSystemSignalRef=DET_SNR_273
            DET_ELEVATION_274_oRDR_DETECTION_273_276_oPCAN_RADAR_a0ed305b_Tx: ComBitPosition=184, ComBitSize=8, ComSignalInitValue=0, ComSignalType=UINT8, ComHandleId=5730, ComSystemTemplateSystemSignalRef=DET_ELEVATION_274
            DET_AZIMUTH_ERR_273_oRDR_DETECTION_273_276_oPCAN_RADAR_895b59cb_Tx: ComBitPosition=105, ComBitSize=7, ComSignalInitValue=0, ComSignalType=UINT8, ComHandleId=5709, ComSystemTemplateSystemSignalRef=DET_AZIMUTH_ERR_273
            DET_CONFD_AZIMUTH_273_oRDR_DETECTION_273_276_oPCAN_RADAR_2f08c6f4_Tx: ComBitPosition=118, ComBitSize=2, ComSignalInitValue=0, ComSignalType=UINT8, ComHandleId=5721, ComSystemTemplateSystemSignalRef=DET_CONFD_AZIMUTH_273
            DET_RANGE_VELOCITY_ERR_274_oRDR_DETECTION_273_276_oPCAN_RADAR_1bd8a57b_Tx: ComBitPosition=176, ComBitSize=8, ComSignalInitValue=0, ComSignalType=UINT8, ComHandleId=5773, ComSystemTemplateSystemSignalRef=DET_RANGE_VELOCITY_ERR_274
            DET_HVC_FLAG_274_oRDR_DETECTION_273_276_oPCAN_RADAR_143f9e31_Tx: ComBitPosition=198, ComBitSize=1, ComSignalInitValue=0, ComSignalType=BOOLEAN, ComHandleId=5742, ComSystemTemplateSystemSignalRef=DET_HVC_FLAG_274
            DET_SNR_274_oRDR_DETECTION_273_276_oPCAN_RADAR_4e4d3d91_Tx: ComBitPosition=232, ComBitSize=8, ComSignalInitValue=0, ComSignalType=UINT8, ComHandleId=5781, ComSystemTemplateSystemSignalRef=DET_SNR_274
            DET_SUPER_RES_TARGET_276_oRDR_DETECTION_273_276_oPCAN_RADAR_8e44ba9f_Tx: ComBitPosition=423, ComBitSize=1, ComSignalInitValue=0, ComSignalType=BOOLEAN, ComHandleId=5787, ComSystemTemplateSystemSignalRef=DET_SUPER_RES_TARGET_276
            DET_EXISTENCE_PROB_273_oRDR_DETECTION_273_276_oPCAN_RADAR_a9fbfe27_Tx: ComBitPosition=112, ComBitSize=6, ComSignalInitValue=0, ComSignalType=UINT8, ComHandleId=5737, ComSystemTemplateSystemSignalRef=DET_EXISTENCE_PROB_273
            DET_AZIMUTH_275_oRDR_DETECTION_273_276_oPCAN_RADAR_e42e3bc2_Tx: ComBitPosition=312, ComBitSize=13, ComSignalInitValue=0, ComSignalType=UINT16, ComHandleId=5707, ComSystemTemplateSystemSignalRef=DET_AZIMUTH_275
            DET_EXISTENCE_PROB_274_oRDR_DETECTION_273_276_oPCAN_RADAR_f54bdd4e_Tx: ComBitPosition=224, ComBitSize=6, ComSignalInitValue=0, ComSignalType=UINT8, ComHandleId=5738, ComSystemTemplateSystemSignalRef=DET_EXISTENCE_PROB_274
            DET_ELEVATION_275_oRDR_DETECTION_273_276_oPCAN_RADAR_359de4ce_Tx: ComBitPosition=296, ComBitSize=8, ComSignalInitValue=0, ComSignalType=UINT8, ComHandleId=5731, ComSystemTemplateSystemSignalRef=DET_ELEVATION_275
            DET_RANGE_275_oRDR_DETECTION_273_276_oPCAN_RADAR_f4b54879_Tx: ComBitPosition=248, ComBitSize=15, ComSignalInitValue=0, ComSignalType=UINT16, ComHandleId=5762, ComSystemTemplateSystemSignalRef=DET_RANGE_275
            DET_AZIMUTH_276_oRDR_DETECTION_273_276_oPCAN_RADAR_80ce403c_Tx: ComBitPosition=424, ComBitSize=13, ComSignalInitValue=0, ComSignalType=UINT16, ComHandleId=5708, ComSystemTemplateSystemSignalRef=DET_AZIMUTH_276
            DET_MH_CRC16_273_276_oRDR_DETECTION_273_276_oPCAN_RADAR_5bbc9a21_Tx: ComBitPosition=0, ComBitSize=16, ComSignalInitValue=0, ComSignalType=UINT16, ComHandleId=5749, ComSystemTemplateSystemSignalRef=DET_MH_CRC16_273_276
            DET_CONFD_AZIMUTH_276_oRDR_DETECTION_273_276_oPCAN_RADAR_82284af6_Tx: ComBitPosition=454, ComBitSize=2, ComSignalInitValue=0, ComSignalType=UINT8, ComHandleId=5724, ComSystemTemplateSystemSignalRef=DET_CONFD_AZIMUTH_276
            DET_RANGE_VELOCITY_276_oRDR_DETECTION_273_276_oPCAN_RADAR_e5f3f1a2_Tx: ComBitPosition=384, ComBitSize=15, ComSignalInitValue=16384, ComSignalType=UINT16, ComHandleId=5771, ComSystemTemplateSystemSignalRef=DET_RANGE_VELOCITY_276
            DET_CONFD_AZIMUTH_274_oRDR_DETECTION_273_276_oPCAN_RADAR_73b8e59d_Tx: ComBitPosition=230, ComBitSize=2, ComSignalInitValue=0, ComSignalType=UINT8, ComHandleId=5722, ComSystemTemplateSystemSignalRef=DET_CONFD_AZIMUTH_274
            DET_CONFD_ELEVATION_274_oRDR_DETECTION_273_276_oPCAN_RADAR_712de467_Tx: ComBitPosition=213, ComBitSize=2, ComSignalInitValue=0, ComSignalType=UINT8, ComHandleId=5726, ComSystemTemplateSystemSignalRef=DET_CONFD_ELEVATION_274
            DET_RANGE_VELOCITY_ERR_275_oRDR_DETECTION_273_276_oPCAN_RADAR_8ea871ee_Tx: ComBitPosition=288, ComBitSize=8, ComSignalInitValue=0, ComSignalType=UINT8, ComHandleId=5774, ComSystemTemplateSystemSignalRef=DET_RANGE_VELOCITY_ERR_275
            DET_RANGE_VELOCITY_275_oRDR_DETECTION_273_276_oPCAN_RADAR_81138a5c_Tx: ComBitPosition=272, ComBitSize=15, ComSignalInitValue=16384, ComSignalType=UINT16, ComHandleId=5770, ComSystemTemplateSystemSignalRef=DET_RANGE_VELOCITY_275
            DET_AZIMUTH_273_oRDR_DETECTION_273_276_oPCAN_RADAR_2deecc3e_Tx: ComBitPosition=88, ComBitSize=13, ComSignalInitValue=0, ComSignalType=UINT16, ComHandleId=5705, ComSystemTemplateSystemSignalRef=DET_AZIMUTH_273
            DET_CONFD_ELEVATION_275_oRDR_DETECTION_273_276_oPCAN_RADAR_e45d30f2_Tx: ComBitPosition=325, ComBitSize=2, ComSignalInitValue=0, ComSignalType=UINT8, ComHandleId=5727, ComSystemTemplateSystemSignalRef=DET_CONFD_ELEVATION_275
            DET_AZIMUTH_ERR_274_oRDR_DETECTION_273_276_oPCAN_RADAR_d5eb7aa2_Tx: ComBitPosition=217, ComBitSize=7, ComSignalInitValue=0, ComSignalType=UINT8, ComHandleId=5710, ComSystemTemplateSystemSignalRef=DET_AZIMUTH_ERR_274
            DET_SNR_276_oRDR_DETECTION_273_276_oPCAN_RADAR_bfdd92fa_Tx: ComBitPosition=456, ComBitSize=8, ComSignalInitValue=0, ComSignalType=UINT8, ComHandleId=5783, ComSystemTemplateSystemSignalRef=DET_SNR_276
            DET_AZIMUTH_274_oRDR_DETECTION_273_276_oPCAN_RADAR_715eef57_Tx: ComBitPosition=200, ComBitSize=13, ComSignalInitValue=0, ComSignalType=UINT16, ComHandleId=5706, ComSystemTemplateSystemSignalRef=DET_AZIMUTH_274
            DET_MH_SCAN_INDEX_4LSB_273_276_oRDR_DETECTION_273_276_oPCAN_RADAR_13e31e9a_Tx: ComBitPosition=476, ComBitSize=4, ComSignalInitValue=0, ComSignalType=UINT8, ComHandleId=5751, ComSystemTemplateSystemSignalRef=DET_MH_SCAN_INDEX_4LSB_273_276
            DET_ELEVATION_273_oRDR_DETECTION_273_276_oPCAN_RADAR_fc5d1332_Tx: ComBitPosition=72, ComBitSize=8, ComSignalInitValue=0, ComSignalType=UINT8, ComHandleId=5729, ComSystemTemplateSystemSignalRef=DET_ELEVATION_273
            DET_CONFD_AZIMUTH_275_oRDR_DETECTION_273_276_oPCAN_RADAR_e6c83108_Tx: ComBitPosition=342, ComBitSize=2, ComSignalInitValue=0, ComSignalType=UINT8, ComHandleId=5723, ComSystemTemplateSystemSignalRef=DET_CONFD_AZIMUTH_275
            DET_RCS_273_oRDR_DETECTION_273_276_oPCAN_RADAR_cf534afa_Tx: ComBitPosition=128, ComBitSize=8, ComSignalInitValue=128, ComSignalType=UINT8, ComHandleId=5776, ComSystemTemplateSystemSignalRef=DET_RCS_273
            DET_CONFD_ELEVATION_273_oRDR_DETECTION_273_276_oPCAN_RADAR_2d9dc70e_Tx: ComBitPosition=101, ComBitSize=2, ComSignalInitValue=0, ComSignalType=UINT8, ComHandleId=5725, ComSystemTemplateSystemSignalRef=DET_CONFD_ELEVATION_273
            DET_SUPER_RES_TARGET_274_oRDR_DETECTION_273_276_oPCAN_RADAR_7fd415f4_Tx: ComBitPosition=199, ComBitSize=1, ComSignalInitValue=0, ComSignalType=BOOLEAN, ComHandleId=5785, ComSystemTemplateSystemSignalRef=DET_SUPER_RES_TARGET_274
            DET_RANGE_VELOCITY_ERR_273_oRDR_DETECTION_273_276_oPCAN_RADAR_47688612_Tx: ComBitPosition=64, ComBitSize=8, ComSignalInitValue=0, ComSignalType=UINT8, ComHandleId=5772, ComSystemTemplateSystemSignalRef=DET_RANGE_VELOCITY_ERR_273
            DET_RANGE_273_oRDR_DETECTION_273_276_oPCAN_RADAR_3d75bf85_Tx: ComBitPosition=24, ComBitSize=15, ComSignalInitValue=0, ComSignalType=UINT16, ComHandleId=5760, ComSystemTemplateSystemSignalRef=DET_RANGE_273
            DET_SUPER_RES_TARGET_273_oRDR_DETECTION_273_276_oPCAN_RADAR_2364369d_Tx: ComBitPosition=87, ComBitSize=1, ComSignalInitValue=0, ComSignalType=BOOLEAN, ComHandleId=5784, ComSystemTemplateSystemSignalRef=DET_SUPER_RES_TARGET_273
            DET_RANGE_274_oRDR_DETECTION_273_276_oPCAN_RADAR_61c59cec_Tx: ComBitPosition=136, ComBitSize=15, ComSignalInitValue=0, ComSignalType=UINT16, ComHandleId=5761, ComSystemTemplateSystemSignalRef=DET_RANGE_274
            DET_BI_STATIC_FLAG_275_oRDR_DETECTION_273_276_oPCAN_RADAR_b2027b47_Tx: ComBitPosition=328, ComBitSize=1, ComSignalInitValue=0, ComSignalType=BOOLEAN, ComHandleId=5719, ComSystemTemplateSystemSignalRef=DET_BI_STATIC_FLAG_275
            DET_EXISTENCE_PROB_275_oRDR_DETECTION_273_276_oPCAN_RADAR_603b09db_Tx: ComBitPosition=336, ComBitSize=6, ComSignalInitValue=0, ComSignalType=UINT8, ComHandleId=5739, ComSystemTemplateSystemSignalRef=DET_EXISTENCE_PROB_275
            DET_HVC_FLAG_275_oRDR_DETECTION_273_276_oPCAN_RADAR_814f4aa4_Tx: ComBitPosition=310, ComBitSize=1, ComSignalInitValue=0, ComSignalType=BOOLEAN, ComHandleId=5743, ComSystemTemplateSystemSignalRef=DET_HVC_FLAG_275
            DET_RANGE_ERR_275_oRDR_DETECTION_273_276_oPCAN_RADAR_535df210_Tx: ComBitPosition=264, ComBitSize=7, ComSignalInitValue=0, ComSignalType=UINT8, ComHandleId=5766, ComSystemTemplateSystemSignalRef=DET_RANGE_ERR_275
            DET_RANGE_VELOCITY_274_oRDR_DETECTION_273_276_oPCAN_RADAR_14635ec9_Tx: ComBitPosition=160, ComBitSize=15, ComSignalInitValue=16384, ComSignalType=UINT16, ComHandleId=5769, ComSystemTemplateSystemSignalRef=DET_RANGE_VELOCITY_274
            DET_ELEVATION_276_oRDR_DETECTION_273_276_oPCAN_RADAR_517d9f30_Tx: ComBitPosition=408, ComBitSize=8, ComSignalInitValue=0, ComSignalType=UINT8, ComHandleId=5732, ComSystemTemplateSystemSignalRef=DET_ELEVATION_276
            DET_ELEVATION_ERR_274_oRDR_DETECTION_273_276_oPCAN_RADAR_27d4a82e_Tx: ComBitPosition=192, ComBitSize=6, ComSignalInitValue=0, ComSignalType=UINT8, ComHandleId=5734, ComSystemTemplateSystemSignalRef=DET_ELEVATION_ERR_274
            DET_MH_CYCLE_COUNTER_273_276_oRDR_DETECTION_273_276_oPCAN_RADAR_dfc93b16_Tx: ComBitPosition=16, ComBitSize=8, ComSignalInitValue=0, ComSignalType=UINT8, ComHandleId=5750, ComSystemTemplateSystemSignalRef=DET_MH_CYCLE_COUNTER_273_276
            DET_RANGE_ERR_274_oRDR_DETECTION_273_276_oPCAN_RADAR_c62d2685_Tx: ComBitPosition=152, ComBitSize=7, ComSignalInitValue=0, ComSignalType=UINT8, ComHandleId=5765, ComSystemTemplateSystemSignalRef=DET_RANGE_ERR_274
            DET_HVC_FLAG_273_oRDR_DETECTION_273_276_oPCAN_RADAR_488fbd58_Tx: ComBitPosition=86, ComBitSize=1, ComSignalInitValue=0, ComSignalType=BOOLEAN, ComHandleId=5741, ComSystemTemplateSystemSignalRef=DET_HVC_FLAG_273
            DET_RCS_275_oRDR_DETECTION_273_276_oPCAN_RADAR_0693bd06_Tx: ComBitPosition=352, ComBitSize=8, ComSignalInitValue=128, ComSignalType=UINT8, ComHandleId=5778, ComSystemTemplateSystemSignalRef=DET_RCS_275
            DET_BI_STATIC_FLAG_273_oRDR_DETECTION_273_276_oPCAN_RADAR_7bc28cbb_Tx: ComBitPosition=104, ComBitSize=1, ComSignalInitValue=0, ComSignalType=BOOLEAN, ComHandleId=5717, ComSystemTemplateSystemSignalRef=DET_BI_STATIC_FLAG_273
            DET_RANGE_276_oRDR_DETECTION_273_276_oPCAN_RADAR_90553387_Tx: ComBitPosition=360, ComBitSize=15, ComSignalInitValue=0, ComSignalType=UINT16, ComHandleId=5763, ComSystemTemplateSystemSignalRef=DET_RANGE_276
            DET_RCS_276_oRDR_DETECTION_273_276_oPCAN_RADAR_6273c6f8_Tx: ComBitPosition=464, ComBitSize=8, ComSignalInitValue=128, ComSignalType=UINT8, ComHandleId=5779, ComSystemTemplateSystemSignalRef=DET_RCS_276
            DET_AZIMUTH_ERR_276_oRDR_DETECTION_273_276_oPCAN_RADAR_247bd5c9_Tx: ComBitPosition=441, ComBitSize=7, ComSignalInitValue=0, ComSignalType=UINT8, ComHandleId=5712, ComSystemTemplateSystemSignalRef=DET_AZIMUTH_ERR_276
            DET_RCS_274_oRDR_DETECTION_273_276_oPCAN_RADAR_93e36993_Tx: ComBitPosition=240, ComBitSize=8, ComSignalInitValue=128, ComSignalType=UINT8, ComHandleId=5777, ComSystemTemplateSystemSignalRef=DET_RCS_274
            DET_RANGE_VELOCITY_273_oRDR_DETECTION_273_276_oPCAN_RADAR_48d37da0_Tx: ComBitPosition=48, ComBitSize=15, ComSignalInitValue=16384, ComSignalType=UINT16, ComHandleId=5768, ComSystemTemplateSystemSignalRef=DET_RANGE_VELOCITY_273
            DET_ELEVATION_ERR_273_oRDR_DETECTION_273_276_oPCAN_RADAR_7b648b47_Tx: ComBitPosition=80, ComBitSize=6, ComSignalInitValue=0, ComSignalType=UINT8, ComHandleId=5733, ComSystemTemplateSystemSignalRef=DET_ELEVATION_ERR_273
            DET_CONFD_ELEVATION_276_oRDR_DETECTION_273_276_oPCAN_RADAR_80bd4b0c_Tx: ComBitPosition=437, ComBitSize=2, ComSignalInitValue=0, ComSignalType=UINT8, ComHandleId=5728, ComSystemTemplateSystemSignalRef=DET_CONFD_ELEVATION_276
            DET_BI_STATIC_FLAG_274_oRDR_DETECTION_273_276_oPCAN_RADAR_2772afd2_Tx: ComBitPosition=216, ComBitSize=1, ComSignalInitValue=0, ComSignalType=BOOLEAN, ComHandleId=5718, ComSystemTemplateSystemSignalRef=DET_BI_STATIC_FLAG_274
            DET_MTD_273_oRDR_DETECTION_273_276_oPCAN_RADAR_a56eb43e_Tx: ComBitPosition=47, ComBitSize=1, ComSignalInitValue=0, ComSignalType=UINT8, ComHandleId=5752, ComSystemTemplateSystemSignalRef=DET_MTD_273
            DET_PROB_1STAZHYPO_274_oRDR_DETECTION_273_276_oPCAN_RADAR_6a6a7f9a_Tx: ComBitPosition=215, ComBitSize=1, ComSignalInitValue=0, ComSignalType=BOOLEAN, ComHandleId=5757, ComSystemTemplateSystemSignalRef=DET_PROB_1STAZHYPO_274
            DET_PROB_1STAZHYPO_273_oRDR_DETECTION_273_276_oPCAN_RADAR_36da5cf3_Tx: ComBitPosition=103, ComBitSize=1, ComSignalInitValue=0, ComSignalType=BOOLEAN, ComHandleId=5756, ComSystemTemplateSystemSignalRef=DET_PROB_1STAZHYPO_273
            DET_BELOW_RAIN_THOLD_275_oRDR_DETECTION_273_276_oPCAN_RADAR_312fa802_Tx: ComBitPosition=263, ComBitSize=1, ComSignalInitValue=0, ComSignalType=UINT8, ComHandleId=5715, ComSystemTemplateSystemSignalRef=DET_BELOW_RAIN_THOLD_275
            DET_MTD_275_oRDR_DETECTION_273_276_oPCAN_RADAR_6cae43c2_Tx: ComBitPosition=271, ComBitSize=1, ComSignalInitValue=0, ComSignalType=UINT8, ComHandleId=5754, ComSystemTemplateSystemSignalRef=DET_MTD_275
            DET_BELOW_RAIN_THOLD_273_oRDR_DETECTION_273_276_oPCAN_RADAR_f8ef5ffe_Tx: ComBitPosition=39, ComBitSize=1, ComSignalInitValue=0, ComSignalType=UINT8, ComHandleId=5713, ComSystemTemplateSystemSignalRef=DET_BELOW_RAIN_THOLD_273
            DET_PROB_1STAZHYPO_276_oRDR_DETECTION_273_276_oPCAN_RADAR_9bfad0f1_Tx: ComBitPosition=439, ComBitSize=1, ComSignalInitValue=0, ComSignalType=BOOLEAN, ComHandleId=5759, ComSystemTemplateSystemSignalRef=DET_PROB_1STAZHYPO_276
            DET_IDM_276_oRDR_DETECTION_273_276_oPCAN_RADAR_6efd0ae7_Tx: ComBitPosition=399, ComBitSize=1, ComSignalInitValue=0, ComSignalType=UINT8, ComHandleId=5748, ComSystemTemplateSystemSignalRef=DET_IDM_276
            DET_IDM_274_oRDR_DETECTION_273_276_oPCAN_RADAR_9f6da58c_Tx: ComBitPosition=175, ComBitSize=1, ComSignalInitValue=0, ComSignalType=UINT8, ComHandleId=5746, ComSystemTemplateSystemSignalRef=DET_IDM_274
            DET_IDM_273_oRDR_DETECTION_273_276_oPCAN_RADAR_c3dd86e5_Tx: ComBitPosition=63, ComBitSize=1, ComSignalInitValue=0, ComSignalType=UINT8, ComHandleId=5745, ComSystemTemplateSystemSignalRef=DET_IDM_273
            DET_MTD_276_oRDR_DETECTION_273_276_oPCAN_RADAR_084e383c_Tx: ComBitPosition=383, ComBitSize=1, ComSignalInitValue=0, ComSignalType=UINT8, ComHandleId=5755, ComSystemTemplateSystemSignalRef=DET_MTD_276
            DET_IDM_275_oRDR_DETECTION_273_276_oPCAN_RADAR_0a1d7119_Tx: ComBitPosition=287, ComBitSize=1, ComSignalInitValue=0, ComSignalType=UINT8, ComHandleId=5747, ComSystemTemplateSystemSignalRef=DET_IDM_275
            DET_BELOW_RAIN_THOLD_274_oRDR_DETECTION_273_276_oPCAN_RADAR_a45f7c97_Tx: ComBitPosition=151, ComBitSize=1, ComSignalInitValue=0, ComSignalType=UINT8, ComHandleId=5714, ComSystemTemplateSystemSignalRef=DET_BELOW_RAIN_THOLD_274
            DET_BELOW_RAIN_THOLD_276_oRDR_DETECTION_273_276_oPCAN_RADAR_55cfd3fc_Tx: ComBitPosition=375, ComBitSize=1, ComSignalInitValue=0, ComSignalType=UINT8, ComHandleId=5716, ComSystemTemplateSystemSignalRef=DET_BELOW_RAIN_THOLD_276
            DET_PROB_1STAZHYPO_275_oRDR_DETECTION_273_276_oPCAN_RADAR_ff1aab0f_Tx: ComBitPosition=327, ComBitSize=1, ComSignalInitValue=0, ComSignalType=BOOLEAN, ComHandleId=5758, ComSystemTemplateSystemSignalRef=DET_PROB_1STAZHYPO_275
            DET_MTD_274_oRDR_DETECTION_273_276_oPCAN_RADAR_f9de9757_Tx: ComBitPosition=159, ComBitSize=1, ComSignalInitValue=0, ComSignalType=UINT8, ComHandleId=5753, ComSystemTemplateSystemSignalRef=DET_MTD_274
        SG_TrackerHeader_oRDR_OBJ_HEADER_002_oPCAN_RADAR_563ddea3_Tx: ComTransferProperty=TRIGGERED, ComHandleId=109, ComSystemTemplateSignalGroupRef=SG_TrackerHeader
          11 x ComGroupSignal, all with ComSignalEndianness=BIG_ENDIAN, ComSignalInitValue=0, ComTransferProperty=PENDING, ComSignalAccess=ACCESS_NEEDED_BY_SWC_OR_COM:
            HED_TRKR_NUM_OF_ACTIV_OBJS_oRDR_OBJ_HEADER_002_oPCAN_RADAR_66219812_Tx: ComBitPosition=55, ComBitSize=8, ComSignalType=UINT8, ComHandleId=8522, ComSystemTemplateSystemSignalRef=HED_TRKR_NUM_OF_ACTIV_OBJS
            HED_TRKR_TIME_INST_oRDR_OBJ_HEADER_002_oPCAN_RADAR_b8b3e235_Tx: ComBitPosition=63, ComBitSize=8, ComSignalType=UINT8, ComHandleId=8525, ComSystemTemplateSystemSignalRef=HED_TRKR_TIME_INST
            HED_TRKR_VEHICLE_IDX_oRDR_OBJ_HEADER_002_oPCAN_RADAR_90acc389_Tx: ComBitPosition=23, ComBitSize=16, ComSignalType=UINT16, ComHandleId=8527, ComSystemTemplateSystemSignalRef=HED_TRKR_VEHICLE_IDX
            HED_TRKR_VEH_COORD_TYPE_oRDR_OBJ_HEADER_002_oPCAN_RADAR_7d99e32a_Tx: ComBitPosition=32, ComBitSize=1, ComSignalType=BOOLEAN, ComHandleId=8528, ComSystemTemplateSystemSignalRef=HED_TRKR_VEH_COORD_TYPE
            HED_MH_002_CRC16_oRDR_OBJ_HEADER_002_oPCAN_RADAR_81f46ac0_Tx: ComBitPosition=143, ComBitSize=16, ComSignalType=UINT16, ComHandleId=8518, ComSystemTemplateSystemSignalRef=HED_MH_002_CRC16
            HED_TRKR_IDX_oRDR_OBJ_HEADER_002_oPCAN_RADAR_1c8e25ae_Tx: ComBitPosition=7, ComBitSize=16, ComSignalType=UINT16, ComHandleId=8521, ComSystemTemplateSystemSignalRef=HED_TRKR_IDX
            HED_TRKR_OBJLST_TIME_STAMP_SC_oRDR_OBJ_HEADER_002_oPCAN_RADAR_606a08de_Tx: ComBitPosition=79, ComBitSize=32, ComSignalType=UINT32, ComHandleId=8524, ComSystemTemplateSystemSignalRef=HED_TRKR_OBJLST_TIME_STAMP_SC
            HED_TRKR_TIME_PEAK_oRDR_OBJ_HEADER_002_oPCAN_RADAR_a4f5b1b3_Tx: ComBitPosition=71, ComBitSize=8, ComSignalType=UINT8, ComHandleId=8526, ComSystemTemplateSystemSignalRef=HED_TRKR_TIME_PEAK
            HED_TRKR_OBJLST_TIME_STAMP_NS_oRDR_OBJ_HEADER_002_oPCAN_RADAR_d5ff88d0_Tx: ComBitPosition=111, ComBitSize=32, ComSignalType=UINT32, ComHandleId=8523, ComSystemTemplateSystemSignalRef=HED_TRKR_OBJLST_TIME_STAMP_NS
            HED_MH_002_CYCLE_COUNTER_oRDR_OBJ_HEADER_002_oPCAN_RADAR_03c7ff49_Tx: ComBitPosition=159, ComBitSize=8, ComSignalType=UINT8, ComHandleId=8519, ComSystemTemplateSystemSignalRef=HED_MH_002_CYCLE_COUNTER
            HED_TRKR_DATA_QUALIFIER_oRDR_OBJ_HEADER_002_oPCAN_RADAR_2d7db6a6_Tx: ComBitPosition=42, ComBitSize=3, ComSignalType=UINT8, ComHandleId=8520, ComSystemTemplateSystemSignalRef=HED_TRKR_DATA_QUALIFIER
        SG_TrackerStatus_oRDR_OBJ_STATUS_003_oPCAN_RADAR_3d577421_Tx: ComTransferProperty=TRIGGERED, ComHandleId=174, ComSystemTemplateSignalGroupRef=SG_TrackerStatus
          8 x ComGroupSignal, all with ComSignalEndianness=BIG_ENDIAN, ComSignalInitValue=0, ComTransferProperty=PENDING, ComSignalAccess=ACCESS_NEEDED_BY_SWC_OR_COM:
            STS_OBJ_DBC_BASE_VER_MAJOR_oRDR_OBJ_STATUS_003_oPCAN_RADAR_9a35e806_Tx: ComBitPosition=71, ComBitSize=8, ComSignalType=UINT8, ComHandleId=11667, ComSystemTemplateSystemSignalRef=STS_OBJ_DBC_BASE_VER_MAJOR
            STS_OBJ_DBC_BASE_VER_MINOR_oRDR_OBJ_STATUS_003_oPCAN_RADAR_620f0a8a_Tx: ComBitPosition=79, ComBitSize=8, ComSignalType=UINT8, ComHandleId=11668, ComSystemTemplateSystemSignalRef=STS_OBJ_DBC_BASE_VER_MINOR
            STS_PERCEPTION_MODULE_ID_oRDR_OBJ_STATUS_003_oPCAN_RADAR_a04fe4df_Tx: ComBitPosition=31, ComBitSize=16, ComSignalType=UINT16, ComHandleId=11669, ComSystemTemplateSystemSignalRef=STS_PERCEPTION_MODULE_ID
            STS_TRKR_PATCH_VERSION_oRDR_OBJ_STATUS_003_oPCAN_RADAR_4bf666f9_Tx: ComBitPosition=23, ComBitSize=8, ComSignalType=UINT8, ComHandleId=11672, ComSystemTemplateSystemSignalRef=STS_TRKR_PATCH_VERSION
            STS_MH_003_CRC16_oRDR_OBJ_STATUS_003_oPCAN_RADAR_358216b5_Tx: ComBitPosition=87, ComBitSize=16, ComSignalType=UINT16, ComHandleId=11665, ComSystemTemplateSystemSignalRef=STS_MH_003_CRC16
            STS_TRKR_MINOR_VERSION_oRDR_OBJ_STATUS_003_oPCAN_RADAR_49ba56fe_Tx: ComBitPosition=15, ComBitSize=8, ComSignalType=UINT8, ComHandleId=11671, ComSystemTemplateSystemSignalRef=STS_TRKR_MINOR_VERSION
            STS_MH_003_CYCLE_COUNTER_oRDR_OBJ_STATUS_003_oPCAN_RADAR_49230fca_Tx: ComBitPosition=103, ComBitSize=8, ComSignalType=UINT8, ComHandleId=11666, ComSystemTemplateSystemSignalRef=STS_MH_003_CYCLE_COUNTER
            STS_TRKR_MAJOR_VERSION_oRDR_OBJ_STATUS_003_oPCAN_RADAR_04b44e02_Tx: ComBitPosition=7, ComBitSize=8, ComSignalType=UINT8, ComHandleId=11670, ComSystemTemplateSystemSignalRef=STS_TRKR_MAJOR_VERSION
        SG_Detections_081_084_oRDR_DETECTION_081_084_oPCAN_RADAR_0a9e14ed_Tx: ComTransferProperty=TRIGGERED, ComHandleId=22, ComSystemTemplateSignalGroupRef=SG_Detections_081_084
          83 x ComGroupSignal, all with ComSignalEndianness=LITTLE_ENDIAN, ComTransferProperty=PENDING, ComSignalAccess=ACCESS_NEEDED_BY_SWC_OR_COM:
            DET_AZIMUTH_082_oRDR_DETECTION_081_084_oPCAN_RADAR_58d3a3fd_Tx: ComBitPosition=200, ComBitSize=13, ComSignalInitValue=0, ComSignalType=UINT16, ComHandleId=1722, ComSystemTemplateSystemSignalRef=DET_AZIMUTH_082
            DET_RANGE_VELOCITY_081_oRDR_DETECTION_081_084_oPCAN_RADAR_590e699d_Tx: ComBitPosition=48, ComBitSize=15, ComSignalInitValue=16384, ComSignalType=UINT16, ComHandleId=1784, ComSystemTemplateSystemSignalRef=DET_RANGE_VELOCITY_081
            DET_MH_CRC16_081_084_oRDR_DETECTION_081_084_oPCAN_RADAR_8e16c6e6_Tx: ComBitPosition=0, ComBitSize=16, ComSignalInitValue=0, ComSignalType=UINT16, ComHandleId=1765, ComSystemTemplateSystemSignalRef=DET_MH_CRC16_081_084
            DET_BI_STATIC_FLAG_084_oRDR_DETECTION_081_084_oPCAN_RADAR_c73f1484_Tx: ComBitPosition=440, ComBitSize=1, ComSignalInitValue=0, ComSignalType=BOOLEAN, ComHandleId=1736, ComSystemTemplateSystemSignalRef=DET_BI_STATIC_FLAG_084
            DET_BI_STATIC_FLAG_082_oRDR_DETECTION_081_084_oPCAN_RADAR_0effe378_Tx: ComBitPosition=216, ComBitSize=1, ComSignalInitValue=0, ComSignalType=BOOLEAN, ComHandleId=1734, ComSystemTemplateSystemSignalRef=DET_BI_STATIC_FLAG_082
            DET_ELEVATION_ERR_082_oRDR_DETECTION_081_084_oPCAN_RADAR_0e59e484_Tx: ComBitPosition=192, ComBitSize=6, ComSignalInitValue=0, ComSignalType=UINT8, ComHandleId=1750, ComSystemTemplateSystemSignalRef=DET_ELEVATION_ERR_082
            DET_ELEVATION_083_oRDR_DETECTION_081_084_oPCAN_RADAR_1c10a864_Tx: ComBitPosition=296, ComBitSize=8, ComSignalInitValue=0, ComSignalType=UINT8, ComHandleId=1747, ComSystemTemplateSystemSignalRef=DET_ELEVATION_083
            DET_SUPER_RES_TARGET_083_oRDR_DETECTION_081_084_oPCAN_RADAR_c3298dcb_Tx: ComBitPosition=311, ComBitSize=1, ComSignalInitValue=0, ComSignalType=BOOLEAN, ComHandleId=1802, ComSystemTemplateSystemSignalRef=DET_SUPER_RES_TARGET_083
            DET_ELEVATION_ERR_083_oRDR_DETECTION_081_084_oPCAN_RADAR_9b293011_Tx: ComBitPosition=304, ComBitSize=6, ComSignalInitValue=0, ComSignalType=UINT8, ComHandleId=1751, ComSystemTemplateSystemSignalRef=DET_ELEVATION_ERR_083
            DET_CONFD_ELEVATION_083_oRDR_DETECTION_081_084_oPCAN_RADAR_cdd07c58_Tx: ComBitPosition=325, ComBitSize=2, ComSignalInitValue=0, ComSignalType=UINT8, ComHandleId=1743, ComSystemTemplateSystemSignalRef=DET_CONFD_ELEVATION_083
            DET_SUPER_RES_TARGET_084_oRDR_DETECTION_081_084_oPCAN_RADAR_9f99aea2_Tx: ComBitPosition=423, ComBitSize=1, ComSignalInitValue=0, ComSignalType=BOOLEAN, ComHandleId=1803, ComSystemTemplateSystemSignalRef=DET_SUPER_RES_TARGET_084
            DET_RCS_084_oRDR_DETECTION_081_084_oPCAN_RADAR_73aed2c5_Tx: ComBitPosition=464, ComBitSize=8, ComSignalInitValue=128, ComSignalType=UINT8, ComHandleId=1795, ComSystemTemplateSystemSignalRef=DET_RCS_084
            DET_AZIMUTH_ERR_082_oRDR_DETECTION_081_084_oPCAN_RADAR_fc663608_Tx: ComBitPosition=217, ComBitSize=7, ComSignalInitValue=0, ComSignalType=UINT8, ComHandleId=1726, ComSystemTemplateSystemSignalRef=DET_AZIMUTH_ERR_082
            DET_ELEVATION_082_oRDR_DETECTION_081_084_oPCAN_RADAR_89607cf1_Tx: ComBitPosition=184, ComBitSize=8, ComSignalInitValue=0, ComSignalType=UINT8, ComHandleId=1746, ComSystemTemplateSystemSignalRef=DET_ELEVATION_082
            DET_MH_SCAN_INDEX_4LSB_081_084_oRDR_DETECTION_081_084_oPCAN_RADAR_c649425d_Tx: ComBitPosition=476, ComBitSize=4, ComSignalInitValue=0, ComSignalType=UINT8, ComHandleId=1767, ComSystemTemplateSystemSignalRef=DET_MH_SCAN_INDEX_4LSB_081_084
            DET_SNR_082_oRDR_DETECTION_081_084_oPCAN_RADAR_67c0713b_Tx: ComBitPosition=232, ComBitSize=8, ComSignalInitValue=0, ComSignalType=UINT8, ComHandleId=1797, ComSystemTemplateSystemSignalRef=DET_SNR_082
            DET_RANGE_VELOCITY_ERR_081_oRDR_DETECTION_081_084_oPCAN_RADAR_56b5922f_Tx: ComBitPosition=64, ComBitSize=8, ComSignalInitValue=0, ComSignalType=UINT8, ComHandleId=1788, ComSystemTemplateSystemSignalRef=DET_RANGE_VELOCITY_ERR_081
            DET_AZIMUTH_083_oRDR_DETECTION_081_084_oPCAN_RADAR_cda37768_Tx: ComBitPosition=312, ComBitSize=13, ComSignalInitValue=0, ComSignalType=UINT16, ComHandleId=1723, ComSystemTemplateSystemSignalRef=DET_AZIMUTH_083
            DET_RANGE_ERR_082_oRDR_DETECTION_081_084_oPCAN_RADAR_efa06a2f_Tx: ComBitPosition=152, ComBitSize=7, ComSignalInitValue=0, ComSignalType=UINT8, ComHandleId=1781, ComSystemTemplateSystemSignalRef=DET_RANGE_ERR_082
            DET_AZIMUTH_084_oRDR_DETECTION_081_084_oPCAN_RADAR_91135401_Tx: ComBitPosition=424, ComBitSize=13, ComSignalInitValue=0, ComSignalType=UINT16, ComHandleId=1724, ComSystemTemplateSystemSignalRef=DET_AZIMUTH_084
            DET_SNR_084_oRDR_DETECTION_081_084_oPCAN_RADAR_ae0086c7_Tx: ComBitPosition=456, ComBitSize=8, ComSignalInitValue=0, ComSignalType=UINT8, ComHandleId=1799, ComSystemTemplateSystemSignalRef=DET_SNR_084
            DET_AZIMUTH_ERR_084_oRDR_DETECTION_081_084_oPCAN_RADAR_35a6c1f4_Tx: ComBitPosition=441, ComBitSize=7, ComSignalInitValue=0, ComSignalType=UINT8, ComHandleId=1728, ComSystemTemplateSystemSignalRef=DET_AZIMUTH_ERR_084
            DET_ELEVATION_081_oRDR_DETECTION_081_084_oPCAN_RADAR_ed80070f_Tx: ComBitPosition=72, ComBitSize=8, ComSignalInitValue=0, ComSignalType=UINT8, ComHandleId=1745, ComSystemTemplateSystemSignalRef=DET_ELEVATION_081
            DET_CONFD_ELEVATION_081_oRDR_DETECTION_081_084_oPCAN_RADAR_3c40d333_Tx: ComBitPosition=101, ComBitSize=2, ComSignalInitValue=0, ComSignalType=UINT8, ComHandleId=1741, ComSystemTemplateSystemSignalRef=DET_CONFD_ELEVATION_081
            DET_RANGE_081_oRDR_DETECTION_081_084_oPCAN_RADAR_2ca8abb8_Tx: ComBitPosition=24, ComBitSize=15, ComSignalInitValue=0, ComSignalType=UINT16, ComHandleId=1776, ComSystemTemplateSystemSignalRef=DET_RANGE_081
            DET_SUPER_RES_TARGET_082_oRDR_DETECTION_081_084_oPCAN_RADAR_5659595e_Tx: ComBitPosition=199, ComBitSize=1, ComSignalInitValue=0, ComSignalType=BOOLEAN, ComHandleId=1801, ComSystemTemplateSystemSignalRef=DET_SUPER_RES_TARGET_082
            DET_CONFD_AZIMUTH_084_oRDR_DETECTION_081_084_oPCAN_RADAR_93f55ecb_Tx: ComBitPosition=454, ComBitSize=2, ComSignalInitValue=0, ComSignalType=UINT8, ComHandleId=1740, ComSystemTemplateSystemSignalRef=DET_CONFD_AZIMUTH_084
            DET_CONFD_AZIMUTH_082_oRDR_DETECTION_081_084_oPCAN_RADAR_5a35a937_Tx: ComBitPosition=230, ComBitSize=2, ComSignalInitValue=0, ComSignalType=UINT8, ComHandleId=1738, ComSystemTemplateSystemSignalRef=DET_CONFD_AZIMUTH_082
            DET_RANGE_ERR_081_oRDR_DETECTION_081_084_oPCAN_RADAR_8b4011d1_Tx: ComBitPosition=40, ComBitSize=7, ComSignalInitValue=0, ComSignalType=UINT8, ComHandleId=1780, ComSystemTemplateSystemSignalRef=DET_RANGE_ERR_081
            DET_BI_STATIC_FLAG_083_oRDR_DETECTION_081_084_oPCAN_RADAR_9b8f37ed_Tx: ComBitPosition=328, ComBitSize=1, ComSignalInitValue=0, ComSignalType=BOOLEAN, ComHandleId=1735, ComSystemTemplateSystemSignalRef=DET_BI_STATIC_FLAG_083
            DET_EXISTENCE_PROB_084_oRDR_DETECTION_081_084_oPCAN_RADAR_15066618_Tx: ComBitPosition=448, ComBitSize=6, ComSignalInitValue=0, ComSignalType=UINT8, ComHandleId=1756, ComSystemTemplateSystemSignalRef=DET_EXISTENCE_PROB_084
            DET_RANGE_082_oRDR_DETECTION_081_084_oPCAN_RADAR_4848d046_Tx: ComBitPosition=136, ComBitSize=15, ComSignalInitValue=0, ComSignalType=UINT16, ComHandleId=1777, ComSystemTemplateSystemSignalRef=DET_RANGE_082
            DET_RANGE_VELOCITY_083_oRDR_DETECTION_081_084_oPCAN_RADAR_a89ec6f6_Tx: ComBitPosition=272, ComBitSize=15, ComSignalInitValue=16384, ComSignalType=UINT16, ComHandleId=1786, ComSystemTemplateSystemSignalRef=DET_RANGE_VELOCITY_083
            DET_AZIMUTH_081_oRDR_DETECTION_081_084_oPCAN_RADAR_3c33d803_Tx: ComBitPosition=88, ComBitSize=13, ComSignalInitValue=0, ComSignalType=UINT16, ComHandleId=1721, ComSystemTemplateSystemSignalRef=DET_AZIMUTH_081
            DET_RANGE_083_oRDR_DETECTION_081_084_oPCAN_RADAR_dd3804d3_Tx: ComBitPosition=248, ComBitSize=15, ComSignalInitValue=0, ComSignalType=UINT16, ComHandleId=1778, ComSystemTemplateSystemSignalRef=DET_RANGE_083
            DET_RCS_081_oRDR_DETECTION_081_084_oPCAN_RADAR_de8e5ec7_Tx: ComBitPosition=128, ComBitSize=8, ComSignalInitValue=128, ComSignalType=UINT8, ComHandleId=1792, ComSystemTemplateSystemSignalRef=DET_RCS_081
            DET_RCS_083_oRDR_DETECTION_081_084_oPCAN_RADAR_2f1ef1ac_Tx: ComBitPosition=352, ComBitSize=8, ComSignalInitValue=128, ComSignalType=UINT8, ComHandleId=1794, ComSystemTemplateSystemSignalRef=DET_RCS_083
            DET_CONFD_ELEVATION_082_oRDR_DETECTION_081_084_oPCAN_RADAR_58a0a8cd_Tx: ComBitPosition=213, ComBitSize=2, ComSignalInitValue=0, ComSignalType=UINT8, ComHandleId=1742, ComSystemTemplateSystemSignalRef=DET_CONFD_ELEVATION_082
            DET_RANGE_VELOCITY_ERR_083_oRDR_DETECTION_081_084_oPCAN_RADAR_a7253d44_Tx: ComBitPosition=288, ComBitSize=8, ComSignalInitValue=0, ComSignalType=UINT8, ComHandleId=1790, ComSystemTemplateSystemSignalRef=DET_RANGE_VELOCITY_ERR_083
            DET_SNR_081_oRDR_DETECTION_081_084_oPCAN_RADAR_03200ac5_Tx: ComBitPosition=120, ComBitSize=8, ComSignalInitValue=0, ComSignalType=UINT8, ComHandleId=1796, ComSystemTemplateSystemSignalRef=DET_SNR_081
            DET_ELEVATION_ERR_081_oRDR_DETECTION_081_084_oPCAN_RADAR_6ab99f7a_Tx: ComBitPosition=80, ComBitSize=6, ComSignalInitValue=0, ComSignalType=UINT8, ComHandleId=1749, ComSystemTemplateSystemSignalRef=DET_ELEVATION_ERR_081
            DET_HVC_FLAG_083_oRDR_DETECTION_081_084_oPCAN_RADAR_a8c2060e_Tx: ComBitPosition=310, ComBitSize=1, ComSignalInitValue=0, ComSignalType=BOOLEAN, ComHandleId=1759, ComSystemTemplateSystemSignalRef=DET_HVC_FLAG_083
            DET_MH_CYCLE_COUNTER_081_084_oRDR_DETECTION_081_084_oPCAN_RADAR_0a6367d1_Tx: ComBitPosition=16, ComBitSize=8, ComSignalInitValue=0, ComSignalType=UINT8, ComHandleId=1766, ComSystemTemplateSystemSignalRef=DET_MH_CYCLE_COUNTER_081_084
            DET_RANGE_084_oRDR_DETECTION_081_084_oPCAN_RADAR_818827ba_Tx: ComBitPosition=360, ComBitSize=15, ComSignalInitValue=0, ComSignalType=UINT16, ComHandleId=1779, ComSystemTemplateSystemSignalRef=DET_RANGE_084
            DET_HVC_FLAG_084_oRDR_DETECTION_081_084_oPCAN_RADAR_f4722567_Tx: ComBitPosition=422, ComBitSize=1, ComSignalInitValue=0, ComSignalType=BOOLEAN, ComHandleId=1760, ComSystemTemplateSystemSignalRef=DET_HVC_FLAG_084
            DET_HVC_FLAG_081_oRDR_DETECTION_081_084_oPCAN_RADAR_5952a965_Tx: ComBitPosition=86, ComBitSize=1, ComSignalInitValue=0, ComSignalType=BOOLEAN, ComHandleId=1757, ComSystemTemplateSystemSignalRef=DET_HVC_FLAG_081
            DET_EXISTENCE_PROB_082_oRDR_DETECTION_081_084_oPCAN_RADAR_dcc691e4_Tx: ComBitPosition=224, ComBitSize=6, ComSignalInitValue=0, ComSignalType=UINT8, ComHandleId=1754, ComSystemTemplateSystemSignalRef=DET_EXISTENCE_PROB_082
            DET_HVC_FLAG_082_oRDR_DETECTION_081_084_oPCAN_RADAR_3db2d29b_Tx: ComBitPosition=198, ComBitSize=1, ComSignalInitValue=0, ComSignalType=BOOLEAN, ComHandleId=1758, ComSystemTemplateSystemSignalRef=DET_HVC_FLAG_082
            DET_RANGE_ERR_083_oRDR_DETECTION_081_084_oPCAN_RADAR_7ad0beba_Tx: ComBitPosition=264, ComBitSize=7, ComSignalInitValue=0, ComSignalType=UINT8, ComHandleId=1782, ComSystemTemplateSystemSignalRef=DET_RANGE_ERR_083
            DET_RANGE_ERR_084_oRDR_DETECTION_081_084_oPCAN_RADAR_26609dd3_Tx: ComBitPosition=376, ComBitSize=7, ComSignalInitValue=0, ComSignalType=UINT8, ComHandleId=1783, ComSystemTemplateSystemSignalRef=DET_RANGE_ERR_084
            DET_SNR_083_oRDR_DETECTION_081_084_oPCAN_RADAR_f2b0a5ae_Tx: ComBitPosition=344, ComBitSize=8, ComSignalInitValue=0, ComSignalType=UINT8, ComHandleId=1798, ComSystemTemplateSystemSignalRef=DET_SNR_083
            DET_RANGE_VELOCITY_ERR_084_oRDR_DETECTION_081_084_oPCAN_RADAR_fb951e2d_Tx: ComBitPosition=400, ComBitSize=8, ComSignalInitValue=0, ComSignalType=UINT8, ComHandleId=1791, ComSystemTemplateSystemSignalRef=DET_RANGE_VELOCITY_ERR_084
            DET_CONFD_AZIMUTH_083_oRDR_DETECTION_081_084_oPCAN_RADAR_cf457da2_Tx: ComBitPosition=342, ComBitSize=2, ComSignalInitValue=0, ComSignalType=UINT8, ComHandleId=1739, ComSystemTemplateSystemSignalRef=DET_CONFD_AZIMUTH_083
            DET_CONFD_AZIMUTH_081_oRDR_DETECTION_081_084_oPCAN_RADAR_3ed5d2c9_Tx: ComBitPosition=118, ComBitSize=2, ComSignalInitValue=0, ComSignalType=UINT8, ComHandleId=1737, ComSystemTemplateSystemSignalRef=DET_CONFD_AZIMUTH_081
            DET_RANGE_VELOCITY_ERR_082_oRDR_DETECTION_081_084_oPCAN_RADAR_3255e9d1_Tx: ComBitPosition=176, ComBitSize=8, ComSignalInitValue=0, ComSignalType=UINT8, ComHandleId=1789, ComSystemTemplateSystemSignalRef=DET_RANGE_VELOCITY_ERR_082
            DET_BI_STATIC_FLAG_081_oRDR_DETECTION_081_084_oPCAN_RADAR_6a1f9886_Tx: ComBitPosition=104, ComBitSize=1, ComSignalInitValue=0, ComSignalType=BOOLEAN, ComHandleId=1733, ComSystemTemplateSystemSignalRef=DET_BI_STATIC_FLAG_081
            DET_RANGE_VELOCITY_082_oRDR_DETECTION_081_084_oPCAN_RADAR_3dee1263_Tx: ComBitPosition=160, ComBitSize=15, ComSignalInitValue=16384, ComSignalType=UINT16, ComHandleId=1785, ComSystemTemplateSystemSignalRef=DET_RANGE_VELOCITY_082
            DET_SUPER_RES_TARGET_081_oRDR_DETECTION_081_084_oPCAN_RADAR_32b922a0_Tx: ComBitPosition=87, ComBitSize=1, ComSignalInitValue=0, ComSignalType=BOOLEAN, ComHandleId=1800, ComSystemTemplateSystemSignalRef=DET_SUPER_RES_TARGET_081
            DET_ELEVATION_084_oRDR_DETECTION_081_084_oPCAN_RADAR_40a08b0d_Tx: ComBitPosition=408, ComBitSize=8, ComSignalInitValue=0, ComSignalType=UINT8, ComHandleId=1748, ComSystemTemplateSystemSignalRef=DET_ELEVATION_084
            DET_EXISTENCE_PROB_083_oRDR_DETECTION_081_084_oPCAN_RADAR_49b64571_Tx: ComBitPosition=336, ComBitSize=6, ComSignalInitValue=0, ComSignalType=UINT8, ComHandleId=1755, ComSystemTemplateSystemSignalRef=DET_EXISTENCE_PROB_083
            DET_AZIMUTH_ERR_081_oRDR_DETECTION_081_084_oPCAN_RADAR_98864df6_Tx: ComBitPosition=105, ComBitSize=7, ComSignalInitValue=0, ComSignalType=UINT8, ComHandleId=1725, ComSystemTemplateSystemSignalRef=DET_AZIMUTH_ERR_081
            DET_RANGE_VELOCITY_084_oRDR_DETECTION_081_084_oPCAN_RADAR_f42ee59f_Tx: ComBitPosition=384, ComBitSize=15, ComSignalInitValue=16384, ComSignalType=UINT16, ComHandleId=1787, ComSystemTemplateSystemSignalRef=DET_RANGE_VELOCITY_084
            DET_AZIMUTH_ERR_083_oRDR_DETECTION_081_084_oPCAN_RADAR_6916e29d_Tx: ComBitPosition=329, ComBitSize=7, ComSignalInitValue=0, ComSignalType=UINT8, ComHandleId=1727, ComSystemTemplateSystemSignalRef=DET_AZIMUTH_ERR_083
            DET_CONFD_ELEVATION_084_oRDR_DETECTION_081_084_oPCAN_RADAR_91605f31_Tx: ComBitPosition=437, ComBitSize=2, ComSignalInitValue=0, ComSignalType=UINT8, ComHandleId=1744, ComSystemTemplateSystemSignalRef=DET_CONFD_ELEVATION_084
            DET_EXISTENCE_PROB_081_oRDR_DETECTION_081_084_oPCAN_RADAR_b826ea1a_Tx: ComBitPosition=112, ComBitSize=6, ComSignalInitValue=0, ComSignalType=UINT8, ComHandleId=1753, ComSystemTemplateSystemSignalRef=DET_EXISTENCE_PROB_081
            DET_ELEVATION_ERR_084_oRDR_DETECTION_081_084_oPCAN_RADAR_c7991378_Tx: ComBitPosition=416, ComBitSize=6, ComSignalInitValue=0, ComSignalType=UINT8, ComHandleId=1752, ComSystemTemplateSystemSignalRef=DET_ELEVATION_ERR_084
            DET_RCS_082_oRDR_DETECTION_081_084_oPCAN_RADAR_ba6e2539_Tx: ComBitPosition=240, ComBitSize=8, ComSignalInitValue=128, ComSignalType=UINT8, ComHandleId=1793, ComSystemTemplateSystemSignalRef=DET_RCS_082
            DET_MTD_081_oRDR_DETECTION_081_084_oPCAN_RADAR_b4b3a003_Tx: ComBitPosition=47, ComBitSize=1, ComSignalInitValue=0, ComSignalType=UINT8, ComHandleId=1768, ComSystemTemplateSystemSignalRef=DET_MTD_081
            DET_PROB_1STAZHYPO_081_oRDR_DETECTION_081_084_oPCAN_RADAR_270748ce_Tx: ComBitPosition=103, ComBitSize=1, ComSignalInitValue=0, ComSignalType=BOOLEAN, ComHandleId=1772, ComSystemTemplateSystemSignalRef=DET_PROB_1STAZHYPO_081
            DET_BELOW_RAIN_THOLD_081_oRDR_DETECTION_081_084_oPCAN_RADAR_e9324bc3_Tx: ComBitPosition=39, ComBitSize=1, ComSignalInitValue=0, ComSignalType=UINT8, ComHandleId=1729, ComSystemTemplateSystemSignalRef=DET_BELOW_RAIN_THOLD_081
            DET_BELOW_RAIN_THOLD_084_oRDR_DETECTION_081_084_oPCAN_RADAR_4412c7c1_Tx: ComBitPosition=375, ComBitSize=1, ComSignalInitValue=0, ComSignalType=UINT8, ComHandleId=1732, ComSystemTemplateSystemSignalRef=DET_BELOW_RAIN_THOLD_084
            DET_IDM_083_oRDR_DETECTION_081_084_oPCAN_RADAR_23903db3_Tx: ComBitPosition=287, ComBitSize=1, ComSignalInitValue=0, ComSignalType=UINT8, ComHandleId=1763, ComSystemTemplateSystemSignalRef=DET_IDM_083
            DET_PROB_1STAZHYPO_083_oRDR_DETECTION_081_084_oPCAN_RADAR_d697e7a5_Tx: ComBitPosition=327, ComBitSize=1, ComSignalInitValue=0, ComSignalType=BOOLEAN, ComHandleId=1774, ComSystemTemplateSystemSignalRef=DET_PROB_1STAZHYPO_083
            DET_IDM_082_oRDR_DETECTION_081_084_oPCAN_RADAR_b6e0e926_Tx: ComBitPosition=175, ComBitSize=1, ComSignalInitValue=0, ComSignalType=UINT8, ComHandleId=1762, ComSystemTemplateSystemSignalRef=DET_IDM_082
            DET_PROB_1STAZHYPO_082_oRDR_DETECTION_081_084_oPCAN_RADAR_43e73330_Tx: ComBitPosition=215, ComBitSize=1, ComSignalInitValue=0, ComSignalType=BOOLEAN, ComHandleId=1773, ComSystemTemplateSystemSignalRef=DET_PROB_1STAZHYPO_082
            DET_IDM_084_oRDR_DETECTION_081_084_oPCAN_RADAR_7f201eda_Tx: ComBitPosition=399, ComBitSize=1, ComSignalInitValue=0, ComSignalType=UINT8, ComHandleId=1764, ComSystemTemplateSystemSignalRef=DET_IDM_084
            DET_PROB_1STAZHYPO_084_oRDR_DETECTION_081_084_oPCAN_RADAR_8a27c4cc_Tx: ComBitPosition=439, ComBitSize=1, ComSignalInitValue=0, ComSignalType=BOOLEAN, ComHandleId=1775, ComSystemTemplateSystemSignalRef=DET_PROB_1STAZHYPO_084
            DET_BELOW_RAIN_THOLD_082_oRDR_DETECTION_081_084_oPCAN_RADAR_8dd2303d_Tx: ComBitPosition=151, ComBitSize=1, ComSignalInitValue=0, ComSignalType=UINT8, ComHandleId=1730, ComSystemTemplateSystemSignalRef=DET_BELOW_RAIN_THOLD_082
            DET_IDM_081_oRDR_DETECTION_081_084_oPCAN_RADAR_d20092d8_Tx: ComBitPosition=63, ComBitSize=1, ComSignalInitValue=0, ComSignalType=UINT8, ComHandleId=1761, ComSystemTemplateSystemSignalRef=DET_IDM_081
            DET_MTD_083_oRDR_DETECTION_081_084_oPCAN_RADAR_45230f68_Tx: ComBitPosition=271, ComBitSize=1, ComSignalInitValue=0, ComSignalType=UINT8, ComHandleId=1770, ComSystemTemplateSystemSignalRef=DET_MTD_083
            DET_MTD_084_oRDR_DETECTION_081_084_oPCAN_RADAR_19932c01_Tx: ComBitPosition=383, ComBitSize=1, ComSignalInitValue=0, ComSignalType=UINT8, ComHandleId=1771, ComSystemTemplateSystemSignalRef=DET_MTD_084
            DET_BELOW_RAIN_THOLD_083_oRDR_DETECTION_081_084_oPCAN_RADAR_18a2e4a8_Tx: ComBitPosition=263, ComBitSize=1, ComSignalInitValue=0, ComSignalType=UINT8, ComHandleId=1731, ComSystemTemplateSystemSignalRef=DET_BELOW_RAIN_THOLD_083
            DET_MTD_082_oRDR_DETECTION_081_084_oPCAN_RADAR_d053dbfd_Tx: ComBitPosition=159, ComBitSize=1, ComSignalInitValue=0, ComSignalType=UINT8, ComHandleId=1769, ComSystemTemplateSystemSignalRef=DET_MTD_082
        SG_Detections_009_012_oRDR_DETECTION_009_012_oPCAN_RADAR_37f1858c_Tx: ComTransferProperty=TRIGGERED, ComHandleId=4, ComSystemTemplateSignalGroupRef=SG_Detections_009_012
          83 x ComGroupSignal, all with ComSignalEndianness=LITTLE_ENDIAN, ComTransferProperty=PENDING, ComSignalAccess=ACCESS_NEEDED_BY_SWC_OR_COM:
            DET_RANGE_ERR_009_oRDR_DETECTION_009_012_oPCAN_RADAR_d8b4cc8e_Tx: ComBitPosition=40, ComBitSize=7, ComSignalInitValue=0, ComSignalType=UINT8, ComHandleId=286, ComSystemTemplateSystemSignalRef=DET_RANGE_ERR_009
            DET_AZIMUTH_ERR_012_oRDR_DETECTION_009_012_oPCAN_RADAR_5fc24d66_Tx: ComBitPosition=441, ComBitSize=7, ComSignalInitValue=0, ComSignalType=UINT8, ComHandleId=234, ComSystemTemplateSystemSignalRef=DET_AZIMUTH_ERR_012
            DET_ELEVATION_ERR_010_oRDR_DETECTION_009_012_oPCAN_RADAR_5c6d3081_Tx: ComBitPosition=192, ComBitSize=6, ComSignalInitValue=0, ComSignalType=UINT8, ComHandleId=256, ComSystemTemplateSystemSignalRef=DET_ELEVATION_ERR_010
            DET_SNR_009_oRDR_DETECTION_009_012_oPCAN_RADAR_50d4d79a_Tx: ComBitPosition=120, ComBitSize=8, ComSignalInitValue=0, ComSignalType=UINT8, ComHandleId=302, ComSystemTemplateSystemSignalRef=DET_SNR_009
            DET_AZIMUTH_ERR_009_oRDR_DETECTION_009_012_oPCAN_RADAR_cb7290a9_Tx: ComBitPosition=105, ComBitSize=7, ComSignalInitValue=0, ComSignalType=UINT8, ComHandleId=231, ComSystemTemplateSystemSignalRef=DET_AZIMUTH_ERR_009
            DET_EXISTENCE_PROB_012_oRDR_DETECTION_009_012_oPCAN_RADAR_7f62ea8a_Tx: ComBitPosition=448, ComBitSize=6, ComSignalInitValue=0, ComSignalType=UINT8, ComHandleId=262, ComSystemTemplateSystemSignalRef=DET_EXISTENCE_PROB_012
            DET_RCS_012_oRDR_DETECTION_009_012_oPCAN_RADAR_19ca5e57_Tx: ComBitPosition=464, ComBitSize=8, ComSignalInitValue=128, ComSignalType=UINT8, ComHandleId=301, ComSystemTemplateSystemSignalRef=DET_RCS_012
            DET_ELEVATION_009_oRDR_DETECTION_009_012_oPCAN_RADAR_be74da50_Tx: ComBitPosition=72, ComBitSize=8, ComSignalInitValue=0, ComSignalType=UINT8, ComHandleId=251, ComSystemTemplateSystemSignalRef=DET_ELEVATION_009
            DET_BI_STATIC_FLAG_012_oRDR_DETECTION_009_012_oPCAN_RADAR_ad5b9816_Tx: ComBitPosition=440, ComBitSize=1, ComSignalInitValue=0, ComSignalType=BOOLEAN, ComHandleId=242, ComSystemTemplateSystemSignalRef=DET_BI_STATIC_FLAG_012
            DET_CONFD_ELEVATION_012_oRDR_DETECTION_009_012_oPCAN_RADAR_fb04d3a3_Tx: ComBitPosition=437, ComBitSize=2, ComSignalInitValue=0, ComSignalType=UINT8, ComHandleId=250, ComSystemTemplateSystemSignalRef=DET_CONFD_ELEVATION_012
            DET_RANGE_ERR_011_oRDR_DETECTION_009_012_oPCAN_RADAR_28e46abf_Tx: ComBitPosition=264, ComBitSize=7, ComSignalInitValue=0, ComSignalType=UINT8, ComHandleId=288, ComSystemTemplateSystemSignalRef=DET_RANGE_ERR_011
            DET_MH_SCAN_INDEX_4LSB_009_012_oRDR_DETECTION_009_012_oPCAN_RADAR_fb26d33c_Tx: ComBitPosition=476, ComBitSize=4, ComSignalInitValue=0, ComSignalType=UINT8, ComHandleId=273, ComSystemTemplateSystemSignalRef=DET_MH_SCAN_INDEX_4LSB_009_012
            DET_RCS_009_oRDR_DETECTION_009_012_oPCAN_RADAR_8d7a8398_Tx: ComBitPosition=128, ComBitSize=8, ComSignalInitValue=128, ComSignalType=UINT8, ComHandleId=298, ComSystemTemplateSystemSignalRef=DET_RCS_009
            DET_CONFD_AZIMUTH_009_oRDR_DETECTION_009_012_oPCAN_RADAR_6d210f96_Tx: ComBitPosition=118, ComBitSize=2, ComSignalInitValue=0, ComSignalType=UINT8, ComHandleId=243, ComSystemTemplateSystemSignalRef=DET_CONFD_AZIMUTH_009
            DET_ELEVATION_010_oRDR_DETECTION_009_012_oPCAN_RADAR_db54a8f4_Tx: ComBitPosition=184, ComBitSize=8, ComSignalInitValue=0, ComSignalType=UINT8, ComHandleId=252, ComSystemTemplateSystemSignalRef=DET_ELEVATION_010
            DET_CONFD_ELEVATION_011_oRDR_DETECTION_009_012_oPCAN_RADAR_9fe4a85d_Tx: ComBitPosition=325, ComBitSize=2, ComSignalInitValue=0, ComSignalType=UINT8, ComHandleId=249, ComSystemTemplateSystemSignalRef=DET_CONFD_ELEVATION_011
            DET_AZIMUTH_012_oRDR_DETECTION_009_012_oPCAN_RADAR_fb77d893_Tx: ComBitPosition=424, ComBitSize=13, ComSignalInitValue=0, ComSignalType=UINT16, ComHandleId=230, ComSystemTemplateSystemSignalRef=DET_AZIMUTH_012
            DET_BI_STATIC_FLAG_011_oRDR_DETECTION_009_012_oPCAN_RADAR_c9bbe3e8_Tx: ComBitPosition=328, ComBitSize=1, ComSignalInitValue=0, ComSignalType=BOOLEAN, ComHandleId=241, ComSystemTemplateSystemSignalRef=DET_BI_STATIC_FLAG_011
            DET_RANGE_VELOCITY_ERR_011_oRDR_DETECTION_009_012_oPCAN_RADAR_f511e941_Tx: ComBitPosition=288, ComBitSize=8, ComSignalInitValue=0, ComSignalType=UINT8, ComHandleId=296, ComSystemTemplateSystemSignalRef=DET_RANGE_VELOCITY_ERR_011
            DET_ELEVATION_ERR_009_oRDR_DETECTION_009_012_oPCAN_RADAR_394d4225_Tx: ComBitPosition=80, ComBitSize=6, ComSignalInitValue=0, ComSignalType=UINT8, ComHandleId=255, ComSystemTemplateSystemSignalRef=DET_ELEVATION_ERR_009
            DET_BI_STATIC_FLAG_009_oRDR_DETECTION_009_012_oPCAN_RADAR_39eb45d9_Tx: ComBitPosition=104, ComBitSize=1, ComSignalInitValue=0, ComSignalType=BOOLEAN, ComHandleId=239, ComSystemTemplateSystemSignalRef=DET_BI_STATIC_FLAG_009
            DET_RCS_010_oRDR_DETECTION_009_012_oPCAN_RADAR_e85af13c_Tx: ComBitPosition=240, ComBitSize=8, ComSignalInitValue=128, ComSignalType=UINT8, ComHandleId=299, ComSystemTemplateSystemSignalRef=DET_RCS_010
            DET_CONFD_AZIMUTH_010_oRDR_DETECTION_009_012_oPCAN_RADAR_08017d32_Tx: ComBitPosition=230, ComBitSize=2, ComSignalInitValue=0, ComSignalType=UINT8, ComHandleId=244, ComSystemTemplateSystemSignalRef=DET_CONFD_AZIMUTH_010
            DET_CONFD_ELEVATION_010_oRDR_DETECTION_009_012_oPCAN_RADAR_0a947cc8_Tx: ComBitPosition=213, ComBitSize=2, ComSignalInitValue=0, ComSignalType=UINT8, ComHandleId=248, ComSystemTemplateSystemSignalRef=DET_CONFD_ELEVATION_010
            DET_MH_CRC16_009_012_oRDR_DETECTION_009_012_oPCAN_RADAR_b3795787_Tx: ComBitPosition=0, ComBitSize=16, ComSignalInitValue=0, ComSignalType=UINT16, ComHandleId=271, ComSystemTemplateSystemSignalRef=DET_MH_CRC16_009_012
            DET_RANGE_VELOCITY_009_oRDR_DETECTION_009_012_oPCAN_RADAR_0afab4c2_Tx: ComBitPosition=48, ComBitSize=15, ComSignalInitValue=16384, ComSignalType=UINT16, ComHandleId=290, ComSystemTemplateSystemSignalRef=DET_RANGE_VELOCITY_009
            DET_AZIMUTH_010_oRDR_DETECTION_009_012_oPCAN_RADAR_0ae777f8_Tx: ComBitPosition=200, ComBitSize=13, ComSignalInitValue=0, ComSignalType=UINT16, ComHandleId=228, ComSystemTemplateSystemSignalRef=DET_AZIMUTH_010
            DET_MH_CYCLE_COUNTER_009_012_oRDR_DETECTION_009_012_oPCAN_RADAR_370cf6b0_Tx: ComBitPosition=16, ComBitSize=8, ComSignalInitValue=0, ComSignalType=UINT8, ComHandleId=272, ComSystemTemplateSystemSignalRef=DET_MH_CYCLE_COUNTER_009_012
            DET_BI_STATIC_FLAG_010_oRDR_DETECTION_009_012_oPCAN_RADAR_5ccb377d_Tx: ComBitPosition=216, ComBitSize=1, ComSignalInitValue=0, ComSignalType=BOOLEAN, ComHandleId=240, ComSystemTemplateSystemSignalRef=DET_BI_STATIC_FLAG_010
            DET_ELEVATION_ERR_012_oRDR_DETECTION_009_012_oPCAN_RADAR_adfd9fea_Tx: ComBitPosition=416, ComBitSize=6, ComSignalInitValue=0, ComSignalType=UINT8, ComHandleId=258, ComSystemTemplateSystemSignalRef=DET_ELEVATION_ERR_012
            DET_EXISTENCE_PROB_011_oRDR_DETECTION_009_012_oPCAN_RADAR_1b829174_Tx: ComBitPosition=336, ComBitSize=6, ComSignalInitValue=0, ComSignalType=UINT8, ComHandleId=261, ComSystemTemplateSystemSignalRef=DET_EXISTENCE_PROB_011
            DET_SUPER_RES_TARGET_012_oRDR_DETECTION_009_012_oPCAN_RADAR_f5fd2230_Tx: ComBitPosition=423, ComBitSize=1, ComSignalInitValue=0, ComSignalType=BOOLEAN, ComHandleId=309, ComSystemTemplateSystemSignalRef=DET_SUPER_RES_TARGET_012
            DET_AZIMUTH_ERR_011_oRDR_DETECTION_009_012_oPCAN_RADAR_3b223698_Tx: ComBitPosition=329, ComBitSize=7, ComSignalInitValue=0, ComSignalType=UINT8, ComHandleId=233, ComSystemTemplateSystemSignalRef=DET_AZIMUTH_ERR_011
            DET_SUPER_RES_TARGET_009_oRDR_DETECTION_009_012_oPCAN_RADAR_614dffff_Tx: ComBitPosition=87, ComBitSize=1, ComSignalInitValue=0, ComSignalType=BOOLEAN, ComHandleId=306, ComSystemTemplateSystemSignalRef=DET_SUPER_RES_TARGET_009
            DET_SUPER_RES_TARGET_011_oRDR_DETECTION_009_012_oPCAN_RADAR_911d59ce_Tx: ComBitPosition=311, ComBitSize=1, ComSignalInitValue=0, ComSignalType=BOOLEAN, ComHandleId=308, ComSystemTemplateSystemSignalRef=DET_SUPER_RES_TARGET_011
            DET_RANGE_012_oRDR_DETECTION_009_012_oPCAN_RADAR_ebecab28_Tx: ComBitPosition=360, ComBitSize=15, ComSignalInitValue=0, ComSignalType=UINT16, ComHandleId=285, ComSystemTemplateSystemSignalRef=DET_RANGE_012
            DET_RANGE_009_oRDR_DETECTION_009_012_oPCAN_RADAR_7f5c76e7_Tx: ComBitPosition=24, ComBitSize=15, ComSignalInitValue=0, ComSignalType=UINT16, ComHandleId=282, ComSystemTemplateSystemSignalRef=DET_RANGE_009
            DET_CONFD_ELEVATION_009_oRDR_DETECTION_009_012_oPCAN_RADAR_6fb40e6c_Tx: ComBitPosition=101, ComBitSize=2, ComSignalInitValue=0, ComSignalType=UINT8, ComHandleId=247, ComSystemTemplateSystemSignalRef=DET_CONFD_ELEVATION_009
            DET_SUPER_RES_TARGET_010_oRDR_DETECTION_009_012_oPCAN_RADAR_046d8d5b_Tx: ComBitPosition=199, ComBitSize=1, ComSignalInitValue=0, ComSignalType=BOOLEAN, ComHandleId=307, ComSystemTemplateSystemSignalRef=DET_SUPER_RES_TARGET_010
            DET_ELEVATION_ERR_011_oRDR_DETECTION_009_012_oPCAN_RADAR_c91de414_Tx: ComBitPosition=304, ComBitSize=6, ComSignalInitValue=0, ComSignalType=UINT8, ComHandleId=257, ComSystemTemplateSystemSignalRef=DET_ELEVATION_ERR_011
            DET_SNR_011_oRDR_DETECTION_009_012_oPCAN_RADAR_a08471ab_Tx: ComBitPosition=344, ComBitSize=8, ComSignalInitValue=0, ComSignalType=UINT8, ComHandleId=304, ComSystemTemplateSystemSignalRef=DET_SNR_011
            DET_RANGE_VELOCITY_ERR_012_oRDR_DETECTION_009_012_oPCAN_RADAR_91f192bf_Tx: ComBitPosition=400, ComBitSize=8, ComSignalInitValue=0, ComSignalType=UINT8, ComHandleId=297, ComSystemTemplateSystemSignalRef=DET_RANGE_VELOCITY_ERR_012
            DET_HVC_FLAG_010_oRDR_DETECTION_009_012_oPCAN_RADAR_6f86069e_Tx: ComBitPosition=198, ComBitSize=1, ComSignalInitValue=0, ComSignalType=BOOLEAN, ComHandleId=264, ComSystemTemplateSystemSignalRef=DET_HVC_FLAG_010
            DET_RANGE_VELOCITY_010_oRDR_DETECTION_009_012_oPCAN_RADAR_6fdac666_Tx: ComBitPosition=160, ComBitSize=15, ComSignalInitValue=16384, ComSignalType=UINT16, ComHandleId=291, ComSystemTemplateSystemSignalRef=DET_RANGE_VELOCITY_010
            DET_RANGE_VELOCITY_012_oRDR_DETECTION_009_012_oPCAN_RADAR_9e4a690d_Tx: ComBitPosition=384, ComBitSize=15, ComSignalInitValue=16384, ComSignalType=UINT16, ComHandleId=293, ComSystemTemplateSystemSignalRef=DET_RANGE_VELOCITY_012
            DET_RANGE_VELOCITY_ERR_010_oRDR_DETECTION_009_012_oPCAN_RADAR_60613dd4_Tx: ComBitPosition=176, ComBitSize=8, ComSignalInitValue=0, ComSignalType=UINT8, ComHandleId=295, ComSystemTemplateSystemSignalRef=DET_RANGE_VELOCITY_ERR_010
            DET_CONFD_AZIMUTH_011_oRDR_DETECTION_009_012_oPCAN_RADAR_9d71a9a7_Tx: ComBitPosition=342, ComBitSize=2, ComSignalInitValue=0, ComSignalType=UINT8, ComHandleId=245, ComSystemTemplateSystemSignalRef=DET_CONFD_AZIMUTH_011
            DET_RANGE_ERR_010_oRDR_DETECTION_009_012_oPCAN_RADAR_bd94be2a_Tx: ComBitPosition=152, ComBitSize=7, ComSignalInitValue=0, ComSignalType=UINT8, ComHandleId=287, ComSystemTemplateSystemSignalRef=DET_RANGE_ERR_010
            DET_ELEVATION_011_oRDR_DETECTION_009_012_oPCAN_RADAR_4e247c61_Tx: ComBitPosition=296, ComBitSize=8, ComSignalInitValue=0, ComSignalType=UINT8, ComHandleId=253, ComSystemTemplateSystemSignalRef=DET_ELEVATION_011
            DET_ELEVATION_012_oRDR_DETECTION_009_012_oPCAN_RADAR_2ac4079f_Tx: ComBitPosition=408, ComBitSize=8, ComSignalInitValue=0, ComSignalType=UINT8, ComHandleId=254, ComSystemTemplateSystemSignalRef=DET_ELEVATION_012
            DET_AZIMUTH_011_oRDR_DETECTION_009_012_oPCAN_RADAR_9f97a36d_Tx: ComBitPosition=312, ComBitSize=13, ComSignalInitValue=0, ComSignalType=UINT16, ComHandleId=229, ComSystemTemplateSystemSignalRef=DET_AZIMUTH_011
            DET_AZIMUTH_ERR_010_oRDR_DETECTION_009_012_oPCAN_RADAR_ae52e20d_Tx: ComBitPosition=217, ComBitSize=7, ComSignalInitValue=0, ComSignalType=UINT8, ComHandleId=232, ComSystemTemplateSystemSignalRef=DET_AZIMUTH_ERR_010
            DET_RANGE_010_oRDR_DETECTION_009_012_oPCAN_RADAR_1a7c0443_Tx: ComBitPosition=136, ComBitSize=15, ComSignalInitValue=0, ComSignalType=UINT16, ComHandleId=283, ComSystemTemplateSystemSignalRef=DET_RANGE_010
            DET_SNR_010_oRDR_DETECTION_009_012_oPCAN_RADAR_35f4a53e_Tx: ComBitPosition=232, ComBitSize=8, ComSignalInitValue=0, ComSignalType=UINT8, ComHandleId=303, ComSystemTemplateSystemSignalRef=DET_SNR_010
            DET_EXISTENCE_PROB_010_oRDR_DETECTION_009_012_oPCAN_RADAR_8ef245e1_Tx: ComBitPosition=224, ComBitSize=6, ComSignalInitValue=0, ComSignalType=UINT8, ComHandleId=260, ComSystemTemplateSystemSignalRef=DET_EXISTENCE_PROB_010
            DET_RANGE_VELOCITY_ERR_009_oRDR_DETECTION_009_012_oPCAN_RADAR_05414f70_Tx: ComBitPosition=64, ComBitSize=8, ComSignalInitValue=0, ComSignalType=UINT8, ComHandleId=294, ComSystemTemplateSystemSignalRef=DET_RANGE_VELOCITY_ERR_009
            DET_RCS_011_oRDR_DETECTION_009_012_oPCAN_RADAR_7d2a25a9_Tx: ComBitPosition=352, ComBitSize=8, ComSignalInitValue=128, ComSignalType=UINT8, ComHandleId=300, ComSystemTemplateSystemSignalRef=DET_RCS_011
            DET_HVC_FLAG_012_oRDR_DETECTION_009_012_oPCAN_RADAR_9e16a9f5_Tx: ComBitPosition=422, ComBitSize=1, ComSignalInitValue=0, ComSignalType=BOOLEAN, ComHandleId=266, ComSystemTemplateSystemSignalRef=DET_HVC_FLAG_012
            DET_EXISTENCE_PROB_009_oRDR_DETECTION_009_012_oPCAN_RADAR_ebd23745_Tx: ComBitPosition=112, ComBitSize=6, ComSignalInitValue=0, ComSignalType=UINT8, ComHandleId=259, ComSystemTemplateSystemSignalRef=DET_EXISTENCE_PROB_009
            DET_HVC_FLAG_011_oRDR_DETECTION_009_012_oPCAN_RADAR_faf6d20b_Tx: ComBitPosition=310, ComBitSize=1, ComSignalInitValue=0, ComSignalType=BOOLEAN, ComHandleId=265, ComSystemTemplateSystemSignalRef=DET_HVC_FLAG_011
            DET_RANGE_ERR_012_oRDR_DETECTION_009_012_oPCAN_RADAR_4c041141_Tx: ComBitPosition=376, ComBitSize=7, ComSignalInitValue=0, ComSignalType=UINT8, ComHandleId=289, ComSystemTemplateSystemSignalRef=DET_RANGE_ERR_012
            DET_AZIMUTH_009_oRDR_DETECTION_009_012_oPCAN_RADAR_6fc7055c_Tx: ComBitPosition=88, ComBitSize=13, ComSignalInitValue=0, ComSignalType=UINT16, ComHandleId=227, ComSystemTemplateSystemSignalRef=DET_AZIMUTH_009
            DET_HVC_FLAG_009_oRDR_DETECTION_009_012_oPCAN_RADAR_0aa6743a_Tx: ComBitPosition=86, ComBitSize=1, ComSignalInitValue=0, ComSignalType=BOOLEAN, ComHandleId=263, ComSystemTemplateSystemSignalRef=DET_HVC_FLAG_009
            DET_SNR_012_oRDR_DETECTION_009_012_oPCAN_RADAR_c4640a55_Tx: ComBitPosition=456, ComBitSize=8, ComSignalInitValue=0, ComSignalType=UINT8, ComHandleId=305, ComSystemTemplateSystemSignalRef=DET_SNR_012
            DET_RANGE_011_oRDR_DETECTION_009_012_oPCAN_RADAR_8f0cd0d6_Tx: ComBitPosition=248, ComBitSize=15, ComSignalInitValue=0, ComSignalType=UINT16, ComHandleId=284, ComSystemTemplateSystemSignalRef=DET_RANGE_011
            DET_RANGE_VELOCITY_011_oRDR_DETECTION_009_012_oPCAN_RADAR_faaa12f3_Tx: ComBitPosition=272, ComBitSize=15, ComSignalInitValue=16384, ComSignalType=UINT16, ComHandleId=292, ComSystemTemplateSystemSignalRef=DET_RANGE_VELOCITY_011
            DET_CONFD_AZIMUTH_012_oRDR_DETECTION_009_012_oPCAN_RADAR_f991d259_Tx: ComBitPosition=454, ComBitSize=2, ComSignalInitValue=0, ComSignalType=UINT8, ComHandleId=246, ComSystemTemplateSystemSignalRef=DET_CONFD_AZIMUTH_012
            DET_BELOW_RAIN_THOLD_011_oRDR_DETECTION_009_012_oPCAN_RADAR_4a9630ad_Tx: ComBitPosition=263, ComBitSize=1, ComSignalInitValue=0, ComSignalType=UINT8, ComHandleId=237, ComSystemTemplateSystemSignalRef=DET_BELOW_RAIN_THOLD_011
            DET_MTD_010_oRDR_DETECTION_009_012_oPCAN_RADAR_82670ff8_Tx: ComBitPosition=159, ComBitSize=1, ComSignalInitValue=0, ComSignalType=UINT8, ComHandleId=275, ComSystemTemplateSystemSignalRef=DET_MTD_010
            DET_PROB_1STAZHYPO_011_oRDR_DETECTION_009_012_oPCAN_RADAR_84a333a0_Tx: ComBitPosition=327, ComBitSize=1, ComSignalInitValue=0, ComSignalType=BOOLEAN, ComHandleId=280, ComSystemTemplateSystemSignalRef=DET_PROB_1STAZHYPO_011
            DET_IDM_012_oRDR_DETECTION_009_012_oPCAN_RADAR_15449248_Tx: ComBitPosition=399, ComBitSize=1, ComSignalInitValue=0, ComSignalType=UINT8, ComHandleId=270, ComSystemTemplateSystemSignalRef=DET_IDM_012
            DET_MTD_012_oRDR_DETECTION_009_012_oPCAN_RADAR_73f7a093_Tx: ComBitPosition=383, ComBitSize=1, ComSignalInitValue=0, ComSignalType=UINT8, ComHandleId=277, ComSystemTemplateSystemSignalRef=DET_MTD_012
            DET_IDM_011_oRDR_DETECTION_009_012_oPCAN_RADAR_71a4e9b6_Tx: ComBitPosition=287, ComBitSize=1, ComSignalInitValue=0, ComSignalType=UINT8, ComHandleId=269, ComSystemTemplateSystemSignalRef=DET_IDM_011
            DET_PROB_1STAZHYPO_012_oRDR_DETECTION_009_012_oPCAN_RADAR_e043485e_Tx: ComBitPosition=439, ComBitSize=1, ComSignalInitValue=0, ComSignalType=BOOLEAN, ComHandleId=281, ComSystemTemplateSystemSignalRef=DET_PROB_1STAZHYPO_012
            DET_IDM_010_oRDR_DETECTION_009_012_oPCAN_RADAR_e4d43d23_Tx: ComBitPosition=175, ComBitSize=1, ComSignalInitValue=0, ComSignalType=UINT8, ComHandleId=268, ComSystemTemplateSystemSignalRef=DET_IDM_010
            DET_BELOW_RAIN_THOLD_009_oRDR_DETECTION_009_012_oPCAN_RADAR_bac6969c_Tx: ComBitPosition=39, ComBitSize=1, ComSignalInitValue=0, ComSignalType=UINT8, ComHandleId=235, ComSystemTemplateSystemSignalRef=DET_BELOW_RAIN_THOLD_009
            DET_BELOW_RAIN_THOLD_012_oRDR_DETECTION_009_012_oPCAN_RADAR_2e764b53_Tx: ComBitPosition=375, ComBitSize=1, ComSignalInitValue=0, ComSignalType=UINT8, ComHandleId=238, ComSystemTemplateSystemSignalRef=DET_BELOW_RAIN_THOLD_012
            DET_PROB_1STAZHYPO_010_oRDR_DETECTION_009_012_oPCAN_RADAR_11d3e735_Tx: ComBitPosition=215, ComBitSize=1, ComSignalInitValue=0, ComSignalType=BOOLEAN, ComHandleId=279, ComSystemTemplateSystemSignalRef=DET_PROB_1STAZHYPO_010
            DET_BELOW_RAIN_THOLD_010_oRDR_DETECTION_009_012_oPCAN_RADAR_dfe6e438_Tx: ComBitPosition=151, ComBitSize=1, ComSignalInitValue=0, ComSignalType=UINT8, ComHandleId=236, ComSystemTemplateSystemSignalRef=DET_BELOW_RAIN_THOLD_010
            DET_PROB_1STAZHYPO_009_oRDR_DETECTION_009_012_oPCAN_RADAR_74f39591_Tx: ComBitPosition=103, ComBitSize=1, ComSignalInitValue=0, ComSignalType=BOOLEAN, ComHandleId=278, ComSystemTemplateSystemSignalRef=DET_PROB_1STAZHYPO_009
            DET_IDM_009_oRDR_DETECTION_009_012_oPCAN_RADAR_81f44f87_Tx: ComBitPosition=63, ComBitSize=1, ComSignalInitValue=0, ComSignalType=UINT8, ComHandleId=267, ComSystemTemplateSystemSignalRef=DET_IDM_009
            DET_MTD_009_oRDR_DETECTION_009_012_oPCAN_RADAR_e7477d5c_Tx: ComBitPosition=47, ComBitSize=1, ComSignalInitValue=0, ComSignalType=UINT8, ComHandleId=274, ComSystemTemplateSystemSignalRef=DET_MTD_009
            DET_MTD_011_oRDR_DETECTION_009_012_oPCAN_RADAR_1717db6d_Tx: ComBitPosition=271, ComBitSize=1, ComSignalInitValue=0, ComSignalType=UINT8, ComHandleId=276, ComSystemTemplateSystemSignalRef=DET_MTD_011
        SG_Detections_053_056_oRDR_DETECTION_053_056_oPCAN_RADAR_6f11ad00_Tx: ComTransferProperty=TRIGGERED, ComHandleId=15, ComSystemTemplateSignalGroupRef=SG_Detections_053_056
          83 x ComGroupSignal, all with ComSignalEndianness=LITTLE_ENDIAN, ComTransferProperty=PENDING, ComSignalAccess=ACCESS_NEEDED_BY_SWC_OR_COM:
            DET_ELEVATION_ERR_056_oRDR_DETECTION_053_056_oPCAN_RADAR_f43dcaf1_Tx: ComBitPosition=416, ComBitSize=6, ComSignalInitValue=0, ComSignalType=UINT8, ComHandleId=1171, ComSystemTemplateSystemSignalRef=DET_ELEVATION_ERR_056
            DET_AZIMUTH_056_oRDR_DETECTION_053_056_oPCAN_RADAR_a2b78d88_Tx: ComBitPosition=424, ComBitSize=13, ComSignalInitValue=0, ComSignalType=UINT16, ComHandleId=1143, ComSystemTemplateSystemSignalRef=DET_AZIMUTH_056
            DET_ELEVATION_055_oRDR_DETECTION_053_056_oPCAN_RADAR_17e4297a_Tx: ComBitPosition=296, ComBitSize=8, ComSignalInitValue=0, ComSignalType=UINT8, ComHandleId=1166, ComSystemTemplateSystemSignalRef=DET_ELEVATION_055
            DET_SNR_053_oRDR_DETECTION_053_056_oPCAN_RADAR_3084d34c_Tx: ComBitPosition=120, ComBitSize=8, ComSignalInitValue=0, ComSignalType=UINT8, ComHandleId=1215, ComSystemTemplateSystemSignalRef=DET_SNR_053
            DET_ELEVATION_ERR_053_oRDR_DETECTION_053_056_oPCAN_RADAR_591d46f3_Tx: ComBitPosition=80, ComBitSize=6, ComSignalInitValue=0, ComSignalType=UINT8, ComHandleId=1168, ComSystemTemplateSystemSignalRef=DET_ELEVATION_ERR_053
            DET_CONFD_AZIMUTH_055_oRDR_DETECTION_053_056_oPCAN_RADAR_c4b1fcbc_Tx: ComBitPosition=342, ComBitSize=2, ComSignalInitValue=0, ComSignalType=UINT8, ComHandleId=1158, ComSystemTemplateSystemSignalRef=DET_CONFD_AZIMUTH_055
            DET_RANGE_ERR_053_oRDR_DETECTION_053_056_oPCAN_RADAR_b8e4c858_Tx: ComBitPosition=40, ComBitSize=7, ComSignalInitValue=0, ComSignalType=UINT8, ComHandleId=1199, ComSystemTemplateSystemSignalRef=DET_RANGE_ERR_053
            DET_EXISTENCE_PROB_053_oRDR_DETECTION_053_056_oPCAN_RADAR_8b823393_Tx: ComBitPosition=112, ComBitSize=6, ComSignalInitValue=0, ComSignalType=UINT8, ComHandleId=1172, ComSystemTemplateSystemSignalRef=DET_EXISTENCE_PROB_053
            DET_RANGE_VELOCITY_054_oRDR_DETECTION_053_056_oPCAN_RADAR_361a937d_Tx: ComBitPosition=160, ComBitSize=15, ComSignalInitValue=16384, ComSignalType=UINT16, ComHandleId=1204, ComSystemTemplateSystemSignalRef=DET_RANGE_VELOCITY_054
            DET_RANGE_ERR_055_oRDR_DETECTION_053_056_oPCAN_RADAR_71243fa4_Tx: ComBitPosition=264, ComBitSize=7, ComSignalInitValue=0, ComSignalType=UINT8, ComHandleId=1201, ComSystemTemplateSystemSignalRef=DET_RANGE_ERR_055
            DET_BI_STATIC_FLAG_055_oRDR_DETECTION_053_056_oPCAN_RADAR_907bb6f3_Tx: ComBitPosition=328, ComBitSize=1, ComSignalInitValue=0, ComSignalType=BOOLEAN, ComHandleId=1154, ComSystemTemplateSystemSignalRef=DET_BI_STATIC_FLAG_055
            DET_BI_STATIC_FLAG_056_oRDR_DETECTION_053_056_oPCAN_RADAR_f49bcd0d_Tx: ComBitPosition=440, ComBitSize=1, ComSignalInitValue=0, ComSignalType=BOOLEAN, ComHandleId=1155, ComSystemTemplateSystemSignalRef=DET_BI_STATIC_FLAG_056
            DET_MH_SCAN_INDEX_4LSB_053_056_oRDR_DETECTION_053_056_oPCAN_RADAR_a3c6fbb0_Tx: ComBitPosition=476, ComBitSize=4, ComSignalInitValue=0, ComSignalType=UINT8, ComHandleId=1186, ComSystemTemplateSystemSignalRef=DET_MH_SCAN_INDEX_4LSB_053_056
            DET_RANGE_ERR_054_oRDR_DETECTION_053_056_oPCAN_RADAR_e454eb31_Tx: ComBitPosition=152, ComBitSize=7, ComSignalInitValue=0, ComSignalType=UINT8, ComHandleId=1200, ComSystemTemplateSystemSignalRef=DET_RANGE_ERR_054
            DET_AZIMUTH_054_oRDR_DETECTION_053_056_oPCAN_RADAR_532722e3_Tx: ComBitPosition=200, ComBitSize=13, ComSignalInitValue=0, ComSignalType=UINT16, ComHandleId=1141, ComSystemTemplateSystemSignalRef=DET_AZIMUTH_054
            DET_RANGE_056_oRDR_DETECTION_053_056_oPCAN_RADAR_b22cfe33_Tx: ComBitPosition=360, ComBitSize=15, ComSignalInitValue=0, ComSignalType=UINT16, ComHandleId=1198, ComSystemTemplateSystemSignalRef=DET_RANGE_056
            DET_RANGE_VELOCITY_056_oRDR_DETECTION_053_056_oPCAN_RADAR_c78a3c16_Tx: ComBitPosition=384, ComBitSize=15, ComSignalInitValue=16384, ComSignalType=UINT16, ComHandleId=1206, ComSystemTemplateSystemSignalRef=DET_RANGE_VELOCITY_056
            DET_HVC_FLAG_053_oRDR_DETECTION_053_056_oPCAN_RADAR_6af670ec_Tx: ComBitPosition=86, ComBitSize=1, ComSignalInitValue=0, ComSignalType=BOOLEAN, ComHandleId=1176, ComSystemTemplateSystemSignalRef=DET_HVC_FLAG_053
            DET_RCS_053_oRDR_DETECTION_053_056_oPCAN_RADAR_ed2a874e_Tx: ComBitPosition=128, ComBitSize=8, ComSignalInitValue=128, ComSignalType=UINT8, ComHandleId=1211, ComSystemTemplateSystemSignalRef=DET_RCS_053
            DET_SNR_055_oRDR_DETECTION_053_056_oPCAN_RADAR_f94424b0_Tx: ComBitPosition=344, ComBitSize=8, ComSignalInitValue=0, ComSignalType=UINT8, ComHandleId=1217, ComSystemTemplateSystemSignalRef=DET_SNR_055
            DET_SUPER_RES_TARGET_053_oRDR_DETECTION_053_056_oPCAN_RADAR_011dfb29_Tx: ComBitPosition=87, ComBitSize=1, ComSignalInitValue=0, ComSignalType=BOOLEAN, ComHandleId=1219, ComSystemTemplateSystemSignalRef=DET_SUPER_RES_TARGET_053
            DET_ELEVATION_056_oRDR_DETECTION_053_056_oPCAN_RADAR_73045284_Tx: ComBitPosition=408, ComBitSize=8, ComSignalInitValue=0, ComSignalType=UINT8, ComHandleId=1167, ComSystemTemplateSystemSignalRef=DET_ELEVATION_056
            DET_AZIMUTH_ERR_054_oRDR_DETECTION_053_056_oPCAN_RADAR_f792b716_Tx: ComBitPosition=217, ComBitSize=7, ComSignalInitValue=0, ComSignalType=UINT8, ComHandleId=1145, ComSystemTemplateSystemSignalRef=DET_AZIMUTH_ERR_054
            DET_SUPER_RES_TARGET_054_oRDR_DETECTION_053_056_oPCAN_RADAR_5dadd840_Tx: ComBitPosition=199, ComBitSize=1, ComSignalInitValue=0, ComSignalType=BOOLEAN, ComHandleId=1220, ComSystemTemplateSystemSignalRef=DET_SUPER_RES_TARGET_054
            DET_BI_STATIC_FLAG_053_oRDR_DETECTION_053_056_oPCAN_RADAR_59bb410f_Tx: ComBitPosition=104, ComBitSize=1, ComSignalInitValue=0, ComSignalType=BOOLEAN, ComHandleId=1152, ComSystemTemplateSystemSignalRef=DET_BI_STATIC_FLAG_053
            DET_RANGE_053_oRDR_DETECTION_053_056_oPCAN_RADAR_1f0c7231_Tx: ComBitPosition=24, ComBitSize=15, ComSignalInitValue=0, ComSignalType=UINT16, ComHandleId=1195, ComSystemTemplateSystemSignalRef=DET_RANGE_053
            DET_RANGE_VELOCITY_055_oRDR_DETECTION_053_056_oPCAN_RADAR_a36a47e8_Tx: ComBitPosition=272, ComBitSize=15, ComSignalInitValue=16384, ComSignalType=UINT16, ComHandleId=1205, ComSystemTemplateSystemSignalRef=DET_RANGE_VELOCITY_055
            DET_AZIMUTH_053_oRDR_DETECTION_053_056_oPCAN_RADAR_0f97018a_Tx: ComBitPosition=88, ComBitSize=13, ComSignalInitValue=0, ComSignalType=UINT16, ComHandleId=1140, ComSystemTemplateSystemSignalRef=DET_AZIMUTH_053
            DET_ELEVATION_ERR_054_oRDR_DETECTION_053_056_oPCAN_RADAR_05ad659a_Tx: ComBitPosition=192, ComBitSize=6, ComSignalInitValue=0, ComSignalType=UINT8, ComHandleId=1169, ComSystemTemplateSystemSignalRef=DET_ELEVATION_ERR_054
            DET_HVC_FLAG_056_oRDR_DETECTION_053_056_oPCAN_RADAR_c7d6fcee_Tx: ComBitPosition=422, ComBitSize=1, ComSignalInitValue=0, ComSignalType=BOOLEAN, ComHandleId=1179, ComSystemTemplateSystemSignalRef=DET_HVC_FLAG_056
            DET_CONFD_AZIMUTH_056_oRDR_DETECTION_053_056_oPCAN_RADAR_a0518742_Tx: ComBitPosition=454, ComBitSize=2, ComSignalInitValue=0, ComSignalType=UINT8, ComHandleId=1159, ComSystemTemplateSystemSignalRef=DET_CONFD_AZIMUTH_056
            DET_RCS_054_oRDR_DETECTION_053_056_oPCAN_RADAR_b19aa427_Tx: ComBitPosition=240, ComBitSize=8, ComSignalInitValue=128, ComSignalType=UINT8, ComHandleId=1212, ComSystemTemplateSystemSignalRef=DET_RCS_054
            DET_RANGE_055_oRDR_DETECTION_053_056_oPCAN_RADAR_d6cc85cd_Tx: ComBitPosition=248, ComBitSize=15, ComSignalInitValue=0, ComSignalType=UINT16, ComHandleId=1197, ComSystemTemplateSystemSignalRef=DET_RANGE_055
            DET_CONFD_ELEVATION_053_oRDR_DETECTION_053_056_oPCAN_RADAR_0fe40aba_Tx: ComBitPosition=101, ComBitSize=2, ComSignalInitValue=0, ComSignalType=UINT8, ComHandleId=1160, ComSystemTemplateSystemSignalRef=DET_CONFD_ELEVATION_053
            DET_RANGE_VELOCITY_053_oRDR_DETECTION_053_056_oPCAN_RADAR_6aaab014_Tx: ComBitPosition=48, ComBitSize=15, ComSignalInitValue=16384, ComSignalType=UINT16, ComHandleId=1203, ComSystemTemplateSystemSignalRef=DET_RANGE_VELOCITY_053
            DET_AZIMUTH_055_oRDR_DETECTION_053_056_oPCAN_RADAR_c657f676_Tx: ComBitPosition=312, ComBitSize=13, ComSignalInitValue=0, ComSignalType=UINT16, ComHandleId=1142, ComSystemTemplateSystemSignalRef=DET_AZIMUTH_055
            DET_CONFD_AZIMUTH_054_oRDR_DETECTION_053_056_oPCAN_RADAR_51c12829_Tx: ComBitPosition=230, ComBitSize=2, ComSignalInitValue=0, ComSignalType=UINT8, ComHandleId=1157, ComSystemTemplateSystemSignalRef=DET_CONFD_AZIMUTH_054
            DET_RANGE_VELOCITY_ERR_056_oRDR_DETECTION_053_056_oPCAN_RADAR_c831c7a4_Tx: ComBitPosition=400, ComBitSize=8, ComSignalInitValue=0, ComSignalType=UINT8, ComHandleId=1210, ComSystemTemplateSystemSignalRef=DET_RANGE_VELOCITY_ERR_056
            DET_ELEVATION_054_oRDR_DETECTION_053_056_oPCAN_RADAR_8294fdef_Tx: ComBitPosition=184, ComBitSize=8, ComSignalInitValue=0, ComSignalType=UINT8, ComHandleId=1165, ComSystemTemplateSystemSignalRef=DET_ELEVATION_054
            DET_ELEVATION_ERR_055_oRDR_DETECTION_053_056_oPCAN_RADAR_90ddb10f_Tx: ComBitPosition=304, ComBitSize=6, ComSignalInitValue=0, ComSignalType=UINT8, ComHandleId=1170, ComSystemTemplateSystemSignalRef=DET_ELEVATION_ERR_055
            DET_EXISTENCE_PROB_055_oRDR_DETECTION_053_056_oPCAN_RADAR_4242c46f_Tx: ComBitPosition=336, ComBitSize=6, ComSignalInitValue=0, ComSignalType=UINT8, ComHandleId=1174, ComSystemTemplateSystemSignalRef=DET_EXISTENCE_PROB_055
            DET_CONFD_AZIMUTH_053_oRDR_DETECTION_053_056_oPCAN_RADAR_0d710b40_Tx: ComBitPosition=118, ComBitSize=2, ComSignalInitValue=0, ComSignalType=UINT8, ComHandleId=1156, ComSystemTemplateSystemSignalRef=DET_CONFD_AZIMUTH_053
            DET_RCS_055_oRDR_DETECTION_053_056_oPCAN_RADAR_24ea70b2_Tx: ComBitPosition=352, ComBitSize=8, ComSignalInitValue=128, ComSignalType=UINT8, ComHandleId=1213, ComSystemTemplateSystemSignalRef=DET_RCS_055
            DET_AZIMUTH_ERR_056_oRDR_DETECTION_053_056_oPCAN_RADAR_0602187d_Tx: ComBitPosition=441, ComBitSize=7, ComSignalInitValue=0, ComSignalType=UINT8, ComHandleId=1147, ComSystemTemplateSystemSignalRef=DET_AZIMUTH_ERR_056
            DET_EXISTENCE_PROB_054_oRDR_DETECTION_053_056_oPCAN_RADAR_d73210fa_Tx: ComBitPosition=224, ComBitSize=6, ComSignalInitValue=0, ComSignalType=UINT8, ComHandleId=1173, ComSystemTemplateSystemSignalRef=DET_EXISTENCE_PROB_054
            DET_SUPER_RES_TARGET_055_oRDR_DETECTION_053_056_oPCAN_RADAR_c8dd0cd5_Tx: ComBitPosition=311, ComBitSize=1, ComSignalInitValue=0, ComSignalType=BOOLEAN, ComHandleId=1221, ComSystemTemplateSystemSignalRef=DET_SUPER_RES_TARGET_055
            DET_CONFD_ELEVATION_055_oRDR_DETECTION_053_056_oPCAN_RADAR_c624fd46_Tx: ComBitPosition=325, ComBitSize=2, ComSignalInitValue=0, ComSignalType=UINT8, ComHandleId=1162, ComSystemTemplateSystemSignalRef=DET_CONFD_ELEVATION_055
            DET_SNR_056_oRDR_DETECTION_053_056_oPCAN_RADAR_9da45f4e_Tx: ComBitPosition=456, ComBitSize=8, ComSignalInitValue=0, ComSignalType=UINT8, ComHandleId=1218, ComSystemTemplateSystemSignalRef=DET_SNR_056
            DET_RANGE_054_oRDR_DETECTION_053_056_oPCAN_RADAR_43bc5158_Tx: ComBitPosition=136, ComBitSize=15, ComSignalInitValue=0, ComSignalType=UINT16, ComHandleId=1196, ComSystemTemplateSystemSignalRef=DET_RANGE_054
            DET_HVC_FLAG_054_oRDR_DETECTION_053_056_oPCAN_RADAR_36465385_Tx: ComBitPosition=198, ComBitSize=1, ComSignalInitValue=0, ComSignalType=BOOLEAN, ComHandleId=1177, ComSystemTemplateSystemSignalRef=DET_HVC_FLAG_054
            DET_HVC_FLAG_055_oRDR_DETECTION_053_056_oPCAN_RADAR_a3368710_Tx: ComBitPosition=310, ComBitSize=1, ComSignalInitValue=0, ComSignalType=BOOLEAN, ComHandleId=1178, ComSystemTemplateSystemSignalRef=DET_HVC_FLAG_055
            DET_SNR_054_oRDR_DETECTION_053_056_oPCAN_RADAR_6c34f025_Tx: ComBitPosition=232, ComBitSize=8, ComSignalInitValue=0, ComSignalType=UINT8, ComHandleId=1216, ComSystemTemplateSystemSignalRef=DET_SNR_054
            DET_SUPER_RES_TARGET_056_oRDR_DETECTION_053_056_oPCAN_RADAR_ac3d772b_Tx: ComBitPosition=423, ComBitSize=1, ComSignalInitValue=0, ComSignalType=BOOLEAN, ComHandleId=1222, ComSystemTemplateSystemSignalRef=DET_SUPER_RES_TARGET_056
            DET_RANGE_ERR_056_oRDR_DETECTION_053_056_oPCAN_RADAR_15c4445a_Tx: ComBitPosition=376, ComBitSize=7, ComSignalInitValue=0, ComSignalType=UINT8, ComHandleId=1202, ComSystemTemplateSystemSignalRef=DET_RANGE_ERR_056
            DET_AZIMUTH_ERR_055_oRDR_DETECTION_053_056_oPCAN_RADAR_62e26383_Tx: ComBitPosition=329, ComBitSize=7, ComSignalInitValue=0, ComSignalType=UINT8, ComHandleId=1146, ComSystemTemplateSystemSignalRef=DET_AZIMUTH_ERR_055
            DET_ELEVATION_053_oRDR_DETECTION_053_056_oPCAN_RADAR_de24de86_Tx: ComBitPosition=72, ComBitSize=8, ComSignalInitValue=0, ComSignalType=UINT8, ComHandleId=1164, ComSystemTemplateSystemSignalRef=DET_ELEVATION_053
            DET_RANGE_VELOCITY_ERR_054_oRDR_DETECTION_053_056_oPCAN_RADAR_39a168cf_Tx: ComBitPosition=176, ComBitSize=8, ComSignalInitValue=0, ComSignalType=UINT8, ComHandleId=1208, ComSystemTemplateSystemSignalRef=DET_RANGE_VELOCITY_ERR_054
            DET_MH_CYCLE_COUNTER_053_056_oRDR_DETECTION_053_056_oPCAN_RADAR_6fecde3c_Tx: ComBitPosition=16, ComBitSize=8, ComSignalInitValue=0, ComSignalType=UINT8, ComHandleId=1185, ComSystemTemplateSystemSignalRef=DET_MH_CYCLE_COUNTER_053_056
            DET_RANGE_VELOCITY_ERR_055_oRDR_DETECTION_053_056_oPCAN_RADAR_acd1bc5a_Tx: ComBitPosition=288, ComBitSize=8, ComSignalInitValue=0, ComSignalType=UINT8, ComHandleId=1209, ComSystemTemplateSystemSignalRef=DET_RANGE_VELOCITY_ERR_055
            DET_CONFD_ELEVATION_056_oRDR_DETECTION_053_056_oPCAN_RADAR_a2c486b8_Tx: ComBitPosition=437, ComBitSize=2, ComSignalInitValue=0, ComSignalType=UINT8, ComHandleId=1163, ComSystemTemplateSystemSignalRef=DET_CONFD_ELEVATION_056
            DET_AZIMUTH_ERR_053_oRDR_DETECTION_053_056_oPCAN_RADAR_ab22947f_Tx: ComBitPosition=105, ComBitSize=7, ComSignalInitValue=0, ComSignalType=UINT8, ComHandleId=1144, ComSystemTemplateSystemSignalRef=DET_AZIMUTH_ERR_053
            DET_BI_STATIC_FLAG_054_oRDR_DETECTION_053_056_oPCAN_RADAR_050b6266_Tx: ComBitPosition=216, ComBitSize=1, ComSignalInitValue=0, ComSignalType=BOOLEAN, ComHandleId=1153, ComSystemTemplateSystemSignalRef=DET_BI_STATIC_FLAG_054
            DET_CONFD_ELEVATION_054_oRDR_DETECTION_053_056_oPCAN_RADAR_535429d3_Tx: ComBitPosition=213, ComBitSize=2, ComSignalInitValue=0, ComSignalType=UINT8, ComHandleId=1161, ComSystemTemplateSystemSignalRef=DET_CONFD_ELEVATION_054
            DET_RANGE_VELOCITY_ERR_053_oRDR_DETECTION_053_056_oPCAN_RADAR_65114ba6_Tx: ComBitPosition=64, ComBitSize=8, ComSignalInitValue=0, ComSignalType=UINT8, ComHandleId=1207, ComSystemTemplateSystemSignalRef=DET_RANGE_VELOCITY_ERR_053
            DET_EXISTENCE_PROB_056_oRDR_DETECTION_053_056_oPCAN_RADAR_26a2bf91_Tx: ComBitPosition=448, ComBitSize=6, ComSignalInitValue=0, ComSignalType=UINT8, ComHandleId=1175, ComSystemTemplateSystemSignalRef=DET_EXISTENCE_PROB_056
            DET_MH_CRC16_053_056_oRDR_DETECTION_053_056_oPCAN_RADAR_eb997f0b_Tx: ComBitPosition=0, ComBitSize=16, ComSignalInitValue=0, ComSignalType=UINT16, ComHandleId=1184, ComSystemTemplateSystemSignalRef=DET_MH_CRC16_053_056
            DET_RCS_056_oRDR_DETECTION_053_056_oPCAN_RADAR_400a0b4c_Tx: ComBitPosition=464, ComBitSize=8, ComSignalInitValue=128, ComSignalType=UINT8, ComHandleId=1214, ComSystemTemplateSystemSignalRef=DET_RCS_056
            DET_IDM_053_oRDR_DETECTION_053_056_oPCAN_RADAR_e1a44b51_Tx: ComBitPosition=63, ComBitSize=1, ComSignalInitValue=0, ComSignalType=UINT8, ComHandleId=1180, ComSystemTemplateSystemSignalRef=DET_IDM_053
            DET_MTD_054_oRDR_DETECTION_053_056_oPCAN_RADAR_dba75ae3_Tx: ComBitPosition=159, ComBitSize=1, ComSignalInitValue=0, ComSignalType=UINT8, ComHandleId=1188, ComSystemTemplateSystemSignalRef=DET_MTD_054
            DET_PROB_1STAZHYPO_054_oRDR_DETECTION_053_056_oPCAN_RADAR_4813b22e_Tx: ComBitPosition=215, ComBitSize=1, ComSignalInitValue=0, ComSignalType=BOOLEAN, ComHandleId=1192, ComSystemTemplateSystemSignalRef=DET_PROB_1STAZHYPO_054
            DET_PROB_1STAZHYPO_056_oRDR_DETECTION_053_056_oPCAN_RADAR_b9831d45_Tx: ComBitPosition=439, ComBitSize=1, ComSignalInitValue=0, ComSignalType=BOOLEAN, ComHandleId=1194, ComSystemTemplateSystemSignalRef=DET_PROB_1STAZHYPO_056
            DET_BELOW_RAIN_THOLD_056_oRDR_DETECTION_053_056_oPCAN_RADAR_77b61e48_Tx: ComBitPosition=375, ComBitSize=1, ComSignalInitValue=0, ComSignalType=UINT8, ComHandleId=1151, ComSystemTemplateSystemSignalRef=DET_BELOW_RAIN_THOLD_056
            DET_BELOW_RAIN_THOLD_053_oRDR_DETECTION_053_056_oPCAN_RADAR_da96924a_Tx: ComBitPosition=39, ComBitSize=1, ComSignalInitValue=0, ComSignalType=UINT8, ComHandleId=1148, ComSystemTemplateSystemSignalRef=DET_BELOW_RAIN_THOLD_053
            DET_BELOW_RAIN_THOLD_055_oRDR_DETECTION_053_056_oPCAN_RADAR_135665b6_Tx: ComBitPosition=263, ComBitSize=1, ComSignalInitValue=0, ComSignalType=UINT8, ComHandleId=1150, ComSystemTemplateSystemSignalRef=DET_BELOW_RAIN_THOLD_055
            DET_MTD_056_oRDR_DETECTION_053_056_oPCAN_RADAR_2a37f588_Tx: ComBitPosition=383, ComBitSize=1, ComSignalInitValue=0, ComSignalType=UINT8, ComHandleId=1190, ComSystemTemplateSystemSignalRef=DET_MTD_056
            DET_MTD_055_oRDR_DETECTION_053_056_oPCAN_RADAR_4ed78e76_Tx: ComBitPosition=271, ComBitSize=1, ComSignalInitValue=0, ComSignalType=UINT8, ComHandleId=1189, ComSystemTemplateSystemSignalRef=DET_MTD_055
            DET_BELOW_RAIN_THOLD_054_oRDR_DETECTION_053_056_oPCAN_RADAR_8626b123_Tx: ComBitPosition=151, ComBitSize=1, ComSignalInitValue=0, ComSignalType=UINT8, ComHandleId=1149, ComSystemTemplateSystemSignalRef=DET_BELOW_RAIN_THOLD_054
            DET_IDM_055_oRDR_DETECTION_053_056_oPCAN_RADAR_2864bcad_Tx: ComBitPosition=287, ComBitSize=1, ComSignalInitValue=0, ComSignalType=UINT8, ComHandleId=1182, ComSystemTemplateSystemSignalRef=DET_IDM_055
            DET_PROB_1STAZHYPO_053_oRDR_DETECTION_053_056_oPCAN_RADAR_14a39147_Tx: ComBitPosition=103, ComBitSize=1, ComSignalInitValue=0, ComSignalType=BOOLEAN, ComHandleId=1191, ComSystemTemplateSystemSignalRef=DET_PROB_1STAZHYPO_053
            DET_IDM_054_oRDR_DETECTION_053_056_oPCAN_RADAR_bd146838_Tx: ComBitPosition=175, ComBitSize=1, ComSignalInitValue=0, ComSignalType=UINT8, ComHandleId=1181, ComSystemTemplateSystemSignalRef=DET_IDM_054
            DET_MTD_053_oRDR_DETECTION_053_056_oPCAN_RADAR_8717798a_Tx: ComBitPosition=47, ComBitSize=1, ComSignalInitValue=0, ComSignalType=UINT8, ComHandleId=1187, ComSystemTemplateSystemSignalRef=DET_MTD_053
            DET_IDM_056_oRDR_DETECTION_053_056_oPCAN_RADAR_4c84c753_Tx: ComBitPosition=399, ComBitSize=1, ComSignalInitValue=0, ComSignalType=UINT8, ComHandleId=1183, ComSystemTemplateSystemSignalRef=DET_IDM_056
            DET_PROB_1STAZHYPO_055_oRDR_DETECTION_053_056_oPCAN_RADAR_dd6366bb_Tx: ComBitPosition=327, ComBitSize=1, ComSignalInitValue=0, ComSignalType=BOOLEAN, ComHandleId=1193, ComSystemTemplateSystemSignalRef=DET_PROB_1STAZHYPO_055
        SG_Detections_393_396_oRDR_DETECTION_393_396_oPCAN_RADAR_17d40b28_Tx: ComTransferProperty=TRIGGERED, ComHandleId=100, ComSystemTemplateSignalGroupRef=SG_Detections_393_396
          83 x ComGroupSignal, all with ComSignalEndianness=LITTLE_ENDIAN, ComTransferProperty=PENDING, ComSignalAccess=ACCESS_NEEDED_BY_SWC_OR_COM:
            DET_RANGE_ERR_396_oRDR_DETECTION_393_396_oPCAN_RADAR_6efebb0b_Tx: ComBitPosition=376, ComBitSize=7, ComSignalInitValue=0, ComSignalType=UINT8, ComHandleId=8257, ComSystemTemplateSystemSignalRef=DET_RANGE_ERR_396
            DET_ELEVATION_394_oRDR_DETECTION_393_396_oPCAN_RADAR_f9ae02be_Tx: ComBitPosition=184, ComBitSize=8, ComSignalInitValue=0, ComSignalType=UINT8, ComHandleId=8220, ComSystemTemplateSystemSignalRef=DET_ELEVATION_394
            DET_SUPER_RES_TARGET_396_oRDR_DETECTION_393_396_oPCAN_RADAR_d707887a_Tx: ComBitPosition=423, ComBitSize=1, ComSignalInitValue=0, ComSignalType=BOOLEAN, ComHandleId=8277, ComSystemTemplateSystemSignalRef=DET_SUPER_RES_TARGET_396
            DET_RCS_394_oRDR_DETECTION_393_396_oPCAN_RADAR_caa05b76_Tx: ComBitPosition=240, ComBitSize=8, ComSignalInitValue=128, ComSignalType=UINT8, ComHandleId=8267, ComSystemTemplateSystemSignalRef=DET_RCS_394
            DET_RANGE_VELOCITY_394_oRDR_DETECTION_393_396_oPCAN_RADAR_4d206c2c_Tx: ComBitPosition=160, ComBitSize=15, ComSignalInitValue=16384, ComSignalType=UINT16, ComHandleId=8259, ComSystemTemplateSystemSignalRef=DET_RANGE_VELOCITY_394
            DET_SNR_395_oRDR_DETECTION_393_396_oPCAN_RADAR_827edbe1_Tx: ComBitPosition=344, ComBitSize=8, ComSignalInitValue=0, ComSignalType=UINT8, ComHandleId=8272, ComSystemTemplateSystemSignalRef=DET_SNR_395
            DET_EXISTENCE_PROB_394_oRDR_DETECTION_393_396_oPCAN_RADAR_ac08efab_Tx: ComBitPosition=224, ComBitSize=6, ComSignalInitValue=0, ComSignalType=UINT8, ComHandleId=8228, ComSystemTemplateSystemSignalRef=DET_EXISTENCE_PROB_394
            DET_BI_STATIC_FLAG_396_oRDR_DETECTION_393_396_oPCAN_RADAR_8fa1325c_Tx: ComBitPosition=440, ComBitSize=1, ComSignalInitValue=0, ComSignalType=BOOLEAN, ComHandleId=8210, ComSystemTemplateSystemSignalRef=DET_BI_STATIC_FLAG_396
            DET_SNR_396_oRDR_DETECTION_393_396_oPCAN_RADAR_e69ea01f_Tx: ComBitPosition=456, ComBitSize=8, ComSignalInitValue=0, ComSignalType=UINT8, ComHandleId=8273, ComSystemTemplateSystemSignalRef=DET_SNR_396
            DET_RANGE_393_oRDR_DETECTION_393_396_oPCAN_RADAR_64368d60_Tx: ComBitPosition=24, ComBitSize=15, ComSignalInitValue=0, ComSignalType=UINT16, ComHandleId=8250, ComSystemTemplateSystemSignalRef=DET_RANGE_393
            DET_SNR_394_oRDR_DETECTION_393_396_oPCAN_RADAR_170e0f74_Tx: ComBitPosition=232, ComBitSize=8, ComSignalInitValue=0, ComSignalType=UINT8, ComHandleId=8271, ComSystemTemplateSystemSignalRef=DET_SNR_394
            DET_RANGE_396_oRDR_DETECTION_393_396_oPCAN_RADAR_c9160162_Tx: ComBitPosition=360, ComBitSize=15, ComSignalInitValue=0, ComSignalType=UINT16, ComHandleId=8253, ComSystemTemplateSystemSignalRef=DET_RANGE_396
            DET_ELEVATION_ERR_393_oRDR_DETECTION_393_396_oPCAN_RADAR_2227b9a2_Tx: ComBitPosition=80, ComBitSize=6, ComSignalInitValue=0, ComSignalType=UINT8, ComHandleId=8223, ComSystemTemplateSystemSignalRef=DET_ELEVATION_ERR_393
            DET_CONFD_AZIMUTH_395_oRDR_DETECTION_393_396_oPCAN_RADAR_bf8b03ed_Tx: ComBitPosition=342, ComBitSize=2, ComSignalInitValue=0, ComSignalType=UINT8, ComHandleId=8213, ComSystemTemplateSystemSignalRef=DET_CONFD_AZIMUTH_395
            DET_ELEVATION_ERR_394_oRDR_DETECTION_393_396_oPCAN_RADAR_7e979acb_Tx: ComBitPosition=192, ComBitSize=6, ComSignalInitValue=0, ComSignalType=UINT8, ComHandleId=8224, ComSystemTemplateSystemSignalRef=DET_ELEVATION_ERR_394
            DET_RCS_393_oRDR_DETECTION_393_396_oPCAN_RADAR_9610781f_Tx: ComBitPosition=128, ComBitSize=8, ComSignalInitValue=128, ComSignalType=UINT8, ComHandleId=8266, ComSystemTemplateSystemSignalRef=DET_RCS_393
            DET_RANGE_VELOCITY_ERR_394_oRDR_DETECTION_393_396_oPCAN_RADAR_429b979e_Tx: ComBitPosition=176, ComBitSize=8, ComSignalInitValue=0, ComSignalType=UINT8, ComHandleId=8263, ComSystemTemplateSystemSignalRef=DET_RANGE_VELOCITY_ERR_394
            DET_RANGE_VELOCITY_393_oRDR_DETECTION_393_396_oPCAN_RADAR_11904f45_Tx: ComBitPosition=48, ComBitSize=15, ComSignalInitValue=16384, ComSignalType=UINT16, ComHandleId=8258, ComSystemTemplateSystemSignalRef=DET_RANGE_VELOCITY_393
            DET_RANGE_VELOCITY_ERR_393_oRDR_DETECTION_393_396_oPCAN_RADAR_1e2bb4f7_Tx: ComBitPosition=64, ComBitSize=8, ComSignalInitValue=0, ComSignalType=UINT8, ComHandleId=8262, ComSystemTemplateSystemSignalRef=DET_RANGE_VELOCITY_ERR_393
            DET_RANGE_395_oRDR_DETECTION_393_396_oPCAN_RADAR_adf67a9c_Tx: ComBitPosition=248, ComBitSize=15, ComSignalInitValue=0, ComSignalType=UINT16, ComHandleId=8252, ComSystemTemplateSystemSignalRef=DET_RANGE_395
            DET_ELEVATION_ERR_395_oRDR_DETECTION_393_396_oPCAN_RADAR_ebe74e5e_Tx: ComBitPosition=304, ComBitSize=6, ComSignalInitValue=0, ComSignalType=UINT8, ComHandleId=8225, ComSystemTemplateSystemSignalRef=DET_ELEVATION_ERR_395
            DET_SUPER_RES_TARGET_393_oRDR_DETECTION_393_396_oPCAN_RADAR_7a270478_Tx: ComBitPosition=87, ComBitSize=1, ComSignalInitValue=0, ComSignalType=BOOLEAN, ComHandleId=8274, ComSystemTemplateSystemSignalRef=DET_SUPER_RES_TARGET_393
            DET_RANGE_VELOCITY_396_oRDR_DETECTION_393_396_oPCAN_RADAR_bcb0c347_Tx: ComBitPosition=384, ComBitSize=15, ComSignalInitValue=16384, ComSignalType=UINT16, ComHandleId=8261, ComSystemTemplateSystemSignalRef=DET_RANGE_VELOCITY_396
            DET_RANGE_VELOCITY_ERR_395_oRDR_DETECTION_393_396_oPCAN_RADAR_d7eb430b_Tx: ComBitPosition=288, ComBitSize=8, ComSignalInitValue=0, ComSignalType=UINT8, ComHandleId=8264, ComSystemTemplateSystemSignalRef=DET_RANGE_VELOCITY_ERR_395
            DET_AZIMUTH_ERR_396_oRDR_DETECTION_393_396_oPCAN_RADAR_7d38e72c_Tx: ComBitPosition=441, ComBitSize=7, ComSignalInitValue=0, ComSignalType=UINT8, ComHandleId=8202, ComSystemTemplateSystemSignalRef=DET_AZIMUTH_ERR_396
            DET_SNR_393_oRDR_DETECTION_393_396_oPCAN_RADAR_4bbe2c1d_Tx: ComBitPosition=120, ComBitSize=8, ComSignalInitValue=0, ComSignalType=UINT8, ComHandleId=8270, ComSystemTemplateSystemSignalRef=DET_SNR_393
            DET_AZIMUTH_ERR_393_oRDR_DETECTION_393_396_oPCAN_RADAR_d0186b2e_Tx: ComBitPosition=105, ComBitSize=7, ComSignalInitValue=0, ComSignalType=UINT8, ComHandleId=8199, ComSystemTemplateSystemSignalRef=DET_AZIMUTH_ERR_393
            DET_HVC_FLAG_396_oRDR_DETECTION_393_396_oPCAN_RADAR_bcec03bf_Tx: ComBitPosition=422, ComBitSize=1, ComSignalInitValue=0, ComSignalType=BOOLEAN, ComHandleId=8234, ComSystemTemplateSystemSignalRef=DET_HVC_FLAG_396
            DET_CONFD_AZIMUTH_396_oRDR_DETECTION_393_396_oPCAN_RADAR_db6b7813_Tx: ComBitPosition=454, ComBitSize=2, ComSignalInitValue=0, ComSignalType=UINT8, ComHandleId=8214, ComSystemTemplateSystemSignalRef=DET_CONFD_AZIMUTH_396
            DET_MH_CRC16_393_396_oRDR_DETECTION_393_396_oPCAN_RADAR_935cd923_Tx: ComBitPosition=0, ComBitSize=16, ComSignalInitValue=0, ComSignalType=UINT16, ComHandleId=8239, ComSystemTemplateSystemSignalRef=DET_MH_CRC16_393_396
            DET_RANGE_VELOCITY_395_oRDR_DETECTION_393_396_oPCAN_RADAR_d850b8b9_Tx: ComBitPosition=272, ComBitSize=15, ComSignalInitValue=16384, ComSignalType=UINT16, ComHandleId=8260, ComSystemTemplateSystemSignalRef=DET_RANGE_VELOCITY_395
            DET_ELEVATION_396_oRDR_DETECTION_393_396_oPCAN_RADAR_083eadd5_Tx: ComBitPosition=408, ComBitSize=8, ComSignalInitValue=0, ComSignalType=UINT8, ComHandleId=8222, ComSystemTemplateSystemSignalRef=DET_ELEVATION_396
            DET_EXISTENCE_PROB_393_oRDR_DETECTION_393_396_oPCAN_RADAR_f0b8ccc2_Tx: ComBitPosition=112, ComBitSize=6, ComSignalInitValue=0, ComSignalType=UINT8, ComHandleId=8227, ComSystemTemplateSystemSignalRef=DET_EXISTENCE_PROB_393
            DET_RCS_395_oRDR_DETECTION_393_396_oPCAN_RADAR_5fd08fe3_Tx: ComBitPosition=352, ComBitSize=8, ComSignalInitValue=128, ComSignalType=UINT8, ComHandleId=8268, ComSystemTemplateSystemSignalRef=DET_RCS_395
            DET_CONFD_AZIMUTH_393_oRDR_DETECTION_393_396_oPCAN_RADAR_764bf411_Tx: ComBitPosition=118, ComBitSize=2, ComSignalInitValue=0, ComSignalType=UINT8, ComHandleId=8211, ComSystemTemplateSystemSignalRef=DET_CONFD_AZIMUTH_393
            DET_RANGE_ERR_393_oRDR_DETECTION_393_396_oPCAN_RADAR_c3de3709_Tx: ComBitPosition=40, ComBitSize=7, ComSignalInitValue=0, ComSignalType=UINT8, ComHandleId=8254, ComSystemTemplateSystemSignalRef=DET_RANGE_ERR_393
            DET_EXISTENCE_PROB_395_oRDR_DETECTION_393_396_oPCAN_RADAR_39783b3e_Tx: ComBitPosition=336, ComBitSize=6, ComSignalInitValue=0, ComSignalType=UINT8, ComHandleId=8229, ComSystemTemplateSystemSignalRef=DET_EXISTENCE_PROB_395
            DET_AZIMUTH_ERR_394_oRDR_DETECTION_393_396_oPCAN_RADAR_8ca84847_Tx: ComBitPosition=217, ComBitSize=7, ComSignalInitValue=0, ComSignalType=UINT8, ComHandleId=8200, ComSystemTemplateSystemSignalRef=DET_AZIMUTH_ERR_394
            DET_CONFD_ELEVATION_394_oRDR_DETECTION_393_396_oPCAN_RADAR_286ed682_Tx: ComBitPosition=213, ComBitSize=2, ComSignalInitValue=0, ComSignalType=UINT8, ComHandleId=8216, ComSystemTemplateSystemSignalRef=DET_CONFD_ELEVATION_394
            DET_RANGE_ERR_394_oRDR_DETECTION_393_396_oPCAN_RADAR_9f6e1460_Tx: ComBitPosition=152, ComBitSize=7, ComSignalInitValue=0, ComSignalType=UINT8, ComHandleId=8255, ComSystemTemplateSystemSignalRef=DET_RANGE_ERR_394
            DET_SUPER_RES_TARGET_394_oRDR_DETECTION_393_396_oPCAN_RADAR_26972711_Tx: ComBitPosition=199, ComBitSize=1, ComSignalInitValue=0, ComSignalType=BOOLEAN, ComHandleId=8275, ComSystemTemplateSystemSignalRef=DET_SUPER_RES_TARGET_394
            DET_CONFD_ELEVATION_395_oRDR_DETECTION_393_396_oPCAN_RADAR_bd1e0217_Tx: ComBitPosition=325, ComBitSize=2, ComSignalInitValue=0, ComSignalType=UINT8, ComHandleId=8217, ComSystemTemplateSystemSignalRef=DET_CONFD_ELEVATION_395
            DET_HVC_FLAG_393_oRDR_DETECTION_393_396_oPCAN_RADAR_11cc8fbd_Tx: ComBitPosition=86, ComBitSize=1, ComSignalInitValue=0, ComSignalType=BOOLEAN, ComHandleId=8231, ComSystemTemplateSystemSignalRef=DET_HVC_FLAG_393
            DET_ELEVATION_ERR_396_oRDR_DETECTION_393_396_oPCAN_RADAR_8f0735a0_Tx: ComBitPosition=416, ComBitSize=6, ComSignalInitValue=0, ComSignalType=UINT8, ComHandleId=8226, ComSystemTemplateSystemSignalRef=DET_ELEVATION_ERR_396
            DET_AZIMUTH_393_oRDR_DETECTION_393_396_oPCAN_RADAR_74adfedb_Tx: ComBitPosition=88, ComBitSize=13, ComSignalInitValue=0, ComSignalType=UINT16, ComHandleId=8195, ComSystemTemplateSystemSignalRef=DET_AZIMUTH_393
            DET_ELEVATION_393_oRDR_DETECTION_393_396_oPCAN_RADAR_a51e21d7_Tx: ComBitPosition=72, ComBitSize=8, ComSignalInitValue=0, ComSignalType=UINT8, ComHandleId=8219, ComSystemTemplateSystemSignalRef=DET_ELEVATION_393
            DET_RANGE_ERR_395_oRDR_DETECTION_393_396_oPCAN_RADAR_0a1ec0f5_Tx: ComBitPosition=264, ComBitSize=7, ComSignalInitValue=0, ComSignalType=UINT8, ComHandleId=8256, ComSystemTemplateSystemSignalRef=DET_RANGE_ERR_395
            DET_AZIMUTH_396_oRDR_DETECTION_393_396_oPCAN_RADAR_d98d72d9_Tx: ComBitPosition=424, ComBitSize=13, ComSignalInitValue=0, ComSignalType=UINT16, ComHandleId=8198, ComSystemTemplateSystemSignalRef=DET_AZIMUTH_396
            DET_BI_STATIC_FLAG_393_oRDR_DETECTION_393_396_oPCAN_RADAR_2281be5e_Tx: ComBitPosition=104, ComBitSize=1, ComSignalInitValue=0, ComSignalType=BOOLEAN, ComHandleId=8207, ComSystemTemplateSystemSignalRef=DET_BI_STATIC_FLAG_393
            DET_BI_STATIC_FLAG_395_oRDR_DETECTION_393_396_oPCAN_RADAR_eb4149a2_Tx: ComBitPosition=328, ComBitSize=1, ComSignalInitValue=0, ComSignalType=BOOLEAN, ComHandleId=8209, ComSystemTemplateSystemSignalRef=DET_BI_STATIC_FLAG_395
            DET_EXISTENCE_PROB_396_oRDR_DETECTION_393_396_oPCAN_RADAR_5d9840c0_Tx: ComBitPosition=448, ComBitSize=6, ComSignalInitValue=0, ComSignalType=UINT8, ComHandleId=8230, ComSystemTemplateSystemSignalRef=DET_EXISTENCE_PROB_396
            DET_CONFD_AZIMUTH_394_oRDR_DETECTION_393_396_oPCAN_RADAR_2afbd778_Tx: ComBitPosition=230, ComBitSize=2, ComSignalInitValue=0, ComSignalType=UINT8, ComHandleId=8212, ComSystemTemplateSystemSignalRef=DET_CONFD_AZIMUTH_394
            DET_HVC_FLAG_394_oRDR_DETECTION_393_396_oPCAN_RADAR_4d7cacd4_Tx: ComBitPosition=198, ComBitSize=1, ComSignalInitValue=0, ComSignalType=BOOLEAN, ComHandleId=8232, ComSystemTemplateSystemSignalRef=DET_HVC_FLAG_394
            DET_AZIMUTH_394_oRDR_DETECTION_393_396_oPCAN_RADAR_281dddb2_Tx: ComBitPosition=200, ComBitSize=13, ComSignalInitValue=0, ComSignalType=UINT16, ComHandleId=8196, ComSystemTemplateSystemSignalRef=DET_AZIMUTH_394
            DET_CONFD_ELEVATION_396_oRDR_DETECTION_393_396_oPCAN_RADAR_d9fe79e9_Tx: ComBitPosition=437, ComBitSize=2, ComSignalInitValue=0, ComSignalType=UINT8, ComHandleId=8218, ComSystemTemplateSystemSignalRef=DET_CONFD_ELEVATION_396
            DET_MH_CYCLE_COUNTER_393_396_oRDR_DETECTION_393_396_oPCAN_RADAR_17297814_Tx: ComBitPosition=16, ComBitSize=8, ComSignalInitValue=0, ComSignalType=UINT8, ComHandleId=8240, ComSystemTemplateSystemSignalRef=DET_MH_CYCLE_COUNTER_393_396
            DET_CONFD_ELEVATION_393_oRDR_DETECTION_393_396_oPCAN_RADAR_74def5eb_Tx: ComBitPosition=101, ComBitSize=2, ComSignalInitValue=0, ComSignalType=UINT8, ComHandleId=8215, ComSystemTemplateSystemSignalRef=DET_CONFD_ELEVATION_393
            DET_RANGE_VELOCITY_ERR_396_oRDR_DETECTION_393_396_oPCAN_RADAR_b30b38f5_Tx: ComBitPosition=400, ComBitSize=8, ComSignalInitValue=0, ComSignalType=UINT8, ComHandleId=8265, ComSystemTemplateSystemSignalRef=DET_RANGE_VELOCITY_ERR_396
            DET_MH_SCAN_INDEX_4LSB_393_396_oRDR_DETECTION_393_396_oPCAN_RADAR_db035d98_Tx: ComBitPosition=476, ComBitSize=4, ComSignalInitValue=0, ComSignalType=UINT8, ComHandleId=8241, ComSystemTemplateSystemSignalRef=DET_MH_SCAN_INDEX_4LSB_393_396
            DET_AZIMUTH_395_oRDR_DETECTION_393_396_oPCAN_RADAR_bd6d0927_Tx: ComBitPosition=312, ComBitSize=13, ComSignalInitValue=0, ComSignalType=UINT16, ComHandleId=8197, ComSystemTemplateSystemSignalRef=DET_AZIMUTH_395
            DET_ELEVATION_395_oRDR_DETECTION_393_396_oPCAN_RADAR_6cded62b_Tx: ComBitPosition=296, ComBitSize=8, ComSignalInitValue=0, ComSignalType=UINT8, ComHandleId=8221, ComSystemTemplateSystemSignalRef=DET_ELEVATION_395
            DET_RCS_396_oRDR_DETECTION_393_396_oPCAN_RADAR_3b30f41d_Tx: ComBitPosition=464, ComBitSize=8, ComSignalInitValue=128, ComSignalType=UINT8, ComHandleId=8269, ComSystemTemplateSystemSignalRef=DET_RCS_396
            DET_BI_STATIC_FLAG_394_oRDR_DETECTION_393_396_oPCAN_RADAR_7e319d37_Tx: ComBitPosition=216, ComBitSize=1, ComSignalInitValue=0, ComSignalType=BOOLEAN, ComHandleId=8208, ComSystemTemplateSystemSignalRef=DET_BI_STATIC_FLAG_394
            DET_SUPER_RES_TARGET_395_oRDR_DETECTION_393_396_oPCAN_RADAR_b3e7f384_Tx: ComBitPosition=311, ComBitSize=1, ComSignalInitValue=0, ComSignalType=BOOLEAN, ComHandleId=8276, ComSystemTemplateSystemSignalRef=DET_SUPER_RES_TARGET_395
            DET_AZIMUTH_ERR_395_oRDR_DETECTION_393_396_oPCAN_RADAR_19d89cd2_Tx: ComBitPosition=329, ComBitSize=7, ComSignalInitValue=0, ComSignalType=UINT8, ComHandleId=8201, ComSystemTemplateSystemSignalRef=DET_AZIMUTH_ERR_395
            DET_RANGE_394_oRDR_DETECTION_393_396_oPCAN_RADAR_3886ae09_Tx: ComBitPosition=136, ComBitSize=15, ComSignalInitValue=0, ComSignalType=UINT16, ComHandleId=8251, ComSystemTemplateSystemSignalRef=DET_RANGE_394
            DET_HVC_FLAG_395_oRDR_DETECTION_393_396_oPCAN_RADAR_d80c7841_Tx: ComBitPosition=310, ComBitSize=1, ComSignalInitValue=0, ComSignalType=BOOLEAN, ComHandleId=8233, ComSystemTemplateSystemSignalRef=DET_HVC_FLAG_395
            DET_MTD_394_oRDR_DETECTION_393_396_oPCAN_RADAR_a09da5b2_Tx: ComBitPosition=159, ComBitSize=1, ComSignalInitValue=0, ComSignalType=UINT8, ComHandleId=8243, ComSystemTemplateSystemSignalRef=DET_MTD_394
            DET_PROB_1STAZHYPO_396_oRDR_DETECTION_393_396_oPCAN_RADAR_c2b9e214_Tx: ComBitPosition=439, ComBitSize=1, ComSignalInitValue=0, ComSignalType=BOOLEAN, ComHandleId=8249, ComSystemTemplateSystemSignalRef=DET_PROB_1STAZHYPO_396
            DET_PROB_1STAZHYPO_394_oRDR_DETECTION_393_396_oPCAN_RADAR_33294d7f_Tx: ComBitPosition=215, ComBitSize=1, ComSignalInitValue=0, ComSignalType=BOOLEAN, ComHandleId=8247, ComSystemTemplateSystemSignalRef=DET_PROB_1STAZHYPO_394
            DET_PROB_1STAZHYPO_393_oRDR_DETECTION_393_396_oPCAN_RADAR_6f996e16_Tx: ComBitPosition=103, ComBitSize=1, ComSignalInitValue=0, ComSignalType=BOOLEAN, ComHandleId=8246, ComSystemTemplateSystemSignalRef=DET_PROB_1STAZHYPO_393
            DET_IDM_396_oRDR_DETECTION_393_396_oPCAN_RADAR_37be3802_Tx: ComBitPosition=399, ComBitSize=1, ComSignalInitValue=0, ComSignalType=UINT8, ComHandleId=8238, ComSystemTemplateSystemSignalRef=DET_IDM_396
            DET_IDM_393_oRDR_DETECTION_393_396_oPCAN_RADAR_9a9eb400_Tx: ComBitPosition=63, ComBitSize=1, ComSignalInitValue=0, ComSignalType=UINT8, ComHandleId=8235, ComSystemTemplateSystemSignalRef=DET_IDM_393
            DET_MTD_395_oRDR_DETECTION_393_396_oPCAN_RADAR_35ed7127_Tx: ComBitPosition=271, ComBitSize=1, ComSignalInitValue=0, ComSignalType=UINT8, ComHandleId=8244, ComSystemTemplateSystemSignalRef=DET_MTD_395
            DET_BELOW_RAIN_THOLD_393_oRDR_DETECTION_393_396_oPCAN_RADAR_a1ac6d1b_Tx: ComBitPosition=39, ComBitSize=1, ComSignalInitValue=0, ComSignalType=UINT8, ComHandleId=8203, ComSystemTemplateSystemSignalRef=DET_BELOW_RAIN_THOLD_393
            DET_BELOW_RAIN_THOLD_394_oRDR_DETECTION_393_396_oPCAN_RADAR_fd1c4e72_Tx: ComBitPosition=151, ComBitSize=1, ComSignalInitValue=0, ComSignalType=UINT8, ComHandleId=8204, ComSystemTemplateSystemSignalRef=DET_BELOW_RAIN_THOLD_394
            DET_IDM_395_oRDR_DETECTION_393_396_oPCAN_RADAR_535e43fc_Tx: ComBitPosition=287, ComBitSize=1, ComSignalInitValue=0, ComSignalType=UINT8, ComHandleId=8237, ComSystemTemplateSystemSignalRef=DET_IDM_395
            DET_MTD_393_oRDR_DETECTION_393_396_oPCAN_RADAR_fc2d86db_Tx: ComBitPosition=47, ComBitSize=1, ComSignalInitValue=0, ComSignalType=UINT8, ComHandleId=8242, ComSystemTemplateSystemSignalRef=DET_MTD_393
            DET_PROB_1STAZHYPO_395_oRDR_DETECTION_393_396_oPCAN_RADAR_a65999ea_Tx: ComBitPosition=327, ComBitSize=1, ComSignalInitValue=0, ComSignalType=BOOLEAN, ComHandleId=8248, ComSystemTemplateSystemSignalRef=DET_PROB_1STAZHYPO_395
            DET_BELOW_RAIN_THOLD_395_oRDR_DETECTION_393_396_oPCAN_RADAR_686c9ae7_Tx: ComBitPosition=263, ComBitSize=1, ComSignalInitValue=0, ComSignalType=UINT8, ComHandleId=8205, ComSystemTemplateSystemSignalRef=DET_BELOW_RAIN_THOLD_395
            DET_BELOW_RAIN_THOLD_396_oRDR_DETECTION_393_396_oPCAN_RADAR_0c8ce119_Tx: ComBitPosition=375, ComBitSize=1, ComSignalInitValue=0, ComSignalType=UINT8, ComHandleId=8206, ComSystemTemplateSystemSignalRef=DET_BELOW_RAIN_THOLD_396
            DET_MTD_396_oRDR_DETECTION_393_396_oPCAN_RADAR_510d0ad9_Tx: ComBitPosition=383, ComBitSize=1, ComSignalInitValue=0, ComSignalType=UINT8, ComHandleId=8245, ComSystemTemplateSystemSignalRef=DET_MTD_396
            DET_IDM_394_oRDR_DETECTION_393_396_oPCAN_RADAR_c62e9769_Tx: ComBitPosition=175, ComBitSize=1, ComSignalInitValue=0, ComSignalType=UINT8, ComHandleId=8236, ComSystemTemplateSystemSignalRef=DET_IDM_394
