[part 1 of 20: package /ActiveEcuC]
AUTOSAR XML (schema 00053)
package /ActiveEcuC
  module config Com: implementation-config-variant=VARIANT-PRE-COMPILE, module-description=Com_Impl
    ComGeneration:
      ComOutOfBoundsWriteProtectionStrategy = NONE
      ComOutOfBoundsWriteSanitizer = false
      ComOutOfBoundsReadSanitizer = false
      ComReduceConstantData2Define = false
      ComBoolDataInArrayOfStructStrategy = BOOLEAN
      ComDeduplicateIndirectedData = true
      ComDataDeduplicationStrategy = WITH_CAST
      ComReduceBoolDataByNegationThreshold = 2
      ComReduceBoolDataByNumericalComparisonThreshold = 2
      ComReduceBoolDataByNumericalRelationThreshold = 2
      ComReduceBoolDataByNumericalOperandStrategy = WITH_ANY_VALUE
      ComReduceNumericalDataByOffsetThreshold = 2
      ComReduceNumericalDataByArraySubtractionThreshold = 2
      ComReduceDataByStreaming = false
      ComShortSymbols = false
      ComInterfacesForDeactivatedData = false
      ComReferringKeysInComments = false
      ComNumberOfElementsCommentThreshold = 1000
      ComEnableAdditionalRAMDebugData = false
    ComOptimization:
      ComTxProcessingISRLockThreshold = 1
      ComRxProcessingISRLockThreshold = 1
      ComGatewayProcessingISRLockThreshold = 1
      ComGatewayDescriptionProcessingISRLockThreshold = 1
      ComIPduGroupISRLockThreshold = 1
    ComConfig: ComConfigurationId=0, ComRxImmediateNotificationCacheSize=0, ComRxDeferredNotificationCacheSize=1
      ComMainFunctionTx_Event (ComMainFunctionTx): ComMainTxTimeBase=0.01, ComMainFunctionTxHandleId=0
      ComMainFunctionRx: ComMainRxTimeBase=0.01, ComMainFunctionRxHandleId=0
      SG_TrackerObject004_oRDR_TRACKER_OBJ_004_oPCAN_RADAR_0e1ad860_Tx (ComSignalGroup):
        ComTransferProperty = TRIGGERED
        ComSignalGroupAccess = ACCESS_NEEDED_BY_SWC_OR_COM
        ComHandleId = 113
        ComSignalGroupArrayAccess = true
        ComSystemTemplateSignalGroupRef = SG_TrackerObject004
        49 x ComGroupSignal, all with ComSignalEndianness=BIG_ENDIAN, ComSignalInitValue=0, ComTransferProperty=PENDING, ComSignalAccess=ACCESS_NEEDED_BY_SWC_OR_COM:
          OBJ_DIMENSION_LENGTH_004_oRDR_TRACKER_OBJ_004_oPCAN_RADAR_c7ea2329_Tx: ComBitPosition=37, ComBitSize=12, ComSignalType=UINT16, ComHandleId=8694, ComSystemTemplateSystemSignalRef=OBJ_DIMENSION_LENGTH_004
          OBJ_POS_ERR_CRR_COEF_004_oRDR_TRACKER_OBJ_004_oPCAN_RADAR_55c748d8_Tx: ComBitPosition=415, ComBitSize=8, ComSignalType=UINT8, ComHandleId=8705, ComSystemTemplateSystemSignalRef=OBJ_POS_ERR_CRR_COEF_004
          OBJ_ACCELERATION_LONG_004_oRDR_TRACKER_OBJ_004_oPCAN_RADAR_72cedaf7_Tx: ComBitPosition=193, ComBitSize=10, ComSignalType=UINT16, ComHandleId=8678, ComSystemTemplateSystemSignalRef=OBJ_ACCELERATION_LONG_004
          OBJ_TRACK_MOTION_MODEL_004_oRDR_TRACKER_OBJ_004_oPCAN_RADAR_5908e218_Tx: ComBitPosition=9, ComBitSize=2, ComSignalType=UINT8, ComHandleId=8714, ComSystemTemplateSystemSignalRef=OBJ_TRACK_MOTION_MODEL_004
          OBJ_CLS_TYPE1_PROB_004_oRDR_TRACKER_OBJ_004_oPCAN_RADAR_2d2ca79e_Tx: ComBitPosition=303, ComBitSize=8, ComSignalType=UINT8, ComHandleId=8683, ComSystemTemplateSystemSignalRef=OBJ_CLS_TYPE1_PROB_004
          OBJ_ALIVE_TIME_004_oRDR_TRACKER_OBJ_004_oPCAN_RADAR_12af914b_Tx: ComBitPosition=255, ComBitSize=16, ComSignalType=UINT16, ComHandleId=8681, ComSystemTemplateSystemSignalRef=OBJ_ALIVE_TIME_004
          OBJ_CLS_TYPE2_PROB_004_oRDR_TRACKER_OBJ_004_oPCAN_RADAR_e418bc93_Tx: ComBitPosition=311, ComBitSize=8, ComSignalType=UINT8, ComHandleId=8685, ComSystemTemplateSystemSignalRef=OBJ_CLS_TYPE2_PROB_004
          OBJ_YAW_RATE_ERR_004_oRDR_TRACKER_OBJ_004_oPCAN_RADAR_05e00668_Tx: ComBitPosition=388, ComBitSize=5, ComSignalType=UINT8, ComHandleId=8724, ComSystemTemplateSystemSignalRef=OBJ_YAW_RATE_ERR_004
          OBJ_GROUP_ID_004_oRDR_TRACKER_OBJ_004_oPCAN_RADAR_66ea4414_Tx: ComBitPosition=405, ComBitSize=6, ComSignalType=UINT8, ComHandleId=8699, ComSystemTemplateSystemSignalRef=OBJ_GROUP_ID_004
          OBJ_TIMESTAMP_OFFSET_004_oRDR_TRACKER_OBJ_004_oPCAN_RADAR_950be3c5_Tx: ComBitPosition=247, ComBitSize=8, ComSignalType=UINT8, ComHandleId=8713, ComSystemTemplateSystemSignalRef=OBJ_TIMESTAMP_OFFSET_004
          OBJ_ACCELERATION_LAT_004_oRDR_TRACKER_OBJ_004_oPCAN_RADAR_003e8317_Tx: ComBitPosition=177, ComBitSize=10, ComSignalType=UINT16, ComHandleId=8676, ComSystemTemplateSystemSignalRef=OBJ_ACCELERATION_LAT_004
          OBJ_DIMENSION_WIDTH_004_oRDR_TRACKER_OBJ_004_oPCAN_RADAR_e424d484_Tx: ComBitPosition=17, ComBitSize=10, ComSignalType=UINT16, ComHandleId=8696, ComSystemTemplateSystemSignalRef=OBJ_DIMENSION_WIDTH_004
          OBJ_REF_PT_LAT_OFFSET_004_oRDR_TRACKER_OBJ_004_oPCAN_RADAR_609a88e6_Tx: ComBitPosition=370, ComBitSize=14, ComSignalType=UINT16, ComHandleId=8711, ComSystemTemplateSystemSignalRef=OBJ_REF_PT_LAT_OFFSET_004
          OBJ_VEH_TRACK_FLAG_004_oRDR_TRACKER_OBJ_004_oPCAN_RADAR_db221445_Tx: ComBitPosition=10, ComBitSize=1, ComSignalType=BOOLEAN, ComHandleId=8715, ComSystemTemplateSystemSignalRef=OBJ_VEH_TRACK_FLAG_004
          OBJ_ACCELERATION_LAT_ERR_004_oRDR_TRACKER_OBJ_004_oPCAN_RADAR_d5cab9a9_Tx: ComBitPosition=223, ComBitSize=8, ComSignalType=UINT8, ComHandleId=8677, ComSystemTemplateSystemSignalRef=OBJ_ACCELERATION_LAT_ERR_004
          OBJ_DIMENSION_WIDTH_ERR_004_oRDR_TRACKER_OBJ_004_oPCAN_RADAR_0486136c_Tx: ComBitPosition=23, ComBitSize=6, ComSignalType=UINT8, ComHandleId=8697, ComSystemTemplateSystemSignalRef=OBJ_DIMENSION_WIDTH_ERR_004
          OBJ_VELOCITY_LAT_004_oRDR_TRACKER_OBJ_004_oPCAN_RADAR_f30bf0b3_Tx: ComBitPosition=126, ComBitSize=15, ComSignalType=UINT16, ComHandleId=8717, ComSystemTemplateSystemSignalRef=OBJ_VELOCITY_LAT_004
          OBJ_CLS_TYPE6_PROB_004_oRDR_TRACKER_OBJ_004_oPCAN_RADAR_2326613e_Tx: ComBitPosition=343, ComBitSize=8, ComSignalType=UINT8, ComHandleId=8693, ComSystemTemplateSystemSignalRef=OBJ_CLS_TYPE6_PROB_004
          OBJ_ID_004_oRDR_TRACKER_OBJ_004_oPCAN_RADAR_95c46f13_Tx: ComBitPosition=7, ComBitSize=8, ComSignalType=UINT8, ComHandleId=8700, ComSystemTemplateSystemSignalRef=OBJ_ID_004
          OBJ_ACCEL_ERR_CRR_COEF_004_oRDR_TRACKER_OBJ_004_oPCAN_RADAR_6acc3d65_Tx: ComBitPosition=431, ComBitSize=8, ComSignalType=UINT8, ComHandleId=8680, ComSystemTemplateSystemSignalRef=OBJ_ACCEL_ERR_CRR_COEF_004
          OBJ_VELOCITY_LONG_ERR_004_oRDR_TRACKER_OBJ_004_oPCAN_RADAR_2b73bf22_Tx: ComBitPosition=143, ComBitSize=8, ComSignalType=UINT8, ComHandleId=8720, ComSystemTemplateSystemSignalRef=OBJ_VELOCITY_LONG_ERR_004
          OBJ_CLS_TYPE4_004_oRDR_TRACKER_OBJ_004_oPCAN_RADAR_534c70c4_Tx: ComBitPosition=275, ComBitSize=4, ComSignalType=UINT8, ComHandleId=8688, ComSystemTemplateSystemSignalRef=OBJ_CLS_TYPE4_004
          OBJ_EXISTENCE_PROB_004_oRDR_TRACKER_OBJ_004_oPCAN_RADAR_ef9850b9_Tx: ComBitPosition=229, ComBitSize=14, ComSignalType=UINT16, ComHandleId=8698, ComSystemTemplateSystemSignalRef=OBJ_EXISTENCE_PROB_004
          OBJ_MEASUREMENT_STATUS_004_oRDR_TRACKER_OBJ_004_oPCAN_RADAR_ea161dae_Tx: ComBitPosition=14, ComBitSize=3, ComSignalType=UINT8, ComHandleId=8701, ComSystemTemplateSystemSignalRef=OBJ_MEASUREMENT_STATUS_004
          OBJ_REF_PT_LONG_OFFSET_004_oRDR_TRACKER_OBJ_004_oPCAN_RADAR_2fc878e5_Tx: ComBitPosition=357, ComBitSize=14, ComSignalType=UINT16, ComHandleId=8712, ComSystemTemplateSystemSignalRef=OBJ_REF_PT_LONG_OFFSET_004
          OBJ_MOVEMENT_STATUS_004_oRDR_TRACKER_OBJ_004_oPCAN_RADAR_c5b888e2_Tx: ComBitPosition=196, ComBitSize=3, ComSignalType=UINT8, ComHandleId=8704, ComSystemTemplateSystemSignalRef=OBJ_MOVEMENT_STATUS_004
          OBJ_RCS_004_oRDR_TRACKER_OBJ_004_oPCAN_RADAR_95a7e393_Tx: ComBitPosition=351, ComBitSize=7, ComSignalType=UINT8, ComHandleId=8710, ComSystemTemplateSystemSignalRef=OBJ_RCS_004
          OBJ_ACCELERATION_LONG_ERR_004_oRDR_TRACKER_OBJ_004_oPCAN_RADAR_ca6f1c03_Tx: ComBitPosition=215, ComBitSize=8, ComSignalType=UINT8, ComHandleId=8679, ComSystemTemplateSystemSignalRef=OBJ_ACCELERATION_LONG_ERR_004
          OBJ_CLS_TYPE5_PROB_004_oRDR_TRACKER_OBJ_004_oPCAN_RADAR_ea127a33_Tx: ComBitPosition=335, ComBitSize=8, ComSignalType=UINT8, ComHandleId=8691, ComSystemTemplateSystemSignalRef=OBJ_CLS_TYPE5_PROB_004
          OBJ_DIMENSION_LENGTH_ERR_004_oRDR_TRACKER_OBJ_004_oPCAN_RADAR_fc123c53_Tx: ComBitPosition=41, ComBitSize=10, ComSignalType=UINT16, ComHandleId=8695, ComSystemTemplateSystemSignalRef=OBJ_DIMENSION_LENGTH_ERR_004
          OBJ_VELOCITY_LONG_004_oRDR_TRACKER_OBJ_004_oPCAN_RADAR_a3868875_Tx: ComBitPosition=110, ComBitSize=15, ComSignalType=UINT16, ComHandleId=8719, ComSystemTemplateSystemSignalRef=OBJ_VELOCITY_LONG_004
          OBJ_YAW_ANGLE_ERR_004_oRDR_TRACKER_OBJ_004_oPCAN_RADAR_cabab224_Tx: ComBitPosition=175, ComBitSize=7, ComSignalType=UINT8, ComHandleId=8722, ComSystemTemplateSystemSignalRef=OBJ_YAW_ANGLE_ERR_004
          OBJ_CLS_TYPE1_004_oRDR_TRACKER_OBJ_004_oPCAN_RADAR_8574706d_Tx: ComBitPosition=271, ComBitSize=4, ComSignalType=UINT8, ComHandleId=8682, ComSystemTemplateSystemSignalRef=OBJ_CLS_TYPE1_004
          OBJ_VELOCITY_ERR_CRR_COEF_004_oRDR_TRACKER_OBJ_004_oPCAN_RADAR_fcbd7539_Tx: ComBitPosition=423, ComBitSize=8, ComSignalType=UINT8, ComHandleId=8716, ComSystemTemplateSystemSignalRef=OBJ_VELOCITY_ERR_CRR_COEF_004
          OBJ_CLS_TYPE3_PROB_004_oRDR_TRACKER_OBJ_004_oPCAN_RADAR_a30b4a68_Tx: ComBitPosition=319, ComBitSize=8, ComSignalType=UINT8, ComHandleId=8687, ComSystemTemplateSystemSignalRef=OBJ_CLS_TYPE3_PROB_004
          OBJ_CLS_TYPE6_004_oRDR_TRACKER_OBJ_004_oPCAN_RADAR_932c8d41_Tx: ComBitPosition=282, ComBitSize=4, ComSignalType=UINT8, ComHandleId=8692, ComSystemTemplateSystemSignalRef=OBJ_CLS_TYPE6_004
          OBJ_CLS_TYPE3_004_oRDR_TRACKER_OBJ_004_oPCAN_RADAR_45148de8_Tx: ComBitPosition=279, ComBitSize=4, ComSignalType=UINT8, ComHandleId=8686, ComSystemTemplateSystemSignalRef=OBJ_CLS_TYPE3_004
          OBJ_POS_LONG_004_oRDR_TRACKER_OBJ_004_oPCAN_RADAR_06c85e5b_Tx: ComBitPosition=63, ComBitSize=16, ComSignalType=UINT16, ComHandleId=8708, ComSystemTemplateSystemSignalRef=OBJ_POS_LONG_004
          OBJ_POS_LAT_004_oRDR_TRACKER_OBJ_004_oPCAN_RADAR_b768b594_Tx: ComBitPosition=79, ComBitSize=16, ComSignalType=UINT16, ComHandleId=8706, ComSystemTemplateSystemSignalRef=OBJ_POS_LAT_004
          OBJ_YAW_RATE_004_oRDR_TRACKER_OBJ_004_oPCAN_RADAR_3a3891b4_Tx: ComBitPosition=399, ComBitSize=10, ComSignalType=UINT16, ComHandleId=8723, ComSystemTemplateSystemSignalRef=OBJ_YAW_RATE_004
          OBJ_VELOCITY_LAT_ERR_004_oRDR_TRACKER_OBJ_004_oPCAN_RADAR_c7f180e2_Tx: ComBitPosition=151, ComBitSize=8, ComSignalType=UINT8, ComHandleId=8718, ComSystemTemplateSystemSignalRef=OBJ_VELOCITY_LAT_ERR_004
          OBJ_POS_LAT_ERR_004_oRDR_TRACKER_OBJ_004_oPCAN_RADAR_b324e5a3_Tx: ComBitPosition=103, ComBitSize=8, ComSignalType=UINT8, ComHandleId=8707, ComSystemTemplateSystemSignalRef=OBJ_POS_LAT_ERR_004
          OBJ_YAW_ANGLE_004_oRDR_TRACKER_OBJ_004_oPCAN_RADAR_1fb7b4f3_Tx: ComBitPosition=155, ComBitSize=12, ComSignalType=UINT16, ComHandleId=8721, ComSystemTemplateSystemSignalRef=OBJ_YAW_ANGLE_004
          OBJ_CLS_TYPE2_004_oRDR_TRACKER_OBJ_004_oPCAN_RADAR_c89c700a_Tx: ComBitPosition=267, ComBitSize=4, ComSignalType=UINT8, ComHandleId=8684, ComSystemTemplateSystemSignalRef=OBJ_CLS_TYPE2_004
          OBJ_CLS_TYPE4_PROB_004_oRDR_TRACKER_OBJ_004_oPCAN_RADAR_ad018cc8_Tx: ComBitPosition=327, ComBitSize=8, ComSignalType=UINT8, ComHandleId=8689, ComSystemTemplateSystemSignalRef=OBJ_CLS_TYPE4_PROB_004
          OBJ_CLS_TYPE5_004_oRDR_TRACKER_OBJ_004_oPCAN_RADAR_dec48d26_Tx: ComBitPosition=287, ComBitSize=4, ComSignalType=UINT8, ComHandleId=8690, ComSystemTemplateSystemSignalRef=OBJ_CLS_TYPE5_004
          OBJ_POS_LONG_ERR_004_oRDR_TRACKER_OBJ_004_oPCAN_RADAR_2adc1b41_Tx: ComBitPosition=95, ComBitSize=8, ComSignalType=UINT8, ComHandleId=8709, ComSystemTemplateSystemSignalRef=OBJ_POS_LONG_ERR_004
          OBJ_MH_CYCLE_COUNTER_004_oRDR_TRACKER_OBJ_004_oPCAN_RADAR_e792f073_Tx: ComBitPosition=487, ComBitSize=8, ComSignalType=UINT8, ComHandleId=8703, ComSystemTemplateSystemSignalRef=OBJ_MH_CYCLE_COUNTER_004
          OBJ_MH_CRC16_004_oRDR_TRACKER_OBJ_004_oPCAN_RADAR_9676aa92_Tx: ComBitPosition=495, ComBitSize=16, ComSignalType=UINT16, ComHandleId=8702, ComSystemTemplateSystemSignalRef=OBJ_MH_CRC16_004
      3 x ComIPdu, all with ComIPduType=NORMAL, ComIPduCancellationSupport=false, ComIPduSignalProcessing=DEFERRED, ComIPduChannelRef=CN_PCAN_RADAR_458ff0f1:
        SYS_VEHICLE_STATUS_oPCAN_RADAR_43e5dd0e_Rx: ComIPduDirection=RECEIVE, ComIPduHandleId=58, ComIPduGroupRef=RDR01_oPCAN_RADAR_Rx_e0e717e1 if post-build-variant-condition{matching-criterion=RDR_POS, value=0}, ComIPduSignalGroupRef=SG_VehicleStatus_oSYS_VEHICLE_STATUS_oPCAN_RADAR_0411a809_Rx, ComPduIdRef=SYS_VEHICLE_STATUS_oPCAN_RADAR_43e5dd0e_Rx, ComIPduMainFunctionRef=ComMainFunctionRx, ComIPduGroupRef=RDR02_oPCAN_RADAR_Rx_c92fa313 if post-build-variant-condition{matching-criterion=RDR_POS, value=1}, ComIPduGroupRef=RDR03_oPCAN_RADAR_Rx_67473282 if post-build-variant-condition{matching-criterion=RDR_POS, value=2}, ComIPduGroupRef=RDR04_oPCAN_RADAR_Rx_9abecaf7 if post-build-variant-condition{matching-criterion=RDR_POS, value=3}, ComIPduGroupRef=RDR05_oPCAN_RADAR_Rx_34d65b66 if post-build-variant-condition{matching-criterion=RDR_POS, value=4}, ComIPduGroupRef=RDR06_oPCAN_RADAR_Rx_1d1eef94 if post-build-variant-condition{matching-criterion=RDR_POS, value=5}, ComIPduGroupRef=RDR07_oPCAN_RADAR_Rx_b3767e05 if post-build-variant-condition{matching-criterion=RDR_POS, value=6}, ComIPduGroupRef=RDR08_oPCAN_RADAR_Rx_3d9c193f if post-build-variant-condition{matching-criterion=RDR_POS, value=7}
        RDR_TRACKER_OBJ_004_oPCAN_RADAR_33a84845_Tx: ComIPduDirection=SEND, ComIPduHandleId=114, ComIPduGroupRef=RDR01_oPCAN_RADAR_Tx_b6bdb067 if post-build-variant-condition{matching-criterion=RDR_POS, value=0}, ComIPduSignalGroupRef=SG_TrackerObject004_oRDR_TRACKER_OBJ_004_oPCAN_RADAR_0e1ad860_Tx, ComPduIdRef=RDR_TRACKER_OBJ_004_oPCAN_RADAR_33a84845_Tx, ComIPduMainFunctionRef=ComMainFunctionTx_Event, ComIPduGroupRef=RDR02_oPCAN_RADAR_Tx_9f750495 if post-build-variant-condition{matching-criterion=RDR_POS, value=1}, ComIPduGroupRef=RDR03_oPCAN_RADAR_Tx_311d9504 if post-build-variant-condition{matching-criterion=RDR_POS, value=2}, ComIPduGroupRef=RDR04_oPCAN_RADAR_Tx_cce46d71 if post-build-variant-condition{matching-criterion=RDR_POS, value=3}, ComIPduGroupRef=RDR05_oPCAN_RADAR_Tx_628cfce0 if post-build-variant-condition{matching-criterion=RDR_POS, value=4}, ComIPduGroupRef=RDR06_oPCAN_RADAR_Tx_4b444812 if post-build-variant-condition{matching-criterion=RDR_POS, value=5}, ComIPduGroupRef=RDR07_oPCAN_RADAR_Tx_e52cd983 if post-build-variant-condition{matching-criterion=RDR_POS, value=6}, ComIPduGroupRef=RDR08_oPCAN_RADAR_Tx_6bc6beb9 if post-build-variant-condition{matching-criterion=RDR_POS, value=7}
          ComTxIPdu: ComMinimumDelayTime=0, ComTxIPduUnusedAreasDefault=0
            ComTxModeTrue
              ComTxMode: ComTxModeMode=DIRECT, ComTxModeNumberOfRepetitions=0
            ComTxModeFalse
              ComTxMode: ComTxModeMode=NONE
        RDR_TRACKER_OBJ_051_oPCAN_RADAR_aa24953b_Tx: ComIPduDirection=SEND, ComIPduHandleId=161, ComIPduGroupRef=RDR01_oPCAN_RADAR_Tx_b6bdb067 if post-build-variant-condition{matching-criterion=RDR_POS, value=0}, ComIPduSignalGroupRef=SG_TrackerObject051_oRDR_TRACKER_OBJ_051_oPCAN_RADAR_6619549a_Tx, ComPduIdRef=RDR_TRACKER_OBJ_051_oPCAN_RADAR_aa24953b_Tx, ComIPduMainFunctionRef=ComMainFunctionTx_Event, ComIPduGroupRef=RDR02_oPCAN_RADAR_Tx_9f750495 if post-build-variant-condition{matching-criterion=RDR_POS, value=1}, ComIPduGroupRef=RDR03_oPCAN_RADAR_Tx_311d9504 if post-build-variant-condition{matching-criterion=RDR_POS, value=2}, ComIPduGroupRef=RDR04_oPCAN_RADAR_Tx_cce46d71 if post-build-variant-condition{matching-criterion=RDR_POS, value=3}, ComIPduGroupRef=RDR05_oPCAN_RADAR_Tx_628cfce0 if post-build-variant-condition{matching-criterion=RDR_POS, value=4}, ComIPduGroupRef=RDR06_oPCAN_RADAR_Tx_4b444812 if post-build-variant-condition{matching-criterion=RDR_POS, value=5}, ComIPduGroupRef=RDR07_oPCAN_RADAR_Tx_e52cd983 if post-build-variant-condition{matching-criterion=RDR_POS, value=6}, ComIPduGroupRef=RDR08_oPCAN_RADAR_Tx_6bc6beb9 if post-build-variant-condition{matching-criterion=RDR_POS, value=7}
          ComTxIPdu: ComMinimumDelayTime=0, ComTxIPduUnusedAreasDefault=0
            ComTxModeTrue
              ComTxMode: ComTxModeMode=DIRECT, ComTxModeNumberOfRepetitions=0
            ComTxModeFalse
              ComTxMode: ComTxModeMode=NONE
      SG_TrackerObject044_oRDR_TRACKER_OBJ_044_oPCAN_RADAR_9f2c04d9_Tx (ComSignalGroup):
        ComTransferProperty = TRIGGERED
        ComSignalGroupAccess = ACCESS_NEEDED_BY_SWC_OR_COM
        ComHandleId = 153
        ComSignalGroupArrayAccess = true
        ComSystemTemplateSignalGroupRef = SG_TrackerObject044
        49 x ComGroupSignal, all with ComSignalEndianness=BIG_ENDIAN, ComSignalInitValue=0, ComTransferProperty=PENDING, ComSignalAccess=ACCESS_NEEDED_BY_SWC_OR_COM:
          OBJ_CLS_TYPE3_044_oRDR_TRACKER_OBJ_044_oPCAN_RADAR_d4225151_Tx: ComBitPosition=279, ComBitSize=4, ComSignalType=UINT8, ComHandleId=10646, ComSystemTemplateSystemSignalRef=OBJ_CLS_TYPE3_044
          OBJ_CLS_TYPE5_044_oRDR_TRACKER_OBJ_044_oPCAN_RADAR_4ff2519f_Tx: ComBitPosition=287, ComBitSize=4, ComSignalType=UINT8, ComHandleId=10650, ComSystemTemplateSystemSignalRef=OBJ_CLS_TYPE5_044
          OBJ_VELOCITY_LAT_ERR_044_oRDR_TRACKER_OBJ_044_oPCAN_RADAR_56c75c5b_Tx: ComBitPosition=151, ComBitSize=8, ComSignalType=UINT8, ComHandleId=10678, ComSystemTemplateSystemSignalRef=OBJ_VELOCITY_LAT_ERR_044
          OBJ_CLS_TYPE1_PROB_044_oRDR_TRACKER_OBJ_044_oPCAN_RADAR_bc1a7b27_Tx: ComBitPosition=303, ComBitSize=8, ComSignalType=UINT8, ComHandleId=10643, ComSystemTemplateSystemSignalRef=OBJ_CLS_TYPE1_PROB_044
          OBJ_VELOCITY_LAT_044_oRDR_TRACKER_OBJ_044_oPCAN_RADAR_623d2c0a_Tx: ComBitPosition=126, ComBitSize=15, ComSignalType=UINT16, ComHandleId=10677, ComSystemTemplateSystemSignalRef=OBJ_VELOCITY_LAT_044
          OBJ_CLS_TYPE2_044_oRDR_TRACKER_OBJ_044_oPCAN_RADAR_59aaacb3_Tx: ComBitPosition=267, ComBitSize=4, ComSignalType=UINT8, ComHandleId=10644, ComSystemTemplateSystemSignalRef=OBJ_CLS_TYPE2_044
          OBJ_VELOCITY_LONG_ERR_044_oRDR_TRACKER_OBJ_044_oPCAN_RADAR_ba45639b_Tx: ComBitPosition=143, ComBitSize=8, ComSignalType=UINT8, ComHandleId=10680, ComSystemTemplateSystemSignalRef=OBJ_VELOCITY_LONG_ERR_044
          OBJ_ACCELERATION_LONG_ERR_044_oRDR_TRACKER_OBJ_044_oPCAN_RADAR_5b59c0ba_Tx: ComBitPosition=215, ComBitSize=8, ComSignalType=UINT8, ComHandleId=10639, ComSystemTemplateSystemSignalRef=OBJ_ACCELERATION_LONG_ERR_044
          OBJ_CLS_TYPE4_044_oRDR_TRACKER_OBJ_044_oPCAN_RADAR_c27aac7d_Tx: ComBitPosition=275, ComBitSize=4, ComSignalType=UINT8, ComHandleId=10648, ComSystemTemplateSystemSignalRef=OBJ_CLS_TYPE4_044
          OBJ_DIMENSION_WIDTH_044_oRDR_TRACKER_OBJ_044_oPCAN_RADAR_7512083d_Tx: ComBitPosition=17, ComBitSize=10, ComSignalType=UINT16, ComHandleId=10656, ComSystemTemplateSystemSignalRef=OBJ_DIMENSION_WIDTH_044
          OBJ_DIMENSION_WIDTH_ERR_044_oRDR_TRACKER_OBJ_044_oPCAN_RADAR_95b0cfd5_Tx: ComBitPosition=23, ComBitSize=6, ComSignalType=UINT8, ComHandleId=10657, ComSystemTemplateSystemSignalRef=OBJ_DIMENSION_WIDTH_ERR_044
          OBJ_CLS_TYPE1_044_oRDR_TRACKER_OBJ_044_oPCAN_RADAR_1442acd4_Tx: ComBitPosition=271, ComBitSize=4, ComSignalType=UINT8, ComHandleId=10642, ComSystemTemplateSystemSignalRef=OBJ_CLS_TYPE1_044
          OBJ_CLS_TYPE4_PROB_044_oRDR_TRACKER_OBJ_044_oPCAN_RADAR_3c375071_Tx: ComBitPosition=327, ComBitSize=8, ComSignalType=UINT8, ComHandleId=10649, ComSystemTemplateSystemSignalRef=OBJ_CLS_TYPE4_PROB_044
          OBJ_MOVEMENT_STATUS_044_oRDR_TRACKER_OBJ_044_oPCAN_RADAR_548e545b_Tx: ComBitPosition=196, ComBitSize=3, ComSignalType=UINT8, ComHandleId=10664, ComSystemTemplateSystemSignalRef=OBJ_MOVEMENT_STATUS_044
          OBJ_ACCEL_ERR_CRR_COEF_044_oRDR_TRACKER_OBJ_044_oPCAN_RADAR_fbfae1dc_Tx: ComBitPosition=431, ComBitSize=8, ComSignalType=UINT8, ComHandleId=10640, ComSystemTemplateSystemSignalRef=OBJ_ACCEL_ERR_CRR_COEF_044
          OBJ_ACCELERATION_LONG_044_oRDR_TRACKER_OBJ_044_oPCAN_RADAR_e3f8064e_Tx: ComBitPosition=193, ComBitSize=10, ComSignalType=UINT16, ComHandleId=10638, ComSystemTemplateSystemSignalRef=OBJ_ACCELERATION_LONG_044
          OBJ_DIMENSION_LENGTH_ERR_044_oRDR_TRACKER_OBJ_044_oPCAN_RADAR_6d24e0ea_Tx: ComBitPosition=41, ComBitSize=10, ComSignalType=UINT16, ComHandleId=10655, ComSystemTemplateSystemSignalRef=OBJ_DIMENSION_LENGTH_ERR_044
          OBJ_POS_LONG_ERR_044_oRDR_TRACKER_OBJ_044_oPCAN_RADAR_bbeac7f8_Tx: ComBitPosition=95, ComBitSize=8, ComSignalType=UINT8, ComHandleId=10669, ComSystemTemplateSystemSignalRef=OBJ_POS_LONG_ERR_044
          OBJ_YAW_ANGLE_044_oRDR_TRACKER_OBJ_044_oPCAN_RADAR_8e81684a_Tx: ComBitPosition=155, ComBitSize=12, ComSignalType=UINT16, ComHandleId=10681, ComSystemTemplateSystemSignalRef=OBJ_YAW_ANGLE_044
          OBJ_REF_PT_LONG_OFFSET_044_oRDR_TRACKER_OBJ_044_oPCAN_RADAR_befea45c_Tx: ComBitPosition=357, ComBitSize=14, ComSignalType=UINT16, ComHandleId=10672, ComSystemTemplateSystemSignalRef=OBJ_REF_PT_LONG_OFFSET_044
          OBJ_CLS_TYPE6_PROB_044_oRDR_TRACKER_OBJ_044_oPCAN_RADAR_b210bd87_Tx: ComBitPosition=343, ComBitSize=8, ComSignalType=UINT8, ComHandleId=10653, ComSystemTemplateSystemSignalRef=OBJ_CLS_TYPE6_PROB_044
          OBJ_DIMENSION_LENGTH_044_oRDR_TRACKER_OBJ_044_oPCAN_RADAR_56dcff90_Tx: ComBitPosition=37, ComBitSize=12, ComSignalType=UINT16, ComHandleId=10654, ComSystemTemplateSystemSignalRef=OBJ_DIMENSION_LENGTH_044
          OBJ_GROUP_ID_044_oRDR_TRACKER_OBJ_044_oPCAN_RADAR_f7dc98ad_Tx: ComBitPosition=405, ComBitSize=6, ComSignalType=UINT8, ComHandleId=10659, ComSystemTemplateSystemSignalRef=OBJ_GROUP_ID_044
          OBJ_POS_ERR_CRR_COEF_044_oRDR_TRACKER_OBJ_044_oPCAN_RADAR_c4f19461_Tx: ComBitPosition=415, ComBitSize=8, ComSignalType=UINT8, ComHandleId=10665, ComSystemTemplateSystemSignalRef=OBJ_POS_ERR_CRR_COEF_044
          OBJ_TRACK_MOTION_MODEL_044_oRDR_TRACKER_OBJ_044_oPCAN_RADAR_c83e3ea1_Tx: ComBitPosition=9, ComBitSize=2, ComSignalType=UINT8, ComHandleId=10674, ComSystemTemplateSystemSignalRef=OBJ_TRACK_MOTION_MODEL_044
          OBJ_TIMESTAMP_OFFSET_044_oRDR_TRACKER_OBJ_044_oPCAN_RADAR_043d3f7c_Tx: ComBitPosition=247, ComBitSize=8, ComSignalType=UINT8, ComHandleId=10673, ComSystemTemplateSystemSignalRef=OBJ_TIMESTAMP_OFFSET_044
          OBJ_POS_LAT_044_oRDR_TRACKER_OBJ_044_oPCAN_RADAR_265e692d_Tx: ComBitPosition=79, ComBitSize=16, ComSignalType=UINT16, ComHandleId=10666, ComSystemTemplateSystemSignalRef=OBJ_POS_LAT_044
          OBJ_RCS_044_oRDR_TRACKER_OBJ_044_oPCAN_RADAR_04913f2a_Tx: ComBitPosition=351, ComBitSize=7, ComSignalType=UINT8, ComHandleId=10670, ComSystemTemplateSystemSignalRef=OBJ_RCS_044
          OBJ_ACCELERATION_LAT_ERR_044_oRDR_TRACKER_OBJ_044_oPCAN_RADAR_44fc6510_Tx: ComBitPosition=223, ComBitSize=8, ComSignalType=UINT8, ComHandleId=10637, ComSystemTemplateSystemSignalRef=OBJ_ACCELERATION_LAT_ERR_044
          OBJ_POS_LONG_044_oRDR_TRACKER_OBJ_044_oPCAN_RADAR_97fe82e2_Tx: ComBitPosition=63, ComBitSize=16, ComSignalType=UINT16, ComHandleId=10668, ComSystemTemplateSystemSignalRef=OBJ_POS_LONG_044
          OBJ_MEASUREMENT_STATUS_044_oRDR_TRACKER_OBJ_044_oPCAN_RADAR_7b20c117_Tx: ComBitPosition=14, ComBitSize=3, ComSignalType=UINT8, ComHandleId=10661, ComSystemTemplateSystemSignalRef=OBJ_MEASUREMENT_STATUS_044
          OBJ_YAW_RATE_044_oRDR_TRACKER_OBJ_044_oPCAN_RADAR_ab0e4d0d_Tx: ComBitPosition=399, ComBitSize=10, ComSignalType=UINT16, ComHandleId=10683, ComSystemTemplateSystemSignalRef=OBJ_YAW_RATE_044
          OBJ_VEH_TRACK_FLAG_044_oRDR_TRACKER_OBJ_044_oPCAN_RADAR_4a14c8fc_Tx: ComBitPosition=10, ComBitSize=1, ComSignalType=BOOLEAN, ComHandleId=10675, ComSystemTemplateSystemSignalRef=OBJ_VEH_TRACK_FLAG_044
          OBJ_VELOCITY_LONG_044_oRDR_TRACKER_OBJ_044_oPCAN_RADAR_32b054cc_Tx: ComBitPosition=110, ComBitSize=15, ComSignalType=UINT16, ComHandleId=10679, ComSystemTemplateSystemSignalRef=OBJ_VELOCITY_LONG_044
          OBJ_POS_LAT_ERR_044_oRDR_TRACKER_OBJ_044_oPCAN_RADAR_2212391a_Tx: ComBitPosition=103, ComBitSize=8, ComSignalType=UINT8, ComHandleId=10667, ComSystemTemplateSystemSignalRef=OBJ_POS_LAT_ERR_044
          OBJ_CLS_TYPE5_PROB_044_oRDR_TRACKER_OBJ_044_oPCAN_RADAR_7b24a68a_Tx: ComBitPosition=335, ComBitSize=8, ComSignalType=UINT8, ComHandleId=10651, ComSystemTemplateSystemSignalRef=OBJ_CLS_TYPE5_PROB_044
          OBJ_CLS_TYPE3_PROB_044_oRDR_TRACKER_OBJ_044_oPCAN_RADAR_323d96d1_Tx: ComBitPosition=319, ComBitSize=8, ComSignalType=UINT8, ComHandleId=10647, ComSystemTemplateSystemSignalRef=OBJ_CLS_TYPE3_PROB_044
          OBJ_CLS_TYPE6_044_oRDR_TRACKER_OBJ_044_oPCAN_RADAR_021a51f8_Tx: ComBitPosition=282, ComBitSize=4, ComSignalType=UINT8, ComHandleId=10652, ComSystemTemplateSystemSignalRef=OBJ_CLS_TYPE6_044
          OBJ_ID_044_oRDR_TRACKER_OBJ_044_oPCAN_RADAR_04f2b3aa_Tx: ComBitPosition=7, ComBitSize=8, ComSignalType=UINT8, ComHandleId=10660, ComSystemTemplateSystemSignalRef=OBJ_ID_044
          OBJ_ACCELERATION_LAT_044_oRDR_TRACKER_OBJ_044_oPCAN_RADAR_91085fae_Tx: ComBitPosition=177, ComBitSize=10, ComSignalType=UINT16, ComHandleId=10636, ComSystemTemplateSystemSignalRef=OBJ_ACCELERATION_LAT_044
          OBJ_REF_PT_LAT_OFFSET_044_oRDR_TRACKER_OBJ_044_oPCAN_RADAR_f1ac545f_Tx: ComBitPosition=370, ComBitSize=14, ComSignalType=UINT16, ComHandleId=10671, ComSystemTemplateSystemSignalRef=OBJ_REF_PT_LAT_OFFSET_044
          OBJ_ALIVE_TIME_044_oRDR_TRACKER_OBJ_044_oPCAN_RADAR_83994df2_Tx: ComBitPosition=255, ComBitSize=16, ComSignalType=UINT16, ComHandleId=10641, ComSystemTemplateSystemSignalRef=OBJ_ALIVE_TIME_044
          OBJ_YAW_ANGLE_ERR_044_oRDR_TRACKER_OBJ_044_oPCAN_RADAR_5b8c6e9d_Tx: ComBitPosition=175, ComBitSize=7, ComSignalType=UINT8, ComHandleId=10682, ComSystemTemplateSystemSignalRef=OBJ_YAW_ANGLE_ERR_044
          OBJ_YAW_RATE_ERR_044_oRDR_TRACKER_OBJ_044_oPCAN_RADAR_94d6dad1_Tx: ComBitPosition=388, ComBitSize=5, ComSignalType=UINT8, ComHandleId=10684, ComSystemTemplateSystemSignalRef=OBJ_YAW_RATE_ERR_044
          OBJ_CLS_TYPE2_PROB_044_oRDR_TRACKER_OBJ_044_oPCAN_RADAR_752e602a_Tx: ComBitPosition=311, ComBitSize=8, ComSignalType=UINT8, ComHandleId=10645, ComSystemTemplateSystemSignalRef=OBJ_CLS_TYPE2_PROB_044
          OBJ_EXISTENCE_PROB_044_oRDR_TRACKER_OBJ_044_oPCAN_RADAR_7eae8c00_Tx: ComBitPosition=229, ComBitSize=14, ComSignalType=UINT16, ComHandleId=10658, ComSystemTemplateSystemSignalRef=OBJ_EXISTENCE_PROB_044
          OBJ_VELOCITY_ERR_CRR_COEF_044_oRDR_TRACKER_OBJ_044_oPCAN_RADAR_6d8ba980_Tx: ComBitPosition=423, ComBitSize=8, ComSignalType=UINT8, ComHandleId=10676, ComSystemTemplateSystemSignalRef=OBJ_VELOCITY_ERR_CRR_COEF_044
          OBJ_MH_CYCLE_COUNTER_044_oRDR_TRACKER_OBJ_044_oPCAN_RADAR_76a42cca_Tx: ComBitPosition=487, ComBitSize=8, ComSignalType=UINT8, ComHandleId=10663, ComSystemTemplateSystemSignalRef=OBJ_MH_CYCLE_COUNTER_044
          OBJ_MH_CRC16_044_oRDR_TRACKER_OBJ_044_oPCAN_RADAR_0740762b_Tx: ComBitPosition=495, ComBitSize=16, ComSignalType=UINT16, ComHandleId=10662, ComSystemTemplateSystemSignalRef=OBJ_MH_CRC16_044
      RDR_DETECTION_117_120_oPCAN_RADAR_b7eaf422_Tx (ComIPdu):
        ComIPduDirection = SEND
        ComIPduType = NORMAL
        ComIPduCancellationSupport = false
        ComIPduHandleId = 35
        ComIPduSignalProcessing = DEFERRED
        ComIPduChannelRef = CN_PCAN_RADAR_458ff0f1
        ComIPduGroupRef = RDR01_oPCAN_RADAR_Tx_b6bdb067 if post-build-variant-condition{matching-criterion=RDR_POS, value=0}
        ComIPduSignalGroupRef = SG_Detections_117_120_oRDR_DETECTION_117_120_oPCAN_RADAR_abfe9992_Tx
        ComPduIdRef = RDR_DETECTION_117_120_oPCAN_RADAR_b7eaf422_Tx
        ComIPduMainFunctionRef = ComMainFunctionTx_Event
        ComIPduGroupRef = RDR02_oPCAN_RADAR_Tx_9f750495 if post-build-variant-condition{matching-criterion=RDR_POS, value=1}
        ComIPduGroupRef = RDR03_oPCAN_RADAR_Tx_311d9504 if post-build-variant-condition{matching-criterion=RDR_POS, value=2}
        ComIPduGroupRef = RDR04_oPCAN_RADAR_Tx_cce46d71 if post-build-variant-condition{matching-criterion=RDR_POS, value=3}
        ComIPduGroupRef = RDR05_oPCAN_RADAR_Tx_628cfce0 if post-build-variant-condition{matching-criterion=RDR_POS, value=4}
        ComIPduGroupRef = RDR06_oPCAN_RADAR_Tx_4b444812 if post-build-variant-condition{matching-criterion=RDR_POS, value=5}
        ComIPduGroupRef = RDR07_oPCAN_RADAR_Tx_e52cd983 if post-build-variant-condition{matching-criterion=RDR_POS, value=6}
        ComIPduGroupRef = RDR08_oPCAN_RADAR_Tx_6bc6beb9 if post-build-variant-condition{matching-criterion=RDR_POS, value=7}
        ComTxIPdu: ComMinimumDelayTime=0, ComTxIPduUnusedAreasDefault=0
          ComTxModeTrue
            ComTxMode: ComTxModeMode=DIRECT, ComTxModeNumberOfRepetitions=0
          ComTxModeFalse
            ComTxMode: ComTxModeMode=NONE
      SG_TrackerObject013_oRDR_TRACKER_OBJ_013_oPCAN_RADAR_de779f04_Tx (ComSignalGroup):
        ComTransferProperty = TRIGGERED
        ComSignalGroupAccess = ACCESS_NEEDED_BY_SWC_OR_COM
        ComHandleId = 122
        ComSignalGroupArrayAccess = true
        ComSystemTemplateSignalGroupRef = SG_TrackerObject013
        49 x ComGroupSignal, all with ComSignalEndianness=BIG_ENDIAN, ComSignalInitValue=0, ComTransferProperty=PENDING, ComSignalAccess=ACCESS_NEEDED_BY_SWC_OR_COM:
          OBJ_YAW_RATE_013_oRDR_TRACKER_OBJ_013_oPCAN_RADAR_ea55d6d0_Tx: ComBitPosition=399, ComBitSize=10, ComSignalType=UINT16, ComHandleId=9164, ComSystemTemplateSystemSignalRef=OBJ_YAW_RATE_013
          OBJ_ACCELERATION_LONG_013_oRDR_TRACKER_OBJ_013_oPCAN_RADAR_a2a39d93_Tx: ComBitPosition=193, ComBitSize=10, ComSignalType=UINT16, ComHandleId=9119, ComSystemTemplateSystemSignalRef=OBJ_ACCELERATION_LONG_013
          OBJ_REF_PT_LONG_OFFSET_013_oRDR_TRACKER_OBJ_013_oPCAN_RADAR_ffa53f81_Tx: ComBitPosition=357, ComBitSize=14, ComSignalType=UINT16, ComHandleId=9153, ComSystemTemplateSystemSignalRef=OBJ_REF_PT_LONG_OFFSET_013
          OBJ_VELOCITY_LONG_013_oRDR_TRACKER_OBJ_013_oPCAN_RADAR_73ebcf11_Tx: ComBitPosition=110, ComBitSize=15, ComSignalType=UINT16, ComHandleId=9160, ComSystemTemplateSystemSignalRef=OBJ_VELOCITY_LONG_013
          OBJ_VELOCITY_LAT_013_oRDR_TRACKER_OBJ_013_oPCAN_RADAR_2366b7d7_Tx: ComBitPosition=126, ComBitSize=15, ComSignalType=UINT16, ComHandleId=9158, ComSystemTemplateSystemSignalRef=OBJ_VELOCITY_LAT_013
          OBJ_VEH_TRACK_FLAG_013_oRDR_TRACKER_OBJ_013_oPCAN_RADAR_0b4f5321_Tx: ComBitPosition=10, ComBitSize=1, ComSignalType=BOOLEAN, ComHandleId=9156, ComSystemTemplateSystemSignalRef=OBJ_VEH_TRACK_FLAG_013
          OBJ_YAW_RATE_ERR_013_oRDR_TRACKER_OBJ_013_oPCAN_RADAR_d58d410c_Tx: ComBitPosition=388, ComBitSize=5, ComSignalType=UINT8, ComHandleId=9165, ComSystemTemplateSystemSignalRef=OBJ_YAW_RATE_ERR_013
          OBJ_RCS_013_oRDR_TRACKER_OBJ_013_oPCAN_RADAR_45caa4f7_Tx: ComBitPosition=351, ComBitSize=7, ComSignalType=UINT8, ComHandleId=9151, ComSystemTemplateSystemSignalRef=OBJ_RCS_013
          OBJ_TRACK_MOTION_MODEL_013_oRDR_TRACKER_OBJ_013_oPCAN_RADAR_8965a57c_Tx: ComBitPosition=9, ComBitSize=2, ComSignalType=UINT8, ComHandleId=9155, ComSystemTemplateSystemSignalRef=OBJ_TRACK_MOTION_MODEL_013
          OBJ_POS_LAT_013_oRDR_TRACKER_OBJ_013_oPCAN_RADAR_6705f2f0_Tx: ComBitPosition=79, ComBitSize=16, ComSignalType=UINT16, ComHandleId=9147, ComSystemTemplateSystemSignalRef=OBJ_POS_LAT_013
          OBJ_VELOCITY_ERR_CRR_COEF_013_oRDR_TRACKER_OBJ_013_oPCAN_RADAR_2cd0325d_Tx: ComBitPosition=423, ComBitSize=8, ComSignalType=UINT8, ComHandleId=9157, ComSystemTemplateSystemSignalRef=OBJ_VELOCITY_ERR_CRR_COEF_013
          OBJ_CLS_TYPE6_PROB_013_oRDR_TRACKER_OBJ_013_oPCAN_RADAR_f34b265a_Tx: ComBitPosition=343, ComBitSize=8, ComSignalType=UINT8, ComHandleId=9134, ComSystemTemplateSystemSignalRef=OBJ_CLS_TYPE6_PROB_013
          OBJ_CLS_TYPE2_PROB_013_oRDR_TRACKER_OBJ_013_oPCAN_RADAR_3475fbf7_Tx: ComBitPosition=311, ComBitSize=8, ComSignalType=UINT8, ComHandleId=9126, ComSystemTemplateSystemSignalRef=OBJ_CLS_TYPE2_PROB_013
          OBJ_CLS_TYPE3_PROB_013_oRDR_TRACKER_OBJ_013_oPCAN_RADAR_73660d0c_Tx: ComBitPosition=319, ComBitSize=8, ComSignalType=UINT8, ComHandleId=9128, ComSystemTemplateSystemSignalRef=OBJ_CLS_TYPE3_PROB_013
          OBJ_REF_PT_LAT_OFFSET_013_oRDR_TRACKER_OBJ_013_oPCAN_RADAR_b0f7cf82_Tx: ComBitPosition=370, ComBitSize=14, ComSignalType=UINT16, ComHandleId=9152, ComSystemTemplateSystemSignalRef=OBJ_REF_PT_LAT_OFFSET_013
          OBJ_CLS_TYPE1_PROB_013_oRDR_TRACKER_OBJ_013_oPCAN_RADAR_fd41e0fa_Tx: ComBitPosition=303, ComBitSize=8, ComSignalType=UINT8, ComHandleId=9124, ComSystemTemplateSystemSignalRef=OBJ_CLS_TYPE1_PROB_013
          OBJ_GROUP_ID_013_oRDR_TRACKER_OBJ_013_oPCAN_RADAR_b6870370_Tx: ComBitPosition=405, ComBitSize=6, ComSignalType=UINT8, ComHandleId=9140, ComSystemTemplateSystemSignalRef=OBJ_GROUP_ID_013
          OBJ_CLS_TYPE5_013_oRDR_TRACKER_OBJ_013_oPCAN_RADAR_0ea9ca42_Tx: ComBitPosition=287, ComBitSize=4, ComSignalType=UINT8, ComHandleId=9131, ComSystemTemplateSystemSignalRef=OBJ_CLS_TYPE5_013
          OBJ_VELOCITY_LAT_ERR_013_oRDR_TRACKER_OBJ_013_oPCAN_RADAR_179cc786_Tx: ComBitPosition=151, ComBitSize=8, ComSignalType=UINT8, ComHandleId=9159, ComSystemTemplateSystemSignalRef=OBJ_VELOCITY_LAT_ERR_013
          OBJ_CLS_TYPE2_013_oRDR_TRACKER_OBJ_013_oPCAN_RADAR_18f1376e_Tx: ComBitPosition=267, ComBitSize=4, ComSignalType=UINT8, ComHandleId=9125, ComSystemTemplateSystemSignalRef=OBJ_CLS_TYPE2_013
          OBJ_DIMENSION_LENGTH_013_oRDR_TRACKER_OBJ_013_oPCAN_RADAR_1787644d_Tx: ComBitPosition=37, ComBitSize=12, ComSignalType=UINT16, ComHandleId=9135, ComSystemTemplateSystemSignalRef=OBJ_DIMENSION_LENGTH_013
          OBJ_ID_013_oRDR_TRACKER_OBJ_013_oPCAN_RADAR_45a92877_Tx: ComBitPosition=7, ComBitSize=8, ComSignalType=UINT8, ComHandleId=9141, ComSystemTemplateSystemSignalRef=OBJ_ID_013
          OBJ_CLS_TYPE4_PROB_013_oRDR_TRACKER_OBJ_013_oPCAN_RADAR_7d6ccbac_Tx: ComBitPosition=327, ComBitSize=8, ComSignalType=UINT8, ComHandleId=9130, ComSystemTemplateSystemSignalRef=OBJ_CLS_TYPE4_PROB_013
          OBJ_CLS_TYPE5_PROB_013_oRDR_TRACKER_OBJ_013_oPCAN_RADAR_3a7f3d57_Tx: ComBitPosition=335, ComBitSize=8, ComSignalType=UINT8, ComHandleId=9132, ComSystemTemplateSystemSignalRef=OBJ_CLS_TYPE5_PROB_013
          OBJ_POS_LONG_013_oRDR_TRACKER_OBJ_013_oPCAN_RADAR_d6a5193f_Tx: ComBitPosition=63, ComBitSize=16, ComSignalType=UINT16, ComHandleId=9149, ComSystemTemplateSystemSignalRef=OBJ_POS_LONG_013
          OBJ_DIMENSION_WIDTH_ERR_013_oRDR_TRACKER_OBJ_013_oPCAN_RADAR_d4eb5408_Tx: ComBitPosition=23, ComBitSize=6, ComSignalType=UINT8, ComHandleId=9138, ComSystemTemplateSystemSignalRef=OBJ_DIMENSION_WIDTH_ERR_013
          OBJ_DIMENSION_WIDTH_013_oRDR_TRACKER_OBJ_013_oPCAN_RADAR_344993e0_Tx: ComBitPosition=17, ComBitSize=10, ComSignalType=UINT16, ComHandleId=9137, ComSystemTemplateSystemSignalRef=OBJ_DIMENSION_WIDTH_013
          OBJ_ACCELERATION_LAT_013_oRDR_TRACKER_OBJ_013_oPCAN_RADAR_d053c473_Tx: ComBitPosition=177, ComBitSize=10, ComSignalType=UINT16, ComHandleId=9117, ComSystemTemplateSystemSignalRef=OBJ_ACCELERATION_LAT_013
          OBJ_ACCELERATION_LAT_ERR_013_oRDR_TRACKER_OBJ_013_oPCAN_RADAR_05a7fecd_Tx: ComBitPosition=223, ComBitSize=8, ComSignalType=UINT8, ComHandleId=9118, ComSystemTemplateSystemSignalRef=OBJ_ACCELERATION_LAT_ERR_013
          OBJ_POS_LONG_ERR_013_oRDR_TRACKER_OBJ_013_oPCAN_RADAR_fab15c25_Tx: ComBitPosition=95, ComBitSize=8, ComSignalType=UINT8, ComHandleId=9150, ComSystemTemplateSystemSignalRef=OBJ_POS_LONG_ERR_013
          OBJ_ACCELERATION_LONG_ERR_013_oRDR_TRACKER_OBJ_013_oPCAN_RADAR_1a025b67_Tx: ComBitPosition=215, ComBitSize=8, ComSignalType=UINT8, ComHandleId=9120, ComSystemTemplateSystemSignalRef=OBJ_ACCELERATION_LONG_ERR_013
          OBJ_CLS_TYPE4_013_oRDR_TRACKER_OBJ_013_oPCAN_RADAR_832137a0_Tx: ComBitPosition=275, ComBitSize=4, ComSignalType=UINT8, ComHandleId=9129, ComSystemTemplateSystemSignalRef=OBJ_CLS_TYPE4_013
          OBJ_MEASUREMENT_STATUS_013_oRDR_TRACKER_OBJ_013_oPCAN_RADAR_3a7b5aca_Tx: ComBitPosition=14, ComBitSize=3, ComSignalType=UINT8, ComHandleId=9142, ComSystemTemplateSystemSignalRef=OBJ_MEASUREMENT_STATUS_013
          OBJ_ALIVE_TIME_013_oRDR_TRACKER_OBJ_013_oPCAN_RADAR_c2c2d62f_Tx: ComBitPosition=255, ComBitSize=16, ComSignalType=UINT16, ComHandleId=9122, ComSystemTemplateSystemSignalRef=OBJ_ALIVE_TIME_013
          OBJ_EXISTENCE_PROB_013_oRDR_TRACKER_OBJ_013_oPCAN_RADAR_3ff517dd_Tx: ComBitPosition=229, ComBitSize=14, ComSignalType=UINT16, ComHandleId=9139, ComSystemTemplateSystemSignalRef=OBJ_EXISTENCE_PROB_013
          OBJ_TIMESTAMP_OFFSET_013_oRDR_TRACKER_OBJ_013_oPCAN_RADAR_4566a4a1_Tx: ComBitPosition=247, ComBitSize=8, ComSignalType=UINT8, ComHandleId=9154, ComSystemTemplateSystemSignalRef=OBJ_TIMESTAMP_OFFSET_013
          OBJ_DIMENSION_LENGTH_ERR_013_oRDR_TRACKER_OBJ_013_oPCAN_RADAR_2c7f7b37_Tx: ComBitPosition=41, ComBitSize=10, ComSignalType=UINT16, ComHandleId=9136, ComSystemTemplateSystemSignalRef=OBJ_DIMENSION_LENGTH_ERR_013
          OBJ_YAW_ANGLE_ERR_013_oRDR_TRACKER_OBJ_013_oPCAN_RADAR_1ad7f540_Tx: ComBitPosition=175, ComBitSize=7, ComSignalType=UINT8, ComHandleId=9163, ComSystemTemplateSystemSignalRef=OBJ_YAW_ANGLE_ERR_013
          OBJ_CLS_TYPE6_013_oRDR_TRACKER_OBJ_013_oPCAN_RADAR_4341ca25_Tx: ComBitPosition=282, ComBitSize=4, ComSignalType=UINT8, ComHandleId=9133, ComSystemTemplateSystemSignalRef=OBJ_CLS_TYPE6_013
          OBJ_CLS_TYPE1_013_oRDR_TRACKER_OBJ_013_oPCAN_RADAR_55193709_Tx: ComBitPosition=271, ComBitSize=4, ComSignalType=UINT8, ComHandleId=9123, ComSystemTemplateSystemSignalRef=OBJ_CLS_TYPE1_013
          OBJ_MOVEMENT_STATUS_013_oRDR_TRACKER_OBJ_013_oPCAN_RADAR_15d5cf86_Tx: ComBitPosition=196, ComBitSize=3, ComSignalType=UINT8, ComHandleId=9145, ComSystemTemplateSystemSignalRef=OBJ_MOVEMENT_STATUS_013
          OBJ_POS_ERR_CRR_COEF_013_oRDR_TRACKER_OBJ_013_oPCAN_RADAR_85aa0fbc_Tx: ComBitPosition=415, ComBitSize=8, ComSignalType=UINT8, ComHandleId=9146, ComSystemTemplateSystemSignalRef=OBJ_POS_ERR_CRR_COEF_013
          OBJ_POS_LAT_ERR_013_oRDR_TRACKER_OBJ_013_oPCAN_RADAR_6349a2c7_Tx: ComBitPosition=103, ComBitSize=8, ComSignalType=UINT8, ComHandleId=9148, ComSystemTemplateSystemSignalRef=OBJ_POS_LAT_ERR_013
          OBJ_VELOCITY_LONG_ERR_013_oRDR_TRACKER_OBJ_013_oPCAN_RADAR_fb1ef846_Tx: ComBitPosition=143, ComBitSize=8, ComSignalType=UINT8, ComHandleId=9161, ComSystemTemplateSystemSignalRef=OBJ_VELOCITY_LONG_ERR_013
          OBJ_ACCEL_ERR_CRR_COEF_013_oRDR_TRACKER_OBJ_013_oPCAN_RADAR_baa17a01_Tx: ComBitPosition=431, ComBitSize=8, ComSignalType=UINT8, ComHandleId=9121, ComSystemTemplateSystemSignalRef=OBJ_ACCEL_ERR_CRR_COEF_013
          OBJ_CLS_TYPE3_013_oRDR_TRACKER_OBJ_013_oPCAN_RADAR_9579ca8c_Tx: ComBitPosition=279, ComBitSize=4, ComSignalType=UINT8, ComHandleId=9127, ComSystemTemplateSystemSignalRef=OBJ_CLS_TYPE3_013
          OBJ_YAW_ANGLE_013_oRDR_TRACKER_OBJ_013_oPCAN_RADAR_cfdaf397_Tx: ComBitPosition=155, ComBitSize=12, ComSignalType=UINT16, ComHandleId=9162, ComSystemTemplateSystemSignalRef=OBJ_YAW_ANGLE_013
          OBJ_MH_CRC16_013_oRDR_TRACKER_OBJ_013_oPCAN_RADAR_461bedf6_Tx: ComBitPosition=495, ComBitSize=16, ComSignalType=UINT16, ComHandleId=9143, ComSystemTemplateSystemSignalRef=OBJ_MH_CRC16_013
          OBJ_MH_CYCLE_COUNTER_013_oRDR_TRACKER_OBJ_013_oPCAN_RADAR_37ffb717_Tx: ComBitPosition=487, ComBitSize=8, ComSignalType=UINT8, ComHandleId=9144, ComSystemTemplateSystemSignalRef=OBJ_MH_CYCLE_COUNTER_013
      3 x ComIPdu, all with ComIPduDirection=SEND, ComIPduType=NORMAL, ComIPduCancellationSupport=false, ComIPduSignalProcessing=DEFERRED, ComIPduChannelRef=CN_PCAN_RADAR_458ff0f1, ComIPduGroupRef=RDR01_oPCAN_RADAR_Tx_b6bdb067 if post-build-variant-condition{matching-criterion=RDR_POS, value=0}, ComIPduMainFunctionRef=ComMainFunctionTx_Event, ComIPduGroupRef=RDR02_oPCAN_RADAR_Tx_9f750495 if post-build-variant-condition{matching-criterion=RDR_POS, value=1}, ComIPduGroupRef=RDR03_oPCAN_RADAR_Tx_311d9504 if post-build-variant-condition{matching-criterion=RDR_POS, value=2}, ComIPduGroupRef=RDR04_oPCAN_RADAR_Tx_cce46d71 if post-build-variant-condition{matching-criterion=RDR_POS, value=3}, ComIPduGroupRef=RDR05_oPCAN_RADAR_Tx_628cfce0 if post-build-variant-condition{matching-criterion=RDR_POS, value=4}, ComIPduGroupRef=RDR06_oPCAN_RADAR_Tx_4b444812 if post-build-variant-condition{matching-criterion=RDR_POS, value=5}, ComIPduGroupRef=RDR07_oPCAN_RADAR_Tx_e52cd983 if post-build-variant-condition{matching-criterion=RDR_POS, value=6}, ComIPduGroupRef=RDR08_oPCAN_RADAR_Tx_6bc6beb9 if post-build-variant-condition{matching-criterion=RDR_POS, value=7}:
        RDR_TRACKER_OBJ_013_oPCAN_RADAR_d3d4af6b_Tx: ComIPduHandleId=123, ComIPduSignalGroupRef=SG_TrackerObject013_oRDR_TRACKER_OBJ_013_oPCAN_RADAR_de779f04_Tx, ComPduIdRef=RDR_TRACKER_OBJ_013_oPCAN_RADAR_d3d4af6b_Tx
          ComTxIPdu: ComMinimumDelayTime=0, ComTxIPduUnusedAreasDefault=0
            ComTxModeTrue
              ComTxMode: ComTxModeMode=DIRECT, ComTxModeNumberOfRepetitions=0
            ComTxModeFalse
              ComTxMode: ComTxModeMode=NONE
        RDR_DETECTION_153_156_oPCAN_RADAR_0a6271f6_Tx: ComIPduHandleId=44, ComIPduSignalGroupRef=SG_Detections_153_156_oRDR_DETECTION_153_156_oPCAN_RADAR_2db98fbc_Tx, ComPduIdRef=RDR_DETECTION_153_156_oPCAN_RADAR_0a6271f6_Tx
          ComTxIPdu: ComMinimumDelayTime=0, ComTxIPduUnusedAreasDefault=0
            ComTxModeTrue
              ComTxMode: ComTxModeMode=DIRECT, ComTxModeNumberOfRepetitions=0
            ComTxModeFalse
              ComTxMode: ComTxModeMode=NONE
        RDR_DETECTION_333_336_oPCAN_RADAR_20ee31a5_Tx: ComIPduHandleId=89, ComIPduSignalGroupRef=SG_Detections_333_336_oRDR_DETECTION_333_336_oPCAN_RADAR_f7772a32_Tx, ComPduIdRef=RDR_DETECTION_333_336_oPCAN_RADAR_20ee31a5_Tx
          ComTxIPdu: ComMinimumDelayTime=0, ComTxIPduUnusedAreasDefault=0
            ComTxModeTrue
              ComTxMode: ComTxModeMode=DIRECT, ComTxModeNumberOfRepetitions=0
            ComTxModeFalse
              ComTxMode: ComTxModeMode=NONE
      SG_TrackerObject002_oRDR_TRACKER_OBJ_002_oPCAN_RADAR_75f2e109_Tx (ComSignalGroup):
        ComTransferProperty = TRIGGERED
        ComSignalGroupAccess = ACCESS_NEEDED_BY_SWC_OR_COM
        ComHandleId = 111
        ComSignalGroupArrayAccess = true
        ComSystemTemplateSignalGroupRef = SG_TrackerObject002
        49 x ComGroupSignal, all with ComSignalEndianness=BIG_ENDIAN, ComSignalInitValue=0, ComTransferProperty=PENDING, ComSignalAccess=ACCESS_NEEDED_BY_SWC_OR_COM:
          OBJ_CLS_TYPE2_PROB_002_oRDR_TRACKER_OBJ_002_oPCAN_RADAR_9ff085fa_Tx: ComBitPosition=311, ComBitSize=8, ComSignalType=UINT8, ComHandleId=8587, ComSystemTemplateSystemSignalRef=OBJ_CLS_TYPE2_PROB_002
          OBJ_CLS_TYPE3_002_oRDR_TRACKER_OBJ_002_oPCAN_RADAR_3efcb481_Tx: ComBitPosition=279, ComBitSize=4, ComSignalType=UINT8, ComHandleId=8588, ComSystemTemplateSystemSignalRef=OBJ_CLS_TYPE3_002
          OBJ_POS_LAT_ERR_002_oRDR_TRACKER_OBJ_002_oPCAN_RADAR_c8ccdcca_Tx: ComBitPosition=103, ComBitSize=8, ComSignalType=UINT8, ComHandleId=8609, ComSystemTemplateSystemSignalRef=OBJ_POS_LAT_ERR_002
          OBJ_ACCELERATION_LONG_002_oRDR_TRACKER_OBJ_002_oPCAN_RADAR_0926e39e_Tx: ComBitPosition=193, ComBitSize=10, ComSignalType=UINT16, ComHandleId=8580, ComSystemTemplateSystemSignalRef=OBJ_ACCELERATION_LONG_002
          OBJ_DIMENSION_LENGTH_ERR_002_oRDR_TRACKER_OBJ_002_oPCAN_RADAR_87fa053a_Tx: ComBitPosition=41, ComBitSize=10, ComSignalType=UINT16, ComHandleId=8597, ComSystemTemplateSystemSignalRef=OBJ_DIMENSION_LENGTH_ERR_002
          OBJ_YAW_ANGLE_002_oRDR_TRACKER_OBJ_002_oPCAN_RADAR_645f8d9a_Tx: ComBitPosition=155, ComBitSize=12, ComSignalType=UINT16, ComHandleId=8623, ComSystemTemplateSystemSignalRef=OBJ_YAW_ANGLE_002
          OBJ_ACCELERATION_LAT_002_oRDR_TRACKER_OBJ_002_oPCAN_RADAR_7bd6ba7e_Tx: ComBitPosition=177, ComBitSize=10, ComSignalType=UINT16, ComHandleId=8578, ComSystemTemplateSystemSignalRef=OBJ_ACCELERATION_LAT_002
          OBJ_ACCEL_ERR_CRR_COEF_002_oRDR_TRACKER_OBJ_002_oPCAN_RADAR_1124040c_Tx: ComBitPosition=431, ComBitSize=8, ComSignalType=UINT8, ComHandleId=8582, ComSystemTemplateSystemSignalRef=OBJ_ACCEL_ERR_CRR_COEF_002
          OBJ_MEASUREMENT_STATUS_002_oRDR_TRACKER_OBJ_002_oPCAN_RADAR_91fe24c7_Tx: ComBitPosition=14, ComBitSize=3, ComSignalType=UINT8, ComHandleId=8603, ComSystemTemplateSystemSignalRef=OBJ_MEASUREMENT_STATUS_002
          OBJ_TIMESTAMP_OFFSET_002_oRDR_TRACKER_OBJ_002_oPCAN_RADAR_eee3daac_Tx: ComBitPosition=247, ComBitSize=8, ComSignalType=UINT8, ComHandleId=8615, ComSystemTemplateSystemSignalRef=OBJ_TIMESTAMP_OFFSET_002
          OBJ_POS_ERR_CRR_COEF_002_oRDR_TRACKER_OBJ_002_oPCAN_RADAR_2e2f71b1_Tx: ComBitPosition=415, ComBitSize=8, ComSignalType=UINT8, ComHandleId=8607, ComSystemTemplateSystemSignalRef=OBJ_POS_ERR_CRR_COEF_002
          OBJ_CLS_TYPE5_002_oRDR_TRACKER_OBJ_002_oPCAN_RADAR_a52cb44f_Tx: ComBitPosition=287, ComBitSize=4, ComSignalType=UINT8, ComHandleId=8592, ComSystemTemplateSystemSignalRef=OBJ_CLS_TYPE5_002
          OBJ_ACCELERATION_LAT_ERR_002_oRDR_TRACKER_OBJ_002_oPCAN_RADAR_ae2280c0_Tx: ComBitPosition=223, ComBitSize=8, ComSignalType=UINT8, ComHandleId=8579, ComSystemTemplateSystemSignalRef=OBJ_ACCELERATION_LAT_ERR_002
          OBJ_DIMENSION_LENGTH_002_oRDR_TRACKER_OBJ_002_oPCAN_RADAR_bc021a40_Tx: ComBitPosition=37, ComBitSize=12, ComSignalType=UINT16, ComHandleId=8596, ComSystemTemplateSystemSignalRef=OBJ_DIMENSION_LENGTH_002
          OBJ_TRACK_MOTION_MODEL_002_oRDR_TRACKER_OBJ_002_oPCAN_RADAR_22e0db71_Tx: ComBitPosition=9, ComBitSize=2, ComSignalType=UINT8, ComHandleId=8616, ComSystemTemplateSystemSignalRef=OBJ_TRACK_MOTION_MODEL_002
          OBJ_ALIVE_TIME_002_oRDR_TRACKER_OBJ_002_oPCAN_RADAR_6947a822_Tx: ComBitPosition=255, ComBitSize=16, ComSignalType=UINT16, ComHandleId=8583, ComSystemTemplateSystemSignalRef=OBJ_ALIVE_TIME_002
          OBJ_VELOCITY_ERR_CRR_COEF_002_oRDR_TRACKER_OBJ_002_oPCAN_RADAR_87554c50_Tx: ComBitPosition=423, ComBitSize=8, ComSignalType=UINT8, ComHandleId=8618, ComSystemTemplateSystemSignalRef=OBJ_VELOCITY_ERR_CRR_COEF_002
          OBJ_CLS_TYPE4_002_oRDR_TRACKER_OBJ_002_oPCAN_RADAR_28a449ad_Tx: ComBitPosition=275, ComBitSize=4, ComSignalType=UINT8, ComHandleId=8590, ComSystemTemplateSystemSignalRef=OBJ_CLS_TYPE4_002
          OBJ_POS_LONG_ERR_002_oRDR_TRACKER_OBJ_002_oPCAN_RADAR_51342228_Tx: ComBitPosition=95, ComBitSize=8, ComSignalType=UINT8, ComHandleId=8611, ComSystemTemplateSystemSignalRef=OBJ_POS_LONG_ERR_002
          OBJ_CLS_TYPE1_PROB_002_oRDR_TRACKER_OBJ_002_oPCAN_RADAR_56c49ef7_Tx: ComBitPosition=303, ComBitSize=8, ComSignalType=UINT8, ComHandleId=8585, ComSystemTemplateSystemSignalRef=OBJ_CLS_TYPE1_PROB_002
          OBJ_CLS_TYPE2_002_oRDR_TRACKER_OBJ_002_oPCAN_RADAR_b3744963_Tx: ComBitPosition=267, ComBitSize=4, ComSignalType=UINT8, ComHandleId=8586, ComSystemTemplateSystemSignalRef=OBJ_CLS_TYPE2_002
          OBJ_CLS_TYPE4_PROB_002_oRDR_TRACKER_OBJ_002_oPCAN_RADAR_d6e9b5a1_Tx: ComBitPosition=327, ComBitSize=8, ComSignalType=UINT8, ComHandleId=8591, ComSystemTemplateSystemSignalRef=OBJ_CLS_TYPE4_PROB_002
          OBJ_VELOCITY_LAT_002_oRDR_TRACKER_OBJ_002_oPCAN_RADAR_88e3c9da_Tx: ComBitPosition=126, ComBitSize=15, ComSignalType=UINT16, ComHandleId=8619, ComSystemTemplateSystemSignalRef=OBJ_VELOCITY_LAT_002
          OBJ_RCS_002_oRDR_TRACKER_OBJ_002_oPCAN_RADAR_ee4fdafa_Tx: ComBitPosition=351, ComBitSize=7, ComSignalType=UINT8, ComHandleId=8612, ComSystemTemplateSystemSignalRef=OBJ_RCS_002
          OBJ_ACCELERATION_LONG_ERR_002_oRDR_TRACKER_OBJ_002_oPCAN_RADAR_b187256a_Tx: ComBitPosition=215, ComBitSize=8, ComSignalType=UINT8, ComHandleId=8581, ComSystemTemplateSystemSignalRef=OBJ_ACCELERATION_LONG_ERR_002
          OBJ_VELOCITY_LONG_002_oRDR_TRACKER_OBJ_002_oPCAN_RADAR_d86eb11c_Tx: ComBitPosition=110, ComBitSize=15, ComSignalType=UINT16, ComHandleId=8621, ComSystemTemplateSystemSignalRef=OBJ_VELOCITY_LONG_002
          OBJ_YAW_ANGLE_ERR_002_oRDR_TRACKER_OBJ_002_oPCAN_RADAR_b1528b4d_Tx: ComBitPosition=175, ComBitSize=7, ComSignalType=UINT8, ComHandleId=8624, ComSystemTemplateSystemSignalRef=OBJ_YAW_ANGLE_ERR_002
          OBJ_REF_PT_LONG_OFFSET_002_oRDR_TRACKER_OBJ_002_oPCAN_RADAR_5420418c_Tx: ComBitPosition=357, ComBitSize=14, ComSignalType=UINT16, ComHandleId=8614, ComSystemTemplateSystemSignalRef=OBJ_REF_PT_LONG_OFFSET_002
          OBJ_ID_002_oRDR_TRACKER_OBJ_002_oPCAN_RADAR_ee2c567a_Tx: ComBitPosition=7, ComBitSize=8, ComSignalType=UINT8, ComHandleId=8602, ComSystemTemplateSystemSignalRef=OBJ_ID_002
          OBJ_POS_LONG_002_oRDR_TRACKER_OBJ_002_oPCAN_RADAR_7d206732_Tx: ComBitPosition=63, ComBitSize=16, ComSignalType=UINT16, ComHandleId=8610, ComSystemTemplateSystemSignalRef=OBJ_POS_LONG_002
          OBJ_GROUP_ID_002_oRDR_TRACKER_OBJ_002_oPCAN_RADAR_1d027d7d_Tx: ComBitPosition=405, ComBitSize=6, ComSignalType=UINT8, ComHandleId=8601, ComSystemTemplateSystemSignalRef=OBJ_GROUP_ID_002
          OBJ_REF_PT_LAT_OFFSET_002_oRDR_TRACKER_OBJ_002_oPCAN_RADAR_1b72b18f_Tx: ComBitPosition=370, ComBitSize=14, ComSignalType=UINT16, ComHandleId=8613, ComSystemTemplateSystemSignalRef=OBJ_REF_PT_LAT_OFFSET_002
          OBJ_YAW_RATE_002_oRDR_TRACKER_OBJ_002_oPCAN_RADAR_41d0a8dd_Tx: ComBitPosition=399, ComBitSize=10, ComSignalType=UINT16, ComHandleId=8625, ComSystemTemplateSystemSignalRef=OBJ_YAW_RATE_002
          OBJ_CLS_TYPE6_PROB_002_oRDR_TRACKER_OBJ_002_oPCAN_RADAR_58ce5857_Tx: ComBitPosition=343, ComBitSize=8, ComSignalType=UINT8, ComHandleId=8595, ComSystemTemplateSystemSignalRef=OBJ_CLS_TYPE6_PROB_002
          OBJ_CLS_TYPE1_002_oRDR_TRACKER_OBJ_002_oPCAN_RADAR_fe9c4904_Tx: ComBitPosition=271, ComBitSize=4, ComSignalType=UINT8, ComHandleId=8584, ComSystemTemplateSystemSignalRef=OBJ_CLS_TYPE1_002
          OBJ_DIMENSION_WIDTH_002_oRDR_TRACKER_OBJ_002_oPCAN_RADAR_9fcceded_Tx: ComBitPosition=17, ComBitSize=10, ComSignalType=UINT16, ComHandleId=8598, ComSystemTemplateSystemSignalRef=OBJ_DIMENSION_WIDTH_002
          OBJ_MOVEMENT_STATUS_002_oRDR_TRACKER_OBJ_002_oPCAN_RADAR_be50b18b_Tx: ComBitPosition=196, ComBitSize=3, ComSignalType=UINT8, ComHandleId=8606, ComSystemTemplateSystemSignalRef=OBJ_MOVEMENT_STATUS_002
          OBJ_EXISTENCE_PROB_002_oRDR_TRACKER_OBJ_002_oPCAN_RADAR_947069d0_Tx: ComBitPosition=229, ComBitSize=14, ComSignalType=UINT16, ComHandleId=8600, ComSystemTemplateSystemSignalRef=OBJ_EXISTENCE_PROB_002
          OBJ_YAW_RATE_ERR_002_oRDR_TRACKER_OBJ_002_oPCAN_RADAR_7e083f01_Tx: ComBitPosition=388, ComBitSize=5, ComSignalType=UINT8, ComHandleId=8626, ComSystemTemplateSystemSignalRef=OBJ_YAW_RATE_ERR_002
          OBJ_CLS_TYPE6_002_oRDR_TRACKER_OBJ_002_oPCAN_RADAR_e8c4b428_Tx: ComBitPosition=282, ComBitSize=4, ComSignalType=UINT8, ComHandleId=8594, ComSystemTemplateSystemSignalRef=OBJ_CLS_TYPE6_002
          OBJ_VEH_TRACK_FLAG_002_oRDR_TRACKER_OBJ_002_oPCAN_RADAR_a0ca2d2c_Tx: ComBitPosition=10, ComBitSize=1, ComSignalType=BOOLEAN, ComHandleId=8617, ComSystemTemplateSystemSignalRef=OBJ_VEH_TRACK_FLAG_002
          OBJ_POS_LAT_002_oRDR_TRACKER_OBJ_002_oPCAN_RADAR_cc808cfd_Tx: ComBitPosition=79, ComBitSize=16, ComSignalType=UINT16, ComHandleId=8608, ComSystemTemplateSystemSignalRef=OBJ_POS_LAT_002
          OBJ_CLS_TYPE5_PROB_002_oRDR_TRACKER_OBJ_002_oPCAN_RADAR_91fa435a_Tx: ComBitPosition=335, ComBitSize=8, ComSignalType=UINT8, ComHandleId=8593, ComSystemTemplateSystemSignalRef=OBJ_CLS_TYPE5_PROB_002
          OBJ_VELOCITY_LONG_ERR_002_oRDR_TRACKER_OBJ_002_oPCAN_RADAR_509b864b_Tx: ComBitPosition=143, ComBitSize=8, ComSignalType=UINT8, ComHandleId=8622, ComSystemTemplateSystemSignalRef=OBJ_VELOCITY_LONG_ERR_002
          OBJ_CLS_TYPE3_PROB_002_oRDR_TRACKER_OBJ_002_oPCAN_RADAR_d8e37301_Tx: ComBitPosition=319, ComBitSize=8, ComSignalType=UINT8, ComHandleId=8589, ComSystemTemplateSystemSignalRef=OBJ_CLS_TYPE3_PROB_002
          OBJ_DIMENSION_WIDTH_ERR_002_oRDR_TRACKER_OBJ_002_oPCAN_RADAR_7f6e2a05_Tx: ComBitPosition=23, ComBitSize=6, ComSignalType=UINT8, ComHandleId=8599, ComSystemTemplateSystemSignalRef=OBJ_DIMENSION_WIDTH_ERR_002
          OBJ_VELOCITY_LAT_ERR_002_oRDR_TRACKER_OBJ_002_oPCAN_RADAR_bc19b98b_Tx: ComBitPosition=151, ComBitSize=8, ComSignalType=UINT8, ComHandleId=8620, ComSystemTemplateSystemSignalRef=OBJ_VELOCITY_LAT_ERR_002
          OBJ_MH_CRC16_002_oRDR_TRACKER_OBJ_002_oPCAN_RADAR_ed9e93fb_Tx: ComBitPosition=495, ComBitSize=16, ComSignalType=UINT16, ComHandleId=8604, ComSystemTemplateSystemSignalRef=OBJ_MH_CRC16_002
          OBJ_MH_CYCLE_COUNTER_002_oRDR_TRACKER_OBJ_002_oPCAN_RADAR_9c7ac91a_Tx: ComBitPosition=487, ComBitSize=8, ComSignalType=UINT8, ComHandleId=8605, ComSystemTemplateSystemSignalRef=OBJ_MH_CYCLE_COUNTER_002
      SG_TrackerObject005_oRDR_TRACKER_OBJ_005_oPCAN_RADAR_f70e50d3_Tx (ComSignalGroup):
        ComTransferProperty = TRIGGERED
        ComSignalGroupAccess = ACCESS_NEEDED_BY_SWC_OR_COM
        ComHandleId = 114
        ComSignalGroupArrayAccess = true
        ComSystemTemplateSignalGroupRef = SG_TrackerObject005
        49 x ComGroupSignal, all with ComSignalEndianness=BIG_ENDIAN, ComSignalInitValue=0, ComTransferProperty=PENDING, ComSignalAccess=ACCESS_NEEDED_BY_SWC_OR_COM:
          OBJ_CLS_TYPE5_PROB_005_oRDR_TRACKER_OBJ_005_oPCAN_RADAR_1306f280_Tx: ComBitPosition=335, ComBitSize=8, ComSignalType=UINT8, ComHandleId=8740, ComSystemTemplateSystemSignalRef=OBJ_CLS_TYPE5_PROB_005
          OBJ_VELOCITY_ERR_CRR_COEF_005_oRDR_TRACKER_OBJ_005_oPCAN_RADAR_05a9fd8a_Tx: ComBitPosition=423, ComBitSize=8, ComSignalType=UINT8, ComHandleId=8765, ComSystemTemplateSystemSignalRef=OBJ_VELOCITY_ERR_CRR_COEF_005
          OBJ_RCS_005_oRDR_TRACKER_OBJ_005_oPCAN_RADAR_6cb36b20_Tx: ComBitPosition=351, ComBitSize=7, ComSignalType=UINT8, ComHandleId=8759, ComSystemTemplateSystemSignalRef=OBJ_RCS_005
          OBJ_DIMENSION_WIDTH_005_oRDR_TRACKER_OBJ_005_oPCAN_RADAR_1d305c37_Tx: ComBitPosition=17, ComBitSize=10, ComSignalType=UINT16, ComHandleId=8745, ComSystemTemplateSystemSignalRef=OBJ_DIMENSION_WIDTH_005
          OBJ_MOVEMENT_STATUS_005_oRDR_TRACKER_OBJ_005_oPCAN_RADAR_3cac0051_Tx: ComBitPosition=196, ComBitSize=3, ComSignalType=UINT8, ComHandleId=8753, ComSystemTemplateSystemSignalRef=OBJ_MOVEMENT_STATUS_005
          OBJ_VELOCITY_LONG_ERR_005_oRDR_TRACKER_OBJ_005_oPCAN_RADAR_d2673791_Tx: ComBitPosition=143, ComBitSize=8, ComSignalType=UINT8, ComHandleId=8769, ComSystemTemplateSystemSignalRef=OBJ_VELOCITY_LONG_ERR_005
          OBJ_YAW_RATE_ERR_005_oRDR_TRACKER_OBJ_005_oPCAN_RADAR_fcf48edb_Tx: ComBitPosition=388, ComBitSize=5, ComSignalType=UINT8, ComHandleId=8773, ComSystemTemplateSystemSignalRef=OBJ_YAW_RATE_ERR_005
          OBJ_ACCELERATION_LAT_ERR_005_oRDR_TRACKER_OBJ_005_oPCAN_RADAR_2cde311a_Tx: ComBitPosition=223, ComBitSize=8, ComSignalType=UINT8, ComHandleId=8726, ComSystemTemplateSystemSignalRef=OBJ_ACCELERATION_LAT_ERR_005
          OBJ_CLS_TYPE2_PROB_005_oRDR_TRACKER_OBJ_005_oPCAN_RADAR_1d0c3420_Tx: ComBitPosition=311, ComBitSize=8, ComSignalType=UINT8, ComHandleId=8734, ComSystemTemplateSystemSignalRef=OBJ_CLS_TYPE2_PROB_005
          OBJ_CLS_TYPE4_PROB_005_oRDR_TRACKER_OBJ_005_oPCAN_RADAR_5415047b_Tx: ComBitPosition=327, ComBitSize=8, ComSignalType=UINT8, ComHandleId=8738, ComSystemTemplateSystemSignalRef=OBJ_CLS_TYPE4_PROB_005
          OBJ_CLS_TYPE3_PROB_005_oRDR_TRACKER_OBJ_005_oPCAN_RADAR_5a1fc2db_Tx: ComBitPosition=319, ComBitSize=8, ComSignalType=UINT8, ComHandleId=8736, ComSystemTemplateSystemSignalRef=OBJ_CLS_TYPE3_PROB_005
          OBJ_POS_LAT_005_oRDR_TRACKER_OBJ_005_oPCAN_RADAR_4e7c3d27_Tx: ComBitPosition=79, ComBitSize=16, ComSignalType=UINT16, ComHandleId=8755, ComSystemTemplateSystemSignalRef=OBJ_POS_LAT_005
          OBJ_CLS_TYPE2_005_oRDR_TRACKER_OBJ_005_oPCAN_RADAR_3188f8b9_Tx: ComBitPosition=267, ComBitSize=4, ComSignalType=UINT8, ComHandleId=8733, ComSystemTemplateSystemSignalRef=OBJ_CLS_TYPE2_005
          OBJ_CLS_TYPE5_005_oRDR_TRACKER_OBJ_005_oPCAN_RADAR_27d00595_Tx: ComBitPosition=287, ComBitSize=4, ComSignalType=UINT8, ComHandleId=8739, ComSystemTemplateSystemSignalRef=OBJ_CLS_TYPE5_005
          OBJ_YAW_ANGLE_ERR_005_oRDR_TRACKER_OBJ_005_oPCAN_RADAR_33ae3a97_Tx: ComBitPosition=175, ComBitSize=7, ComSignalType=UINT8, ComHandleId=8771, ComSystemTemplateSystemSignalRef=OBJ_YAW_ANGLE_ERR_005
          OBJ_CLS_TYPE6_005_oRDR_TRACKER_OBJ_005_oPCAN_RADAR_6a3805f2_Tx: ComBitPosition=282, ComBitSize=4, ComSignalType=UINT8, ComHandleId=8741, ComSystemTemplateSystemSignalRef=OBJ_CLS_TYPE6_005
          OBJ_TRACK_MOTION_MODEL_005_oRDR_TRACKER_OBJ_005_oPCAN_RADAR_a01c6aab_Tx: ComBitPosition=9, ComBitSize=2, ComSignalType=UINT8, ComHandleId=8763, ComSystemTemplateSystemSignalRef=OBJ_TRACK_MOTION_MODEL_005
          OBJ_YAW_RATE_005_oRDR_TRACKER_OBJ_005_oPCAN_RADAR_c32c1907_Tx: ComBitPosition=399, ComBitSize=10, ComSignalType=UINT16, ComHandleId=8772, ComSystemTemplateSystemSignalRef=OBJ_YAW_RATE_005
          OBJ_REF_PT_LAT_OFFSET_005_oRDR_TRACKER_OBJ_005_oPCAN_RADAR_998e0055_Tx: ComBitPosition=370, ComBitSize=14, ComSignalType=UINT16, ComHandleId=8760, ComSystemTemplateSystemSignalRef=OBJ_REF_PT_LAT_OFFSET_005
          OBJ_VELOCITY_LAT_ERR_005_oRDR_TRACKER_OBJ_005_oPCAN_RADAR_3ee50851_Tx: ComBitPosition=151, ComBitSize=8, ComSignalType=UINT8, ComHandleId=8767, ComSystemTemplateSystemSignalRef=OBJ_VELOCITY_LAT_ERR_005
          OBJ_ALIVE_TIME_005_oRDR_TRACKER_OBJ_005_oPCAN_RADAR_ebbb19f8_Tx: ComBitPosition=255, ComBitSize=16, ComSignalType=UINT16, ComHandleId=8730, ComSystemTemplateSystemSignalRef=OBJ_ALIVE_TIME_005
          OBJ_POS_ERR_CRR_COEF_005_oRDR_TRACKER_OBJ_005_oPCAN_RADAR_acd3c06b_Tx: ComBitPosition=415, ComBitSize=8, ComSignalType=UINT8, ComHandleId=8754, ComSystemTemplateSystemSignalRef=OBJ_POS_ERR_CRR_COEF_005
          OBJ_ACCELERATION_LONG_ERR_005_oRDR_TRACKER_OBJ_005_oPCAN_RADAR_337b94b0_Tx: ComBitPosition=215, ComBitSize=8, ComSignalType=UINT8, ComHandleId=8728, ComSystemTemplateSystemSignalRef=OBJ_ACCELERATION_LONG_ERR_005
          OBJ_DIMENSION_LENGTH_ERR_005_oRDR_TRACKER_OBJ_005_oPCAN_RADAR_0506b4e0_Tx: ComBitPosition=41, ComBitSize=10, ComSignalType=UINT16, ComHandleId=8744, ComSystemTemplateSystemSignalRef=OBJ_DIMENSION_LENGTH_ERR_005
          OBJ_ACCELERATION_LAT_005_oRDR_TRACKER_OBJ_005_oPCAN_RADAR_f92a0ba4_Tx: ComBitPosition=177, ComBitSize=10, ComSignalType=UINT16, ComHandleId=8725, ComSystemTemplateSystemSignalRef=OBJ_ACCELERATION_LAT_005
          OBJ_CLS_TYPE1_005_oRDR_TRACKER_OBJ_005_oPCAN_RADAR_7c60f8de_Tx: ComBitPosition=271, ComBitSize=4, ComSignalType=UINT8, ComHandleId=8731, ComSystemTemplateSystemSignalRef=OBJ_CLS_TYPE1_005
          OBJ_GROUP_ID_005_oRDR_TRACKER_OBJ_005_oPCAN_RADAR_9ffecca7_Tx: ComBitPosition=405, ComBitSize=6, ComSignalType=UINT8, ComHandleId=8748, ComSystemTemplateSystemSignalRef=OBJ_GROUP_ID_005
          OBJ_CLS_TYPE1_PROB_005_oRDR_TRACKER_OBJ_005_oPCAN_RADAR_d4382f2d_Tx: ComBitPosition=303, ComBitSize=8, ComSignalType=UINT8, ComHandleId=8732, ComSystemTemplateSystemSignalRef=OBJ_CLS_TYPE1_PROB_005
          OBJ_VELOCITY_LONG_005_oRDR_TRACKER_OBJ_005_oPCAN_RADAR_5a9200c6_Tx: ComBitPosition=110, ComBitSize=15, ComSignalType=UINT16, ComHandleId=8768, ComSystemTemplateSystemSignalRef=OBJ_VELOCITY_LONG_005
          OBJ_REF_PT_LONG_OFFSET_005_oRDR_TRACKER_OBJ_005_oPCAN_RADAR_d6dcf056_Tx: ComBitPosition=357, ComBitSize=14, ComSignalType=UINT16, ComHandleId=8761, ComSystemTemplateSystemSignalRef=OBJ_REF_PT_LONG_OFFSET_005
          OBJ_POS_LONG_005_oRDR_TRACKER_OBJ_005_oPCAN_RADAR_ffdcd6e8_Tx: ComBitPosition=63, ComBitSize=16, ComSignalType=UINT16, ComHandleId=8757, ComSystemTemplateSystemSignalRef=OBJ_POS_LONG_005
          OBJ_DIMENSION_WIDTH_ERR_005_oRDR_TRACKER_OBJ_005_oPCAN_RADAR_fd929bdf_Tx: ComBitPosition=23, ComBitSize=6, ComSignalType=UINT8, ComHandleId=8746, ComSystemTemplateSystemSignalRef=OBJ_DIMENSION_WIDTH_ERR_005
          OBJ_CLS_TYPE6_PROB_005_oRDR_TRACKER_OBJ_005_oPCAN_RADAR_da32e98d_Tx: ComBitPosition=343, ComBitSize=8, ComSignalType=UINT8, ComHandleId=8742, ComSystemTemplateSystemSignalRef=OBJ_CLS_TYPE6_PROB_005
          OBJ_MEASUREMENT_STATUS_005_oRDR_TRACKER_OBJ_005_oPCAN_RADAR_1302951d_Tx: ComBitPosition=14, ComBitSize=3, ComSignalType=UINT8, ComHandleId=8750, ComSystemTemplateSystemSignalRef=OBJ_MEASUREMENT_STATUS_005
          OBJ_POS_LAT_ERR_005_oRDR_TRACKER_OBJ_005_oPCAN_RADAR_4a306d10_Tx: ComBitPosition=103, ComBitSize=8, ComSignalType=UINT8, ComHandleId=8756, ComSystemTemplateSystemSignalRef=OBJ_POS_LAT_ERR_005
          OBJ_YAW_ANGLE_005_oRDR_TRACKER_OBJ_005_oPCAN_RADAR_e6a33c40_Tx: ComBitPosition=155, ComBitSize=12, ComSignalType=UINT16, ComHandleId=8770, ComSystemTemplateSystemSignalRef=OBJ_YAW_ANGLE_005
          OBJ_VELOCITY_LAT_005_oRDR_TRACKER_OBJ_005_oPCAN_RADAR_0a1f7800_Tx: ComBitPosition=126, ComBitSize=15, ComSignalType=UINT16, ComHandleId=8766, ComSystemTemplateSystemSignalRef=OBJ_VELOCITY_LAT_005
          OBJ_EXISTENCE_PROB_005_oRDR_TRACKER_OBJ_005_oPCAN_RADAR_168cd80a_Tx: ComBitPosition=229, ComBitSize=14, ComSignalType=UINT16, ComHandleId=8747, ComSystemTemplateSystemSignalRef=OBJ_EXISTENCE_PROB_005
          OBJ_CLS_TYPE3_005_oRDR_TRACKER_OBJ_005_oPCAN_RADAR_bc00055b_Tx: ComBitPosition=279, ComBitSize=4, ComSignalType=UINT8, ComHandleId=8735, ComSystemTemplateSystemSignalRef=OBJ_CLS_TYPE3_005
          OBJ_POS_LONG_ERR_005_oRDR_TRACKER_OBJ_005_oPCAN_RADAR_d3c893f2_Tx: ComBitPosition=95, ComBitSize=8, ComSignalType=UINT8, ComHandleId=8758, ComSystemTemplateSystemSignalRef=OBJ_POS_LONG_ERR_005
          OBJ_TIMESTAMP_OFFSET_005_oRDR_TRACKER_OBJ_005_oPCAN_RADAR_6c1f6b76_Tx: ComBitPosition=247, ComBitSize=8, ComSignalType=UINT8, ComHandleId=8762, ComSystemTemplateSystemSignalRef=OBJ_TIMESTAMP_OFFSET_005
          OBJ_ID_005_oRDR_TRACKER_OBJ_005_oPCAN_RADAR_6cd0e7a0_Tx: ComBitPosition=7, ComBitSize=8, ComSignalType=UINT8, ComHandleId=8749, ComSystemTemplateSystemSignalRef=OBJ_ID_005
          OBJ_ACCELERATION_LONG_005_oRDR_TRACKER_OBJ_005_oPCAN_RADAR_8bda5244_Tx: ComBitPosition=193, ComBitSize=10, ComSignalType=UINT16, ComHandleId=8727, ComSystemTemplateSystemSignalRef=OBJ_ACCELERATION_LONG_005
          OBJ_ACCEL_ERR_CRR_COEF_005_oRDR_TRACKER_OBJ_005_oPCAN_RADAR_93d8b5d6_Tx: ComBitPosition=431, ComBitSize=8, ComSignalType=UINT8, ComHandleId=8729, ComSystemTemplateSystemSignalRef=OBJ_ACCEL_ERR_CRR_COEF_005
          OBJ_CLS_TYPE4_005_oRDR_TRACKER_OBJ_005_oPCAN_RADAR_aa58f877_Tx: ComBitPosition=275, ComBitSize=4, ComSignalType=UINT8, ComHandleId=8737, ComSystemTemplateSystemSignalRef=OBJ_CLS_TYPE4_005
          OBJ_DIMENSION_LENGTH_005_oRDR_TRACKER_OBJ_005_oPCAN_RADAR_3efeab9a_Tx: ComBitPosition=37, ComBitSize=12, ComSignalType=UINT16, ComHandleId=8743, ComSystemTemplateSystemSignalRef=OBJ_DIMENSION_LENGTH_005
          OBJ_VEH_TRACK_FLAG_005_oRDR_TRACKER_OBJ_005_oPCAN_RADAR_22369cf6_Tx: ComBitPosition=10, ComBitSize=1, ComSignalType=BOOLEAN, ComHandleId=8764, ComSystemTemplateSystemSignalRef=OBJ_VEH_TRACK_FLAG_005
          OBJ_MH_CYCLE_COUNTER_005_oRDR_TRACKER_OBJ_005_oPCAN_RADAR_1e8678c0_Tx: ComBitPosition=487, ComBitSize=8, ComSignalType=UINT8, ComHandleId=8752, ComSystemTemplateSystemSignalRef=OBJ_MH_CYCLE_COUNTER_005
          OBJ_MH_CRC16_005_oRDR_TRACKER_OBJ_005_oPCAN_RADAR_6f622221_Tx: ComBitPosition=495, ComBitSize=16, ComSignalType=UINT16, ComHandleId=8751, ComSystemTemplateSystemSignalRef=OBJ_MH_CRC16_005
      6 x ComIPdu, all with ComIPduDirection=SEND, ComIPduType=NORMAL, ComIPduCancellationSupport=false, ComIPduSignalProcessing=DEFERRED, ComIPduChannelRef=CN_PCAN_RADAR_458ff0f1, ComIPduGroupRef=RDR01_oPCAN_RADAR_Tx_b6bdb067 if post-build-variant-condition{matching-criterion=RDR_POS, value=0}, ComIPduMainFunctionRef=ComMainFunctionTx_Event, ComIPduGroupRef=RDR02_oPCAN_RADAR_Tx_9f750495 if post-build-variant-condition{matching-criterion=RDR_POS, value=1}, ComIPduGroupRef=RDR03_oPCAN_RADAR_Tx_311d9504 if post-build-variant-condition{matching-criterion=RDR_POS, value=2}, ComIPduGroupRef=RDR04_oPCAN_RADAR_Tx_cce46d71 if post-build-variant-condition{matching-criterion=RDR_POS, value=3}, ComIPduGroupRef=RDR05_oPCAN_RADAR_Tx_628cfce0 if post-build-variant-condition{matching-criterion=RDR_POS, value=4}, ComIPduGroupRef=RDR06_oPCAN_RADAR_Tx_4b444812 if post-build-variant-condition{matching-criterion=RDR_POS, value=5}, ComIPduGroupRef=RDR07_oPCAN_RADAR_Tx_e52cd983 if post-build-variant-condition{matching-criterion=RDR_POS, value=6}, ComIPduGroupRef=RDR08_oPCAN_RADAR_Tx_6bc6beb9 if post-build-variant-condition{matching-criterion=RDR_POS, value=7}:
        RDR_DETECTION_325_328_oPCAN_RADAR_0f61dd8a_Tx: ComIPduHandleId=87, ComIPduSignalGroupRef=SG_Detections_325_328_oRDR_DETECTION_325_328_oPCAN_RADAR_5c066661_Tx, ComPduIdRef=RDR_DETECTION_325_328_oPCAN_RADAR_0f61dd8a_Tx
          ComTxIPdu: ComMinimumDelayTime=0, ComTxIPduUnusedAreasDefault=0
            ComTxModeTrue
              ComTxMode: ComTxModeMode=DIRECT, ComTxModeNumberOfRepetitions=0
            ComTxModeFalse
              ComTxMode: ComTxModeMode=NONE
        RDR_DETECTION_201_204_oPCAN_RADAR_6c70b720_Tx: ComIPduHandleId=56, ComIPduSignalGroupRef=SG_Detections_201_204_oRDR_DETECTION_201_204_oPCAN_RADAR_5a18d0dd_Tx, ComPduIdRef=RDR_DETECTION_201_204_oPCAN_RADAR_6c70b720_Tx
          ComTxIPdu: ComMinimumDelayTime=0, ComTxIPduUnusedAreasDefault=0
            ComTxModeTrue
              ComTxMode: ComTxModeMode=DIRECT, ComTxModeNumberOfRepetitions=0
            ComTxModeFalse
              ComTxMode: ComTxModeMode=NONE
        RDR_TRACKER_OBJ_047_oPCAN_RADAR_97ceab90_Tx: ComIPduHandleId=157, ComIPduSignalGroupRef=SG_TrackerObject047_oRDR_TRACKER_OBJ_047_oPCAN_RADAR_4f609b4d_Tx, ComPduIdRef=RDR_TRACKER_OBJ_047_oPCAN_RADAR_97ceab90_Tx
          ComTxIPdu: ComMinimumDelayTime=0, ComTxIPduUnusedAreasDefault=0
            ComTxModeTrue
              ComTxMode: ComTxModeMode=DIRECT, ComTxModeNumberOfRepetitions=0
            ComTxModeFalse
              ComTxMode: ComTxModeMode=NONE
        RDR_DETECTION_169_172_oPCAN_RADAR_f31fddf6_Tx: ComIPduHandleId=48, ComIPduSignalGroupRef=SG_Detections_169_172_oRDR_DETECTION_169_172_oPCAN_RADAR_2ac747c6_Tx, ComPduIdRef=RDR_DETECTION_169_172_oPCAN_RADAR_f31fddf6_Tx
          ComTxIPdu: ComMinimumDelayTime=0, ComTxIPduUnusedAreasDefault=0
            ComTxModeTrue
              ComTxMode: ComTxModeMode=DIRECT, ComTxModeNumberOfRepetitions=0
            ComTxModeFalse
              ComTxMode: ComTxModeMode=NONE
        RDR_DETECTION_181_184_oPCAN_RADAR_fa53ebca_Tx: ComIPduHandleId=51, ComIPduSignalGroupRef=SG_Detections_181_184_oRDR_DETECTION_181_184_oPCAN_RADAR_48363651_Tx, ComPduIdRef=RDR_DETECTION_181_184_oPCAN_RADAR_fa53ebca_Tx
          ComTxIPdu: ComMinimumDelayTime=0, ComTxIPduUnusedAreasDefault=0
            ComTxModeTrue
              ComTxMode: ComTxModeMode=DIRECT, ComTxModeNumberOfRepetitions=0
            ComTxModeFalse
              ComTxMode: ComTxModeMode=NONE
        RDR_TRACKER_OBJ_058_oPCAN_RADAR_2db19fd3_Tx: ComIPduHandleId=168, ComIPduSignalGroupRef=SG_TrackerObject058_oRDR_TRACKER_OBJ_058_oPCAN_RADAR_3a6d80b5_Tx, ComPduIdRef=RDR_TRACKER_OBJ_058_oPCAN_RADAR_2db19fd3_Tx
          ComTxIPdu: ComMinimumDelayTime=0, ComTxIPduUnusedAreasDefault=0
            ComTxModeTrue
              ComTxMode: ComTxModeMode=DIRECT, ComTxModeNumberOfRepetitions=0
            ComTxModeFalse
              ComTxMode: ComTxModeMode=NONE
      SG_TrackerObject029_oRDR_TRACKER_OBJ_029_oPCAN_RADAR_a5fdcf7d_Tx (ComSignalGroup):
        ComTransferProperty = TRIGGERED
        ComSignalGroupAccess = ACCESS_NEEDED_BY_SWC_OR_COM
        ComHandleId = 138
        ComSignalGroupArrayAccess = true
        ComSystemTemplateSignalGroupRef = SG_TrackerObject029
        49 x ComGroupSignal, all with ComSignalEndianness=BIG_ENDIAN, ComSignalInitValue=0, ComTransferProperty=PENDING, ComSignalAccess=ACCESS_NEEDED_BY_SWC_OR_COM:
          OBJ_POS_LONG_029_oRDR_TRACKER_OBJ_029_oPCAN_RADAR_ad2f4946_Tx: ComBitPosition=63, ComBitSize=16, ComSignalType=UINT16, ComHandleId=9933, ComSystemTemplateSystemSignalRef=OBJ_POS_LONG_029
          OBJ_ACCELERATION_LONG_029_oRDR_TRACKER_OBJ_029_oPCAN_RADAR_d929cdea_Tx: ComBitPosition=193, ComBitSize=10, ComSignalType=UINT16, ComHandleId=9903, ComSystemTemplateSystemSignalRef=OBJ_ACCELERATION_LONG_029
          OBJ_VELOCITY_LONG_029_oRDR_TRACKER_OBJ_029_oPCAN_RADAR_08619f68_Tx: ComBitPosition=110, ComBitSize=15, ComSignalType=UINT16, ComHandleId=9944, ComSystemTemplateSystemSignalRef=OBJ_VELOCITY_LONG_029
          OBJ_DIMENSION_LENGTH_ERR_029_oRDR_TRACKER_OBJ_029_oPCAN_RADAR_57f52b4e_Tx: ComBitPosition=41, ComBitSize=10, ComSignalType=UINT16, ComHandleId=9920, ComSystemTemplateSystemSignalRef=OBJ_DIMENSION_LENGTH_ERR_029
          OBJ_POS_ERR_CRR_COEF_029_oRDR_TRACKER_OBJ_029_oPCAN_RADAR_fe205fc5_Tx: ComBitPosition=415, ComBitSize=8, ComSignalType=UINT8, ComHandleId=9930, ComSystemTemplateSystemSignalRef=OBJ_POS_ERR_CRR_COEF_029
          OBJ_ID_029_oRDR_TRACKER_OBJ_029_oPCAN_RADAR_3e23780e_Tx: ComBitPosition=7, ComBitSize=8, ComSignalType=UINT8, ComHandleId=9925, ComSystemTemplateSystemSignalRef=OBJ_ID_029
          OBJ_REF_PT_LAT_OFFSET_029_oRDR_TRACKER_OBJ_029_oPCAN_RADAR_cb7d9ffb_Tx: ComBitPosition=370, ComBitSize=14, ComSignalType=UINT16, ComHandleId=9936, ComSystemTemplateSystemSignalRef=OBJ_REF_PT_LAT_OFFSET_029
          OBJ_CLS_TYPE4_PROB_029_oRDR_TRACKER_OBJ_029_oPCAN_RADAR_06e69bd5_Tx: ComBitPosition=327, ComBitSize=8, ComSignalType=UINT8, ComHandleId=9914, ComSystemTemplateSystemSignalRef=OBJ_CLS_TYPE4_PROB_029
          OBJ_YAW_RATE_029_oRDR_TRACKER_OBJ_029_oPCAN_RADAR_91df86a9_Tx: ComBitPosition=399, ComBitSize=10, ComSignalType=UINT16, ComHandleId=9948, ComSystemTemplateSystemSignalRef=OBJ_YAW_RATE_029
          OBJ_CLS_TYPE6_029_oRDR_TRACKER_OBJ_029_oPCAN_RADAR_38cb9a5c_Tx: ComBitPosition=282, ComBitSize=4, ComSignalType=UINT8, ComHandleId=9917, ComSystemTemplateSystemSignalRef=OBJ_CLS_TYPE6_029
          OBJ_YAW_ANGLE_ERR_029_oRDR_TRACKER_OBJ_029_oPCAN_RADAR_615da539_Tx: ComBitPosition=175, ComBitSize=7, ComSignalType=UINT8, ComHandleId=9947, ComSystemTemplateSystemSignalRef=OBJ_YAW_ANGLE_ERR_029
          OBJ_CLS_TYPE1_029_oRDR_TRACKER_OBJ_029_oPCAN_RADAR_2e936770_Tx: ComBitPosition=271, ComBitSize=4, ComSignalType=UINT8, ComHandleId=9907, ComSystemTemplateSystemSignalRef=OBJ_CLS_TYPE1_029
          OBJ_CLS_TYPE5_029_oRDR_TRACKER_OBJ_029_oPCAN_RADAR_75239a3b_Tx: ComBitPosition=287, ComBitSize=4, ComSignalType=UINT8, ComHandleId=9915, ComSystemTemplateSystemSignalRef=OBJ_CLS_TYPE5_029
          OBJ_MOVEMENT_STATUS_029_oRDR_TRACKER_OBJ_029_oPCAN_RADAR_6e5f9fff_Tx: ComBitPosition=196, ComBitSize=3, ComSignalType=UINT8, ComHandleId=9929, ComSystemTemplateSystemSignalRef=OBJ_MOVEMENT_STATUS_029
          OBJ_ACCELERATION_LONG_ERR_029_oRDR_TRACKER_OBJ_029_oPCAN_RADAR_61880b1e_Tx: ComBitPosition=215, ComBitSize=8, ComSignalType=UINT8, ComHandleId=9904, ComSystemTemplateSystemSignalRef=OBJ_ACCELERATION_LONG_ERR_029
          OBJ_DIMENSION_WIDTH_ERR_029_oRDR_TRACKER_OBJ_029_oPCAN_RADAR_af610471_Tx: ComBitPosition=23, ComBitSize=6, ComSignalType=UINT8, ComHandleId=9922, ComSystemTemplateSystemSignalRef=OBJ_DIMENSION_WIDTH_ERR_029
          OBJ_YAW_RATE_ERR_029_oRDR_TRACKER_OBJ_029_oPCAN_RADAR_ae071175_Tx: ComBitPosition=388, ComBitSize=5, ComSignalType=UINT8, ComHandleId=9949, ComSystemTemplateSystemSignalRef=OBJ_YAW_RATE_ERR_029
          OBJ_VELOCITY_LONG_ERR_029_oRDR_TRACKER_OBJ_029_oPCAN_RADAR_8094a83f_Tx: ComBitPosition=143, ComBitSize=8, ComSignalType=UINT8, ComHandleId=9945, ComSystemTemplateSystemSignalRef=OBJ_VELOCITY_LONG_ERR_029
          OBJ_VELOCITY_LAT_ERR_029_oRDR_TRACKER_OBJ_029_oPCAN_RADAR_6c1697ff_Tx: ComBitPosition=151, ComBitSize=8, ComSignalType=UINT8, ComHandleId=9943, ComSystemTemplateSystemSignalRef=OBJ_VELOCITY_LAT_ERR_029
          OBJ_ACCELERATION_LAT_ERR_029_oRDR_TRACKER_OBJ_029_oPCAN_RADAR_7e2daeb4_Tx: ComBitPosition=223, ComBitSize=8, ComSignalType=UINT8, ComHandleId=9902, ComSystemTemplateSystemSignalRef=OBJ_ACCELERATION_LAT_ERR_029
          OBJ_CLS_TYPE2_029_oRDR_TRACKER_OBJ_029_oPCAN_RADAR_637b6717_Tx: ComBitPosition=267, ComBitSize=4, ComSignalType=UINT8, ComHandleId=9909, ComSystemTemplateSystemSignalRef=OBJ_CLS_TYPE2_029
          OBJ_TRACK_MOTION_MODEL_029_oRDR_TRACKER_OBJ_029_oPCAN_RADAR_f2eff505_Tx: ComBitPosition=9, ComBitSize=2, ComSignalType=UINT8, ComHandleId=9939, ComSystemTemplateSystemSignalRef=OBJ_TRACK_MOTION_MODEL_029
          OBJ_CLS_TYPE3_PROB_029_oRDR_TRACKER_OBJ_029_oPCAN_RADAR_08ec5d75_Tx: ComBitPosition=319, ComBitSize=8, ComSignalType=UINT8, ComHandleId=9912, ComSystemTemplateSystemSignalRef=OBJ_CLS_TYPE3_PROB_029
          OBJ_ALIVE_TIME_029_oRDR_TRACKER_OBJ_029_oPCAN_RADAR_b9488656_Tx: ComBitPosition=255, ComBitSize=16, ComSignalType=UINT16, ComHandleId=9906, ComSystemTemplateSystemSignalRef=OBJ_ALIVE_TIME_029
          OBJ_CLS_TYPE6_PROB_029_oRDR_TRACKER_OBJ_029_oPCAN_RADAR_88c17623_Tx: ComBitPosition=343, ComBitSize=8, ComSignalType=UINT8, ComHandleId=9918, ComSystemTemplateSystemSignalRef=OBJ_CLS_TYPE6_PROB_029
          OBJ_VEH_TRACK_FLAG_029_oRDR_TRACKER_OBJ_029_oPCAN_RADAR_70c50358_Tx: ComBitPosition=10, ComBitSize=1, ComSignalType=BOOLEAN, ComHandleId=9940, ComSystemTemplateSystemSignalRef=OBJ_VEH_TRACK_FLAG_029
          OBJ_YAW_ANGLE_029_oRDR_TRACKER_OBJ_029_oPCAN_RADAR_b450a3ee_Tx: ComBitPosition=155, ComBitSize=12, ComSignalType=UINT16, ComHandleId=9946, ComSystemTemplateSystemSignalRef=OBJ_YAW_ANGLE_029
          OBJ_CLS_TYPE4_029_oRDR_TRACKER_OBJ_029_oPCAN_RADAR_f8ab67d9_Tx: ComBitPosition=275, ComBitSize=4, ComSignalType=UINT8, ComHandleId=9913, ComSystemTemplateSystemSignalRef=OBJ_CLS_TYPE4_029
          OBJ_CLS_TYPE2_PROB_029_oRDR_TRACKER_OBJ_029_oPCAN_RADAR_4fffab8e_Tx: ComBitPosition=311, ComBitSize=8, ComSignalType=UINT8, ComHandleId=9910, ComSystemTemplateSystemSignalRef=OBJ_CLS_TYPE2_PROB_029
          OBJ_DIMENSION_WIDTH_029_oRDR_TRACKER_OBJ_029_oPCAN_RADAR_4fc3c399_Tx: ComBitPosition=17, ComBitSize=10, ComSignalType=UINT16, ComHandleId=9921, ComSystemTemplateSystemSignalRef=OBJ_DIMENSION_WIDTH_029
          OBJ_ACCELERATION_LAT_029_oRDR_TRACKER_OBJ_029_oPCAN_RADAR_abd9940a_Tx: ComBitPosition=177, ComBitSize=10, ComSignalType=UINT16, ComHandleId=9901, ComSystemTemplateSystemSignalRef=OBJ_ACCELERATION_LAT_029
          OBJ_CLS_TYPE1_PROB_029_oRDR_TRACKER_OBJ_029_oPCAN_RADAR_86cbb083_Tx: ComBitPosition=303, ComBitSize=8, ComSignalType=UINT8, ComHandleId=9908, ComSystemTemplateSystemSignalRef=OBJ_CLS_TYPE1_PROB_029
          OBJ_MEASUREMENT_STATUS_029_oRDR_TRACKER_OBJ_029_oPCAN_RADAR_41f10ab3_Tx: ComBitPosition=14, ComBitSize=3, ComSignalType=UINT8, ComHandleId=9926, ComSystemTemplateSystemSignalRef=OBJ_MEASUREMENT_STATUS_029
          OBJ_RCS_029_oRDR_TRACKER_OBJ_029_oPCAN_RADAR_3e40f48e_Tx: ComBitPosition=351, ComBitSize=7, ComSignalType=UINT8, ComHandleId=9935, ComSystemTemplateSystemSignalRef=OBJ_RCS_029
          OBJ_POS_LONG_ERR_029_oRDR_TRACKER_OBJ_029_oPCAN_RADAR_813b0c5c_Tx: ComBitPosition=95, ComBitSize=8, ComSignalType=UINT8, ComHandleId=9934, ComSystemTemplateSystemSignalRef=OBJ_POS_LONG_ERR_029
          OBJ_VELOCITY_ERR_CRR_COEF_029_oRDR_TRACKER_OBJ_029_oPCAN_RADAR_575a6224_Tx: ComBitPosition=423, ComBitSize=8, ComSignalType=UINT8, ComHandleId=9941, ComSystemTemplateSystemSignalRef=OBJ_VELOCITY_ERR_CRR_COEF_029
          OBJ_CLS_TYPE3_029_oRDR_TRACKER_OBJ_029_oPCAN_RADAR_eef39af5_Tx: ComBitPosition=279, ComBitSize=4, ComSignalType=UINT8, ComHandleId=9911, ComSystemTemplateSystemSignalRef=OBJ_CLS_TYPE3_029
          OBJ_TIMESTAMP_OFFSET_029_oRDR_TRACKER_OBJ_029_oPCAN_RADAR_3eecf4d8_Tx: ComBitPosition=247, ComBitSize=8, ComSignalType=UINT8, ComHandleId=9938, ComSystemTemplateSystemSignalRef=OBJ_TIMESTAMP_OFFSET_029
          OBJ_VELOCITY_LAT_029_oRDR_TRACKER_OBJ_029_oPCAN_RADAR_58ece7ae_Tx: ComBitPosition=126, ComBitSize=15, ComSignalType=UINT16, ComHandleId=9942, ComSystemTemplateSystemSignalRef=OBJ_VELOCITY_LAT_029
          OBJ_POS_LAT_ERR_029_oRDR_TRACKER_OBJ_029_oPCAN_RADAR_18c3f2be_Tx: ComBitPosition=103, ComBitSize=8, ComSignalType=UINT8, ComHandleId=9932, ComSystemTemplateSystemSignalRef=OBJ_POS_LAT_ERR_029
          OBJ_REF_PT_LONG_OFFSET_029_oRDR_TRACKER_OBJ_029_oPCAN_RADAR_842f6ff8_Tx: ComBitPosition=357, ComBitSize=14, ComSignalType=UINT16, ComHandleId=9937, ComSystemTemplateSystemSignalRef=OBJ_REF_PT_LONG_OFFSET_029
          OBJ_EXISTENCE_PROB_029_oRDR_TRACKER_OBJ_029_oPCAN_RADAR_447f47a4_Tx: ComBitPosition=229, ComBitSize=14, ComSignalType=UINT16, ComHandleId=9923, ComSystemTemplateSystemSignalRef=OBJ_EXISTENCE_PROB_029
          OBJ_CLS_TYPE5_PROB_029_oRDR_TRACKER_OBJ_029_oPCAN_RADAR_41f56d2e_Tx: ComBitPosition=335, ComBitSize=8, ComSignalType=UINT8, ComHandleId=9916, ComSystemTemplateSystemSignalRef=OBJ_CLS_TYPE5_PROB_029
          OBJ_GROUP_ID_029_oRDR_TRACKER_OBJ_029_oPCAN_RADAR_cd0d5309_Tx: ComBitPosition=405, ComBitSize=6, ComSignalType=UINT8, ComHandleId=9924, ComSystemTemplateSystemSignalRef=OBJ_GROUP_ID_029
          OBJ_ACCEL_ERR_CRR_COEF_029_oRDR_TRACKER_OBJ_029_oPCAN_RADAR_c12b2a78_Tx: ComBitPosition=431, ComBitSize=8, ComSignalType=UINT8, ComHandleId=9905, ComSystemTemplateSystemSignalRef=OBJ_ACCEL_ERR_CRR_COEF_029
          OBJ_DIMENSION_LENGTH_029_oRDR_TRACKER_OBJ_029_oPCAN_RADAR_6c0d3434_Tx: ComBitPosition=37, ComBitSize=12, ComSignalType=UINT16, ComHandleId=9919, ComSystemTemplateSystemSignalRef=OBJ_DIMENSION_LENGTH_029
          OBJ_POS_LAT_029_oRDR_TRACKER_OBJ_029_oPCAN_RADAR_1c8fa289_Tx: ComBitPosition=79, ComBitSize=16, ComSignalType=UINT16, ComHandleId=9931, ComSystemTemplateSystemSignalRef=OBJ_POS_LAT_029
          OBJ_MH_CRC16_029_oRDR_TRACKER_OBJ_029_oPCAN_RADAR_3d91bd8f_Tx: ComBitPosition=495, ComBitSize=16, ComSignalType=UINT16, ComHandleId=9927, ComSystemTemplateSystemSignalRef=OBJ_MH_CRC16_029
          OBJ_MH_CYCLE_COUNTER_029_oRDR_TRACKER_OBJ_029_oPCAN_RADAR_4c75e76e_Tx: ComBitPosition=487, ComBitSize=8, ComSignalType=UINT8, ComHandleId=9928, ComSystemTemplateSystemSignalRef=OBJ_MH_CYCLE_COUNTER_029
      RDR_TRACKER_OBJ_020_oPCAN_RADAR_127fe67e_Tx (ComIPdu):
        ComIPduDirection = SEND
        ComIPduType = NORMAL
        ComIPduCancellationSupport = false
        ComIPduHandleId = 130
        ComIPduSignalProcessing = DEFERRED
        ComIPduChannelRef = CN_PCAN_RADAR_458ff0f1
        ComIPduGroupRef = RDR01_oPCAN_RADAR_Tx_b6bdb067 if post-build-variant-condition{matching-criterion=RDR_POS, value=0}
        ComIPduSignalGroupRef = SG_TrackerObject020_oRDR_TRACKER_OBJ_020_oPCAN_RADAR_f9891b52_Tx
        ComPduIdRef = RDR_TRACKER_OBJ_020_oPCAN_RADAR_127fe67e_Tx
        ComIPduMainFunctionRef = ComMainFunctionTx_Event
        ComIPduGroupRef = RDR02_oPCAN_RADAR_Tx_9f750495 if post-build-variant-condition{matching-criterion=RDR_POS, value=1}
        ComIPduGroupRef = RDR03_oPCAN_RADAR_Tx_311d9504 if post-build-variant-condition{matching-criterion=RDR_POS, value=2}
        ComIPduGroupRef = RDR04_oPCAN_RADAR_Tx_cce46d71 if post-build-variant-condition{matching-criterion=RDR_POS, value=3}
        ComIPduGroupRef = RDR05_oPCAN_RADAR_Tx_628cfce0 if post-build-variant-condition{matching-criterion=RDR_POS, value=4}
        ComIPduGroupRef = RDR06_oPCAN_RADAR_Tx_4b444812 if post-build-variant-condition{matching-criterion=RDR_POS, value=5}
        ComIPduGroupRef = RDR07_oPCAN_RADAR_Tx_e52cd983 if post-build-variant-condition{matching-criterion=RDR_POS, value=6}
        ComIPduGroupRef = RDR08_oPCAN_RADAR_Tx_6bc6beb9 if post-build-variant-condition{matching-criterion=RDR_POS, value=7}
        ComTxIPdu: ComMinimumDelayTime=0, ComTxIPduUnusedAreasDefault=0
          ComTxModeTrue
            ComTxMode: ComTxModeMode=DIRECT, ComTxModeNumberOfRepetitions=0
          ComTxModeFalse
            ComTxMode: ComTxModeMode=NONE
      RDR_ALIGNMENT_STATUS_002_oPCAN_RADAR_604bf216_Tx (ComIPdu):
        ComIPduDirection = SEND
        ComIPduType = NORMAL
        ComIPduCancellationSupport = false
        ComIPduHandleId = 3
        ComIPduSignalProcessing = DEFERRED
        ComIPduChannelRef = CN_PCAN_RADAR_458ff0f1
        ComIPduGroupRef = RDR01_oPCAN_RADAR_Tx_b6bdb067 if post-build-variant-condition{matching-criterion=RDR_POS, value=0}
        ComIPduSignalGroupRef = SG_AlignmentStatus2_oRDR_ALIGNMENT_STATUS_002_oPCAN_RADAR_1945d616_Tx
        ComPduIdRef = RDR_ALIGNMENT_STATUS_002_oPCAN_RADAR_604bf216_Tx
        ComIPduMainFunctionRef = ComMainFunctionTx_Event
        ComIPduGroupRef = RDR02_oPCAN_RADAR_Tx_9f750495 if post-build-variant-condition{matching-criterion=RDR_POS, value=1}
        ComIPduGroupRef = RDR03_oPCAN_RADAR_Tx_311d9504 if post-build-variant-condition{matching-criterion=RDR_POS, value=2}
        ComIPduGroupRef = RDR04_oPCAN_RADAR_Tx_cce46d71 if post-build-variant-condition{matching-criterion=RDR_POS, value=3}
        ComIPduGroupRef = RDR05_oPCAN_RADAR_Tx_628cfce0 if post-build-variant-condition{matching-criterion=RDR_POS, value=4}
        ComIPduGroupRef = RDR06_oPCAN_RADAR_Tx_4b444812 if post-build-variant-condition{matching-criterion=RDR_POS, value=5}
        ComIPduGroupRef = RDR07_oPCAN_RADAR_Tx_e52cd983 if post-build-variant-condition{matching-criterion=RDR_POS, value=6}
        ComIPduGroupRef = RDR08_oPCAN_RADAR_Tx_6bc6beb9 if post-build-variant-condition{matching-criterion=RDR_POS, value=7}
        ComTxIPdu: ComMinimumDelayTime=0, ComTxIPduUnusedAreasDefault=0
          ComTxModeTrue
            ComTxMode: ComTxModeMode=DIRECT, ComTxModeNumberOfRepetitions=0
          ComTxModeFalse
            ComTxMode: ComTxModeMode=NONE
      SG_TrackerObject063_oRDR_TRACKER_OBJ_063_oPCAN_RADAR_b8f3587f_Tx (ComSignalGroup):
        ComTransferProperty = TRIGGERED
        ComSignalGroupAccess = ACCESS_NEEDED_BY_SWC_OR_COM
        ComHandleId = 172
        ComSignalGroupArrayAccess = true
        ComSystemTemplateSignalGroupRef = SG_TrackerObject063
        49 x ComGroupSignal, all with ComSignalEndianness=BIG_ENDIAN, ComSignalInitValue=0, ComTransferProperty=PENDING, ComSignalAccess=ACCESS_NEEDED_BY_SWC_OR_COM:
          OBJ_EXISTENCE_PROB_063_oRDR_TRACKER_OBJ_063_oPCAN_RADAR_5971d0a6_Tx: ComBitPosition=229, ComBitSize=14, ComSignalType=UINT16, ComHandleId=11589, ComSystemTemplateSystemSignalRef=OBJ_EXISTENCE_PROB_063
          OBJ_YAW_ANGLE_063_oRDR_TRACKER_OBJ_063_oPCAN_RADAR_a95e34ec_Tx: ComBitPosition=155, ComBitSize=12, ComSignalType=UINT16, ComHandleId=11612, ComSystemTemplateSystemSignalRef=OBJ_YAW_ANGLE_063
          OBJ_YAW_ANGLE_ERR_063_oRDR_TRACKER_OBJ_063_oPCAN_RADAR_7c53323b_Tx: ComBitPosition=175, ComBitSize=7, ComSignalType=UINT8, ComHandleId=11613, ComSystemTemplateSystemSignalRef=OBJ_YAW_ANGLE_ERR_063
          OBJ_CLS_TYPE4_063_oRDR_TRACKER_OBJ_063_oPCAN_RADAR_e5a5f0db_Tx: ComBitPosition=275, ComBitSize=4, ComSignalType=UINT8, ComHandleId=11579, ComSystemTemplateSystemSignalRef=OBJ_CLS_TYPE4_063
          OBJ_GROUP_ID_063_oRDR_TRACKER_OBJ_063_oPCAN_RADAR_d003c40b_Tx: ComBitPosition=405, ComBitSize=6, ComSignalType=UINT8, ComHandleId=11590, ComSystemTemplateSystemSignalRef=OBJ_GROUP_ID_063
          OBJ_YAW_RATE_ERR_063_oRDR_TRACKER_OBJ_063_oPCAN_RADAR_b3098677_Tx: ComBitPosition=388, ComBitSize=5, ComSignalType=UINT8, ComHandleId=11615, ComSystemTemplateSystemSignalRef=OBJ_YAW_RATE_ERR_063
          OBJ_ID_063_oRDR_TRACKER_OBJ_063_oPCAN_RADAR_232def0c_Tx: ComBitPosition=7, ComBitSize=8, ComSignalType=UINT8, ComHandleId=11591, ComSystemTemplateSystemSignalRef=OBJ_ID_063
          OBJ_REF_PT_LAT_OFFSET_063_oRDR_TRACKER_OBJ_063_oPCAN_RADAR_d67308f9_Tx: ComBitPosition=370, ComBitSize=14, ComSignalType=UINT16, ComHandleId=11602, ComSystemTemplateSystemSignalRef=OBJ_REF_PT_LAT_OFFSET_063
          OBJ_REF_PT_LONG_OFFSET_063_oRDR_TRACKER_OBJ_063_oPCAN_RADAR_9921f8fa_Tx: ComBitPosition=357, ComBitSize=14, ComSignalType=UINT16, ComHandleId=11603, ComSystemTemplateSystemSignalRef=OBJ_REF_PT_LONG_OFFSET_063
          OBJ_VELOCITY_LAT_063_oRDR_TRACKER_OBJ_063_oPCAN_RADAR_45e270ac_Tx: ComBitPosition=126, ComBitSize=15, ComSignalType=UINT16, ComHandleId=11608, ComSystemTemplateSystemSignalRef=OBJ_VELOCITY_LAT_063
          OBJ_CLS_TYPE3_063_oRDR_TRACKER_OBJ_063_oPCAN_RADAR_f3fd0df7_Tx: ComBitPosition=279, ComBitSize=4, ComSignalType=UINT8, ComHandleId=11577, ComSystemTemplateSystemSignalRef=OBJ_CLS_TYPE3_063
          OBJ_POS_LAT_ERR_063_oRDR_TRACKER_OBJ_063_oPCAN_RADAR_05cd65bc_Tx: ComBitPosition=103, ComBitSize=8, ComSignalType=UINT8, ComHandleId=11598, ComSystemTemplateSystemSignalRef=OBJ_POS_LAT_ERR_063
          OBJ_VELOCITY_LONG_ERR_063_oRDR_TRACKER_OBJ_063_oPCAN_RADAR_9d9a3f3d_Tx: ComBitPosition=143, ComBitSize=8, ComSignalType=UINT8, ComHandleId=11611, ComSystemTemplateSystemSignalRef=OBJ_VELOCITY_LONG_ERR_063
          OBJ_YAW_RATE_063_oRDR_TRACKER_OBJ_063_oPCAN_RADAR_8cd111ab_Tx: ComBitPosition=399, ComBitSize=10, ComSignalType=UINT16, ComHandleId=11614, ComSystemTemplateSystemSignalRef=OBJ_YAW_RATE_063
          OBJ_ACCELERATION_LONG_063_oRDR_TRACKER_OBJ_063_oPCAN_RADAR_c4275ae8_Tx: ComBitPosition=193, ComBitSize=10, ComSignalType=UINT16, ComHandleId=11569, ComSystemTemplateSystemSignalRef=OBJ_ACCELERATION_LONG_063
          OBJ_TRACK_MOTION_MODEL_063_oRDR_TRACKER_OBJ_063_oPCAN_RADAR_efe16207_Tx: ComBitPosition=9, ComBitSize=2, ComSignalType=UINT8, ComHandleId=11605, ComSystemTemplateSystemSignalRef=OBJ_TRACK_MOTION_MODEL_063
          OBJ_ACCELERATION_LAT_063_oRDR_TRACKER_OBJ_063_oPCAN_RADAR_b6d70308_Tx: ComBitPosition=177, ComBitSize=10, ComSignalType=UINT16, ComHandleId=11567, ComSystemTemplateSystemSignalRef=OBJ_ACCELERATION_LAT_063
          OBJ_ALIVE_TIME_063_oRDR_TRACKER_OBJ_063_oPCAN_RADAR_a4461154_Tx: ComBitPosition=255, ComBitSize=16, ComSignalType=UINT16, ComHandleId=11572, ComSystemTemplateSystemSignalRef=OBJ_ALIVE_TIME_063
          OBJ_VELOCITY_ERR_CRR_COEF_063_oRDR_TRACKER_OBJ_063_oPCAN_RADAR_4a54f526_Tx: ComBitPosition=423, ComBitSize=8, ComSignalType=UINT8, ComHandleId=11607, ComSystemTemplateSystemSignalRef=OBJ_VELOCITY_ERR_CRR_COEF_063
          OBJ_CLS_TYPE1_063_oRDR_TRACKER_OBJ_063_oPCAN_RADAR_339df072_Tx: ComBitPosition=271, ComBitSize=4, ComSignalType=UINT8, ComHandleId=11573, ComSystemTemplateSystemSignalRef=OBJ_CLS_TYPE1_063
          OBJ_CLS_TYPE4_PROB_063_oRDR_TRACKER_OBJ_063_oPCAN_RADAR_1be80cd7_Tx: ComBitPosition=327, ComBitSize=8, ComSignalType=UINT8, ComHandleId=11580, ComSystemTemplateSystemSignalRef=OBJ_CLS_TYPE4_PROB_063
          OBJ_POS_LONG_ERR_063_oRDR_TRACKER_OBJ_063_oPCAN_RADAR_9c359b5e_Tx: ComBitPosition=95, ComBitSize=8, ComSignalType=UINT8, ComHandleId=11600, ComSystemTemplateSystemSignalRef=OBJ_POS_LONG_ERR_063
          OBJ_RCS_063_oRDR_TRACKER_OBJ_063_oPCAN_RADAR_234e638c_Tx: ComBitPosition=351, ComBitSize=7, ComSignalType=UINT8, ComHandleId=11601, ComSystemTemplateSystemSignalRef=OBJ_RCS_063
          OBJ_CLS_TYPE5_PROB_063_oRDR_TRACKER_OBJ_063_oPCAN_RADAR_5cfbfa2c_Tx: ComBitPosition=335, ComBitSize=8, ComSignalType=UINT8, ComHandleId=11582, ComSystemTemplateSystemSignalRef=OBJ_CLS_TYPE5_PROB_063
          OBJ_CLS_TYPE2_063_oRDR_TRACKER_OBJ_063_oPCAN_RADAR_7e75f015_Tx: ComBitPosition=267, ComBitSize=4, ComSignalType=UINT8, ComHandleId=11575, ComSystemTemplateSystemSignalRef=OBJ_CLS_TYPE2_063
          OBJ_VEH_TRACK_FLAG_063_oRDR_TRACKER_OBJ_063_oPCAN_RADAR_6dcb945a_Tx: ComBitPosition=10, ComBitSize=1, ComSignalType=BOOLEAN, ComHandleId=11606, ComSystemTemplateSystemSignalRef=OBJ_VEH_TRACK_FLAG_063
          OBJ_DIMENSION_LENGTH_ERR_063_oRDR_TRACKER_OBJ_063_oPCAN_RADAR_4afbbc4c_Tx: ComBitPosition=41, ComBitSize=10, ComSignalType=UINT16, ComHandleId=11586, ComSystemTemplateSystemSignalRef=OBJ_DIMENSION_LENGTH_ERR_063
          OBJ_TIMESTAMP_OFFSET_063_oRDR_TRACKER_OBJ_063_oPCAN_RADAR_23e263da_Tx: ComBitPosition=247, ComBitSize=8, ComSignalType=UINT8, ComHandleId=11604, ComSystemTemplateSystemSignalRef=OBJ_TIMESTAMP_OFFSET_063
          OBJ_DIMENSION_WIDTH_063_oRDR_TRACKER_OBJ_063_oPCAN_RADAR_52cd549b_Tx: ComBitPosition=17, ComBitSize=10, ComSignalType=UINT16, ComHandleId=11587, ComSystemTemplateSystemSignalRef=OBJ_DIMENSION_WIDTH_063
          OBJ_DIMENSION_WIDTH_ERR_063_oRDR_TRACKER_OBJ_063_oPCAN_RADAR_b26f9373_Tx: ComBitPosition=23, ComBitSize=6, ComSignalType=UINT8, ComHandleId=11588, ComSystemTemplateSystemSignalRef=OBJ_DIMENSION_WIDTH_ERR_063
          OBJ_CLS_TYPE6_PROB_063_oRDR_TRACKER_OBJ_063_oPCAN_RADAR_95cfe121_Tx: ComBitPosition=343, ComBitSize=8, ComSignalType=UINT8, ComHandleId=11584, ComSystemTemplateSystemSignalRef=OBJ_CLS_TYPE6_PROB_063
          OBJ_VELOCITY_LAT_ERR_063_oRDR_TRACKER_OBJ_063_oPCAN_RADAR_711800fd_Tx: ComBitPosition=151, ComBitSize=8, ComSignalType=UINT8, ComHandleId=11609, ComSystemTemplateSystemSignalRef=OBJ_VELOCITY_LAT_ERR_063
          OBJ_CLS_TYPE1_PROB_063_oRDR_TRACKER_OBJ_063_oPCAN_RADAR_9bc52781_Tx: ComBitPosition=303, ComBitSize=8, ComSignalType=UINT8, ComHandleId=11574, ComSystemTemplateSystemSignalRef=OBJ_CLS_TYPE1_PROB_063
          OBJ_CLS_TYPE3_PROB_063_oRDR_TRACKER_OBJ_063_oPCAN_RADAR_15e2ca77_Tx: ComBitPosition=319, ComBitSize=8, ComSignalType=UINT8, ComHandleId=11578, ComSystemTemplateSystemSignalRef=OBJ_CLS_TYPE3_PROB_063
          OBJ_ACCELERATION_LAT_ERR_063_oRDR_TRACKER_OBJ_063_oPCAN_RADAR_632339b6_Tx: ComBitPosition=223, ComBitSize=8, ComSignalType=UINT8, ComHandleId=11568, ComSystemTemplateSystemSignalRef=OBJ_ACCELERATION_LAT_ERR_063
          OBJ_DIMENSION_LENGTH_063_oRDR_TRACKER_OBJ_063_oPCAN_RADAR_7103a336_Tx: ComBitPosition=37, ComBitSize=12, ComSignalType=UINT16, ComHandleId=11585, ComSystemTemplateSystemSignalRef=OBJ_DIMENSION_LENGTH_063
          OBJ_POS_ERR_CRR_COEF_063_oRDR_TRACKER_OBJ_063_oPCAN_RADAR_e32ec8c7_Tx: ComBitPosition=415, ComBitSize=8, ComSignalType=UINT8, ComHandleId=11596, ComSystemTemplateSystemSignalRef=OBJ_POS_ERR_CRR_COEF_063
          OBJ_CLS_TYPE5_063_oRDR_TRACKER_OBJ_063_oPCAN_RADAR_682d0d39_Tx: ComBitPosition=287, ComBitSize=4, ComSignalType=UINT8, ComHandleId=11581, ComSystemTemplateSystemSignalRef=OBJ_CLS_TYPE5_063
          OBJ_MOVEMENT_STATUS_063_oRDR_TRACKER_OBJ_063_oPCAN_RADAR_735108fd_Tx: ComBitPosition=196, ComBitSize=3, ComSignalType=UINT8, ComHandleId=11595, ComSystemTemplateSystemSignalRef=OBJ_MOVEMENT_STATUS_063
          OBJ_ACCELERATION_LONG_ERR_063_oRDR_TRACKER_OBJ_063_oPCAN_RADAR_7c869c1c_Tx: ComBitPosition=215, ComBitSize=8, ComSignalType=UINT8, ComHandleId=11570, ComSystemTemplateSystemSignalRef=OBJ_ACCELERATION_LONG_ERR_063
          OBJ_CLS_TYPE6_063_oRDR_TRACKER_OBJ_063_oPCAN_RADAR_25c50d5e_Tx: ComBitPosition=282, ComBitSize=4, ComSignalType=UINT8, ComHandleId=11583, ComSystemTemplateSystemSignalRef=OBJ_CLS_TYPE6_063
          OBJ_ACCEL_ERR_CRR_COEF_063_oRDR_TRACKER_OBJ_063_oPCAN_RADAR_dc25bd7a_Tx: ComBitPosition=431, ComBitSize=8, ComSignalType=UINT8, ComHandleId=11571, ComSystemTemplateSystemSignalRef=OBJ_ACCEL_ERR_CRR_COEF_063
          OBJ_CLS_TYPE2_PROB_063_oRDR_TRACKER_OBJ_063_oPCAN_RADAR_52f13c8c_Tx: ComBitPosition=311, ComBitSize=8, ComSignalType=UINT8, ComHandleId=11576, ComSystemTemplateSystemSignalRef=OBJ_CLS_TYPE2_PROB_063
          OBJ_POS_LAT_063_oRDR_TRACKER_OBJ_063_oPCAN_RADAR_0181358b_Tx: ComBitPosition=79, ComBitSize=16, ComSignalType=UINT16, ComHandleId=11597, ComSystemTemplateSystemSignalRef=OBJ_POS_LAT_063
          OBJ_VELOCITY_LONG_063_oRDR_TRACKER_OBJ_063_oPCAN_RADAR_156f086a_Tx: ComBitPosition=110, ComBitSize=15, ComSignalType=UINT16, ComHandleId=11610, ComSystemTemplateSystemSignalRef=OBJ_VELOCITY_LONG_063
          OBJ_POS_LONG_063_oRDR_TRACKER_OBJ_063_oPCAN_RADAR_b021de44_Tx: ComBitPosition=63, ComBitSize=16, ComSignalType=UINT16, ComHandleId=11599, ComSystemTemplateSystemSignalRef=OBJ_POS_LONG_063
          OBJ_MEASUREMENT_STATUS_063_oRDR_TRACKER_OBJ_063_oPCAN_RADAR_5cff9db1_Tx: ComBitPosition=14, ComBitSize=3, ComSignalType=UINT8, ComHandleId=11592, ComSystemTemplateSystemSignalRef=OBJ_MEASUREMENT_STATUS_063
          OBJ_MH_CYCLE_COUNTER_063_oRDR_TRACKER_OBJ_063_oPCAN_RADAR_517b706c_Tx: ComBitPosition=487, ComBitSize=8, ComSignalType=UINT8, ComHandleId=11594, ComSystemTemplateSystemSignalRef=OBJ_MH_CYCLE_COUNTER_063
          OBJ_MH_CRC16_063_oRDR_TRACKER_OBJ_063_oPCAN_RADAR_209f2a8d_Tx: ComBitPosition=495, ComBitSize=16, ComSignalType=UINT16, ComHandleId=11593, ComSystemTemplateSystemSignalRef=OBJ_MH_CRC16_063
      RDR_DETECTION_129_132_oPCAN_RADAR_e11b85eb_Tx (ComIPdu):
        ComIPduDirection = SEND
        ComIPduType = NORMAL
        ComIPduCancellationSupport = false
        ComIPduHandleId = 38
        ComIPduSignalProcessing = DEFERRED
        ComIPduChannelRef = CN_PCAN_RADAR_458ff0f1
        ComIPduGroupRef = RDR01_oPCAN_RADAR_Tx_b6bdb067 if post-build-variant-condition{matching-criterion=RDR_POS, value=0}
        ComIPduSignalGroupRef = SG_Detections_129_132_oRDR_DETECTION_129_132_oPCAN_RADAR_402c0762_Tx
        ComPduIdRef = RDR_DETECTION_129_132_oPCAN_RADAR_e11b85eb_Tx
        ComIPduMainFunctionRef = ComMainFunctionTx_Event
        ComIPduGroupRef = RDR02_oPCAN_RADAR_Tx_9f750495 if post-build-variant-condition{matching-criterion=RDR_POS, value=1}
        ComIPduGroupRef = RDR03_oPCAN_RADAR_Tx_311d9504 if post-build-variant-condition{matching-criterion=RDR_POS, value=2}
        ComIPduGroupRef = RDR04_oPCAN_RADAR_Tx_cce46d71 if post-build-variant-condition{matching-criterion=RDR_POS, value=3}
        ComIPduGroupRef = RDR05_oPCAN_RADAR_Tx_628cfce0 if post-build-variant-condition{matching-criterion=RDR_POS, value=4}
        ComIPduGroupRef = RDR06_oPCAN_RADAR_Tx_4b444812 if post-build-variant-condition{matching-criterion=RDR_POS, value=5}
        ComIPduGroupRef = RDR07_oPCAN_RADAR_Tx_e52cd983 if post-build-variant-condition{matching-criterion=RDR_POS, value=6}
        ComIPduGroupRef = RDR08_oPCAN_RADAR_Tx_6bc6beb9 if post-build-variant-condition{matching-criterion=RDR_POS, value=7}
        ComTxIPdu: ComMinimumDelayTime=0, ComTxIPduUnusedAreasDefault=0
          ComTxModeTrue
            ComTxMode: ComTxModeMode=DIRECT, ComTxModeNumberOfRepetitions=0
          ComTxModeFalse
            ComTxMode: ComTxModeMode=NONE
      RDR01_oPCAN_RADAR_Rx_e0e717e1 (ComIPduGroup): ComIPduGroupHandleId=0, variation-point=post-build-variant-condition{matching-criterion=RDR_POS, value=0}
      SG_TrackerObject045_oRDR_TRACKER_OBJ_045_oPCAN_RADAR_66388c6a_Tx (ComSignalGroup):
        ComTransferProperty = TRIGGERED
        ComSignalGroupAccess = ACCESS_NEEDED_BY_SWC_OR_COM
        ComHandleId = 154
        ComSignalGroupArrayAccess = true
        ComSystemTemplateSignalGroupRef = SG_TrackerObject045
        49 x ComGroupSignal, all with ComSignalEndianness=BIG_ENDIAN, ComSignalInitValue=0, ComTransferProperty=PENDING, ComSignalAccess=ACCESS_NEEDED_BY_SWC_OR_COM:
          OBJ_ID_045_oRDR_TRACKER_OBJ_045_oPCAN_RADAR_fde63b19_Tx: ComBitPosition=7, ComBitSize=8, ComSignalType=UINT8, ComHandleId=10709, ComSystemTemplateSystemSignalRef=OBJ_ID_045
          OBJ_DIMENSION_LENGTH_045_oRDR_TRACKER_OBJ_045_oPCAN_RADAR_afc87723_Tx: ComBitPosition=37, ComBitSize=12, ComSignalType=UINT16, ComHandleId=10703, ComSystemTemplateSystemSignalRef=OBJ_DIMENSION_LENGTH_045
          OBJ_VELOCITY_LONG_045_oRDR_TRACKER_OBJ_045_oPCAN_RADAR_cba4dc7f_Tx: ComBitPosition=110, ComBitSize=15, ComSignalType=UINT16, ComHandleId=10728, ComSystemTemplateSystemSignalRef=OBJ_VELOCITY_LONG_045
          OBJ_CLS_TYPE2_PROB_045_oRDR_TRACKER_OBJ_045_oPCAN_RADAR_8c3ae899_Tx: ComBitPosition=311, ComBitSize=8, ComSignalType=UINT8, ComHandleId=10694, ComSystemTemplateSystemSignalRef=OBJ_CLS_TYPE2_PROB_045
          OBJ_REF_PT_LAT_OFFSET_045_oRDR_TRACKER_OBJ_045_oPCAN_RADAR_08b8dcec_Tx: ComBitPosition=370, ComBitSize=14, ComSignalType=UINT16, ComHandleId=10720, ComSystemTemplateSystemSignalRef=OBJ_REF_PT_LAT_OFFSET_045
          OBJ_CLS_TYPE3_PROB_045_oRDR_TRACKER_OBJ_045_oPCAN_RADAR_cb291e62_Tx: ComBitPosition=319, ComBitSize=8, ComSignalType=UINT8, ComHandleId=10696, ComSystemTemplateSystemSignalRef=OBJ_CLS_TYPE3_PROB_045
          OBJ_GROUP_ID_045_oRDR_TRACKER_OBJ_045_oPCAN_RADAR_0ec8101e_Tx: ComBitPosition=405, ComBitSize=6, ComSignalType=UINT8, ComHandleId=10708, ComSystemTemplateSystemSignalRef=OBJ_GROUP_ID_045
          OBJ_YAW_ANGLE_ERR_045_oRDR_TRACKER_OBJ_045_oPCAN_RADAR_a298e62e_Tx: ComBitPosition=175, ComBitSize=7, ComSignalType=UINT8, ComHandleId=10731, ComSystemTemplateSystemSignalRef=OBJ_YAW_ANGLE_ERR_045
          OBJ_TRACK_MOTION_MODEL_045_oRDR_TRACKER_OBJ_045_oPCAN_RADAR_312ab612_Tx: ComBitPosition=9, ComBitSize=2, ComSignalType=UINT8, ComHandleId=10723, ComSystemTemplateSystemSignalRef=OBJ_TRACK_MOTION_MODEL_045
          OBJ_CLS_TYPE4_PROB_045_oRDR_TRACKER_OBJ_045_oPCAN_RADAR_c523d8c2_Tx: ComBitPosition=327, ComBitSize=8, ComSignalType=UINT8, ComHandleId=10698, ComSystemTemplateSystemSignalRef=OBJ_CLS_TYPE4_PROB_045
          OBJ_MEASUREMENT_STATUS_045_oRDR_TRACKER_OBJ_045_oPCAN_RADAR_823449a4_Tx: ComBitPosition=14, ComBitSize=3, ComSignalType=UINT8, ComHandleId=10710, ComSystemTemplateSystemSignalRef=OBJ_MEASUREMENT_STATUS_045
          OBJ_CLS_TYPE1_045_oRDR_TRACKER_OBJ_045_oPCAN_RADAR_ed562467_Tx: ComBitPosition=271, ComBitSize=4, ComSignalType=UINT8, ComHandleId=10691, ComSystemTemplateSystemSignalRef=OBJ_CLS_TYPE1_045
          OBJ_VEH_TRACK_FLAG_045_oRDR_TRACKER_OBJ_045_oPCAN_RADAR_b300404f_Tx: ComBitPosition=10, ComBitSize=1, ComSignalType=BOOLEAN, ComHandleId=10724, ComSystemTemplateSystemSignalRef=OBJ_VEH_TRACK_FLAG_045
          OBJ_CLS_TYPE5_PROB_045_oRDR_TRACKER_OBJ_045_oPCAN_RADAR_82302e39_Tx: ComBitPosition=335, ComBitSize=8, ComSignalType=UINT8, ComHandleId=10700, ComSystemTemplateSystemSignalRef=OBJ_CLS_TYPE5_PROB_045
          OBJ_POS_LAT_045_oRDR_TRACKER_OBJ_045_oPCAN_RADAR_df4ae19e_Tx: ComBitPosition=79, ComBitSize=16, ComSignalType=UINT16, ComHandleId=10715, ComSystemTemplateSystemSignalRef=OBJ_POS_LAT_045
          OBJ_CLS_TYPE1_PROB_045_oRDR_TRACKER_OBJ_045_oPCAN_RADAR_450ef394_Tx: ComBitPosition=303, ComBitSize=8, ComSignalType=UINT8, ComHandleId=10692, ComSystemTemplateSystemSignalRef=OBJ_CLS_TYPE1_PROB_045
          OBJ_VELOCITY_ERR_CRR_COEF_045_oRDR_TRACKER_OBJ_045_oPCAN_RADAR_949f2133_Tx: ComBitPosition=423, ComBitSize=8, ComSignalType=UINT8, ComHandleId=10725, ComSystemTemplateSystemSignalRef=OBJ_VELOCITY_ERR_CRR_COEF_045
          OBJ_ALIVE_TIME_045_oRDR_TRACKER_OBJ_045_oPCAN_RADAR_7a8dc541_Tx: ComBitPosition=255, ComBitSize=16, ComSignalType=UINT16, ComHandleId=10690, ComSystemTemplateSystemSignalRef=OBJ_ALIVE_TIME_045
          OBJ_POS_LONG_045_oRDR_TRACKER_OBJ_045_oPCAN_RADAR_6eea0a51_Tx: ComBitPosition=63, ComBitSize=16, ComSignalType=UINT16, ComHandleId=10717, ComSystemTemplateSystemSignalRef=OBJ_POS_LONG_045
          OBJ_DIMENSION_LENGTH_ERR_045_oRDR_TRACKER_OBJ_045_oPCAN_RADAR_94306859_Tx: ComBitPosition=41, ComBitSize=10, ComSignalType=UINT16, ComHandleId=10704, ComSystemTemplateSystemSignalRef=OBJ_DIMENSION_LENGTH_ERR_045
          OBJ_ACCELERATION_LAT_045_oRDR_TRACKER_OBJ_045_oPCAN_RADAR_681cd71d_Tx: ComBitPosition=177, ComBitSize=10, ComSignalType=UINT16, ComHandleId=10685, ComSystemTemplateSystemSignalRef=OBJ_ACCELERATION_LAT_045
          OBJ_CLS_TYPE3_045_oRDR_TRACKER_OBJ_045_oPCAN_RADAR_2d36d9e2_Tx: ComBitPosition=279, ComBitSize=4, ComSignalType=UINT8, ComHandleId=10695, ComSystemTemplateSystemSignalRef=OBJ_CLS_TYPE3_045
          OBJ_CLS_TYPE6_PROB_045_oRDR_TRACKER_OBJ_045_oPCAN_RADAR_4b043534_Tx: ComBitPosition=343, ComBitSize=8, ComSignalType=UINT8, ComHandleId=10702, ComSystemTemplateSystemSignalRef=OBJ_CLS_TYPE6_PROB_045
          OBJ_CLS_TYPE5_045_oRDR_TRACKER_OBJ_045_oPCAN_RADAR_b6e6d92c_Tx: ComBitPosition=287, ComBitSize=4, ComSignalType=UINT8, ComHandleId=10699, ComSystemTemplateSystemSignalRef=OBJ_CLS_TYPE5_045
          OBJ_DIMENSION_WIDTH_045_oRDR_TRACKER_OBJ_045_oPCAN_RADAR_8c06808e_Tx: ComBitPosition=17, ComBitSize=10, ComSignalType=UINT16, ComHandleId=10705, ComSystemTemplateSystemSignalRef=OBJ_DIMENSION_WIDTH_045
          OBJ_VELOCITY_LONG_ERR_045_oRDR_TRACKER_OBJ_045_oPCAN_RADAR_4351eb28_Tx: ComBitPosition=143, ComBitSize=8, ComSignalType=UINT8, ComHandleId=10729, ComSystemTemplateSystemSignalRef=OBJ_VELOCITY_LONG_ERR_045
          OBJ_ACCEL_ERR_CRR_COEF_045_oRDR_TRACKER_OBJ_045_oPCAN_RADAR_02ee696f_Tx: ComBitPosition=431, ComBitSize=8, ComSignalType=UINT8, ComHandleId=10689, ComSystemTemplateSystemSignalRef=OBJ_ACCEL_ERR_CRR_COEF_045
          OBJ_EXISTENCE_PROB_045_oRDR_TRACKER_OBJ_045_oPCAN_RADAR_87ba04b3_Tx: ComBitPosition=229, ComBitSize=14, ComSignalType=UINT16, ComHandleId=10707, ComSystemTemplateSystemSignalRef=OBJ_EXISTENCE_PROB_045
          OBJ_POS_LONG_ERR_045_oRDR_TRACKER_OBJ_045_oPCAN_RADAR_42fe4f4b_Tx: ComBitPosition=95, ComBitSize=8, ComSignalType=UINT8, ComHandleId=10718, ComSystemTemplateSystemSignalRef=OBJ_POS_LONG_ERR_045
          OBJ_MOVEMENT_STATUS_045_oRDR_TRACKER_OBJ_045_oPCAN_RADAR_ad9adce8_Tx: ComBitPosition=196, ComBitSize=3, ComSignalType=UINT8, ComHandleId=10713, ComSystemTemplateSystemSignalRef=OBJ_MOVEMENT_STATUS_045
          OBJ_ACCELERATION_LONG_ERR_045_oRDR_TRACKER_OBJ_045_oPCAN_RADAR_a24d4809_Tx: ComBitPosition=215, ComBitSize=8, ComSignalType=UINT8, ComHandleId=10688, ComSystemTemplateSystemSignalRef=OBJ_ACCELERATION_LONG_ERR_045
          OBJ_ACCELERATION_LONG_045_oRDR_TRACKER_OBJ_045_oPCAN_RADAR_1aec8efd_Tx: ComBitPosition=193, ComBitSize=10, ComSignalType=UINT16, ComHandleId=10687, ComSystemTemplateSystemSignalRef=OBJ_ACCELERATION_LONG_045
          OBJ_YAW_RATE_045_oRDR_TRACKER_OBJ_045_oPCAN_RADAR_521ac5be_Tx: ComBitPosition=399, ComBitSize=10, ComSignalType=UINT16, ComHandleId=10732, ComSystemTemplateSystemSignalRef=OBJ_YAW_RATE_045
          OBJ_CLS_TYPE6_045_oRDR_TRACKER_OBJ_045_oPCAN_RADAR_fb0ed94b_Tx: ComBitPosition=282, ComBitSize=4, ComSignalType=UINT8, ComHandleId=10701, ComSystemTemplateSystemSignalRef=OBJ_CLS_TYPE6_045
          OBJ_YAW_ANGLE_045_oRDR_TRACKER_OBJ_045_oPCAN_RADAR_7795e0f9_Tx: ComBitPosition=155, ComBitSize=12, ComSignalType=UINT16, ComHandleId=10730, ComSystemTemplateSystemSignalRef=OBJ_YAW_ANGLE_045
          OBJ_DIMENSION_WIDTH_ERR_045_oRDR_TRACKER_OBJ_045_oPCAN_RADAR_6ca44766_Tx: ComBitPosition=23, ComBitSize=6, ComSignalType=UINT8, ComHandleId=10706, ComSystemTemplateSystemSignalRef=OBJ_DIMENSION_WIDTH_ERR_045
          OBJ_TIMESTAMP_OFFSET_045_oRDR_TRACKER_OBJ_045_oPCAN_RADAR_fd29b7cf_Tx: ComBitPosition=247, ComBitSize=8, ComSignalType=UINT8, ComHandleId=10722, ComSystemTemplateSystemSignalRef=OBJ_TIMESTAMP_OFFSET_045
          OBJ_VELOCITY_LAT_ERR_045_oRDR_TRACKER_OBJ_045_oPCAN_RADAR_afd3d4e8_Tx: ComBitPosition=151, ComBitSize=8, ComSignalType=UINT8, ComHandleId=10727, ComSystemTemplateSystemSignalRef=OBJ_VELOCITY_LAT_ERR_045
          OBJ_CLS_TYPE2_045_oRDR_TRACKER_OBJ_045_oPCAN_RADAR_a0be2400_Tx: ComBitPosition=267, ComBitSize=4, ComSignalType=UINT8, ComHandleId=10693, ComSystemTemplateSystemSignalRef=OBJ_CLS_TYPE2_045
          OBJ_RCS_045_oRDR_TRACKER_OBJ_045_oPCAN_RADAR_fd85b799_Tx: ComBitPosition=351, ComBitSize=7, ComSignalType=UINT8, ComHandleId=10719, ComSystemTemplateSystemSignalRef=OBJ_RCS_045
          OBJ_CLS_TYPE4_045_oRDR_TRACKER_OBJ_045_oPCAN_RADAR_3b6e24ce_Tx: ComBitPosition=275, ComBitSize=4, ComSignalType=UINT8, ComHandleId=10697, ComSystemTemplateSystemSignalRef=OBJ_CLS_TYPE4_045
          OBJ_POS_ERR_CRR_COEF_045_oRDR_TRACKER_OBJ_045_oPCAN_RADAR_3de51cd2_Tx: ComBitPosition=415, ComBitSize=8, ComSignalType=UINT8, ComHandleId=10714, ComSystemTemplateSystemSignalRef=OBJ_POS_ERR_CRR_COEF_045
          OBJ_ACCELERATION_LAT_ERR_045_oRDR_TRACKER_OBJ_045_oPCAN_RADAR_bde8eda3_Tx: ComBitPosition=223, ComBitSize=8, ComSignalType=UINT8, ComHandleId=10686, ComSystemTemplateSystemSignalRef=OBJ_ACCELERATION_LAT_ERR_045
          OBJ_POS_LAT_ERR_045_oRDR_TRACKER_OBJ_045_oPCAN_RADAR_db06b1a9_Tx: ComBitPosition=103, ComBitSize=8, ComSignalType=UINT8, ComHandleId=10716, ComSystemTemplateSystemSignalRef=OBJ_POS_LAT_ERR_045
          OBJ_REF_PT_LONG_OFFSET_045_oRDR_TRACKER_OBJ_045_oPCAN_RADAR_47ea2cef_Tx: ComBitPosition=357, ComBitSize=14, ComSignalType=UINT16, ComHandleId=10721, ComSystemTemplateSystemSignalRef=OBJ_REF_PT_LONG_OFFSET_045
          OBJ_YAW_RATE_ERR_045_oRDR_TRACKER_OBJ_045_oPCAN_RADAR_6dc25262_Tx: ComBitPosition=388, ComBitSize=5, ComSignalType=UINT8, ComHandleId=10733, ComSystemTemplateSystemSignalRef=OBJ_YAW_RATE_ERR_045
          OBJ_VELOCITY_LAT_045_oRDR_TRACKER_OBJ_045_oPCAN_RADAR_9b29a4b9_Tx: ComBitPosition=126, ComBitSize=15, ComSignalType=UINT16, ComHandleId=10726, ComSystemTemplateSystemSignalRef=OBJ_VELOCITY_LAT_045
          OBJ_MH_CYCLE_COUNTER_045_oRDR_TRACKER_OBJ_045_oPCAN_RADAR_8fb0a479_Tx: ComBitPosition=487, ComBitSize=8, ComSignalType=UINT8, ComHandleId=10712, ComSystemTemplateSystemSignalRef=OBJ_MH_CYCLE_COUNTER_045
          OBJ_MH_CRC16_045_oRDR_TRACKER_OBJ_045_oPCAN_RADAR_fe54fe98_Tx: ComBitPosition=495, ComBitSize=16, ComSignalType=UINT16, ComHandleId=10711, ComSystemTemplateSystemSignalRef=OBJ_MH_CRC16_045
      RDR_OBJ_STATUS_003_oPCAN_RADAR_84871644_Tx (ComIPdu):
        ComIPduDirection = SEND
        ComIPduType = NORMAL
        ComIPduCancellationSupport = false
        ComIPduHandleId = 108
        ComIPduSignalProcessing = DEFERRED
        ComIPduChannelRef = CN_PCAN_RADAR_458ff0f1
        ComIPduGroupRef = RDR01_oPCAN_RADAR_Tx_b6bdb067 if post-build-variant-condition{matching-criterion=RDR_POS, value=0}
        ComIPduSignalGroupRef = SG_TrackerStatus_oRDR_OBJ_STATUS_003_oPCAN_RADAR_3d577421_Tx
        ComPduIdRef = RDR_OBJ_STATUS_003_oPCAN_RADAR_84871644_Tx
        ComIPduMainFunctionRef = ComMainFunctionTx_Event
        ComIPduGroupRef = RDR02_oPCAN_RADAR_Tx_9f750495 if post-build-variant-condition{matching-criterion=RDR_POS, value=1}
        ComIPduGroupRef = RDR03_oPCAN_RADAR_Tx_311d9504 if post-build-variant-condition{matching-criterion=RDR_POS, value=2}
        ComIPduGroupRef = RDR04_oPCAN_RADAR_Tx_cce46d71 if post-build-variant-condition{matching-criterion=RDR_POS, value=3}
        ComIPduGroupRef = RDR05_oPCAN_RADAR_Tx_628cfce0 if post-build-variant-condition{matching-criterion=RDR_POS, value=4}
        ComIPduGroupRef = RDR06_oPCAN_RADAR_Tx_4b444812 if post-build-variant-condition{matching-criterion=RDR_POS, value=5}
        ComIPduGroupRef = RDR07_oPCAN_RADAR_Tx_e52cd983 if post-build-variant-condition{matching-criterion=RDR_POS, value=6}
        ComIPduGroupRef = RDR08_oPCAN_RADAR_Tx_6bc6beb9 if post-build-variant-condition{matching-criterion=RDR_POS, value=7}
        ComTxIPdu: ComMinimumDelayTime=0, ComTxIPduUnusedAreasDefault=0
          ComTxModeTrue
            ComTxMode: ComTxModeMode=DIRECT, ComTxModeNumberOfRepetitions=0
          ComTxModeFalse
            ComTxMode: ComTxModeMode=NONE
      RDR_DETECTION_101_104_oPCAN_RADAR_de5b5bf0_Tx (ComIPdu):
        ComIPduDirection = SEND
        ComIPduType = NORMAL
        ComIPduCancellationSupport = false
        ComIPduHandleId = 31
        ComIPduSignalProcessing = DEFERRED
        ComIPduChannelRef = CN_PCAN_RADAR_458ff0f1
        ComIPduGroupRef = RDR01_oPCAN_RADAR_Tx_b6bdb067 if post-build-variant-condition{matching-criterion=RDR_POS, value=0}
        ComIPduSignalGroupRef = SG_Detections_101_104_oRDR_DETECTION_101_104_oPCAN_RADAR_9de0b719_Tx
        ComPduIdRef = RDR_DETECTION_101_104_oPCAN_RADAR_de5b5bf0_Tx
        ComIPduMainFunctionRef = ComMainFunctionTx_Event
        ComIPduGroupRef = RDR02_oPCAN_RADAR_Tx_9f750495 if post-build-variant-condition{matching-criterion=RDR_POS, value=1}
        ComIPduGroupRef = RDR03_oPCAN_RADAR_Tx_311d9504 if post-build-variant-condition{matching-criterion=RDR_POS, value=2}
        ComIPduGroupRef = RDR04_oPCAN_RADAR_Tx_cce46d71 if post-build-variant-condition{matching-criterion=RDR_POS, value=3}
        ComIPduGroupRef = RDR05_oPCAN_RADAR_Tx_628cfce0 if post-build-variant-condition{matching-criterion=RDR_POS, value=4}
        ComIPduGroupRef = RDR06_oPCAN_RADAR_Tx_4b444812 if post-build-variant-condition{matching-criterion=RDR_POS, value=5}
        ComIPduGroupRef = RDR07_oPCAN_RADAR_Tx_e52cd983 if post-build-variant-condition{matching-criterion=RDR_POS, value=6}
        ComIPduGroupRef = RDR08_oPCAN_RADAR_Tx_6bc6beb9 if post-build-variant-condition{matching-criterion=RDR_POS, value=7}
        ComTxIPdu: ComMinimumDelayTime=0, ComTxIPduUnusedAreasDefault=0
          ComTxModeTrue
            ComTxMode: ComTxModeMode=DIRECT, ComTxModeNumberOfRepetitions=0
          ComTxModeFalse
            ComTxMode: ComTxModeMode=NONE
      SG_TrackerObject036_oRDR_TRACKER_OBJ_036_oPCAN_RADAR_d0f0d485_Tx (ComSignalGroup):
        ComTransferProperty = TRIGGERED
        ComSignalGroupAccess = ACCESS_NEEDED_BY_SWC_OR_COM
        ComHandleId = 145
        ComSignalGroupArrayAccess = true
        ComSystemTemplateSignalGroupRef = SG_TrackerObject036
        49 x ComGroupSignal, all with ComSignalEndianness=BIG_ENDIAN, ComSignalInitValue=0, ComTransferProperty=PENDING, ComSignalAccess=ACCESS_NEEDED_BY_SWC_OR_COM:
          OBJ_CLS_TYPE1_036_oRDR_TRACKER_OBJ_036_oPCAN_RADAR_5b9e7c88_Tx: ComBitPosition=271, ComBitSize=4, ComSignalType=UINT8, ComHandleId=10250, ComSystemTemplateSystemSignalRef=OBJ_CLS_TYPE1_036
          OBJ_CLS_TYPE1_PROB_036_oRDR_TRACKER_OBJ_036_oPCAN_RADAR_f3c6ab7b_Tx: ComBitPosition=303, ComBitSize=8, ComSignalType=UINT8, ComHandleId=10251, ComSystemTemplateSystemSignalRef=OBJ_CLS_TYPE1_PROB_036
          OBJ_VELOCITY_LONG_036_oRDR_TRACKER_OBJ_036_oPCAN_RADAR_7d6c8490_Tx: ComBitPosition=110, ComBitSize=15, ComSignalType=UINT16, ComHandleId=10287, ComSystemTemplateSystemSignalRef=OBJ_VELOCITY_LONG_036
          OBJ_CLS_TYPE6_036_oRDR_TRACKER_OBJ_036_oPCAN_RADAR_4dc681a4_Tx: ComBitPosition=282, ComBitSize=4, ComSignalType=UINT8, ComHandleId=10260, ComSystemTemplateSystemSignalRef=OBJ_CLS_TYPE6_036
          OBJ_DIMENSION_LENGTH_ERR_036_oRDR_TRACKER_OBJ_036_oPCAN_RADAR_22f830b6_Tx: ComBitPosition=41, ComBitSize=10, ComSignalType=UINT16, ComHandleId=10263, ComSystemTemplateSystemSignalRef=OBJ_DIMENSION_LENGTH_ERR_036
          OBJ_ID_036_oRDR_TRACKER_OBJ_036_oPCAN_RADAR_4b2e63f6_Tx: ComBitPosition=7, ComBitSize=8, ComSignalType=UINT8, ComHandleId=10268, ComSystemTemplateSystemSignalRef=OBJ_ID_036
          OBJ_POS_LONG_ERR_036_oRDR_TRACKER_OBJ_036_oPCAN_RADAR_f43617a4_Tx: ComBitPosition=95, ComBitSize=8, ComSignalType=UINT8, ComHandleId=10277, ComSystemTemplateSystemSignalRef=OBJ_POS_LONG_ERR_036
          OBJ_CLS_TYPE2_PROB_036_oRDR_TRACKER_OBJ_036_oPCAN_RADAR_3af2b076_Tx: ComBitPosition=311, ComBitSize=8, ComSignalType=UINT8, ComHandleId=10253, ComSystemTemplateSystemSignalRef=OBJ_CLS_TYPE2_PROB_036
          OBJ_ALIVE_TIME_036_oRDR_TRACKER_OBJ_036_oPCAN_RADAR_cc459dae_Tx: ComBitPosition=255, ComBitSize=16, ComSignalType=UINT16, ComHandleId=10249, ComSystemTemplateSystemSignalRef=OBJ_ALIVE_TIME_036
          OBJ_DIMENSION_LENGTH_036_oRDR_TRACKER_OBJ_036_oPCAN_RADAR_19002fcc_Tx: ComBitPosition=37, ComBitSize=12, ComSignalType=UINT16, ComHandleId=10262, ComSystemTemplateSystemSignalRef=OBJ_DIMENSION_LENGTH_036
          OBJ_ACCEL_ERR_CRR_COEF_036_oRDR_TRACKER_OBJ_036_oPCAN_RADAR_b4263180_Tx: ComBitPosition=431, ComBitSize=8, ComSignalType=UINT8, ComHandleId=10248, ComSystemTemplateSystemSignalRef=OBJ_ACCEL_ERR_CRR_COEF_036
          OBJ_REF_PT_LAT_OFFSET_036_oRDR_TRACKER_OBJ_036_oPCAN_RADAR_be708403_Tx: ComBitPosition=370, ComBitSize=14, ComSignalType=UINT16, ComHandleId=10279, ComSystemTemplateSystemSignalRef=OBJ_REF_PT_LAT_OFFSET_036
          OBJ_ACCELERATION_LONG_036_oRDR_TRACKER_OBJ_036_oPCAN_RADAR_ac24d612_Tx: ComBitPosition=193, ComBitSize=10, ComSignalType=UINT16, ComHandleId=10246, ComSystemTemplateSystemSignalRef=OBJ_ACCELERATION_LONG_036
          OBJ_CLS_TYPE3_PROB_036_oRDR_TRACKER_OBJ_036_oPCAN_RADAR_7de1468d_Tx: ComBitPosition=319, ComBitSize=8, ComSignalType=UINT8, ComHandleId=10255, ComSystemTemplateSystemSignalRef=OBJ_CLS_TYPE3_PROB_036
          OBJ_VELOCITY_LAT_036_oRDR_TRACKER_OBJ_036_oPCAN_RADAR_2de1fc56_Tx: ComBitPosition=126, ComBitSize=15, ComSignalType=UINT16, ComHandleId=10285, ComSystemTemplateSystemSignalRef=OBJ_VELOCITY_LAT_036
          OBJ_CLS_TYPE5_036_oRDR_TRACKER_OBJ_036_oPCAN_RADAR_002e81c3_Tx: ComBitPosition=287, ComBitSize=4, ComSignalType=UINT8, ComHandleId=10258, ComSystemTemplateSystemSignalRef=OBJ_CLS_TYPE5_036
          OBJ_RCS_036_oRDR_TRACKER_OBJ_036_oPCAN_RADAR_4b4def76_Tx: ComBitPosition=351, ComBitSize=7, ComSignalType=UINT8, ComHandleId=10278, ComSystemTemplateSystemSignalRef=OBJ_RCS_036
          OBJ_GROUP_ID_036_oRDR_TRACKER_OBJ_036_oPCAN_RADAR_b80048f1_Tx: ComBitPosition=405, ComBitSize=6, ComSignalType=UINT8, ComHandleId=10267, ComSystemTemplateSystemSignalRef=OBJ_GROUP_ID_036
          OBJ_MEASUREMENT_STATUS_036_oRDR_TRACKER_OBJ_036_oPCAN_RADAR_34fc114b_Tx: ComBitPosition=14, ComBitSize=3, ComSignalType=UINT8, ComHandleId=10269, ComSystemTemplateSystemSignalRef=OBJ_MEASUREMENT_STATUS_036
          OBJ_CLS_TYPE4_036_oRDR_TRACKER_OBJ_036_oPCAN_RADAR_8da67c21_Tx: ComBitPosition=275, ComBitSize=4, ComSignalType=UINT8, ComHandleId=10256, ComSystemTemplateSystemSignalRef=OBJ_CLS_TYPE4_036
          OBJ_DIMENSION_WIDTH_036_oRDR_TRACKER_OBJ_036_oPCAN_RADAR_3aced861_Tx: ComBitPosition=17, ComBitSize=10, ComSignalType=UINT16, ComHandleId=10264, ComSystemTemplateSystemSignalRef=OBJ_DIMENSION_WIDTH_036
          OBJ_YAW_ANGLE_ERR_036_oRDR_TRACKER_OBJ_036_oPCAN_RADAR_1450bec1_Tx: ComBitPosition=175, ComBitSize=7, ComSignalType=UINT8, ComHandleId=10290, ComSystemTemplateSystemSignalRef=OBJ_YAW_ANGLE_ERR_036
          OBJ_CLS_TYPE2_036_oRDR_TRACKER_OBJ_036_oPCAN_RADAR_16767cef_Tx: ComBitPosition=267, ComBitSize=4, ComSignalType=UINT8, ComHandleId=10252, ComSystemTemplateSystemSignalRef=OBJ_CLS_TYPE2_036
          OBJ_POS_LONG_036_oRDR_TRACKER_OBJ_036_oPCAN_RADAR_d82252be_Tx: ComBitPosition=63, ComBitSize=16, ComSignalType=UINT16, ComHandleId=10276, ComSystemTemplateSystemSignalRef=OBJ_POS_LONG_036
          OBJ_YAW_RATE_036_oRDR_TRACKER_OBJ_036_oPCAN_RADAR_e4d29d51_Tx: ComBitPosition=399, ComBitSize=10, ComSignalType=UINT16, ComHandleId=10291, ComSystemTemplateSystemSignalRef=OBJ_YAW_RATE_036
          OBJ_ACCELERATION_LAT_ERR_036_oRDR_TRACKER_OBJ_036_oPCAN_RADAR_0b20b54c_Tx: ComBitPosition=223, ComBitSize=8, ComSignalType=UINT8, ComHandleId=10245, ComSystemTemplateSystemSignalRef=OBJ_ACCELERATION_LAT_ERR_036
          OBJ_CLS_TYPE5_PROB_036_oRDR_TRACKER_OBJ_036_oPCAN_RADAR_34f876d6_Tx: ComBitPosition=335, ComBitSize=8, ComSignalType=UINT8, ComHandleId=10259, ComSystemTemplateSystemSignalRef=OBJ_CLS_TYPE5_PROB_036
          OBJ_VELOCITY_LONG_ERR_036_oRDR_TRACKER_OBJ_036_oPCAN_RADAR_f599b3c7_Tx: ComBitPosition=143, ComBitSize=8, ComSignalType=UINT8, ComHandleId=10288, ComSystemTemplateSystemSignalRef=OBJ_VELOCITY_LONG_ERR_036
          OBJ_CLS_TYPE4_PROB_036_oRDR_TRACKER_OBJ_036_oPCAN_RADAR_73eb802d_Tx: ComBitPosition=327, ComBitSize=8, ComSignalType=UINT8, ComHandleId=10257, ComSystemTemplateSystemSignalRef=OBJ_CLS_TYPE4_PROB_036
          OBJ_YAW_RATE_ERR_036_oRDR_TRACKER_OBJ_036_oPCAN_RADAR_db0a0a8d_Tx: ComBitPosition=388, ComBitSize=5, ComSignalType=UINT8, ComHandleId=10292, ComSystemTemplateSystemSignalRef=OBJ_YAW_RATE_ERR_036
          OBJ_POS_LAT_036_oRDR_TRACKER_OBJ_036_oPCAN_RADAR_6982b971_Tx: ComBitPosition=79, ComBitSize=16, ComSignalType=UINT16, ComHandleId=10274, ComSystemTemplateSystemSignalRef=OBJ_POS_LAT_036
          OBJ_CLS_TYPE6_PROB_036_oRDR_TRACKER_OBJ_036_oPCAN_RADAR_fdcc6ddb_Tx: ComBitPosition=343, ComBitSize=8, ComSignalType=UINT8, ComHandleId=10261, ComSystemTemplateSystemSignalRef=OBJ_CLS_TYPE6_PROB_036
          OBJ_POS_LAT_ERR_036_oRDR_TRACKER_OBJ_036_oPCAN_RADAR_6dcee946_Tx: ComBitPosition=103, ComBitSize=8, ComSignalType=UINT8, ComHandleId=10275, ComSystemTemplateSystemSignalRef=OBJ_POS_LAT_ERR_036
          OBJ_VELOCITY_LAT_ERR_036_oRDR_TRACKER_OBJ_036_oPCAN_RADAR_191b8c07_Tx: ComBitPosition=151, ComBitSize=8, ComSignalType=UINT8, ComHandleId=10286, ComSystemTemplateSystemSignalRef=OBJ_VELOCITY_LAT_ERR_036
          OBJ_YAW_ANGLE_036_oRDR_TRACKER_OBJ_036_oPCAN_RADAR_c15db816_Tx: ComBitPosition=155, ComBitSize=12, ComSignalType=UINT16, ComHandleId=10289, ComSystemTemplateSystemSignalRef=OBJ_YAW_ANGLE_036
          OBJ_ACCELERATION_LAT_036_oRDR_TRACKER_OBJ_036_oPCAN_RADAR_ded48ff2_Tx: ComBitPosition=177, ComBitSize=10, ComSignalType=UINT16, ComHandleId=10244, ComSystemTemplateSystemSignalRef=OBJ_ACCELERATION_LAT_036
          OBJ_VELOCITY_ERR_CRR_COEF_036_oRDR_TRACKER_OBJ_036_oPCAN_RADAR_225779dc_Tx: ComBitPosition=423, ComBitSize=8, ComSignalType=UINT8, ComHandleId=10284, ComSystemTemplateSystemSignalRef=OBJ_VELOCITY_ERR_CRR_COEF_036
          OBJ_REF_PT_LONG_OFFSET_036_oRDR_TRACKER_OBJ_036_oPCAN_RADAR_f1227400_Tx: ComBitPosition=357, ComBitSize=14, ComSignalType=UINT16, ComHandleId=10280, ComSystemTemplateSystemSignalRef=OBJ_REF_PT_LONG_OFFSET_036
          OBJ_ACCELERATION_LONG_ERR_036_oRDR_TRACKER_OBJ_036_oPCAN_RADAR_148510e6_Tx: ComBitPosition=215, ComBitSize=8, ComSignalType=UINT8, ComHandleId=10247, ComSystemTemplateSystemSignalRef=OBJ_ACCELERATION_LONG_ERR_036
          OBJ_POS_ERR_CRR_COEF_036_oRDR_TRACKER_OBJ_036_oPCAN_RADAR_8b2d443d_Tx: ComBitPosition=415, ComBitSize=8, ComSignalType=UINT8, ComHandleId=10273, ComSystemTemplateSystemSignalRef=OBJ_POS_ERR_CRR_COEF_036
          OBJ_TRACK_MOTION_MODEL_036_oRDR_TRACKER_OBJ_036_oPCAN_RADAR_87e2eefd_Tx: ComBitPosition=9, ComBitSize=2, ComSignalType=UINT8, ComHandleId=10282, ComSystemTemplateSystemSignalRef=OBJ_TRACK_MOTION_MODEL_036
          OBJ_CLS_TYPE3_036_oRDR_TRACKER_OBJ_036_oPCAN_RADAR_9bfe810d_Tx: ComBitPosition=279, ComBitSize=4, ComSignalType=UINT8, ComHandleId=10254, ComSystemTemplateSystemSignalRef=OBJ_CLS_TYPE3_036
          OBJ_DIMENSION_WIDTH_ERR_036_oRDR_TRACKER_OBJ_036_oPCAN_RADAR_da6c1f89_Tx: ComBitPosition=23, ComBitSize=6, ComSignalType=UINT8, ComHandleId=10265, ComSystemTemplateSystemSignalRef=OBJ_DIMENSION_WIDTH_ERR_036
          OBJ_MOVEMENT_STATUS_036_oRDR_TRACKER_OBJ_036_oPCAN_RADAR_1b528407_Tx: ComBitPosition=196, ComBitSize=3, ComSignalType=UINT8, ComHandleId=10272, ComSystemTemplateSystemSignalRef=OBJ_MOVEMENT_STATUS_036
          OBJ_TIMESTAMP_OFFSET_036_oRDR_TRACKER_OBJ_036_oPCAN_RADAR_4be1ef20_Tx: ComBitPosition=247, ComBitSize=8, ComSignalType=UINT8, ComHandleId=10281, ComSystemTemplateSystemSignalRef=OBJ_TIMESTAMP_OFFSET_036
          OBJ_EXISTENCE_PROB_036_oRDR_TRACKER_OBJ_036_oPCAN_RADAR_31725c5c_Tx: ComBitPosition=229, ComBitSize=14, ComSignalType=UINT16, ComHandleId=10266, ComSystemTemplateSystemSignalRef=OBJ_EXISTENCE_PROB_036
          OBJ_VEH_TRACK_FLAG_036_oRDR_TRACKER_OBJ_036_oPCAN_RADAR_05c818a0_Tx: ComBitPosition=10, ComBitSize=1, ComSignalType=BOOLEAN, ComHandleId=10283, ComSystemTemplateSystemSignalRef=OBJ_VEH_TRACK_FLAG_036
          OBJ_MH_CYCLE_COUNTER_036_oRDR_TRACKER_OBJ_036_oPCAN_RADAR_3978fc96_Tx: ComBitPosition=487, ComBitSize=8, ComSignalType=UINT8, ComHandleId=10271, ComSystemTemplateSystemSignalRef=OBJ_MH_CYCLE_COUNTER_036
          OBJ_MH_CRC16_036_oRDR_TRACKER_OBJ_036_oPCAN_RADAR_489ca677_Tx: ComBitPosition=495, ComBitSize=16, ComSignalType=UINT16, ComHandleId=10270, ComSystemTemplateSystemSignalRef=OBJ_MH_CRC16_036
      SG_TrackerObject008_oRDR_TRACKER_OBJ_008_oPCAN_RADAR_f9caaab2_Tx (ComSignalGroup):
        ComTransferProperty = TRIGGERED
        ComSignalGroupAccess = ACCESS_NEEDED_BY_SWC_OR_COM
        ComHandleId = 117
        ComSignalGroupArrayAccess = true
        ComSystemTemplateSignalGroupRef = SG_TrackerObject008
        49 x ComGroupSignal, all with ComSignalEndianness=BIG_ENDIAN, ComSignalInitValue=0, ComTransferProperty=PENDING, ComSignalAccess=ACCESS_NEEDED_BY_SWC_OR_COM:
          OBJ_CLS_TYPE4_PROB_008_oRDR_TRACKER_OBJ_008_oPCAN_RADAR_5ad1fe1a_Tx: ComBitPosition=327, ComBitSize=8, ComSignalType=UINT8, ComHandleId=8885, ComSystemTemplateSystemSignalRef=OBJ_CLS_TYPE4_PROB_008
          OBJ_VELOCITY_LONG_ERR_008_oRDR_TRACKER_OBJ_008_oPCAN_RADAR_dca3cdf0_Tx: ComBitPosition=143, ComBitSize=8, ComSignalType=UINT8, ComHandleId=8916, ComSystemTemplateSystemSignalRef=OBJ_VELOCITY_LONG_ERR_008
          OBJ_CLS_TYPE4_008_oRDR_TRACKER_OBJ_008_oPCAN_RADAR_a49c0216_Tx: ComBitPosition=275, ComBitSize=4, ComSignalType=UINT8, ComHandleId=8884, ComSystemTemplateSystemSignalRef=OBJ_CLS_TYPE4_008
          OBJ_CLS_TYPE6_008_oRDR_TRACKER_OBJ_008_oPCAN_RADAR_64fcff93_Tx: ComBitPosition=282, ComBitSize=4, ComSignalType=UINT8, ComHandleId=8888, ComSystemTemplateSystemSignalRef=OBJ_CLS_TYPE6_008
          OBJ_ALIVE_TIME_008_oRDR_TRACKER_OBJ_008_oPCAN_RADAR_e57fe399_Tx: ComBitPosition=255, ComBitSize=16, ComSignalType=UINT16, ComHandleId=8877, ComSystemTemplateSystemSignalRef=OBJ_ALIVE_TIME_008
          OBJ_REF_PT_LAT_OFFSET_008_oRDR_TRACKER_OBJ_008_oPCAN_RADAR_974afa34_Tx: ComBitPosition=370, ComBitSize=14, ComSignalType=UINT16, ComHandleId=8907, ComSystemTemplateSystemSignalRef=OBJ_REF_PT_LAT_OFFSET_008
          OBJ_ACCELERATION_LAT_008_oRDR_TRACKER_OBJ_008_oPCAN_RADAR_f7eef1c5_Tx: ComBitPosition=177, ComBitSize=10, ComSignalType=UINT16, ComHandleId=8872, ComSystemTemplateSystemSignalRef=OBJ_ACCELERATION_LAT_008
          OBJ_ACCEL_ERR_CRR_COEF_008_oRDR_TRACKER_OBJ_008_oPCAN_RADAR_9d1c4fb7_Tx: ComBitPosition=431, ComBitSize=8, ComSignalType=UINT8, ComHandleId=8876, ComSystemTemplateSystemSignalRef=OBJ_ACCEL_ERR_CRR_COEF_008
          OBJ_CLS_TYPE6_PROB_008_oRDR_TRACKER_OBJ_008_oPCAN_RADAR_d4f613ec_Tx: ComBitPosition=343, ComBitSize=8, ComSignalType=UINT8, ComHandleId=8889, ComSystemTemplateSystemSignalRef=OBJ_CLS_TYPE6_PROB_008
          OBJ_VELOCITY_LONG_008_oRDR_TRACKER_OBJ_008_oPCAN_RADAR_5456faa7_Tx: ComBitPosition=110, ComBitSize=15, ComSignalType=UINT16, ComHandleId=8915, ComSystemTemplateSystemSignalRef=OBJ_VELOCITY_LONG_008
          OBJ_EXISTENCE_PROB_008_oRDR_TRACKER_OBJ_008_oPCAN_RADAR_1848226b_Tx: ComBitPosition=229, ComBitSize=14, ComSignalType=UINT16, ComHandleId=8894, ComSystemTemplateSystemSignalRef=OBJ_EXISTENCE_PROB_008
          OBJ_VEH_TRACK_FLAG_008_oRDR_TRACKER_OBJ_008_oPCAN_RADAR_2cf26697_Tx: ComBitPosition=10, ComBitSize=1, ComSignalType=BOOLEAN, ComHandleId=8911, ComSystemTemplateSystemSignalRef=OBJ_VEH_TRACK_FLAG_008
          OBJ_CLS_TYPE5_PROB_008_oRDR_TRACKER_OBJ_008_oPCAN_RADAR_1dc208e1_Tx: ComBitPosition=335, ComBitSize=8, ComSignalType=UINT8, ComHandleId=8887, ComSystemTemplateSystemSignalRef=OBJ_CLS_TYPE5_PROB_008
          OBJ_POS_LAT_008_oRDR_TRACKER_OBJ_008_oPCAN_RADAR_40b8c746_Tx: ComBitPosition=79, ComBitSize=16, ComSignalType=UINT16, ComHandleId=8902, ComSystemTemplateSystemSignalRef=OBJ_POS_LAT_008
          OBJ_CLS_TYPE2_PROB_008_oRDR_TRACKER_OBJ_008_oPCAN_RADAR_13c8ce41_Tx: ComBitPosition=311, ComBitSize=8, ComSignalType=UINT8, ComHandleId=8881, ComSystemTemplateSystemSignalRef=OBJ_CLS_TYPE2_PROB_008
          OBJ_TIMESTAMP_OFFSET_008_oRDR_TRACKER_OBJ_008_oPCAN_RADAR_62db9117_Tx: ComBitPosition=247, ComBitSize=8, ComSignalType=UINT8, ComHandleId=8909, ComSystemTemplateSystemSignalRef=OBJ_TIMESTAMP_OFFSET_008
          OBJ_YAW_ANGLE_008_oRDR_TRACKER_OBJ_008_oPCAN_RADAR_e867c621_Tx: ComBitPosition=155, ComBitSize=12, ComSignalType=UINT16, ComHandleId=8917, ComSystemTemplateSystemSignalRef=OBJ_YAW_ANGLE_008
          OBJ_POS_ERR_CRR_COEF_008_oRDR_TRACKER_OBJ_008_oPCAN_RADAR_a2173a0a_Tx: ComBitPosition=415, ComBitSize=8, ComSignalType=UINT8, ComHandleId=8901, ComSystemTemplateSystemSignalRef=OBJ_POS_ERR_CRR_COEF_008
          OBJ_CLS_TYPE1_008_oRDR_TRACKER_OBJ_008_oPCAN_RADAR_72a402bf_Tx: ComBitPosition=271, ComBitSize=4, ComSignalType=UINT8, ComHandleId=8878, ComSystemTemplateSystemSignalRef=OBJ_CLS_TYPE1_008
          OBJ_ACCELERATION_LONG_008_oRDR_TRACKER_OBJ_008_oPCAN_RADAR_851ea825_Tx: ComBitPosition=193, ComBitSize=10, ComSignalType=UINT16, ComHandleId=8874, ComSystemTemplateSystemSignalRef=OBJ_ACCELERATION_LONG_008
          OBJ_CLS_TYPE3_PROB_008_oRDR_TRACKER_OBJ_008_oPCAN_RADAR_54db38ba_Tx: ComBitPosition=319, ComBitSize=8, ComSignalType=UINT8, ComHandleId=8883, ComSystemTemplateSystemSignalRef=OBJ_CLS_TYPE3_PROB_008
          OBJ_GROUP_ID_008_oRDR_TRACKER_OBJ_008_oPCAN_RADAR_913a36c6_Tx: ComBitPosition=405, ComBitSize=6, ComSignalType=UINT8, ComHandleId=8895, ComSystemTemplateSystemSignalRef=OBJ_GROUP_ID_008
          OBJ_DIMENSION_LENGTH_008_oRDR_TRACKER_OBJ_008_oPCAN_RADAR_303a51fb_Tx: ComBitPosition=37, ComBitSize=12, ComSignalType=UINT16, ComHandleId=8890, ComSystemTemplateSystemSignalRef=OBJ_DIMENSION_LENGTH_008
          OBJ_CLS_TYPE2_008_oRDR_TRACKER_OBJ_008_oPCAN_RADAR_3f4c02d8_Tx: ComBitPosition=267, ComBitSize=4, ComSignalType=UINT8, ComHandleId=8880, ComSystemTemplateSystemSignalRef=OBJ_CLS_TYPE2_008
          OBJ_RCS_008_oRDR_TRACKER_OBJ_008_oPCAN_RADAR_62779141_Tx: ComBitPosition=351, ComBitSize=7, ComSignalType=UINT8, ComHandleId=8906, ComSystemTemplateSystemSignalRef=OBJ_RCS_008
          OBJ_YAW_ANGLE_ERR_008_oRDR_TRACKER_OBJ_008_oPCAN_RADAR_3d6ac0f6_Tx: ComBitPosition=175, ComBitSize=7, ComSignalType=UINT8, ComHandleId=8918, ComSystemTemplateSystemSignalRef=OBJ_YAW_ANGLE_ERR_008
          OBJ_REF_PT_LONG_OFFSET_008_oRDR_TRACKER_OBJ_008_oPCAN_RADAR_d8180a37_Tx: ComBitPosition=357, ComBitSize=14, ComSignalType=UINT16, ComHandleId=8908, ComSystemTemplateSystemSignalRef=OBJ_REF_PT_LONG_OFFSET_008
          OBJ_VELOCITY_LAT_ERR_008_oRDR_TRACKER_OBJ_008_oPCAN_RADAR_3021f230_Tx: ComBitPosition=151, ComBitSize=8, ComSignalType=UINT8, ComHandleId=8914, ComSystemTemplateSystemSignalRef=OBJ_VELOCITY_LAT_ERR_008
          OBJ_MOVEMENT_STATUS_008_oRDR_TRACKER_OBJ_008_oPCAN_RADAR_3268fa30_Tx: ComBitPosition=196, ComBitSize=3, ComSignalType=UINT8, ComHandleId=8900, ComSystemTemplateSystemSignalRef=OBJ_MOVEMENT_STATUS_008
          OBJ_TRACK_MOTION_MODEL_008_oRDR_TRACKER_OBJ_008_oPCAN_RADAR_aed890ca_Tx: ComBitPosition=9, ComBitSize=2, ComSignalType=UINT8, ComHandleId=8910, ComSystemTemplateSystemSignalRef=OBJ_TRACK_MOTION_MODEL_008
          OBJ_ACCELERATION_LAT_ERR_008_oRDR_TRACKER_OBJ_008_oPCAN_RADAR_221acb7b_Tx: ComBitPosition=223, ComBitSize=8, ComSignalType=UINT8, ComHandleId=8873, ComSystemTemplateSystemSignalRef=OBJ_ACCELERATION_LAT_ERR_008
          OBJ_CLS_TYPE1_PROB_008_oRDR_TRACKER_OBJ_008_oPCAN_RADAR_dafcd54c_Tx: ComBitPosition=303, ComBitSize=8, ComSignalType=UINT8, ComHandleId=8879, ComSystemTemplateSystemSignalRef=OBJ_CLS_TYPE1_PROB_008
          OBJ_CLS_TYPE5_008_oRDR_TRACKER_OBJ_008_oPCAN_RADAR_2914fff4_Tx: ComBitPosition=287, ComBitSize=4, ComSignalType=UINT8, ComHandleId=8886, ComSystemTemplateSystemSignalRef=OBJ_CLS_TYPE5_008
          OBJ_ACCELERATION_LONG_ERR_008_oRDR_TRACKER_OBJ_008_oPCAN_RADAR_3dbf6ed1_Tx: ComBitPosition=215, ComBitSize=8, ComSignalType=UINT8, ComHandleId=8875, ComSystemTemplateSystemSignalRef=OBJ_ACCELERATION_LONG_ERR_008
          OBJ_POS_LONG_008_oRDR_TRACKER_OBJ_008_oPCAN_RADAR_f1182c89_Tx: ComBitPosition=63, ComBitSize=16, ComSignalType=UINT16, ComHandleId=8904, ComSystemTemplateSystemSignalRef=OBJ_POS_LONG_008
          OBJ_VELOCITY_ERR_CRR_COEF_008_oRDR_TRACKER_OBJ_008_oPCAN_RADAR_0b6d07eb_Tx: ComBitPosition=423, ComBitSize=8, ComSignalType=UINT8, ComHandleId=8912, ComSystemTemplateSystemSignalRef=OBJ_VELOCITY_ERR_CRR_COEF_008
          OBJ_POS_LAT_ERR_008_oRDR_TRACKER_OBJ_008_oPCAN_RADAR_44f49771_Tx: ComBitPosition=103, ComBitSize=8, ComSignalType=UINT8, ComHandleId=8903, ComSystemTemplateSystemSignalRef=OBJ_POS_LAT_ERR_008
          OBJ_MEASUREMENT_STATUS_008_oRDR_TRACKER_OBJ_008_oPCAN_RADAR_1dc66f7c_Tx: ComBitPosition=14, ComBitSize=3, ComSignalType=UINT8, ComHandleId=8897, ComSystemTemplateSystemSignalRef=OBJ_MEASUREMENT_STATUS_008
          OBJ_DIMENSION_WIDTH_ERR_008_oRDR_TRACKER_OBJ_008_oPCAN_RADAR_f35661be_Tx: ComBitPosition=23, ComBitSize=6, ComSignalType=UINT8, ComHandleId=8893, ComSystemTemplateSystemSignalRef=OBJ_DIMENSION_WIDTH_ERR_008
          OBJ_DIMENSION_LENGTH_ERR_008_oRDR_TRACKER_OBJ_008_oPCAN_RADAR_0bc24e81_Tx: ComBitPosition=41, ComBitSize=10, ComSignalType=UINT16, ComHandleId=8891, ComSystemTemplateSystemSignalRef=OBJ_DIMENSION_LENGTH_ERR_008
          OBJ_ID_008_oRDR_TRACKER_OBJ_008_oPCAN_RADAR_62141dc1_Tx: ComBitPosition=7, ComBitSize=8, ComSignalType=UINT8, ComHandleId=8896, ComSystemTemplateSystemSignalRef=OBJ_ID_008
          OBJ_POS_LONG_ERR_008_oRDR_TRACKER_OBJ_008_oPCAN_RADAR_dd0c6993_Tx: ComBitPosition=95, ComBitSize=8, ComSignalType=UINT8, ComHandleId=8905, ComSystemTemplateSystemSignalRef=OBJ_POS_LONG_ERR_008
          OBJ_YAW_RATE_008_oRDR_TRACKER_OBJ_008_oPCAN_RADAR_cde8e366_Tx: ComBitPosition=399, ComBitSize=10, ComSignalType=UINT16, ComHandleId=8919, ComSystemTemplateSystemSignalRef=OBJ_YAW_RATE_008
          OBJ_VELOCITY_LAT_008_oRDR_TRACKER_OBJ_008_oPCAN_RADAR_04db8261_Tx: ComBitPosition=126, ComBitSize=15, ComSignalType=UINT16, ComHandleId=8913, ComSystemTemplateSystemSignalRef=OBJ_VELOCITY_LAT_008
          OBJ_YAW_RATE_ERR_008_oRDR_TRACKER_OBJ_008_oPCAN_RADAR_f23074ba_Tx: ComBitPosition=388, ComBitSize=5, ComSignalType=UINT8, ComHandleId=8920, ComSystemTemplateSystemSignalRef=OBJ_YAW_RATE_ERR_008
          OBJ_DIMENSION_WIDTH_008_oRDR_TRACKER_OBJ_008_oPCAN_RADAR_13f4a656_Tx: ComBitPosition=17, ComBitSize=10, ComSignalType=UINT16, ComHandleId=8892, ComSystemTemplateSystemSignalRef=OBJ_DIMENSION_WIDTH_008
          OBJ_CLS_TYPE3_008_oRDR_TRACKER_OBJ_008_oPCAN_RADAR_b2c4ff3a_Tx: ComBitPosition=279, ComBitSize=4, ComSignalType=UINT8, ComHandleId=8882, ComSystemTemplateSystemSignalRef=OBJ_CLS_TYPE3_008
          OBJ_MH_CYCLE_COUNTER_008_oRDR_TRACKER_OBJ_008_oPCAN_RADAR_104282a1_Tx: ComBitPosition=487, ComBitSize=8, ComSignalType=UINT8, ComHandleId=8899, ComSystemTemplateSystemSignalRef=OBJ_MH_CYCLE_COUNTER_008
          OBJ_MH_CRC16_008_oRDR_TRACKER_OBJ_008_oPCAN_RADAR_61a6d840_Tx: ComBitPosition=495, ComBitSize=16, ComSignalType=UINT16, ComHandleId=8898, ComSystemTemplateSystemSignalRef=OBJ_MH_CRC16_008
      RDR_DETECTION_253_256_oPCAN_RADAR_b8499d26_Tx (ComIPdu):
        ComIPduDirection = SEND
        ComIPduType = NORMAL
        ComIPduCancellationSupport = false
        ComIPduHandleId = 69
        ComIPduSignalProcessing = DEFERRED
        ComIPduChannelRef = CN_PCAN_RADAR_458ff0f1
        ComIPduGroupRef = RDR01_oPCAN_RADAR_Tx_b6bdb067 if post-build-variant-condition{matching-criterion=RDR_POS, value=0}
        ComIPduSignalGroupRef = SG_Detections_253_256_oRDR_DETECTION_253_256_oPCAN_RADAR_ea41e878_Tx
        ComPduIdRef = RDR_DETECTION_253_256_oPCAN_RADAR_b8499d26_Tx
        ComIPduMainFunctionRef = ComMainFunctionTx_Event
        ComIPduGroupRef = RDR02_oPCAN_RADAR_Tx_9f750495 if post-build-variant-condition{matching-criterion=RDR_POS, value=1}
        ComIPduGroupRef = RDR03_oPCAN_RADAR_Tx_311d9504 if post-build-variant-condition{matching-criterion=RDR_POS, value=2}
        ComIPduGroupRef = RDR04_oPCAN_RADAR_Tx_cce46d71 if post-build-variant-condition{matching-criterion=RDR_POS, value=3}
        ComIPduGroupRef = RDR05_oPCAN_RADAR_Tx_628cfce0 if post-build-variant-condition{matching-criterion=RDR_POS, value=4}
        ComIPduGroupRef = RDR06_oPCAN_RADAR_Tx_4b444812 if post-build-variant-condition{matching-criterion=RDR_POS, value=5}
        ComIPduGroupRef = RDR07_oPCAN_RADAR_Tx_e52cd983 if post-build-variant-condition{matching-criterion=RDR_POS, value=6}
        ComIPduGroupRef = RDR08_oPCAN_RADAR_Tx_6bc6beb9 if post-build-variant-condition{matching-criterion=RDR_POS, value=7}
        ComTxIPdu: ComMinimumDelayTime=0, ComTxIPduUnusedAreasDefault=0
          ComTxModeTrue
            ComTxMode: ComTxModeMode=DIRECT, ComTxModeNumberOfRepetitions=0
          ComTxModeFalse
            ComTxMode: ComTxModeMode=NONE
      SG_TrackerObject055_oRDR_TRACKER_OBJ_055_oPCAN_RADAR_34a97ad4_Tx (ComSignalGroup):
        ComTransferProperty = TRIGGERED
        ComSignalGroupAccess = ACCESS_NEEDED_BY_SWC_OR_COM
        ComHandleId = 164
        ComSignalGroupArrayAccess = true
        ComSystemTemplateSignalGroupRef = SG_TrackerObject055
        49 x ComGroupSignal, all with ComSignalEndianness=BIG_ENDIAN, ComSignalInitValue=0, ComTransferProperty=PENDING, ComSignalAccess=ACCESS_NEEDED_BY_SWC_OR_COM:
          OBJ_CLS_TYPE4_PROB_055_oRDR_TRACKER_OBJ_055_oPCAN_RADAR_97b22e7c_Tx: ComBitPosition=327, ComBitSize=8, ComSignalType=UINT8, ComHandleId=11188, ComSystemTemplateSystemSignalRef=OBJ_CLS_TYPE4_PROB_055
          OBJ_REF_PT_LAT_OFFSET_055_oRDR_TRACKER_OBJ_055_oPCAN_RADAR_5a292a52_Tx: ComBitPosition=370, ComBitSize=14, ComSignalType=UINT16, ComHandleId=11210, ComSystemTemplateSystemSignalRef=OBJ_REF_PT_LAT_OFFSET_055
          OBJ_POS_LAT_055_oRDR_TRACKER_OBJ_055_oPCAN_RADAR_8ddb1720_Tx: ComBitPosition=79, ComBitSize=16, ComSignalType=UINT16, ComHandleId=11205, ComSystemTemplateSystemSignalRef=OBJ_POS_LAT_055
          OBJ_CLS_TYPE5_055_oRDR_TRACKER_OBJ_055_oPCAN_RADAR_e4772f92_Tx: ComBitPosition=287, ComBitSize=4, ComSignalType=UINT8, ComHandleId=11189, ComSystemTemplateSystemSignalRef=OBJ_CLS_TYPE5_055
          OBJ_YAW_RATE_055_oRDR_TRACKER_OBJ_055_oPCAN_RADAR_008b3300_Tx: ComBitPosition=399, ComBitSize=10, ComSignalType=UINT16, ComHandleId=11222, ComSystemTemplateSystemSignalRef=OBJ_YAW_RATE_055
          OBJ_ACCELERATION_LAT_055_oRDR_TRACKER_OBJ_055_oPCAN_RADAR_3a8d21a3_Tx: ComBitPosition=177, ComBitSize=10, ComSignalType=UINT16, ComHandleId=11175, ComSystemTemplateSystemSignalRef=OBJ_ACCELERATION_LAT_055
          OBJ_CLS_TYPE6_PROB_055_oRDR_TRACKER_OBJ_055_oPCAN_RADAR_1995c38a_Tx: ComBitPosition=343, ComBitSize=8, ComSignalType=UINT8, ComHandleId=11192, ComSystemTemplateSystemSignalRef=OBJ_CLS_TYPE6_PROB_055
          OBJ_VEH_TRACK_FLAG_055_oRDR_TRACKER_OBJ_055_oPCAN_RADAR_e191b6f1_Tx: ComBitPosition=10, ComBitSize=1, ComSignalType=BOOLEAN, ComHandleId=11214, ComSystemTemplateSystemSignalRef=OBJ_VEH_TRACK_FLAG_055
          OBJ_CLS_TYPE4_055_oRDR_TRACKER_OBJ_055_oPCAN_RADAR_69ffd270_Tx: ComBitPosition=275, ComBitSize=4, ComSignalType=UINT8, ComHandleId=11187, ComSystemTemplateSystemSignalRef=OBJ_CLS_TYPE4_055
          OBJ_YAW_ANGLE_055_oRDR_TRACKER_OBJ_055_oPCAN_RADAR_25041647_Tx: ComBitPosition=155, ComBitSize=12, ComSignalType=UINT16, ComHandleId=11220, ComSystemTemplateSystemSignalRef=OBJ_YAW_ANGLE_055
          OBJ_YAW_ANGLE_ERR_055_oRDR_TRACKER_OBJ_055_oPCAN_RADAR_f0091090_Tx: ComBitPosition=175, ComBitSize=7, ComSignalType=UINT8, ComHandleId=11221, ComSystemTemplateSystemSignalRef=OBJ_YAW_ANGLE_ERR_055
          OBJ_POS_LONG_ERR_055_oRDR_TRACKER_OBJ_055_oPCAN_RADAR_106fb9f5_Tx: ComBitPosition=95, ComBitSize=8, ComSignalType=UINT8, ComHandleId=11208, ComSystemTemplateSystemSignalRef=OBJ_POS_LONG_ERR_055
          OBJ_VELOCITY_LONG_ERR_055_oRDR_TRACKER_OBJ_055_oPCAN_RADAR_11c01d96_Tx: ComBitPosition=143, ComBitSize=8, ComSignalType=UINT8, ComHandleId=11219, ComSystemTemplateSystemSignalRef=OBJ_VELOCITY_LONG_ERR_055
          OBJ_CLS_TYPE1_055_oRDR_TRACKER_OBJ_055_oPCAN_RADAR_bfc7d2d9_Tx: ComBitPosition=271, ComBitSize=4, ComSignalType=UINT8, ComHandleId=11181, ComSystemTemplateSystemSignalRef=OBJ_CLS_TYPE1_055
          OBJ_DIMENSION_WIDTH_ERR_055_oRDR_TRACKER_OBJ_055_oPCAN_RADAR_3e35b1d8_Tx: ComBitPosition=23, ComBitSize=6, ComSignalType=UINT8, ComHandleId=11196, ComSystemTemplateSystemSignalRef=OBJ_DIMENSION_WIDTH_ERR_055
          OBJ_EXISTENCE_PROB_055_oRDR_TRACKER_OBJ_055_oPCAN_RADAR_d52bf20d_Tx: ComBitPosition=229, ComBitSize=14, ComSignalType=UINT16, ComHandleId=11197, ComSystemTemplateSystemSignalRef=OBJ_EXISTENCE_PROB_055
          OBJ_ID_055_oRDR_TRACKER_OBJ_055_oPCAN_RADAR_af77cda7_Tx: ComBitPosition=7, ComBitSize=8, ComSignalType=UINT8, ComHandleId=11199, ComSystemTemplateSystemSignalRef=OBJ_ID_055
          OBJ_VELOCITY_LAT_055_oRDR_TRACKER_OBJ_055_oPCAN_RADAR_c9b85207_Tx: ComBitPosition=126, ComBitSize=15, ComSignalType=UINT16, ComHandleId=11216, ComSystemTemplateSystemSignalRef=OBJ_VELOCITY_LAT_055
          OBJ_ACCELERATION_LONG_ERR_055_oRDR_TRACKER_OBJ_055_oPCAN_RADAR_f0dcbeb7_Tx: ComBitPosition=215, ComBitSize=8, ComSignalType=UINT8, ComHandleId=11178, ComSystemTemplateSystemSignalRef=OBJ_ACCELERATION_LONG_ERR_055
          OBJ_DIMENSION_WIDTH_055_oRDR_TRACKER_OBJ_055_oPCAN_RADAR_de977630_Tx: ComBitPosition=17, ComBitSize=10, ComSignalType=UINT16, ComHandleId=11195, ComSystemTemplateSystemSignalRef=OBJ_DIMENSION_WIDTH_055
          OBJ_CLS_TYPE3_055_oRDR_TRACKER_OBJ_055_oPCAN_RADAR_7fa72f5c_Tx: ComBitPosition=279, ComBitSize=4, ComSignalType=UINT8, ComHandleId=11185, ComSystemTemplateSystemSignalRef=OBJ_CLS_TYPE3_055
          OBJ_CLS_TYPE2_055_oRDR_TRACKER_OBJ_055_oPCAN_RADAR_f22fd2be_Tx: ComBitPosition=267, ComBitSize=4, ComSignalType=UINT8, ComHandleId=11183, ComSystemTemplateSystemSignalRef=OBJ_CLS_TYPE2_055
          OBJ_DIMENSION_LENGTH_ERR_055_oRDR_TRACKER_OBJ_055_oPCAN_RADAR_c6a19ee7_Tx: ComBitPosition=41, ComBitSize=10, ComSignalType=UINT16, ComHandleId=11194, ComSystemTemplateSystemSignalRef=OBJ_DIMENSION_LENGTH_ERR_055
          OBJ_REF_PT_LONG_OFFSET_055_oRDR_TRACKER_OBJ_055_oPCAN_RADAR_157bda51_Tx: ComBitPosition=357, ComBitSize=14, ComSignalType=UINT16, ComHandleId=11211, ComSystemTemplateSystemSignalRef=OBJ_REF_PT_LONG_OFFSET_055
          OBJ_TRACK_MOTION_MODEL_055_oRDR_TRACKER_OBJ_055_oPCAN_RADAR_63bb40ac_Tx: ComBitPosition=9, ComBitSize=2, ComSignalType=UINT8, ComHandleId=11213, ComSystemTemplateSystemSignalRef=OBJ_TRACK_MOTION_MODEL_055
          OBJ_VELOCITY_LAT_ERR_055_oRDR_TRACKER_OBJ_055_oPCAN_RADAR_fd422256_Tx: ComBitPosition=151, ComBitSize=8, ComSignalType=UINT8, ComHandleId=11217, ComSystemTemplateSystemSignalRef=OBJ_VELOCITY_LAT_ERR_055
          OBJ_CLS_TYPE2_PROB_055_oRDR_TRACKER_OBJ_055_oPCAN_RADAR_deab1e27_Tx: ComBitPosition=311, ComBitSize=8, ComSignalType=UINT8, ComHandleId=11184, ComSystemTemplateSystemSignalRef=OBJ_CLS_TYPE2_PROB_055
          OBJ_RCS_055_oRDR_TRACKER_OBJ_055_oPCAN_RADAR_af144127_Tx: ComBitPosition=351, ComBitSize=7, ComSignalType=UINT8, ComHandleId=11209, ComSystemTemplateSystemSignalRef=OBJ_RCS_055
          OBJ_TIMESTAMP_OFFSET_055_oRDR_TRACKER_OBJ_055_oPCAN_RADAR_afb84171_Tx: ComBitPosition=247, ComBitSize=8, ComSignalType=UINT8, ComHandleId=11212, ComSystemTemplateSystemSignalRef=OBJ_TIMESTAMP_OFFSET_055
          OBJ_VELOCITY_ERR_CRR_COEF_055_oRDR_TRACKER_OBJ_055_oPCAN_RADAR_c60ed78d_Tx: ComBitPosition=423, ComBitSize=8, ComSignalType=UINT8, ComHandleId=11215, ComSystemTemplateSystemSignalRef=OBJ_VELOCITY_ERR_CRR_COEF_055
          OBJ_CLS_TYPE5_PROB_055_oRDR_TRACKER_OBJ_055_oPCAN_RADAR_d0a1d887_Tx: ComBitPosition=335, ComBitSize=8, ComSignalType=UINT8, ComHandleId=11190, ComSystemTemplateSystemSignalRef=OBJ_CLS_TYPE5_PROB_055
          OBJ_ACCELERATION_LONG_055_oRDR_TRACKER_OBJ_055_oPCAN_RADAR_487d7843_Tx: ComBitPosition=193, ComBitSize=10, ComSignalType=UINT16, ComHandleId=11177, ComSystemTemplateSystemSignalRef=OBJ_ACCELERATION_LONG_055
          OBJ_ACCELERATION_LAT_ERR_055_oRDR_TRACKER_OBJ_055_oPCAN_RADAR_ef791b1d_Tx: ComBitPosition=223, ComBitSize=8, ComSignalType=UINT8, ComHandleId=11176, ComSystemTemplateSystemSignalRef=OBJ_ACCELERATION_LAT_ERR_055
          OBJ_MEASUREMENT_STATUS_055_oRDR_TRACKER_OBJ_055_oPCAN_RADAR_d0a5bf1a_Tx: ComBitPosition=14, ComBitSize=3, ComSignalType=UINT8, ComHandleId=11200, ComSystemTemplateSystemSignalRef=OBJ_MEASUREMENT_STATUS_055
          OBJ_ACCEL_ERR_CRR_COEF_055_oRDR_TRACKER_OBJ_055_oPCAN_RADAR_507f9fd1_Tx: ComBitPosition=431, ComBitSize=8, ComSignalType=UINT8, ComHandleId=11179, ComSystemTemplateSystemSignalRef=OBJ_ACCEL_ERR_CRR_COEF_055
          OBJ_YAW_RATE_ERR_055_oRDR_TRACKER_OBJ_055_oPCAN_RADAR_3f53a4dc_Tx: ComBitPosition=388, ComBitSize=5, ComSignalType=UINT8, ComHandleId=11223, ComSystemTemplateSystemSignalRef=OBJ_YAW_RATE_ERR_055
          OBJ_POS_ERR_CRR_COEF_055_oRDR_TRACKER_OBJ_055_oPCAN_RADAR_6f74ea6c_Tx: ComBitPosition=415, ComBitSize=8, ComSignalType=UINT8, ComHandleId=11204, ComSystemTemplateSystemSignalRef=OBJ_POS_ERR_CRR_COEF_055
          OBJ_CLS_TYPE1_PROB_055_oRDR_TRACKER_OBJ_055_oPCAN_RADAR_179f052a_Tx: ComBitPosition=303, ComBitSize=8, ComSignalType=UINT8, ComHandleId=11182, ComSystemTemplateSystemSignalRef=OBJ_CLS_TYPE1_PROB_055
          OBJ_DIMENSION_LENGTH_055_oRDR_TRACKER_OBJ_055_oPCAN_RADAR_fd59819d_Tx: ComBitPosition=37, ComBitSize=12, ComSignalType=UINT16, ComHandleId=11193, ComSystemTemplateSystemSignalRef=OBJ_DIMENSION_LENGTH_055
          OBJ_VELOCITY_LONG_055_oRDR_TRACKER_OBJ_055_oPCAN_RADAR_99352ac1_Tx: ComBitPosition=110, ComBitSize=15, ComSignalType=UINT16, ComHandleId=11218, ComSystemTemplateSystemSignalRef=OBJ_VELOCITY_LONG_055
          OBJ_ALIVE_TIME_055_oRDR_TRACKER_OBJ_055_oPCAN_RADAR_281c33ff_Tx: ComBitPosition=255, ComBitSize=16, ComSignalType=UINT16, ComHandleId=11180, ComSystemTemplateSystemSignalRef=OBJ_ALIVE_TIME_055
          OBJ_POS_LONG_055_oRDR_TRACKER_OBJ_055_oPCAN_RADAR_3c7bfcef_Tx: ComBitPosition=63, ComBitSize=16, ComSignalType=UINT16, ComHandleId=11207, ComSystemTemplateSystemSignalRef=OBJ_POS_LONG_055
          OBJ_CLS_TYPE3_PROB_055_oRDR_TRACKER_OBJ_055_oPCAN_RADAR_99b8e8dc_Tx: ComBitPosition=319, ComBitSize=8, ComSignalType=UINT8, ComHandleId=11186, ComSystemTemplateSystemSignalRef=OBJ_CLS_TYPE3_PROB_055
          OBJ_POS_LAT_ERR_055_oRDR_TRACKER_OBJ_055_oPCAN_RADAR_89974717_Tx: ComBitPosition=103, ComBitSize=8, ComSignalType=UINT8, ComHandleId=11206, ComSystemTemplateSystemSignalRef=OBJ_POS_LAT_ERR_055
          OBJ_GROUP_ID_055_oRDR_TRACKER_OBJ_055_oPCAN_RADAR_5c59e6a0_Tx: ComBitPosition=405, ComBitSize=6, ComSignalType=UINT8, ComHandleId=11198, ComSystemTemplateSystemSignalRef=OBJ_GROUP_ID_055
          OBJ_MOVEMENT_STATUS_055_oRDR_TRACKER_OBJ_055_oPCAN_RADAR_ff0b2a56_Tx: ComBitPosition=196, ComBitSize=3, ComSignalType=UINT8, ComHandleId=11203, ComSystemTemplateSystemSignalRef=OBJ_MOVEMENT_STATUS_055
          OBJ_CLS_TYPE6_055_oRDR_TRACKER_OBJ_055_oPCAN_RADAR_a99f2ff5_Tx: ComBitPosition=282, ComBitSize=4, ComSignalType=UINT8, ComHandleId=11191, ComSystemTemplateSystemSignalRef=OBJ_CLS_TYPE6_055
          OBJ_MH_CRC16_055_oRDR_TRACKER_OBJ_055_oPCAN_RADAR_acc50826_Tx: ComBitPosition=495, ComBitSize=16, ComSignalType=UINT16, ComHandleId=11201, ComSystemTemplateSystemSignalRef=OBJ_MH_CRC16_055
          OBJ_MH_CYCLE_COUNTER_055_oRDR_TRACKER_OBJ_055_oPCAN_RADAR_dd2152c7_Tx: ComBitPosition=487, ComBitSize=8, ComSignalType=UINT8, ComHandleId=11202, ComSystemTemplateSystemSignalRef=OBJ_MH_CYCLE_COUNTER_055
      RDR_TRACKER_OBJ_018_oPCAN_RADAR_341d10c8_Tx (ComIPdu):
        ComIPduDirection = SEND
        ComIPduType = NORMAL
        ComIPduCancellationSupport = false
        ComIPduHandleId = 128
        ComIPduSignalProcessing = DEFERRED
        ComIPduChannelRef = CN_PCAN_RADAR_458ff0f1
        ComIPduGroupRef = RDR01_oPCAN_RADAR_Tx_b6bdb067 if post-build-variant-condition{matching-criterion=RDR_POS, value=0}
        ComIPduSignalGroupRef = SG_TrackerObject018_oRDR_TRACKER_OBJ_018_oPCAN_RADAR_ab5b5c0c_Tx
        ComPduIdRef = RDR_TRACKER_OBJ_018_oPCAN_RADAR_341d10c8_Tx
        ComIPduMainFunctionRef = ComMainFunctionTx_Event
        ComIPduGroupRef = RDR02_oPCAN_RADAR_Tx_9f750495 if post-build-variant-condition{matching-criterion=RDR_POS, value=1}
        ComIPduGroupRef = RDR03_oPCAN_RADAR_Tx_311d9504 if post-build-variant-condition{matching-criterion=RDR_POS, value=2}
        ComIPduGroupRef = RDR04_oPCAN_RADAR_Tx_cce46d71 if post-build-variant-condition{matching-criterion=RDR_POS, value=3}
        ComIPduGroupRef = RDR05_oPCAN_RADAR_Tx_628cfce0 if post-build-variant-condition{matching-criterion=RDR_POS, value=4}
        ComIPduGroupRef = RDR06_oPCAN_RADAR_Tx_4b444812 if post-build-variant-condition{matching-criterion=RDR_POS, value=5}
        ComIPduGroupRef = RDR07_oPCAN_RADAR_Tx_e52cd983 if post-build-variant-condition{matching-criterion=RDR_POS, value=6}
        ComIPduGroupRef = RDR08_oPCAN_RADAR_Tx_6bc6beb9 if post-build-variant-condition{matching-criterion=RDR_POS, value=7}
        ComTxIPdu: ComMinimumDelayTime=0, ComTxIPduUnusedAreasDefault=0
          ComTxModeTrue
            ComTxMode: ComTxModeMode=DIRECT, ComTxModeNumberOfRepetitions=0
          ComTxModeFalse
            ComTxMode: ComTxModeMode=NONE
      RDR_DETECTION_329_332_oPCAN_RADAR_3d29328b_Tx (ComIPdu):
        ComIPduDirection = SEND
        ComIPduType = NORMAL
        ComIPduCancellationSupport = false
        ComIPduHandleId = 88
        ComIPduSignalProcessing = DEFERRED
        ComIPduChannelRef = CN_PCAN_RADAR_458ff0f1
        ComIPduGroupRef = RDR01_oPCAN_RADAR_Tx_b6bdb067 if post-build-variant-condition{matching-criterion=RDR_POS, value=0}
        ComIPduSignalGroupRef = SG_Detections_329_332_oRDR_DETECTION_329_332_oPCAN_RADAR_c57c421a_Tx
        ComPduIdRef = RDR_DETECTION_329_332_oPCAN_RADAR_3d29328b_Tx
        ComIPduMainFunctionRef = ComMainFunctionTx_Event
        ComIPduGroupRef = RDR02_oPCAN_RADAR_Tx_9f750495 if post-build-variant-condition{matching-criterion=RDR_POS, value=1}
        ComIPduGroupRef = RDR03_oPCAN_RADAR_Tx_311d9504 if post-build-variant-condition{matching-criterion=RDR_POS, value=2}
        ComIPduGroupRef = RDR04_oPCAN_RADAR_Tx_cce46d71 if post-build-variant-condition{matching-criterion=RDR_POS, value=3}
        ComIPduGroupRef = RDR05_oPCAN_RADAR_Tx_628cfce0 if post-build-variant-condition{matching-criterion=RDR_POS, value=4}
        ComIPduGroupRef = RDR06_oPCAN_RADAR_Tx_4b444812 if post-build-variant-condition{matching-criterion=RDR_POS, value=5}
        ComIPduGroupRef = RDR07_oPCAN_RADAR_Tx_e52cd983 if post-build-variant-condition{matching-criterion=RDR_POS, value=6}
        ComIPduGroupRef = RDR08_oPCAN_RADAR_Tx_6bc6beb9 if post-build-variant-condition{matching-criterion=RDR_POS, value=7}
        ComTxIPdu: ComMinimumDelayTime=0, ComTxIPduUnusedAreasDefault=0
          ComTxModeTrue
            ComTxMode: ComTxModeMode=DIRECT, ComTxModeNumberOfRepetitions=0
          ComTxModeFalse
            ComTxMode: ComTxModeMode=NONE
      SG_TrackerObject054_oRDR_TRACKER_OBJ_054_oPCAN_RADAR_cdbdf267_Tx (ComSignalGroup):
        ComTransferProperty = TRIGGERED
        ComSignalGroupAccess = ACCESS_NEEDED_BY_SWC_OR_COM
        ComHandleId = 163
        ComSignalGroupArrayAccess = true
        ComSystemTemplateSignalGroupRef = SG_TrackerObject054
        49 x ComGroupSignal, all with ComSignalEndianness=BIG_ENDIAN, ComSignalInitValue=0, ComTransferProperty=PENDING, ComSignalAccess=ACCESS_NEEDED_BY_SWC_OR_COM:
          OBJ_CLS_TYPE2_PROB_054_oRDR_TRACKER_OBJ_054_oPCAN_RADAR_27bf9694_Tx: ComBitPosition=311, ComBitSize=8, ComSignalType=UINT8, ComHandleId=11135, ComSystemTemplateSystemSignalRef=OBJ_CLS_TYPE2_PROB_054
          OBJ_CLS_TYPE1_PROB_054_oRDR_TRACKER_OBJ_054_oPCAN_RADAR_ee8b8d99_Tx: ComBitPosition=303, ComBitSize=8, ComSignalType=UINT8, ComHandleId=11133, ComSystemTemplateSystemSignalRef=OBJ_CLS_TYPE1_PROB_054
          OBJ_CLS_TYPE5_PROB_054_oRDR_TRACKER_OBJ_054_oPCAN_RADAR_29b55034_Tx: ComBitPosition=335, ComBitSize=8, ComSignalType=UINT8, ComHandleId=11141, ComSystemTemplateSystemSignalRef=OBJ_CLS_TYPE5_PROB_054
          OBJ_POS_LAT_ERR_054_oRDR_TRACKER_OBJ_054_oPCAN_RADAR_7083cfa4_Tx: ComBitPosition=103, ComBitSize=8, ComSignalType=UINT8, ComHandleId=11157, ComSystemTemplateSystemSignalRef=OBJ_POS_LAT_ERR_054
          OBJ_DIMENSION_WIDTH_054_oRDR_TRACKER_OBJ_054_oPCAN_RADAR_2783fe83_Tx: ComBitPosition=17, ComBitSize=10, ComSignalType=UINT16, ComHandleId=11146, ComSystemTemplateSystemSignalRef=OBJ_DIMENSION_WIDTH_054
          OBJ_MOVEMENT_STATUS_054_oRDR_TRACKER_OBJ_054_oPCAN_RADAR_061fa2e5_Tx: ComBitPosition=196, ComBitSize=3, ComSignalType=UINT8, ComHandleId=11154, ComSystemTemplateSystemSignalRef=OBJ_MOVEMENT_STATUS_054
          OBJ_ACCELERATION_LAT_ERR_054_oRDR_TRACKER_OBJ_054_oPCAN_RADAR_166d93ae_Tx: ComBitPosition=223, ComBitSize=8, ComSignalType=UINT8, ComHandleId=11127, ComSystemTemplateSystemSignalRef=OBJ_ACCELERATION_LAT_ERR_054
          OBJ_REF_PT_LAT_OFFSET_054_oRDR_TRACKER_OBJ_054_oPCAN_RADAR_a33da2e1_Tx: ComBitPosition=370, ComBitSize=14, ComSignalType=UINT16, ComHandleId=11161, ComSystemTemplateSystemSignalRef=OBJ_REF_PT_LAT_OFFSET_054
          OBJ_CLS_TYPE5_054_oRDR_TRACKER_OBJ_054_oPCAN_RADAR_1d63a721_Tx: ComBitPosition=287, ComBitSize=4, ComSignalType=UINT8, ComHandleId=11140, ComSystemTemplateSystemSignalRef=OBJ_CLS_TYPE5_054
          OBJ_ACCELERATION_LONG_ERR_054_oRDR_TRACKER_OBJ_054_oPCAN_RADAR_09c83604_Tx: ComBitPosition=215, ComBitSize=8, ComSignalType=UINT8, ComHandleId=11129, ComSystemTemplateSystemSignalRef=OBJ_ACCELERATION_LONG_ERR_054
          OBJ_REF_PT_LONG_OFFSET_054_oRDR_TRACKER_OBJ_054_oPCAN_RADAR_ec6f52e2_Tx: ComBitPosition=357, ComBitSize=14, ComSignalType=UINT16, ComHandleId=11162, ComSystemTemplateSystemSignalRef=OBJ_REF_PT_LONG_OFFSET_054
          OBJ_MEASUREMENT_STATUS_054_oRDR_TRACKER_OBJ_054_oPCAN_RADAR_29b137a9_Tx: ComBitPosition=14, ComBitSize=3, ComSignalType=UINT8, ComHandleId=11151, ComSystemTemplateSystemSignalRef=OBJ_MEASUREMENT_STATUS_054
          OBJ_GROUP_ID_054_oRDR_TRACKER_OBJ_054_oPCAN_RADAR_a54d6e13_Tx: ComBitPosition=405, ComBitSize=6, ComSignalType=UINT8, ComHandleId=11149, ComSystemTemplateSystemSignalRef=OBJ_GROUP_ID_054
          OBJ_YAW_ANGLE_054_oRDR_TRACKER_OBJ_054_oPCAN_RADAR_dc109ef4_Tx: ComBitPosition=155, ComBitSize=12, ComSignalType=UINT16, ComHandleId=11171, ComSystemTemplateSystemSignalRef=OBJ_YAW_ANGLE_054
          OBJ_YAW_ANGLE_ERR_054_oRDR_TRACKER_OBJ_054_oPCAN_RADAR_091d9823_Tx: ComBitPosition=175, ComBitSize=7, ComSignalType=UINT8, ComHandleId=11172, ComSystemTemplateSystemSignalRef=OBJ_YAW_ANGLE_ERR_054
          OBJ_ALIVE_TIME_054_oRDR_TRACKER_OBJ_054_oPCAN_RADAR_d108bb4c_Tx: ComBitPosition=255, ComBitSize=16, ComSignalType=UINT16, ComHandleId=11131, ComSystemTemplateSystemSignalRef=OBJ_ALIVE_TIME_054
          OBJ_POS_LONG_ERR_054_oRDR_TRACKER_OBJ_054_oPCAN_RADAR_e97b3146_Tx: ComBitPosition=95, ComBitSize=8, ComSignalType=UINT8, ComHandleId=11159, ComSystemTemplateSystemSignalRef=OBJ_POS_LONG_ERR_054
          OBJ_RCS_054_oRDR_TRACKER_OBJ_054_oPCAN_RADAR_5600c994_Tx: ComBitPosition=351, ComBitSize=7, ComSignalType=UINT8, ComHandleId=11160, ComSystemTemplateSystemSignalRef=OBJ_RCS_054
          OBJ_VELOCITY_ERR_CRR_COEF_054_oRDR_TRACKER_OBJ_054_oPCAN_RADAR_3f1a5f3e_Tx: ComBitPosition=423, ComBitSize=8, ComSignalType=UINT8, ComHandleId=11166, ComSystemTemplateSystemSignalRef=OBJ_VELOCITY_ERR_CRR_COEF_054
          OBJ_DIMENSION_LENGTH_054_oRDR_TRACKER_OBJ_054_oPCAN_RADAR_044d092e_Tx: ComBitPosition=37, ComBitSize=12, ComSignalType=UINT16, ComHandleId=11144, ComSystemTemplateSystemSignalRef=OBJ_DIMENSION_LENGTH_054
          OBJ_CLS_TYPE2_054_oRDR_TRACKER_OBJ_054_oPCAN_RADAR_0b3b5a0d_Tx: ComBitPosition=267, ComBitSize=4, ComSignalType=UINT8, ComHandleId=11134, ComSystemTemplateSystemSignalRef=OBJ_CLS_TYPE2_054
          OBJ_TRACK_MOTION_MODEL_054_oRDR_TRACKER_OBJ_054_oPCAN_RADAR_9aafc81f_Tx: ComBitPosition=9, ComBitSize=2, ComSignalType=UINT8, ComHandleId=11164, ComSystemTemplateSystemSignalRef=OBJ_TRACK_MOTION_MODEL_054
          OBJ_CLS_TYPE4_054_oRDR_TRACKER_OBJ_054_oPCAN_RADAR_90eb5ac3_Tx: ComBitPosition=275, ComBitSize=4, ComSignalType=UINT8, ComHandleId=11138, ComSystemTemplateSystemSignalRef=OBJ_CLS_TYPE4_054
          OBJ_VEH_TRACK_FLAG_054_oRDR_TRACKER_OBJ_054_oPCAN_RADAR_18853e42_Tx: ComBitPosition=10, ComBitSize=1, ComSignalType=BOOLEAN, ComHandleId=11165, ComSystemTemplateSystemSignalRef=OBJ_VEH_TRACK_FLAG_054
          OBJ_CLS_TYPE6_054_oRDR_TRACKER_OBJ_054_oPCAN_RADAR_508ba746_Tx: ComBitPosition=282, ComBitSize=4, ComSignalType=UINT8, ComHandleId=11142, ComSystemTemplateSystemSignalRef=OBJ_CLS_TYPE6_054
          OBJ_POS_ERR_CRR_COEF_054_oRDR_TRACKER_OBJ_054_oPCAN_RADAR_966062df_Tx: ComBitPosition=415, ComBitSize=8, ComSignalType=UINT8, ComHandleId=11155, ComSystemTemplateSystemSignalRef=OBJ_POS_ERR_CRR_COEF_054
          OBJ_CLS_TYPE1_054_oRDR_TRACKER_OBJ_054_oPCAN_RADAR_46d35a6a_Tx: ComBitPosition=271, ComBitSize=4, ComSignalType=UINT8, ComHandleId=11132, ComSystemTemplateSystemSignalRef=OBJ_CLS_TYPE1_054
          OBJ_VELOCITY_LAT_ERR_054_oRDR_TRACKER_OBJ_054_oPCAN_RADAR_0456aae5_Tx: ComBitPosition=151, ComBitSize=8, ComSignalType=UINT8, ComHandleId=11168, ComSystemTemplateSystemSignalRef=OBJ_VELOCITY_LAT_ERR_054
          OBJ_CLS_TYPE3_054_oRDR_TRACKER_OBJ_054_oPCAN_RADAR_86b3a7ef_Tx: ComBitPosition=279, ComBitSize=4, ComSignalType=UINT8, ComHandleId=11136, ComSystemTemplateSystemSignalRef=OBJ_CLS_TYPE3_054
          OBJ_CLS_TYPE4_PROB_054_oRDR_TRACKER_OBJ_054_oPCAN_RADAR_6ea6a6cf_Tx: ComBitPosition=327, ComBitSize=8, ComSignalType=UINT8, ComHandleId=11139, ComSystemTemplateSystemSignalRef=OBJ_CLS_TYPE4_PROB_054
          OBJ_ACCELERATION_LAT_054_oRDR_TRACKER_OBJ_054_oPCAN_RADAR_c399a910_Tx: ComBitPosition=177, ComBitSize=10, ComSignalType=UINT16, ComHandleId=11126, ComSystemTemplateSystemSignalRef=OBJ_ACCELERATION_LAT_054
          OBJ_DIMENSION_LENGTH_ERR_054_oRDR_TRACKER_OBJ_054_oPCAN_RADAR_3fb51654_Tx: ComBitPosition=41, ComBitSize=10, ComSignalType=UINT16, ComHandleId=11145, ComSystemTemplateSystemSignalRef=OBJ_DIMENSION_LENGTH_ERR_054
          OBJ_EXISTENCE_PROB_054_oRDR_TRACKER_OBJ_054_oPCAN_RADAR_2c3f7abe_Tx: ComBitPosition=229, ComBitSize=14, ComSignalType=UINT16, ComHandleId=11148, ComSystemTemplateSystemSignalRef=OBJ_EXISTENCE_PROB_054
          OBJ_CLS_TYPE6_PROB_054_oRDR_TRACKER_OBJ_054_oPCAN_RADAR_e0814b39_Tx: ComBitPosition=343, ComBitSize=8, ComSignalType=UINT8, ComHandleId=11143, ComSystemTemplateSystemSignalRef=OBJ_CLS_TYPE6_PROB_054
          OBJ_TIMESTAMP_OFFSET_054_oRDR_TRACKER_OBJ_054_oPCAN_RADAR_56acc9c2_Tx: ComBitPosition=247, ComBitSize=8, ComSignalType=UINT8, ComHandleId=11163, ComSystemTemplateSystemSignalRef=OBJ_TIMESTAMP_OFFSET_054
          OBJ_CLS_TYPE3_PROB_054_oRDR_TRACKER_OBJ_054_oPCAN_RADAR_60ac606f_Tx: ComBitPosition=319, ComBitSize=8, ComSignalType=UINT8, ComHandleId=11137, ComSystemTemplateSystemSignalRef=OBJ_CLS_TYPE3_PROB_054
          OBJ_VELOCITY_LONG_ERR_054_oRDR_TRACKER_OBJ_054_oPCAN_RADAR_e8d49525_Tx: ComBitPosition=143, ComBitSize=8, ComSignalType=UINT8, ComHandleId=11170, ComSystemTemplateSystemSignalRef=OBJ_VELOCITY_LONG_ERR_054
          OBJ_ACCEL_ERR_CRR_COEF_054_oRDR_TRACKER_OBJ_054_oPCAN_RADAR_a96b1762_Tx: ComBitPosition=431, ComBitSize=8, ComSignalType=UINT8, ComHandleId=11130, ComSystemTemplateSystemSignalRef=OBJ_ACCEL_ERR_CRR_COEF_054
          OBJ_DIMENSION_WIDTH_ERR_054_oRDR_TRACKER_OBJ_054_oPCAN_RADAR_c721396b_Tx: ComBitPosition=23, ComBitSize=6, ComSignalType=UINT8, ComHandleId=11147, ComSystemTemplateSystemSignalRef=OBJ_DIMENSION_WIDTH_ERR_054
          OBJ_POS_LONG_054_oRDR_TRACKER_OBJ_054_oPCAN_RADAR_c56f745c_Tx: ComBitPosition=63, ComBitSize=16, ComSignalType=UINT16, ComHandleId=11158, ComSystemTemplateSystemSignalRef=OBJ_POS_LONG_054
          OBJ_YAW_RATE_054_oRDR_TRACKER_OBJ_054_oPCAN_RADAR_f99fbbb3_Tx: ComBitPosition=399, ComBitSize=10, ComSignalType=UINT16, ComHandleId=11173, ComSystemTemplateSystemSignalRef=OBJ_YAW_RATE_054
          OBJ_POS_LAT_054_oRDR_TRACKER_OBJ_054_oPCAN_RADAR_74cf9f93_Tx: ComBitPosition=79, ComBitSize=16, ComSignalType=UINT16, ComHandleId=11156, ComSystemTemplateSystemSignalRef=OBJ_POS_LAT_054
          OBJ_ID_054_oRDR_TRACKER_OBJ_054_oPCAN_RADAR_56634514_Tx: ComBitPosition=7, ComBitSize=8, ComSignalType=UINT8, ComHandleId=11150, ComSystemTemplateSystemSignalRef=OBJ_ID_054
          OBJ_VELOCITY_LONG_054_oRDR_TRACKER_OBJ_054_oPCAN_RADAR_6021a272_Tx: ComBitPosition=110, ComBitSize=15, ComSignalType=UINT16, ComHandleId=11169, ComSystemTemplateSystemSignalRef=OBJ_VELOCITY_LONG_054
          OBJ_ACCELERATION_LONG_054_oRDR_TRACKER_OBJ_054_oPCAN_RADAR_b169f0f0_Tx: ComBitPosition=193, ComBitSize=10, ComSignalType=UINT16, ComHandleId=11128, ComSystemTemplateSystemSignalRef=OBJ_ACCELERATION_LONG_054
          OBJ_YAW_RATE_ERR_054_oRDR_TRACKER_OBJ_054_oPCAN_RADAR_c6472c6f_Tx: ComBitPosition=388, ComBitSize=5, ComSignalType=UINT8, ComHandleId=11174, ComSystemTemplateSystemSignalRef=OBJ_YAW_RATE_ERR_054
          OBJ_VELOCITY_LAT_054_oRDR_TRACKER_OBJ_054_oPCAN_RADAR_30acdab4_Tx: ComBitPosition=126, ComBitSize=15, ComSignalType=UINT16, ComHandleId=11167, ComSystemTemplateSystemSignalRef=OBJ_VELOCITY_LAT_054
          OBJ_MH_CYCLE_COUNTER_054_oRDR_TRACKER_OBJ_054_oPCAN_RADAR_2435da74_Tx: ComBitPosition=487, ComBitSize=8, ComSignalType=UINT8, ComHandleId=11153, ComSystemTemplateSystemSignalRef=OBJ_MH_CYCLE_COUNTER_054
          OBJ_MH_CRC16_054_oRDR_TRACKER_OBJ_054_oPCAN_RADAR_55d18095_Tx: ComBitPosition=495, ComBitSize=16, ComSignalType=UINT16, ComHandleId=11152, ComSystemTemplateSystemSignalRef=OBJ_MH_CRC16_054
      6 x ComIPdu, all with ComIPduDirection=SEND, ComIPduType=NORMAL, ComIPduCancellationSupport=false, ComIPduSignalProcessing=DEFERRED, ComIPduChannelRef=CN_PCAN_RADAR_458ff0f1, ComIPduGroupRef=RDR01_oPCAN_RADAR_Tx_b6bdb067 if post-build-variant-condition{matching-criterion=RDR_POS, value=0}, ComIPduMainFunctionRef=ComMainFunctionTx_Event, ComIPduGroupRef=RDR02_oPCAN_RADAR_Tx_9f750495 if post-build-variant-condition{matching-criterion=RDR_POS, value=1}, ComIPduGroupRef=RDR03_oPCAN_RADAR_Tx_311d9504 if post-build-variant-condition{matching-criterion=RDR_POS, value=2}, ComIPduGroupRef=RDR04_oPCAN_RADAR_Tx_cce46d71 if post-build-variant-condition{matching-criterion=RDR_POS, value=3}, ComIPduGroupRef=RDR05_oPCAN_RADAR_Tx_628cfce0 if post-build-variant-condition{matching-criterion=RDR_POS, value=4}, ComIPduGroupRef=RDR06_oPCAN_RADAR_Tx_4b444812 if post-build-variant-condition{matching-criterion=RDR_POS, value=5}, ComIPduGroupRef=RDR07_oPCAN_RADAR_Tx_e52cd983 if post-build-variant-condition{matching-criterion=RDR_POS, value=6}, ComIPduGroupRef=RDR08_oPCAN_RADAR_Tx_6bc6beb9 if post-build-variant-condition{matching-criterion=RDR_POS, value=7}:
        RDR_DETECTION_249_252_oPCAN_RADAR_a58e9e08_Tx: ComIPduHandleId=68, ComIPduSignalGroupRef=SG_Detections_249_252_oRDR_DETECTION_249_252_oPCAN_RADAR_d84a8050_Tx, ComPduIdRef=RDR_DETECTION_249_252_oPCAN_RADAR_a58e9e08_Tx
          ComTxIPdu: ComMinimumDelayTime=0, ComTxIPduUnusedAreasDefault=0
            ComTxModeTrue
              ComTxMode: ComTxModeMode=DIRECT, ComTxModeNumberOfRepetitions=0
            ComTxModeFalse
              ComTxMode: ComTxModeMode=NONE
        RDR_TRACKER_OBJ_031_oPCAN_RADAR_52e6de8d_Tx: ComIPduHandleId=141, ComIPduSignalGroupRef=SG_TrackerObject031_oRDR_TRACKER_OBJ_031_oPCAN_RADAR_520c655f_Tx, ComPduIdRef=RDR_TRACKER_OBJ_031_oPCAN_RADAR_52e6de8d_Tx
          ComTxIPdu: ComMinimumDelayTime=0, ComTxIPduUnusedAreasDefault=0
            ComTxModeTrue
              ComTxMode: ComTxModeMode=DIRECT, ComTxModeNumberOfRepetitions=0
            ComTxModeFalse
              ComTxMode: ComTxModeMode=NONE
        RDR_DETECTION_053_056_oPCAN_RADAR_647b2a46_Tx: ComIPduHandleId=19, ComIPduSignalGroupRef=SG_Detections_053_056_oRDR_DETECTION_053_056_oPCAN_RADAR_6f11ad00_Tx, ComPduIdRef=RDR_DETECTION_053_056_oPCAN_RADAR_647b2a46_Tx
          ComTxIPdu: ComMinimumDelayTime=0, ComTxIPduUnusedAreasDefault=0
            ComTxModeTrue
              ComTxMode: ComTxModeMode=DIRECT, ComTxModeNumberOfRepetitions=0
            ComTxModeFalse
              ComTxMode: ComTxModeMode=NONE
        RDR_DETECTION_021_024_oPCAN_RADAR_54f8af6e_Tx: ComIPduHandleId=11, ComIPduSignalGroupRef=SG_Detections_021_024_oRDR_DETECTION_021_024_oPCAN_RADAR_ea3d35f7_Tx, ComPduIdRef=RDR_DETECTION_021_024_oPCAN_RADAR_54f8af6e_Tx
          ComTxIPdu: ComMinimumDelayTime=0, ComTxIPduUnusedAreasDefault=0
            ComTxModeTrue
              ComTxMode: ComTxModeMode=DIRECT, ComTxModeNumberOfRepetitions=0
            ComTxModeFalse
              ComTxMode: ComTxModeMode=NONE
        RDR_TRACKER_OBJ_050_oPCAN_RADAR_77b24cbe_Tx: ComIPduHandleId=160, ComIPduSignalGroupRef=SG_TrackerObject050_oRDR_TRACKER_OBJ_050_oPCAN_RADAR_9f0ddc29_Tx, ComPduIdRef=RDR_TRACKER_OBJ_050_oPCAN_RADAR_77b24cbe_Tx
          ComTxIPdu: ComMinimumDelayTime=0, ComTxIPduUnusedAreasDefault=0
            ComTxModeTrue
              ComTxMode: ComTxModeMode=DIRECT, ComTxModeNumberOfRepetitions=0
            ComTxModeFalse
              ComTxMode: ComTxModeMode=NONE
        RDR_DETECTION_001_004_oPCAN_RADAR_b0420040_Tx: ComIPduHandleId=6, ComIPduSignalGroupRef=SG_Detections_001_004_oRDR_DETECTION_001_004_oPCAN_RADAR_df4895a5_Tx, ComPduIdRef=RDR_DETECTION_001_004_oPCAN_RADAR_b0420040_Tx
          ComTxIPdu: ComMinimumDelayTime=0, ComTxIPduUnusedAreasDefault=0
            ComTxModeTrue
              ComTxMode: ComTxModeMode=DIRECT, ComTxModeNumberOfRepetitions=0
            ComTxModeFalse
              ComTxMode: ComTxModeMode=NONE
      SG_TrackerObject017_oRDR_TRACKER_OBJ_017_oPCAN_RADAR_8cc7b14a_Tx (ComSignalGroup):
        ComTransferProperty = TRIGGERED
        ComSignalGroupAccess = ACCESS_NEEDED_BY_SWC_OR_COM
        ComHandleId = 126
        ComSignalGroupArrayAccess = true
        ComSystemTemplateSignalGroupRef = SG_TrackerObject017
        49 x ComGroupSignal, all with ComSignalEndianness=BIG_ENDIAN, ComSignalInitValue=0, ComTransferProperty=PENDING, ComSignalAccess=ACCESS_NEEDED_BY_SWC_OR_COM:
          OBJ_REF_PT_LAT_OFFSET_017_oRDR_TRACKER_OBJ_017_oPCAN_RADAR_e247e1cc_Tx: ComBitPosition=370, ComBitSize=14, ComSignalType=UINT16, ComHandleId=9348, ComSystemTemplateSystemSignalRef=OBJ_REF_PT_LAT_OFFSET_017
          OBJ_YAW_RATE_017_oRDR_TRACKER_OBJ_017_oPCAN_RADAR_b8e5f89e_Tx: ComBitPosition=399, ComBitSize=10, ComSignalType=UINT16, ComHandleId=9360, ComSystemTemplateSystemSignalRef=OBJ_YAW_RATE_017
          OBJ_ACCEL_ERR_CRR_COEF_017_oRDR_TRACKER_OBJ_017_oPCAN_RADAR_e811544f_Tx: ComBitPosition=431, ComBitSize=8, ComSignalType=UINT8, ComHandleId=9317, ComSystemTemplateSystemSignalRef=OBJ_ACCEL_ERR_CRR_COEF_017
          OBJ_CLS_TYPE4_PROB_017_oRDR_TRACKER_OBJ_017_oPCAN_RADAR_2fdce5e2_Tx: ComBitPosition=327, ComBitSize=8, ComSignalType=UINT8, ComHandleId=9326, ComSystemTemplateSystemSignalRef=OBJ_CLS_TYPE4_PROB_017
          OBJ_DIMENSION_LENGTH_ERR_017_oRDR_TRACKER_OBJ_017_oPCAN_RADAR_7ecf5579_Tx: ComBitPosition=41, ComBitSize=10, ComSignalType=UINT16, ComHandleId=9332, ComSystemTemplateSystemSignalRef=OBJ_DIMENSION_LENGTH_ERR_017
          OBJ_VELOCITY_LONG_ERR_017_oRDR_TRACKER_OBJ_017_oPCAN_RADAR_a9aed608_Tx: ComBitPosition=143, ComBitSize=8, ComSignalType=UINT8, ComHandleId=9357, ComSystemTemplateSystemSignalRef=OBJ_VELOCITY_LONG_ERR_017
          OBJ_DIMENSION_LENGTH_017_oRDR_TRACKER_OBJ_017_oPCAN_RADAR_45374a03_Tx: ComBitPosition=37, ComBitSize=12, ComSignalType=UINT16, ComHandleId=9331, ComSystemTemplateSystemSignalRef=OBJ_DIMENSION_LENGTH_017
          OBJ_CLS_TYPE3_PROB_017_oRDR_TRACKER_OBJ_017_oPCAN_RADAR_21d62342_Tx: ComBitPosition=319, ComBitSize=8, ComSignalType=UINT8, ComHandleId=9324, ComSystemTemplateSystemSignalRef=OBJ_CLS_TYPE3_PROB_017
          OBJ_POS_LONG_ERR_017_oRDR_TRACKER_OBJ_017_oPCAN_RADAR_a801726b_Tx: ComBitPosition=95, ComBitSize=8, ComSignalType=UINT8, ComHandleId=9346, ComSystemTemplateSystemSignalRef=OBJ_POS_LONG_ERR_017
          OBJ_CLS_TYPE2_PROB_017_oRDR_TRACKER_OBJ_017_oPCAN_RADAR_66c5d5b9_Tx: ComBitPosition=311, ComBitSize=8, ComSignalType=UINT8, ComHandleId=9322, ComSystemTemplateSystemSignalRef=OBJ_CLS_TYPE2_PROB_017
          OBJ_POS_ERR_CRR_COEF_017_oRDR_TRACKER_OBJ_017_oPCAN_RADAR_d71a21f2_Tx: ComBitPosition=415, ComBitSize=8, ComSignalType=UINT8, ComHandleId=9342, ComSystemTemplateSystemSignalRef=OBJ_POS_ERR_CRR_COEF_017
          OBJ_CLS_TYPE2_017_oRDR_TRACKER_OBJ_017_oPCAN_RADAR_4a411920_Tx: ComBitPosition=267, ComBitSize=4, ComSignalType=UINT8, ComHandleId=9321, ComSystemTemplateSystemSignalRef=OBJ_CLS_TYPE2_017
          OBJ_YAW_ANGLE_017_oRDR_TRACKER_OBJ_017_oPCAN_RADAR_9d6addd9_Tx: ComBitPosition=155, ComBitSize=12, ComSignalType=UINT16, ComHandleId=9358, ComSystemTemplateSystemSignalRef=OBJ_YAW_ANGLE_017
          OBJ_GROUP_ID_017_oRDR_TRACKER_OBJ_017_oPCAN_RADAR_e4372d3e_Tx: ComBitPosition=405, ComBitSize=6, ComSignalType=UINT8, ComHandleId=9336, ComSystemTemplateSystemSignalRef=OBJ_GROUP_ID_017
          OBJ_CLS_TYPE5_PROB_017_oRDR_TRACKER_OBJ_017_oPCAN_RADAR_68cf1319_Tx: ComBitPosition=335, ComBitSize=8, ComSignalType=UINT8, ComHandleId=9328, ComSystemTemplateSystemSignalRef=OBJ_CLS_TYPE5_PROB_017
          OBJ_CLS_TYPE3_017_oRDR_TRACKER_OBJ_017_oPCAN_RADAR_c7c9e4c2_Tx: ComBitPosition=279, ComBitSize=4, ComSignalType=UINT8, ComHandleId=9323, ComSystemTemplateSystemSignalRef=OBJ_CLS_TYPE3_017
          OBJ_MOVEMENT_STATUS_017_oRDR_TRACKER_OBJ_017_oPCAN_RADAR_4765e1c8_Tx: ComBitPosition=196, ComBitSize=3, ComSignalType=UINT8, ComHandleId=9341, ComSystemTemplateSystemSignalRef=OBJ_MOVEMENT_STATUS_017
          OBJ_POS_LAT_ERR_017_oRDR_TRACKER_OBJ_017_oPCAN_RADAR_31f98c89_Tx: ComBitPosition=103, ComBitSize=8, ComSignalType=UINT8, ComHandleId=9344, ComSystemTemplateSystemSignalRef=OBJ_POS_LAT_ERR_017
          OBJ_REF_PT_LONG_OFFSET_017_oRDR_TRACKER_OBJ_017_oPCAN_RADAR_ad1511cf_Tx: ComBitPosition=357, ComBitSize=14, ComSignalType=UINT16, ComHandleId=9349, ComSystemTemplateSystemSignalRef=OBJ_REF_PT_LONG_OFFSET_017
          OBJ_CLS_TYPE1_PROB_017_oRDR_TRACKER_OBJ_017_oPCAN_RADAR_aff1ceb4_Tx: ComBitPosition=303, ComBitSize=8, ComSignalType=UINT8, ComHandleId=9320, ComSystemTemplateSystemSignalRef=OBJ_CLS_TYPE1_PROB_017
          OBJ_CLS_TYPE5_017_oRDR_TRACKER_OBJ_017_oPCAN_RADAR_5c19e40c_Tx: ComBitPosition=287, ComBitSize=4, ComSignalType=UINT8, ComHandleId=9327, ComSystemTemplateSystemSignalRef=OBJ_CLS_TYPE5_017
          OBJ_CLS_TYPE6_PROB_017_oRDR_TRACKER_OBJ_017_oPCAN_RADAR_a1fb0814_Tx: ComBitPosition=343, ComBitSize=8, ComSignalType=UINT8, ComHandleId=9330, ComSystemTemplateSystemSignalRef=OBJ_CLS_TYPE6_PROB_017
          OBJ_VELOCITY_ERR_CRR_COEF_017_oRDR_TRACKER_OBJ_017_oPCAN_RADAR_7e601c13_Tx: ComBitPosition=423, ComBitSize=8, ComSignalType=UINT8, ComHandleId=9353, ComSystemTemplateSystemSignalRef=OBJ_VELOCITY_ERR_CRR_COEF_017
          OBJ_CLS_TYPE6_017_oRDR_TRACKER_OBJ_017_oPCAN_RADAR_11f1e46b_Tx: ComBitPosition=282, ComBitSize=4, ComSignalType=UINT8, ComHandleId=9329, ComSystemTemplateSystemSignalRef=OBJ_CLS_TYPE6_017
          OBJ_MEASUREMENT_STATUS_017_oRDR_TRACKER_OBJ_017_oPCAN_RADAR_68cb7484_Tx: ComBitPosition=14, ComBitSize=3, ComSignalType=UINT8, ComHandleId=9338, ComSystemTemplateSystemSignalRef=OBJ_MEASUREMENT_STATUS_017
          OBJ_ALIVE_TIME_017_oRDR_TRACKER_OBJ_017_oPCAN_RADAR_9072f861_Tx: ComBitPosition=255, ComBitSize=16, ComSignalType=UINT16, ComHandleId=9318, ComSystemTemplateSystemSignalRef=OBJ_ALIVE_TIME_017
          OBJ_ID_017_oRDR_TRACKER_OBJ_017_oPCAN_RADAR_17190639_Tx: ComBitPosition=7, ComBitSize=8, ComSignalType=UINT8, ComHandleId=9337, ComSystemTemplateSystemSignalRef=OBJ_ID_017
          OBJ_VELOCITY_LAT_ERR_017_oRDR_TRACKER_OBJ_017_oPCAN_RADAR_452ce9c8_Tx: ComBitPosition=151, ComBitSize=8, ComSignalType=UINT8, ComHandleId=9355, ComSystemTemplateSystemSignalRef=OBJ_VELOCITY_LAT_ERR_017
          OBJ_YAW_ANGLE_ERR_017_oRDR_TRACKER_OBJ_017_oPCAN_RADAR_4867db0e_Tx: ComBitPosition=175, ComBitSize=7, ComSignalType=UINT8, ComHandleId=9359, ComSystemTemplateSystemSignalRef=OBJ_YAW_ANGLE_ERR_017
          OBJ_TRACK_MOTION_MODEL_017_oRDR_TRACKER_OBJ_017_oPCAN_RADAR_dbd58b32_Tx: ComBitPosition=9, ComBitSize=2, ComSignalType=UINT8, ComHandleId=9351, ComSystemTemplateSystemSignalRef=OBJ_TRACK_MOTION_MODEL_017
          OBJ_VELOCITY_LAT_017_oRDR_TRACKER_OBJ_017_oPCAN_RADAR_71d69999_Tx: ComBitPosition=126, ComBitSize=15, ComSignalType=UINT16, ComHandleId=9354, ComSystemTemplateSystemSignalRef=OBJ_VELOCITY_LAT_017
          OBJ_EXISTENCE_PROB_017_oRDR_TRACKER_OBJ_017_oPCAN_RADAR_6d453993_Tx: ComBitPosition=229, ComBitSize=14, ComSignalType=UINT16, ComHandleId=9335, ComSystemTemplateSystemSignalRef=OBJ_EXISTENCE_PROB_017
          OBJ_YAW_RATE_ERR_017_oRDR_TRACKER_OBJ_017_oPCAN_RADAR_873d6f42_Tx: ComBitPosition=388, ComBitSize=5, ComSignalType=UINT8, ComHandleId=9361, ComSystemTemplateSystemSignalRef=OBJ_YAW_RATE_ERR_017
          OBJ_POS_LONG_017_oRDR_TRACKER_OBJ_017_oPCAN_RADAR_84153771_Tx: ComBitPosition=63, ComBitSize=16, ComSignalType=UINT16, ComHandleId=9345, ComSystemTemplateSystemSignalRef=OBJ_POS_LONG_017
          OBJ_VEH_TRACK_FLAG_017_oRDR_TRACKER_OBJ_017_oPCAN_RADAR_59ff7d6f_Tx: ComBitPosition=10, ComBitSize=1, ComSignalType=BOOLEAN, ComHandleId=9352, ComSystemTemplateSystemSignalRef=OBJ_VEH_TRACK_FLAG_017
          OBJ_CLS_TYPE1_017_oRDR_TRACKER_OBJ_017_oPCAN_RADAR_07a91947_Tx: ComBitPosition=271, ComBitSize=4, ComSignalType=UINT8, ComHandleId=9319, ComSystemTemplateSystemSignalRef=OBJ_CLS_TYPE1_017
          OBJ_DIMENSION_WIDTH_017_oRDR_TRACKER_OBJ_017_oPCAN_RADAR_66f9bdae_Tx: ComBitPosition=17, ComBitSize=10, ComSignalType=UINT16, ComHandleId=9333, ComSystemTemplateSystemSignalRef=OBJ_DIMENSION_WIDTH_017
          OBJ_ACCELERATION_LONG_ERR_017_oRDR_TRACKER_OBJ_017_oPCAN_RADAR_48b27529_Tx: ComBitPosition=215, ComBitSize=8, ComSignalType=UINT8, ComHandleId=9316, ComSystemTemplateSystemSignalRef=OBJ_ACCELERATION_LONG_ERR_017
          OBJ_RCS_017_oRDR_TRACKER_OBJ_017_oPCAN_RADAR_177a8ab9_Tx: ComBitPosition=351, ComBitSize=7, ComSignalType=UINT8, ComHandleId=9347, ComSystemTemplateSystemSignalRef=OBJ_RCS_017
          OBJ_TIMESTAMP_OFFSET_017_oRDR_TRACKER_OBJ_017_oPCAN_RADAR_17d68aef_Tx: ComBitPosition=247, ComBitSize=8, ComSignalType=UINT8, ComHandleId=9350, ComSystemTemplateSystemSignalRef=OBJ_TIMESTAMP_OFFSET_017
          OBJ_DIMENSION_WIDTH_ERR_017_oRDR_TRACKER_OBJ_017_oPCAN_RADAR_865b7a46_Tx: ComBitPosition=23, ComBitSize=6, ComSignalType=UINT8, ComHandleId=9334, ComSystemTemplateSystemSignalRef=OBJ_DIMENSION_WIDTH_ERR_017
          OBJ_CLS_TYPE4_017_oRDR_TRACKER_OBJ_017_oPCAN_RADAR_d19119ee_Tx: ComBitPosition=275, ComBitSize=4, ComSignalType=UINT8, ComHandleId=9325, ComSystemTemplateSystemSignalRef=OBJ_CLS_TYPE4_017
          OBJ_ACCELERATION_LAT_017_oRDR_TRACKER_OBJ_017_oPCAN_RADAR_82e3ea3d_Tx: ComBitPosition=177, ComBitSize=10, ComSignalType=UINT16, ComHandleId=9313, ComSystemTemplateSystemSignalRef=OBJ_ACCELERATION_LAT_017
          OBJ_POS_LAT_017_oRDR_TRACKER_OBJ_017_oPCAN_RADAR_35b5dcbe_Tx: ComBitPosition=79, ComBitSize=16, ComSignalType=UINT16, ComHandleId=9343, ComSystemTemplateSystemSignalRef=OBJ_POS_LAT_017
          OBJ_ACCELERATION_LONG_017_oRDR_TRACKER_OBJ_017_oPCAN_RADAR_f013b3dd_Tx: ComBitPosition=193, ComBitSize=10, ComSignalType=UINT16, ComHandleId=9315, ComSystemTemplateSystemSignalRef=OBJ_ACCELERATION_LONG_017
          OBJ_VELOCITY_LONG_017_oRDR_TRACKER_OBJ_017_oPCAN_RADAR_215be15f_Tx: ComBitPosition=110, ComBitSize=15, ComSignalType=UINT16, ComHandleId=9356, ComSystemTemplateSystemSignalRef=OBJ_VELOCITY_LONG_017
          OBJ_ACCELERATION_LAT_ERR_017_oRDR_TRACKER_OBJ_017_oPCAN_RADAR_5717d083_Tx: ComBitPosition=223, ComBitSize=8, ComSignalType=UINT8, ComHandleId=9314, ComSystemTemplateSystemSignalRef=OBJ_ACCELERATION_LAT_ERR_017
          OBJ_MH_CYCLE_COUNTER_017_oRDR_TRACKER_OBJ_017_oPCAN_RADAR_654f9959_Tx: ComBitPosition=487, ComBitSize=8, ComSignalType=UINT8, ComHandleId=9340, ComSystemTemplateSystemSignalRef=OBJ_MH_CYCLE_COUNTER_017
          OBJ_MH_CRC16_017_oRDR_TRACKER_OBJ_017_oPCAN_RADAR_14abc3b8_Tx: ComBitPosition=495, ComBitSize=16, ComSignalType=UINT16, ComHandleId=9339, ComSystemTemplateSystemSignalRef=OBJ_MH_CRC16_017
      6 x ComIPdu, all with ComIPduDirection=SEND, ComIPduType=NORMAL, ComIPduCancellationSupport=false, ComIPduSignalProcessing=DEFERRED, ComIPduChannelRef=CN_PCAN_RADAR_458ff0f1, ComIPduGroupRef=RDR01_oPCAN_RADAR_Tx_b6bdb067 if post-build-variant-condition{matching-criterion=RDR_POS, value=0}, ComIPduMainFunctionRef=ComMainFunctionTx_Event, ComIPduGroupRef=RDR02_oPCAN_RADAR_Tx_9f750495 if post-build-variant-condition{matching-criterion=RDR_POS, value=1}, ComIPduGroupRef=RDR03_oPCAN_RADAR_Tx_311d9504 if post-build-variant-condition{matching-criterion=RDR_POS, value=2}, ComIPduGroupRef=RDR04_oPCAN_RADAR_Tx_cce46d71 if post-build-variant-condition{matching-criterion=RDR_POS, value=3}, ComIPduGroupRef=RDR05_oPCAN_RADAR_Tx_628cfce0 if post-build-variant-condition{matching-criterion=RDR_POS, value=4}, ComIPduGroupRef=RDR06_oPCAN_RADAR_Tx_4b444812 if post-build-variant-condition{matching-criterion=RDR_POS, value=5}, ComIPduGroupRef=RDR07_oPCAN_RADAR_Tx_e52cd983 if post-build-variant-condition{matching-criterion=RDR_POS, value=6}, ComIPduGroupRef=RDR08_oPCAN_RADAR_Tx_6bc6beb9 if post-build-variant-condition{matching-criterion=RDR_POS, value=7}:
        RDR_DETECTION_177_180_oPCAN_RADAR_6ba1923c_Tx: ComIPduHandleId=50, ComIPduSignalGroupRef=SG_Detections_177_180_oRDR_DETECTION_177_180_oPCAN_RADAR_6c601388_Tx, ComPduIdRef=RDR_DETECTION_177_180_oPCAN_RADAR_6ba1923c_Tx
          ComTxIPdu: ComMinimumDelayTime=0, ComTxIPduUnusedAreasDefault=0
            ComTxModeTrue
              ComTxMode: ComTxModeMode=DIRECT, ComTxModeNumberOfRepetitions=0
            ComTxModeFalse
              ComTxMode: ComTxModeMode=NONE
        RDR_DETECTION_349_352_oPCAN_RADAR_cb97c5b8_Tx: ComIPduHandleId=93, ComIPduSignalGroupRef=SG_Detections_349_352_oRDR_DETECTION_349_352_oPCAN_RADAR_9ae2a2ec_Tx, ComPduIdRef=RDR_DETECTION_349_352_oPCAN_RADAR_cb97c5b8_Tx
          ComTxIPdu: ComMinimumDelayTime=0, ComTxIPduUnusedAreasDefault=0
            ComTxModeTrue
              ComTxMode: ComTxModeMode=DIRECT, ComTxModeNumberOfRepetitions=0
            ComTxModeFalse
              ComTxMode: ComTxModeMode=NONE
        RDR_DETECTION_389_392_oPCAN_RADAR_fd9b2d9f_Tx: ComIPduHandleId=103, ComIPduSignalGroupRef=SG_Detections_389_392_oRDR_DETECTION_389_392_oPCAN_RADAR_25df6300_Tx, ComPduIdRef=RDR_DETECTION_389_392_oPCAN_RADAR_fd9b2d9f_Tx
          ComTxIPdu: ComMinimumDelayTime=0, ComTxIPduUnusedAreasDefault=0
            ComTxModeTrue
              ComTxMode: ComTxModeMode=DIRECT, ComTxModeNumberOfRepetitions=0
            ComTxModeFalse
              ComTxMode: ComTxModeMode=NONE
        RDR_TRACKER_OBJ_040_oPCAN_RADAR_eabdadc8_Tx: ComIPduHandleId=150, ComIPduSignalGroupRef=SG_TrackerObject040_oRDR_TRACKER_OBJ_040_oPCAN_RADAR_cd9c2a97_Tx, ComPduIdRef=RDR_TRACKER_OBJ_040_oPCAN_RADAR_eabdadc8_Tx
          ComTxIPdu: ComMinimumDelayTime=0, ComTxIPduUnusedAreasDefault=0
            ComTxModeTrue
              ComTxMode: ComTxModeMode=DIRECT, ComTxModeNumberOfRepetitions=0
            ComTxModeFalse
              ComTxMode: ComTxModeMode=NONE
        RDR_TRACKER_OBJ_061_oPCAN_RADAR_d645b0e0_Tx: ComIPduHandleId=171, ComIPduSignalGroupRef=SG_TrackerObject061_oRDR_TRACKER_OBJ_061_oPCAN_RADAR_91ab4f58_Tx, ComPduIdRef=RDR_TRACKER_OBJ_061_oPCAN_RADAR_d645b0e0_Tx
          ComTxIPdu: ComMinimumDelayTime=0, ComTxIPduUnusedAreasDefault=0
            ComTxModeTrue
              ComTxMode: ComTxModeMode=DIRECT, ComTxModeNumberOfRepetitions=0
            ComTxModeFalse
              ComTxMode: ComTxModeMode=NONE
        RDR_DETECTION_185_188_oPCAN_RADAR_13e175fe_Tx: ComIPduHandleId=52, ComIPduSignalGroupRef=SG_Detections_185_188_oRDR_DETECTION_185_188_oPCAN_RADAR_39f50203_Tx, ComPduIdRef=RDR_DETECTION_185_188_oPCAN_RADAR_13e175fe_Tx
          ComTxIPdu: ComMinimumDelayTime=0, ComTxIPduUnusedAreasDefault=0
            ComTxModeTrue
              ComTxMode: ComTxModeMode=DIRECT, ComTxModeNumberOfRepetitions=0
            ComTxModeFalse
              ComTxMode: ComTxModeMode=NONE
