[part 6 of 20: package /ActiveEcuC]
AUTOSAR XML (schema 00053)
package /ActiveEcuC  (continued)
  module config Com: implementation-config-variant=VARIANT-PRE-COMPILE, module-description=Com_Impl  (continued)
    ComConfig: ComConfigurationId=0, ComRxImmediateNotificationCacheSize=0, ComRxDeferredNotificationCacheSize=1  (continued)
      109 x ComSignalGroup, all with ComSignalGroupAccess=ACCESS_NEEDED_BY_SWC_OR_COM, ComSignalGroupArrayAccess=true:  (continued)
        SG_Detections_369_372_oRDR_DETECTION_369_372_oPCAN_RADAR_af9702be_Tx: ComTransferProperty=TRIGGERED, ComHandleId=94, ComSystemTemplateSignalGroupRef=SG_Detections_369_372
          83 x ComGroupSignal, all with ComSignalEndianness=LITTLE_ENDIAN, ComTransferProperty=PENDING, ComSignalAccess=ACCESS_NEEDED_BY_SWC_OR_COM:
            DET_RANGE_VELOCITY_370_oRDR_DETECTION_369_372_oPCAN_RADAR_d265a322_Tx: ComBitPosition=160, ComBitSize=15, ComSignalInitValue=16384, ComSignalType=UINT16, ComHandleId=7761, ComSystemTemplateSystemSignalRef=DET_RANGE_VELOCITY_370
            DET_BI_STATIC_FLAG_370_oRDR_DETECTION_369_372_oPCAN_RADAR_e1745239_Tx: ComBitPosition=216, ComBitSize=1, ComSignalInitValue=0, ComSignalType=BOOLEAN, ComHandleId=7710, ComSystemTemplateSystemSignalRef=DET_BI_STATIC_FLAG_370
            DET_AZIMUTH_ERR_369_oRDR_DETECTION_369_372_oPCAN_RADAR_76cdf5ed_Tx: ComBitPosition=105, ComBitSize=7, ComSignalInitValue=0, ComSignalType=UINT8, ComHandleId=7701, ComSystemTemplateSystemSignalRef=DET_AZIMUTH_ERR_369
            DET_SNR_372_oRDR_DETECTION_369_372_oPCAN_RADAR_79db6f11_Tx: ComBitPosition=456, ComBitSize=8, ComSignalInitValue=0, ComSignalType=UINT8, ComHandleId=7775, ComSystemTemplateSystemSignalRef=DET_SNR_372
            DET_AZIMUTH_370_oRDR_DETECTION_369_372_oPCAN_RADAR_b75812bc_Tx: ComBitPosition=200, ComBitSize=13, ComSignalInitValue=0, ComSignalType=UINT16, ComHandleId=7698, ComSystemTemplateSystemSignalRef=DET_AZIMUTH_370
            DET_ELEVATION_ERR_371_oRDR_DETECTION_369_372_oPCAN_RADAR_74a28150_Tx: ComBitPosition=304, ComBitSize=6, ComSignalInitValue=0, ComSignalType=UINT8, ComHandleId=7727, ComSystemTemplateSystemSignalRef=DET_ELEVATION_ERR_371
            DET_SUPER_RES_TARGET_370_oRDR_DETECTION_369_372_oPCAN_RADAR_b9d2e81f_Tx: ComBitPosition=199, ComBitSize=1, ComSignalInitValue=0, ComSignalType=BOOLEAN, ComHandleId=7777, ComSystemTemplateSystemSignalRef=DET_SUPER_RES_TARGET_370
            DET_CONFD_AZIMUTH_371_oRDR_DETECTION_369_372_oPCAN_RADAR_20cecce3_Tx: ComBitPosition=342, ComBitSize=2, ComSignalInitValue=0, ComSignalType=UINT8, ComHandleId=7715, ComSystemTemplateSystemSignalRef=DET_CONFD_AZIMUTH_371
            DET_ELEVATION_372_oRDR_DETECTION_369_372_oPCAN_RADAR_977b62db_Tx: ComBitPosition=408, ComBitSize=8, ComSignalInitValue=0, ComSignalType=UINT8, ComHandleId=7724, ComSystemTemplateSystemSignalRef=DET_ELEVATION_372
            DET_EXISTENCE_PROB_369_oRDR_DETECTION_369_372_oPCAN_RADAR_566d5201_Tx: ComBitPosition=112, ComBitSize=6, ComSignalInitValue=0, ComSignalType=UINT8, ComHandleId=7729, ComSystemTemplateSystemSignalRef=DET_EXISTENCE_PROB_369
            DET_SUPER_RES_TARGET_371_oRDR_DETECTION_369_372_oPCAN_RADAR_2ca23c8a_Tx: ComBitPosition=311, ComBitSize=1, ComSignalInitValue=0, ComSignalType=BOOLEAN, ComHandleId=7778, ComSystemTemplateSystemSignalRef=DET_SUPER_RES_TARGET_371
            DET_RANGE_VELOCITY_371_oRDR_DETECTION_369_372_oPCAN_RADAR_471577b7_Tx: ComBitPosition=272, ComBitSize=15, ComSignalInitValue=16384, ComSignalType=UINT16, ComHandleId=7762, ComSystemTemplateSystemSignalRef=DET_RANGE_VELOCITY_371
            DET_SNR_370_oRDR_DETECTION_369_372_oPCAN_RADAR_884bc07a_Tx: ComBitPosition=232, ComBitSize=8, ComSignalInitValue=0, ComSignalType=UINT8, ComHandleId=7773, ComSystemTemplateSystemSignalRef=DET_SNR_370
            DET_EXISTENCE_PROB_370_oRDR_DETECTION_369_372_oPCAN_RADAR_334d20a5_Tx: ComBitPosition=224, ComBitSize=6, ComSignalInitValue=0, ComSignalType=UINT8, ComHandleId=7730, ComSystemTemplateSystemSignalRef=DET_EXISTENCE_PROB_370
            DET_ELEVATION_ERR_372_oRDR_DETECTION_369_372_oPCAN_RADAR_1042faae_Tx: ComBitPosition=416, ComBitSize=6, ComSignalInitValue=0, ComSignalType=UINT8, ComHandleId=7728, ComSystemTemplateSystemSignalRef=DET_ELEVATION_ERR_372
            DET_RANGE_ERR_370_oRDR_DETECTION_369_372_oPCAN_RADAR_002bdb6e_Tx: ComBitPosition=152, ComBitSize=7, ComSignalInitValue=0, ComSignalType=UINT8, ComHandleId=7757, ComSystemTemplateSystemSignalRef=DET_RANGE_ERR_370
            DET_HVC_FLAG_372_oRDR_DETECTION_369_372_oPCAN_RADAR_23a9ccb1_Tx: ComBitPosition=422, ComBitSize=1, ComSignalInitValue=0, ComSignalType=BOOLEAN, ComHandleId=7736, ComSystemTemplateSystemSignalRef=DET_HVC_FLAG_372
            DET_RCS_369_oRDR_DETECTION_369_372_oPCAN_RADAR_30c5e6dc_Tx: ComBitPosition=128, ComBitSize=8, ComSignalInitValue=128, ComSignalType=UINT8, ComHandleId=7768, ComSystemTemplateSystemSignalRef=DET_RCS_369
            DET_BI_STATIC_FLAG_372_oRDR_DETECTION_369_372_oPCAN_RADAR_10e4fd52_Tx: ComBitPosition=440, ComBitSize=1, ComSignalInitValue=0, ComSignalType=BOOLEAN, ComHandleId=7712, ComSystemTemplateSystemSignalRef=DET_BI_STATIC_FLAG_372
            DET_RANGE_371_oRDR_DETECTION_369_372_oPCAN_RADAR_32b3b592_Tx: ComBitPosition=248, ComBitSize=15, ComSignalInitValue=0, ComSignalType=UINT16, ComHandleId=7754, ComSystemTemplateSystemSignalRef=DET_RANGE_371
            DET_CONFD_AZIMUTH_370_oRDR_DETECTION_369_372_oPCAN_RADAR_b5be1876_Tx: ComBitPosition=230, ComBitSize=2, ComSignalInitValue=0, ComSignalType=UINT8, ComHandleId=7714, ComSystemTemplateSystemSignalRef=DET_CONFD_AZIMUTH_370
            DET_RANGE_VELOCITY_372_oRDR_DETECTION_369_372_oPCAN_RADAR_23f50c49_Tx: ComBitPosition=384, ComBitSize=15, ComSignalInitValue=16384, ComSignalType=UINT16, ComHandleId=7763, ComSystemTemplateSystemSignalRef=DET_RANGE_VELOCITY_372
            DET_SNR_371_oRDR_DETECTION_369_372_oPCAN_RADAR_1d3b14ef_Tx: ComBitPosition=344, ComBitSize=8, ComSignalInitValue=0, ComSignalType=UINT8, ComHandleId=7774, ComSystemTemplateSystemSignalRef=DET_SNR_371
            DET_HVC_FLAG_371_oRDR_DETECTION_369_372_oPCAN_RADAR_4749b74f_Tx: ComBitPosition=310, ComBitSize=1, ComSignalInitValue=0, ComSignalType=BOOLEAN, ComHandleId=7735, ComSystemTemplateSystemSignalRef=DET_HVC_FLAG_371
            DET_HVC_FLAG_370_oRDR_DETECTION_369_372_oPCAN_RADAR_d23963da_Tx: ComBitPosition=198, ComBitSize=1, ComSignalInitValue=0, ComSignalType=BOOLEAN, ComHandleId=7734, ComSystemTemplateSystemSignalRef=DET_HVC_FLAG_370
            DET_EXISTENCE_PROB_371_oRDR_DETECTION_369_372_oPCAN_RADAR_a63df430_Tx: ComBitPosition=336, ComBitSize=6, ComSignalInitValue=0, ComSignalType=UINT8, ComHandleId=7731, ComSystemTemplateSystemSignalRef=DET_EXISTENCE_PROB_371
            DET_AZIMUTH_369_oRDR_DETECTION_369_372_oPCAN_RADAR_d2786018_Tx: ComBitPosition=88, ComBitSize=13, ComSignalInitValue=0, ComSignalType=UINT16, ComHandleId=7697, ComSystemTemplateSystemSignalRef=DET_AZIMUTH_369
            DET_EXISTENCE_PROB_372_oRDR_DETECTION_369_372_oPCAN_RADAR_c2dd8fce_Tx: ComBitPosition=448, ComBitSize=6, ComSignalInitValue=0, ComSignalType=UINT8, ComHandleId=7732, ComSystemTemplateSystemSignalRef=DET_EXISTENCE_PROB_372
            DET_AZIMUTH_ERR_372_oRDR_DETECTION_369_372_oPCAN_RADAR_e27d2822_Tx: ComBitPosition=441, ComBitSize=7, ComSignalInitValue=0, ComSignalType=UINT8, ComHandleId=7704, ComSystemTemplateSystemSignalRef=DET_AZIMUTH_ERR_372
            DET_CONFD_AZIMUTH_372_oRDR_DETECTION_369_372_oPCAN_RADAR_442eb71d_Tx: ComBitPosition=454, ComBitSize=2, ComSignalInitValue=0, ComSignalType=UINT8, ComHandleId=7716, ComSystemTemplateSystemSignalRef=DET_CONFD_AZIMUTH_372
            DET_MH_SCAN_INDEX_4LSB_369_372_oRDR_DETECTION_369_372_oPCAN_RADAR_6340540e_Tx: ComBitPosition=476, ComBitSize=4, ComSignalInitValue=0, ComSignalType=UINT8, ComHandleId=7743, ComSystemTemplateSystemSignalRef=DET_MH_SCAN_INDEX_4LSB_369_372
            DET_SNR_369_oRDR_DETECTION_369_372_oPCAN_RADAR_ed6bb2de_Tx: ComBitPosition=120, ComBitSize=8, ComSignalInitValue=0, ComSignalType=UINT8, ComHandleId=7772, ComSystemTemplateSystemSignalRef=DET_SNR_369
            DET_CONFD_ELEVATION_369_oRDR_DETECTION_369_372_oPCAN_RADAR_d20b6b28_Tx: ComBitPosition=101, ComBitSize=2, ComSignalInitValue=0, ComSignalType=UINT8, ComHandleId=7717, ComSystemTemplateSystemSignalRef=DET_CONFD_ELEVATION_369
            DET_HVC_FLAG_369_oRDR_DETECTION_369_372_oPCAN_RADAR_b719117e_Tx: ComBitPosition=86, ComBitSize=1, ComSignalInitValue=0, ComSignalType=BOOLEAN, ComHandleId=7733, ComSystemTemplateSystemSignalRef=DET_HVC_FLAG_369
            DET_BI_STATIC_FLAG_369_oRDR_DETECTION_369_372_oPCAN_RADAR_8454209d_Tx: ComBitPosition=104, ComBitSize=1, ComSignalInitValue=0, ComSignalType=BOOLEAN, ComHandleId=7709, ComSystemTemplateSystemSignalRef=DET_BI_STATIC_FLAG_369
            DET_RANGE_ERR_369_oRDR_DETECTION_369_372_oPCAN_RADAR_650ba9ca_Tx: ComBitPosition=40, ComBitSize=7, ComSignalInitValue=0, ComSignalType=UINT8, ComHandleId=7756, ComSystemTemplateSystemSignalRef=DET_RANGE_ERR_369
            DET_AZIMUTH_ERR_371_oRDR_DETECTION_369_372_oPCAN_RADAR_869d53dc_Tx: ComBitPosition=329, ComBitSize=7, ComSignalInitValue=0, ComSignalType=UINT8, ComHandleId=7703, ComSystemTemplateSystemSignalRef=DET_AZIMUTH_ERR_371
            DET_CONFD_ELEVATION_370_oRDR_DETECTION_369_372_oPCAN_RADAR_b72b198c_Tx: ComBitPosition=213, ComBitSize=2, ComSignalInitValue=0, ComSignalType=UINT8, ComHandleId=7718, ComSystemTemplateSystemSignalRef=DET_CONFD_ELEVATION_370
            DET_RANGE_VELOCITY_ERR_371_oRDR_DETECTION_369_372_oPCAN_RADAR_48ae8c05_Tx: ComBitPosition=288, ComBitSize=8, ComSignalInitValue=0, ComSignalType=UINT8, ComHandleId=7766, ComSystemTemplateSystemSignalRef=DET_RANGE_VELOCITY_ERR_371
            DET_CONFD_AZIMUTH_369_oRDR_DETECTION_369_372_oPCAN_RADAR_d09e6ad2_Tx: ComBitPosition=118, ComBitSize=2, ComSignalInitValue=0, ComSignalType=UINT8, ComHandleId=7713, ComSystemTemplateSystemSignalRef=DET_CONFD_AZIMUTH_369
            DET_RANGE_VELOCITY_ERR_369_oRDR_DETECTION_369_372_oPCAN_RADAR_b8fe2a34_Tx: ComBitPosition=64, ComBitSize=8, ComSignalInitValue=0, ComSignalType=UINT8, ComHandleId=7764, ComSystemTemplateSystemSignalRef=DET_RANGE_VELOCITY_ERR_369
            DET_BI_STATIC_FLAG_371_oRDR_DETECTION_369_372_oPCAN_RADAR_740486ac_Tx: ComBitPosition=328, ComBitSize=1, ComSignalInitValue=0, ComSignalType=BOOLEAN, ComHandleId=7711, ComSystemTemplateSystemSignalRef=DET_BI_STATIC_FLAG_371
            DET_ELEVATION_ERR_370_oRDR_DETECTION_369_372_oPCAN_RADAR_e1d255c5_Tx: ComBitPosition=192, ComBitSize=6, ComSignalInitValue=0, ComSignalType=UINT8, ComHandleId=7726, ComSystemTemplateSystemSignalRef=DET_ELEVATION_ERR_370
            DET_MH_CYCLE_COUNTER_369_372_oRDR_DETECTION_369_372_oPCAN_RADAR_af6a7182_Tx: ComBitPosition=16, ComBitSize=8, ComSignalInitValue=0, ComSignalType=UINT8, ComHandleId=7742, ComSystemTemplateSystemSignalRef=DET_MH_CYCLE_COUNTER_369_372
            DET_RCS_372_oRDR_DETECTION_369_372_oPCAN_RADAR_a4753b13_Tx: ComBitPosition=464, ComBitSize=8, ComSignalInitValue=128, ComSignalType=UINT8, ComHandleId=7771, ComSystemTemplateSystemSignalRef=DET_RCS_372
            DET_RANGE_VELOCITY_ERR_370_oRDR_DETECTION_369_372_oPCAN_RADAR_ddde5890_Tx: ComBitPosition=176, ComBitSize=8, ComSignalInitValue=0, ComSignalType=UINT8, ComHandleId=7765, ComSystemTemplateSystemSignalRef=DET_RANGE_VELOCITY_ERR_370
            DET_RANGE_ERR_372_oRDR_DETECTION_369_372_oPCAN_RADAR_f1bb7405_Tx: ComBitPosition=376, ComBitSize=7, ComSignalInitValue=0, ComSignalType=UINT8, ComHandleId=7759, ComSystemTemplateSystemSignalRef=DET_RANGE_ERR_372
            DET_RANGE_VELOCITY_ERR_372_oRDR_DETECTION_369_372_oPCAN_RADAR_2c4ef7fb_Tx: ComBitPosition=400, ComBitSize=8, ComSignalInitValue=0, ComSignalType=UINT8, ComHandleId=7767, ComSystemTemplateSystemSignalRef=DET_RANGE_VELOCITY_ERR_372
            DET_ELEVATION_370_oRDR_DETECTION_369_372_oPCAN_RADAR_66ebcdb0_Tx: ComBitPosition=184, ComBitSize=8, ComSignalInitValue=0, ComSignalType=UINT8, ComHandleId=7722, ComSystemTemplateSystemSignalRef=DET_ELEVATION_370
            DET_RANGE_372_oRDR_DETECTION_369_372_oPCAN_RADAR_5653ce6c_Tx: ComBitPosition=360, ComBitSize=15, ComSignalInitValue=0, ComSignalType=UINT16, ComHandleId=7755, ComSystemTemplateSystemSignalRef=DET_RANGE_372
            DET_ELEVATION_ERR_369_oRDR_DETECTION_369_372_oPCAN_RADAR_84f22761_Tx: ComBitPosition=80, ComBitSize=6, ComSignalInitValue=0, ComSignalType=UINT8, ComHandleId=7725, ComSystemTemplateSystemSignalRef=DET_ELEVATION_ERR_369
            DET_CONFD_ELEVATION_372_oRDR_DETECTION_369_372_oPCAN_RADAR_46bbb6e7_Tx: ComBitPosition=437, ComBitSize=2, ComSignalInitValue=0, ComSignalType=UINT8, ComHandleId=7720, ComSystemTemplateSystemSignalRef=DET_CONFD_ELEVATION_372
            DET_RANGE_VELOCITY_369_oRDR_DETECTION_369_372_oPCAN_RADAR_b745d186_Tx: ComBitPosition=48, ComBitSize=15, ComSignalInitValue=16384, ComSignalType=UINT16, ComHandleId=7760, ComSystemTemplateSystemSignalRef=DET_RANGE_VELOCITY_369
            DET_SUPER_RES_TARGET_372_oRDR_DETECTION_369_372_oPCAN_RADAR_48424774_Tx: ComBitPosition=423, ComBitSize=1, ComSignalInitValue=0, ComSignalType=BOOLEAN, ComHandleId=7779, ComSystemTemplateSystemSignalRef=DET_SUPER_RES_TARGET_372
            DET_AZIMUTH_372_oRDR_DETECTION_369_372_oPCAN_RADAR_46c8bdd7_Tx: ComBitPosition=424, ComBitSize=13, ComSignalInitValue=0, ComSignalType=UINT16, ComHandleId=7700, ComSystemTemplateSystemSignalRef=DET_AZIMUTH_372
            DET_MH_CRC16_369_372_oRDR_DETECTION_369_372_oPCAN_RADAR_2b1fd0b5_Tx: ComBitPosition=0, ComBitSize=16, ComSignalInitValue=0, ComSignalType=UINT16, ComHandleId=7741, ComSystemTemplateSystemSignalRef=DET_MH_CRC16_369_372
            DET_AZIMUTH_371_oRDR_DETECTION_369_372_oPCAN_RADAR_2228c629_Tx: ComBitPosition=312, ComBitSize=13, ComSignalInitValue=0, ComSignalType=UINT16, ComHandleId=7699, ComSystemTemplateSystemSignalRef=DET_AZIMUTH_371
            DET_AZIMUTH_ERR_370_oRDR_DETECTION_369_372_oPCAN_RADAR_13ed8749_Tx: ComBitPosition=217, ComBitSize=7, ComSignalInitValue=0, ComSignalType=UINT8, ComHandleId=7702, ComSystemTemplateSystemSignalRef=DET_AZIMUTH_ERR_370
            DET_RANGE_370_oRDR_DETECTION_369_372_oPCAN_RADAR_a7c36107_Tx: ComBitPosition=136, ComBitSize=15, ComSignalInitValue=0, ComSignalType=UINT16, ComHandleId=7753, ComSystemTemplateSystemSignalRef=DET_RANGE_370
            DET_SUPER_RES_TARGET_369_oRDR_DETECTION_369_372_oPCAN_RADAR_dcf29abb_Tx: ComBitPosition=87, ComBitSize=1, ComSignalInitValue=0, ComSignalType=BOOLEAN, ComHandleId=7776, ComSystemTemplateSystemSignalRef=DET_SUPER_RES_TARGET_369
            DET_RANGE_ERR_371_oRDR_DETECTION_369_372_oPCAN_RADAR_955b0ffb_Tx: ComBitPosition=264, ComBitSize=7, ComSignalInitValue=0, ComSignalType=UINT8, ComHandleId=7758, ComSystemTemplateSystemSignalRef=DET_RANGE_ERR_371
            DET_RCS_370_oRDR_DETECTION_369_372_oPCAN_RADAR_55e59478_Tx: ComBitPosition=240, ComBitSize=8, ComSignalInitValue=128, ComSignalType=UINT8, ComHandleId=7769, ComSystemTemplateSystemSignalRef=DET_RCS_370
            DET_RANGE_369_oRDR_DETECTION_369_372_oPCAN_RADAR_c2e313a3_Tx: ComBitPosition=24, ComBitSize=15, ComSignalInitValue=0, ComSignalType=UINT16, ComHandleId=7752, ComSystemTemplateSystemSignalRef=DET_RANGE_369
            DET_RCS_371_oRDR_DETECTION_369_372_oPCAN_RADAR_c09540ed_Tx: ComBitPosition=352, ComBitSize=8, ComSignalInitValue=128, ComSignalType=UINT8, ComHandleId=7770, ComSystemTemplateSystemSignalRef=DET_RCS_371
            DET_ELEVATION_371_oRDR_DETECTION_369_372_oPCAN_RADAR_f39b1925_Tx: ComBitPosition=296, ComBitSize=8, ComSignalInitValue=0, ComSignalType=UINT8, ComHandleId=7723, ComSystemTemplateSystemSignalRef=DET_ELEVATION_371
            DET_CONFD_ELEVATION_371_oRDR_DETECTION_369_372_oPCAN_RADAR_225bcd19_Tx: ComBitPosition=325, ComBitSize=2, ComSignalInitValue=0, ComSignalType=UINT8, ComHandleId=7719, ComSystemTemplateSystemSignalRef=DET_CONFD_ELEVATION_371
            DET_ELEVATION_369_oRDR_DETECTION_369_372_oPCAN_RADAR_03cbbf14_Tx: ComBitPosition=72, ComBitSize=8, ComSignalInitValue=0, ComSignalType=UINT8, ComHandleId=7721, ComSystemTemplateSystemSignalRef=DET_ELEVATION_369
            DET_MTD_369_oRDR_DETECTION_369_372_oPCAN_RADAR_5af81818_Tx: ComBitPosition=47, ComBitSize=1, ComSignalInitValue=0, ComSignalType=UINT8, ComHandleId=7744, ComSystemTemplateSystemSignalRef=DET_MTD_369
            DET_MTD_372_oRDR_DETECTION_369_372_oPCAN_RADAR_ce48c5d7_Tx: ComBitPosition=383, ComBitSize=1, ComSignalInitValue=0, ComSignalType=UINT8, ComHandleId=7747, ComSystemTemplateSystemSignalRef=DET_MTD_372
            DET_IDM_369_oRDR_DETECTION_369_372_oPCAN_RADAR_3c4b2ac3_Tx: ComBitPosition=63, ComBitSize=1, ComSignalInitValue=0, ComSignalType=UINT8, ComHandleId=7737, ComSystemTemplateSystemSignalRef=DET_IDM_369
            DET_BELOW_RAIN_THOLD_369_oRDR_DETECTION_369_372_oPCAN_RADAR_0779f3d8_Tx: ComBitPosition=39, ComBitSize=1, ComSignalInitValue=0, ComSignalType=UINT8, ComHandleId=7705, ComSystemTemplateSystemSignalRef=DET_BELOW_RAIN_THOLD_369
            DET_BELOW_RAIN_THOLD_371_oRDR_DETECTION_369_372_oPCAN_RADAR_f72955e9_Tx: ComBitPosition=263, ComBitSize=1, ComSignalInitValue=0, ComSignalType=UINT8, ComHandleId=7707, ComSystemTemplateSystemSignalRef=DET_BELOW_RAIN_THOLD_371
            DET_MTD_371_oRDR_DETECTION_369_372_oPCAN_RADAR_aaa8be29_Tx: ComBitPosition=271, ComBitSize=1, ComSignalInitValue=0, ComSignalType=UINT8, ComHandleId=7746, ComSystemTemplateSystemSignalRef=DET_MTD_371
            DET_PROB_1STAZHYPO_372_oRDR_DETECTION_369_372_oPCAN_RADAR_5dfc2d1a_Tx: ComBitPosition=439, ComBitSize=1, ComSignalInitValue=0, ComSignalType=BOOLEAN, ComHandleId=7751, ComSystemTemplateSystemSignalRef=DET_PROB_1STAZHYPO_372
            DET_IDM_370_oRDR_DETECTION_369_372_oPCAN_RADAR_596b5867_Tx: ComBitPosition=175, ComBitSize=1, ComSignalInitValue=0, ComSignalType=UINT8, ComHandleId=7738, ComSystemTemplateSystemSignalRef=DET_IDM_370
            DET_BELOW_RAIN_THOLD_370_oRDR_DETECTION_369_372_oPCAN_RADAR_6259817c_Tx: ComBitPosition=151, ComBitSize=1, ComSignalInitValue=0, ComSignalType=UINT8, ComHandleId=7706, ComSystemTemplateSystemSignalRef=DET_BELOW_RAIN_THOLD_370
            DET_PROB_1STAZHYPO_369_oRDR_DETECTION_369_372_oPCAN_RADAR_c94cf0d5_Tx: ComBitPosition=103, ComBitSize=1, ComSignalInitValue=0, ComSignalType=BOOLEAN, ComHandleId=7748, ComSystemTemplateSystemSignalRef=DET_PROB_1STAZHYPO_369
            DET_PROB_1STAZHYPO_371_oRDR_DETECTION_369_372_oPCAN_RADAR_391c56e4_Tx: ComBitPosition=327, ComBitSize=1, ComSignalInitValue=0, ComSignalType=BOOLEAN, ComHandleId=7750, ComSystemTemplateSystemSignalRef=DET_PROB_1STAZHYPO_371
            DET_PROB_1STAZHYPO_370_oRDR_DETECTION_369_372_oPCAN_RADAR_ac6c8271_Tx: ComBitPosition=215, ComBitSize=1, ComSignalInitValue=0, ComSignalType=BOOLEAN, ComHandleId=7749, ComSystemTemplateSystemSignalRef=DET_PROB_1STAZHYPO_370
            DET_MTD_370_oRDR_DETECTION_369_372_oPCAN_RADAR_3fd86abc_Tx: ComBitPosition=159, ComBitSize=1, ComSignalInitValue=0, ComSignalType=UINT8, ComHandleId=7745, ComSystemTemplateSystemSignalRef=DET_MTD_370
            DET_IDM_371_oRDR_DETECTION_369_372_oPCAN_RADAR_cc1b8cf2_Tx: ComBitPosition=287, ComBitSize=1, ComSignalInitValue=0, ComSignalType=UINT8, ComHandleId=7739, ComSystemTemplateSystemSignalRef=DET_IDM_371
            DET_BELOW_RAIN_THOLD_372_oRDR_DETECTION_369_372_oPCAN_RADAR_93c92e17_Tx: ComBitPosition=375, ComBitSize=1, ComSignalInitValue=0, ComSignalType=UINT8, ComHandleId=7708, ComSystemTemplateSystemSignalRef=DET_BELOW_RAIN_THOLD_372
            DET_IDM_372_oRDR_DETECTION_369_372_oPCAN_RADAR_a8fbf70c_Tx: ComBitPosition=399, ComBitSize=1, ComSignalInitValue=0, ComSignalType=UINT8, ComHandleId=7740, ComSystemTemplateSystemSignalRef=DET_IDM_372
        SG_Detections_325_328_oRDR_DETECTION_325_328_oPCAN_RADAR_5c066661_Tx: ComTransferProperty=TRIGGERED, ComHandleId=83, ComSystemTemplateSignalGroupRef=SG_Detections_325_328
          83 x ComGroupSignal, all with ComSignalEndianness=LITTLE_ENDIAN, ComTransferProperty=PENDING, ComSignalAccess=ACCESS_NEEDED_BY_SWC_OR_COM:
            DET_SUPER_RES_TARGET_325_oRDR_DETECTION_325_328_oPCAN_RADAR_da1d92a1_Tx: ComBitPosition=87, ComBitSize=1, ComSignalInitValue=0, ComSignalType=BOOLEAN, ComHandleId=6863, ComSystemTemplateSystemSignalRef=DET_SUPER_RES_TARGET_325
            DET_ELEVATION_ERR_327_oRDR_DETECTION_325_328_oPCAN_RADAR_738d8010_Tx: ComBitPosition=304, ComBitSize=6, ComSignalInitValue=0, ComSignalType=UINT8, ComHandleId=6814, ComSystemTemplateSystemSignalRef=DET_ELEVATION_ERR_327
            DET_SUPER_RES_TARGET_328_oRDR_DETECTION_325_328_oPCAN_RADAR_079daf8d_Tx: ComBitPosition=423, ComBitSize=1, ComSignalInitValue=0, ComSignalType=BOOLEAN, ComHandleId=6866, ComSystemTemplateSystemSignalRef=DET_SUPER_RES_TARGET_328
            DET_SNR_327_oRDR_DETECTION_325_328_oPCAN_RADAR_1a1415af_Tx: ComBitPosition=344, ComBitSize=8, ComSignalInitValue=0, ComSignalType=UINT8, ComHandleId=6861, ComSystemTemplateSystemSignalRef=DET_SNR_327
            DET_AZIMUTH_327_oRDR_DETECTION_325_328_oPCAN_RADAR_2507c769_Tx: ComBitPosition=312, ComBitSize=13, ComSignalInitValue=0, ComSignalType=UINT16, ComHandleId=6786, ComSystemTemplateSystemSignalRef=DET_AZIMUTH_327
            DET_CONFD_AZIMUTH_327_oRDR_DETECTION_325_328_oPCAN_RADAR_27e1cda3_Tx: ComBitPosition=342, ComBitSize=2, ComSignalInitValue=0, ComSignalType=UINT8, ComHandleId=6802, ComSystemTemplateSystemSignalRef=DET_CONFD_AZIMUTH_327
            DET_EXISTENCE_PROB_328_oRDR_DETECTION_325_328_oPCAN_RADAR_8d026737_Tx: ComBitPosition=448, ComBitSize=6, ComSignalInitValue=0, ComSignalType=UINT8, ComHandleId=6819, ComSystemTemplateSystemSignalRef=DET_EXISTENCE_PROB_328
            DET_ELEVATION_ERR_325_oRDR_DETECTION_325_328_oPCAN_RADAR_821d2f7b_Tx: ComBitPosition=80, ComBitSize=6, ComSignalInitValue=0, ComSignalType=UINT8, ComHandleId=6812, ComSystemTemplateSystemSignalRef=DET_ELEVATION_ERR_325
            DET_SNR_326_oRDR_DETECTION_325_328_oPCAN_RADAR_8f64c13a_Tx: ComBitPosition=232, ComBitSize=8, ComSignalInitValue=0, ComSignalType=UINT8, ComHandleId=6860, ComSystemTemplateSystemSignalRef=DET_SNR_326
            DET_RANGE_ERR_327_oRDR_DETECTION_325_328_oPCAN_RADAR_92740ebb_Tx: ComBitPosition=264, ComBitSize=7, ComSignalInitValue=0, ComSignalType=UINT8, ComHandleId=6845, ComSystemTemplateSystemSignalRef=DET_RANGE_ERR_327
            DET_RANGE_VELOCITY_325_oRDR_DETECTION_325_328_oPCAN_RADAR_b1aad99c_Tx: ComBitPosition=48, ComBitSize=15, ComSignalInitValue=16384, ComSignalType=UINT16, ComHandleId=6847, ComSystemTemplateSystemSignalRef=DET_RANGE_VELOCITY_325
            DET_RANGE_VELOCITY_ERR_326_oRDR_DETECTION_325_328_oPCAN_RADAR_daf159d0_Tx: ComBitPosition=176, ComBitSize=8, ComSignalInitValue=0, ComSignalType=UINT8, ComHandleId=6852, ComSystemTemplateSystemSignalRef=DET_RANGE_VELOCITY_ERR_326
            DET_AZIMUTH_ERR_326_oRDR_DETECTION_325_328_oPCAN_RADAR_14c28609_Tx: ComBitPosition=217, ComBitSize=7, ComSignalInitValue=0, ComSignalType=UINT8, ComHandleId=6789, ComSystemTemplateSystemSignalRef=DET_AZIMUTH_ERR_326
            DET_ELEVATION_325_oRDR_DETECTION_325_328_oPCAN_RADAR_0524b70e_Tx: ComBitPosition=72, ComBitSize=8, ComSignalInitValue=0, ComSignalType=UINT8, ComHandleId=6808, ComSystemTemplateSystemSignalRef=DET_ELEVATION_325
            DET_EXISTENCE_PROB_326_oRDR_DETECTION_325_328_oPCAN_RADAR_346221e5_Tx: ComBitPosition=224, ComBitSize=6, ComSignalInitValue=0, ComSignalType=UINT8, ComHandleId=6817, ComSystemTemplateSystemSignalRef=DET_EXISTENCE_PROB_326
            DET_HVC_FLAG_325_oRDR_DETECTION_325_328_oPCAN_RADAR_b1f61964_Tx: ComBitPosition=86, ComBitSize=1, ComSignalInitValue=0, ComSignalType=BOOLEAN, ComHandleId=6820, ComSystemTemplateSystemSignalRef=DET_HVC_FLAG_325
            DET_AZIMUTH_ERR_328_oRDR_DETECTION_325_328_oPCAN_RADAR_ada2c0db_Tx: ComBitPosition=441, ComBitSize=7, ComSignalInitValue=0, ComSignalType=UINT8, ComHandleId=6791, ComSystemTemplateSystemSignalRef=DET_AZIMUTH_ERR_328
            DET_AZIMUTH_325_oRDR_DETECTION_325_328_oPCAN_RADAR_d4976802_Tx: ComBitPosition=88, ComBitSize=13, ComSignalInitValue=0, ComSignalType=UINT16, ComHandleId=6784, ComSystemTemplateSystemSignalRef=DET_AZIMUTH_325
            DET_BI_STATIC_FLAG_325_oRDR_DETECTION_325_328_oPCAN_RADAR_82bb2887_Tx: ComBitPosition=104, ComBitSize=1, ComSignalInitValue=0, ComSignalType=BOOLEAN, ComHandleId=6796, ComSystemTemplateSystemSignalRef=DET_BI_STATIC_FLAG_325
            DET_ELEVATION_ERR_326_oRDR_DETECTION_325_328_oPCAN_RADAR_e6fd5485_Tx: ComBitPosition=192, ComBitSize=6, ComSignalInitValue=0, ComSignalType=UINT8, ComHandleId=6813, ComSystemTemplateSystemSignalRef=DET_ELEVATION_ERR_326
            DET_RANGE_325_oRDR_DETECTION_325_328_oPCAN_RADAR_c40c1bb9_Tx: ComBitPosition=24, ComBitSize=15, ComSignalInitValue=0, ComSignalType=UINT16, ComHandleId=6839, ComSystemTemplateSystemSignalRef=DET_RANGE_325
            DET_CONFD_AZIMUTH_328_oRDR_DETECTION_325_328_oPCAN_RADAR_0bf15fe4_Tx: ComBitPosition=454, ComBitSize=2, ComSignalInitValue=0, ComSignalType=UINT8, ComHandleId=6803, ComSystemTemplateSystemSignalRef=DET_CONFD_AZIMUTH_328
            DET_CONFD_ELEVATION_327_oRDR_DETECTION_325_328_oPCAN_RADAR_2574cc59_Tx: ComBitPosition=325, ComBitSize=2, ComSignalInitValue=0, ComSignalType=UINT8, ComHandleId=6806, ComSystemTemplateSystemSignalRef=DET_CONFD_ELEVATION_327
            DET_RANGE_326_oRDR_DETECTION_325_328_oPCAN_RADAR_a0ec6047_Tx: ComBitPosition=136, ComBitSize=15, ComSignalInitValue=0, ComSignalType=UINT16, ComHandleId=6840, ComSystemTemplateSystemSignalRef=DET_RANGE_326
            DET_AZIMUTH_ERR_325_oRDR_DETECTION_325_328_oPCAN_RADAR_7022fdf7_Tx: ComBitPosition=105, ComBitSize=7, ComSignalInitValue=0, ComSignalType=UINT8, ComHandleId=6788, ComSystemTemplateSystemSignalRef=DET_AZIMUTH_ERR_325
            DET_EXISTENCE_PROB_327_oRDR_DETECTION_325_328_oPCAN_RADAR_a112f570_Tx: ComBitPosition=336, ComBitSize=6, ComSignalInitValue=0, ComSignalType=UINT8, ComHandleId=6818, ComSystemTemplateSystemSignalRef=DET_EXISTENCE_PROB_327
            DET_HVC_FLAG_328_oRDR_DETECTION_325_328_oPCAN_RADAR_6c762448_Tx: ComBitPosition=422, ComBitSize=1, ComSignalInitValue=0, ComSignalType=BOOLEAN, ComHandleId=6823, ComSystemTemplateSystemSignalRef=DET_HVC_FLAG_328
            DET_RANGE_VELOCITY_ERR_328_oRDR_DETECTION_325_328_oPCAN_RADAR_63911f02_Tx: ComBitPosition=400, ComBitSize=8, ComSignalInitValue=0, ComSignalType=UINT8, ComHandleId=6854, ComSystemTemplateSystemSignalRef=DET_RANGE_VELOCITY_ERR_328
            DET_SUPER_RES_TARGET_326_oRDR_DETECTION_325_328_oPCAN_RADAR_befde95f_Tx: ComBitPosition=199, ComBitSize=1, ComSignalInitValue=0, ComSignalType=BOOLEAN, ComHandleId=6864, ComSystemTemplateSystemSignalRef=DET_SUPER_RES_TARGET_326
            DET_RANGE_327_oRDR_DETECTION_325_328_oPCAN_RADAR_359cb4d2_Tx: ComBitPosition=248, ComBitSize=15, ComSignalInitValue=0, ComSignalType=UINT16, ComHandleId=6841, ComSystemTemplateSystemSignalRef=DET_RANGE_327
            DET_RCS_327_oRDR_DETECTION_325_328_oPCAN_RADAR_c7ba41ad_Tx: ComBitPosition=352, ComBitSize=8, ComSignalInitValue=128, ComSignalType=UINT8, ComHandleId=6857, ComSystemTemplateSystemSignalRef=DET_RCS_327
            DET_ELEVATION_ERR_328_oRDR_DETECTION_325_328_oPCAN_RADAR_5f9d1257_Tx: ComBitPosition=416, ComBitSize=6, ComSignalInitValue=0, ComSignalType=UINT8, ComHandleId=6815, ComSystemTemplateSystemSignalRef=DET_ELEVATION_ERR_328
            DET_RANGE_VELOCITY_ERR_325_oRDR_DETECTION_325_328_oPCAN_RADAR_be11222e_Tx: ComBitPosition=64, ComBitSize=8, ComSignalInitValue=0, ComSignalType=UINT8, ComHandleId=6851, ComSystemTemplateSystemSignalRef=DET_RANGE_VELOCITY_ERR_325
            DET_CONFD_AZIMUTH_325_oRDR_DETECTION_325_328_oPCAN_RADAR_d67162c8_Tx: ComBitPosition=118, ComBitSize=2, ComSignalInitValue=0, ComSignalType=UINT8, ComHandleId=6800, ComSystemTemplateSystemSignalRef=DET_CONFD_AZIMUTH_325
            DET_CONFD_ELEVATION_328_oRDR_DETECTION_325_328_oPCAN_RADAR_09645e1e_Tx: ComBitPosition=437, ComBitSize=2, ComSignalInitValue=0, ComSignalType=UINT8, ComHandleId=6807, ComSystemTemplateSystemSignalRef=DET_CONFD_ELEVATION_328
            DET_BI_STATIC_FLAG_327_oRDR_DETECTION_325_328_oPCAN_RADAR_732b87ec_Tx: ComBitPosition=328, ComBitSize=1, ComSignalInitValue=0, ComSignalType=BOOLEAN, ComHandleId=6798, ComSystemTemplateSystemSignalRef=DET_BI_STATIC_FLAG_327
            DET_RANGE_ERR_328_oRDR_DETECTION_325_328_oPCAN_RADAR_be649cfc_Tx: ComBitPosition=376, ComBitSize=7, ComSignalInitValue=0, ComSignalType=UINT8, ComHandleId=6846, ComSystemTemplateSystemSignalRef=DET_RANGE_ERR_328
            DET_RANGE_VELOCITY_327_oRDR_DETECTION_325_328_oPCAN_RADAR_403a76f7_Tx: ComBitPosition=272, ComBitSize=15, ComSignalInitValue=16384, ComSignalType=UINT16, ComHandleId=6849, ComSystemTemplateSystemSignalRef=DET_RANGE_VELOCITY_327
            DET_CONFD_ELEVATION_326_oRDR_DETECTION_325_328_oPCAN_RADAR_b00418cc_Tx: ComBitPosition=213, ComBitSize=2, ComSignalInitValue=0, ComSignalType=UINT8, ComHandleId=6805, ComSystemTemplateSystemSignalRef=DET_CONFD_ELEVATION_326
            DET_HVC_FLAG_327_oRDR_DETECTION_325_328_oPCAN_RADAR_4066b60f_Tx: ComBitPosition=310, ComBitSize=1, ComSignalInitValue=0, ComSignalType=BOOLEAN, ComHandleId=6822, ComSystemTemplateSystemSignalRef=DET_HVC_FLAG_327
            DET_ELEVATION_328_oRDR_DETECTION_325_328_oPCAN_RADAR_d8a48a22_Tx: ComBitPosition=408, ComBitSize=8, ComSignalInitValue=0, ComSignalType=UINT8, ComHandleId=6811, ComSystemTemplateSystemSignalRef=DET_ELEVATION_328
            DET_SNR_325_oRDR_DETECTION_325_328_oPCAN_RADAR_eb84bac4_Tx: ComBitPosition=120, ComBitSize=8, ComSignalInitValue=0, ComSignalType=UINT8, ComHandleId=6859, ComSystemTemplateSystemSignalRef=DET_SNR_325
            DET_AZIMUTH_328_oRDR_DETECTION_325_328_oPCAN_RADAR_0917552e_Tx: ComBitPosition=424, ComBitSize=13, ComSignalInitValue=0, ComSignalType=UINT16, ComHandleId=6787, ComSystemTemplateSystemSignalRef=DET_AZIMUTH_328
            DET_EXISTENCE_PROB_325_oRDR_DETECTION_325_328_oPCAN_RADAR_50825a1b_Tx: ComBitPosition=112, ComBitSize=6, ComSignalInitValue=0, ComSignalType=UINT8, ComHandleId=6816, ComSystemTemplateSystemSignalRef=DET_EXISTENCE_PROB_325
            DET_RANGE_328_oRDR_DETECTION_325_328_oPCAN_RADAR_198c2695_Tx: ComBitPosition=360, ComBitSize=15, ComSignalInitValue=0, ComSignalType=UINT16, ComHandleId=6842, ComSystemTemplateSystemSignalRef=DET_RANGE_328
            DET_HVC_FLAG_326_oRDR_DETECTION_325_328_oPCAN_RADAR_d516629a_Tx: ComBitPosition=198, ComBitSize=1, ComSignalInitValue=0, ComSignalType=BOOLEAN, ComHandleId=6821, ComSystemTemplateSystemSignalRef=DET_HVC_FLAG_326
            DET_RANGE_VELOCITY_ERR_327_oRDR_DETECTION_325_328_oPCAN_RADAR_4f818d45_Tx: ComBitPosition=288, ComBitSize=8, ComSignalInitValue=0, ComSignalType=UINT8, ComHandleId=6853, ComSystemTemplateSystemSignalRef=DET_RANGE_VELOCITY_ERR_327
            DET_CONFD_ELEVATION_325_oRDR_DETECTION_325_328_oPCAN_RADAR_d4e46332_Tx: ComBitPosition=101, ComBitSize=2, ComSignalInitValue=0, ComSignalType=UINT8, ComHandleId=6804, ComSystemTemplateSystemSignalRef=DET_CONFD_ELEVATION_325
            DET_BI_STATIC_FLAG_326_oRDR_DETECTION_325_328_oPCAN_RADAR_e65b5379_Tx: ComBitPosition=216, ComBitSize=1, ComSignalInitValue=0, ComSignalType=BOOLEAN, ComHandleId=6797, ComSystemTemplateSystemSignalRef=DET_BI_STATIC_FLAG_326
            DET_MH_SCAN_INDEX_4LSB_325_328_oRDR_DETECTION_325_328_oPCAN_RADAR_90d130d1_Tx: ComBitPosition=476, ComBitSize=4, ComSignalInitValue=0, ComSignalType=UINT8, ComHandleId=6830, ComSystemTemplateSystemSignalRef=DET_MH_SCAN_INDEX_4LSB_325_328
            DET_SNR_328_oRDR_DETECTION_325_328_oPCAN_RADAR_360487e8_Tx: ComBitPosition=456, ComBitSize=8, ComSignalInitValue=0, ComSignalType=UINT8, ComHandleId=6862, ComSystemTemplateSystemSignalRef=DET_SNR_328
            DET_RANGE_ERR_326_oRDR_DETECTION_325_328_oPCAN_RADAR_0704da2e_Tx: ComBitPosition=152, ComBitSize=7, ComSignalInitValue=0, ComSignalType=UINT8, ComHandleId=6844, ComSystemTemplateSystemSignalRef=DET_RANGE_ERR_326
            DET_RCS_328_oRDR_DETECTION_325_328_oPCAN_RADAR_ebaad3ea_Tx: ComBitPosition=464, ComBitSize=8, ComSignalInitValue=128, ComSignalType=UINT8, ComHandleId=6858, ComSystemTemplateSystemSignalRef=DET_RCS_328
            DET_RANGE_VELOCITY_328_oRDR_DETECTION_325_328_oPCAN_RADAR_6c2ae4b0_Tx: ComBitPosition=384, ComBitSize=15, ComSignalInitValue=16384, ComSignalType=UINT16, ComHandleId=6850, ComSystemTemplateSystemSignalRef=DET_RANGE_VELOCITY_328
            DET_ELEVATION_326_oRDR_DETECTION_325_328_oPCAN_RADAR_61c4ccf0_Tx: ComBitPosition=184, ComBitSize=8, ComSignalInitValue=0, ComSignalType=UINT8, ComHandleId=6809, ComSystemTemplateSystemSignalRef=DET_ELEVATION_326
            DET_MH_CRC16_325_328_oRDR_DETECTION_325_328_oPCAN_RADAR_d88eb46a_Tx: ComBitPosition=0, ComBitSize=16, ComSignalInitValue=0, ComSignalType=UINT16, ComHandleId=6828, ComSystemTemplateSystemSignalRef=DET_MH_CRC16_325_328
            DET_RANGE_VELOCITY_326_oRDR_DETECTION_325_328_oPCAN_RADAR_d54aa262_Tx: ComBitPosition=160, ComBitSize=15, ComSignalInitValue=16384, ComSignalType=UINT16, ComHandleId=6848, ComSystemTemplateSystemSignalRef=DET_RANGE_VELOCITY_326
            DET_SUPER_RES_TARGET_327_oRDR_DETECTION_325_328_oPCAN_RADAR_2b8d3dca_Tx: ComBitPosition=311, ComBitSize=1, ComSignalInitValue=0, ComSignalType=BOOLEAN, ComHandleId=6865, ComSystemTemplateSystemSignalRef=DET_SUPER_RES_TARGET_327
            DET_RCS_325_oRDR_DETECTION_325_328_oPCAN_RADAR_362aeec6_Tx: ComBitPosition=128, ComBitSize=8, ComSignalInitValue=128, ComSignalType=UINT8, ComHandleId=6855, ComSystemTemplateSystemSignalRef=DET_RCS_325
            DET_MH_CYCLE_COUNTER_325_328_oRDR_DETECTION_325_328_oPCAN_RADAR_5cfb155d_Tx: ComBitPosition=16, ComBitSize=8, ComSignalInitValue=0, ComSignalType=UINT8, ComHandleId=6829, ComSystemTemplateSystemSignalRef=DET_MH_CYCLE_COUNTER_325_328
            DET_AZIMUTH_326_oRDR_DETECTION_325_328_oPCAN_RADAR_b07713fc_Tx: ComBitPosition=200, ComBitSize=13, ComSignalInitValue=0, ComSignalType=UINT16, ComHandleId=6785, ComSystemTemplateSystemSignalRef=DET_AZIMUTH_326
            DET_RANGE_ERR_325_oRDR_DETECTION_325_328_oPCAN_RADAR_63e4a1d0_Tx: ComBitPosition=40, ComBitSize=7, ComSignalInitValue=0, ComSignalType=UINT8, ComHandleId=6843, ComSystemTemplateSystemSignalRef=DET_RANGE_ERR_325
            DET_BI_STATIC_FLAG_328_oRDR_DETECTION_325_328_oPCAN_RADAR_5f3b15ab_Tx: ComBitPosition=440, ComBitSize=1, ComSignalInitValue=0, ComSignalType=BOOLEAN, ComHandleId=6799, ComSystemTemplateSystemSignalRef=DET_BI_STATIC_FLAG_328
            DET_CONFD_AZIMUTH_326_oRDR_DETECTION_325_328_oPCAN_RADAR_b2911936_Tx: ComBitPosition=230, ComBitSize=2, ComSignalInitValue=0, ComSignalType=UINT8, ComHandleId=6801, ComSystemTemplateSystemSignalRef=DET_CONFD_AZIMUTH_326
            DET_ELEVATION_327_oRDR_DETECTION_325_328_oPCAN_RADAR_f4b41865_Tx: ComBitPosition=296, ComBitSize=8, ComSignalInitValue=0, ComSignalType=UINT8, ComHandleId=6810, ComSystemTemplateSystemSignalRef=DET_ELEVATION_327
            DET_RCS_326_oRDR_DETECTION_325_328_oPCAN_RADAR_52ca9538_Tx: ComBitPosition=240, ComBitSize=8, ComSignalInitValue=128, ComSignalType=UINT8, ComHandleId=6856, ComSystemTemplateSystemSignalRef=DET_RCS_326
            DET_AZIMUTH_ERR_327_oRDR_DETECTION_325_328_oPCAN_RADAR_81b2529c_Tx: ComBitPosition=329, ComBitSize=7, ComSignalInitValue=0, ComSignalType=UINT8, ComHandleId=6790, ComSystemTemplateSystemSignalRef=DET_AZIMUTH_ERR_327
            DET_MTD_327_oRDR_DETECTION_325_328_oPCAN_RADAR_ad87bf69_Tx: ComBitPosition=271, ComBitSize=1, ComSignalInitValue=0, ComSignalType=UINT8, ComHandleId=6833, ComSystemTemplateSystemSignalRef=DET_MTD_327
            DET_BELOW_RAIN_THOLD_325_oRDR_DETECTION_325_328_oPCAN_RADAR_0196fbc2_Tx: ComBitPosition=39, ComBitSize=1, ComSignalInitValue=0, ComSignalType=UINT8, ComHandleId=6792, ComSystemTemplateSystemSignalRef=DET_BELOW_RAIN_THOLD_325
            DET_IDM_328_oRDR_DETECTION_325_328_oPCAN_RADAR_e7241ff5_Tx: ComBitPosition=399, ComBitSize=1, ComSignalInitValue=0, ComSignalType=UINT8, ComHandleId=6827, ComSystemTemplateSystemSignalRef=DET_IDM_328
            DET_PROB_1STAZHYPO_328_oRDR_DETECTION_325_328_oPCAN_RADAR_1223c5e3_Tx: ComBitPosition=439, ComBitSize=1, ComSignalInitValue=0, ComSignalType=BOOLEAN, ComHandleId=6838, ComSystemTemplateSystemSignalRef=DET_PROB_1STAZHYPO_328
            DET_IDM_327_oRDR_DETECTION_325_328_oPCAN_RADAR_cb348db2_Tx: ComBitPosition=287, ComBitSize=1, ComSignalInitValue=0, ComSignalType=UINT8, ComHandleId=6826, ComSystemTemplateSystemSignalRef=DET_IDM_327
            DET_PROB_1STAZHYPO_327_oRDR_DETECTION_325_328_oPCAN_RADAR_3e3357a4_Tx: ComBitPosition=327, ComBitSize=1, ComSignalInitValue=0, ComSignalType=BOOLEAN, ComHandleId=6837, ComSystemTemplateSystemSignalRef=DET_PROB_1STAZHYPO_327
            DET_BELOW_RAIN_THOLD_327_oRDR_DETECTION_325_328_oPCAN_RADAR_f00654a9_Tx: ComBitPosition=263, ComBitSize=1, ComSignalInitValue=0, ComSignalType=UINT8, ComHandleId=6794, ComSystemTemplateSystemSignalRef=DET_BELOW_RAIN_THOLD_327
            DET_PROB_1STAZHYPO_326_oRDR_DETECTION_325_328_oPCAN_RADAR_ab438331_Tx: ComBitPosition=215, ComBitSize=1, ComSignalInitValue=0, ComSignalType=BOOLEAN, ComHandleId=6836, ComSystemTemplateSystemSignalRef=DET_PROB_1STAZHYPO_326
            DET_MTD_326_oRDR_DETECTION_325_328_oPCAN_RADAR_38f76bfc_Tx: ComBitPosition=159, ComBitSize=1, ComSignalInitValue=0, ComSignalType=UINT8, ComHandleId=6832, ComSystemTemplateSystemSignalRef=DET_MTD_326
            DET_IDM_326_oRDR_DETECTION_325_328_oPCAN_RADAR_5e445927_Tx: ComBitPosition=175, ComBitSize=1, ComSignalInitValue=0, ComSignalType=UINT8, ComHandleId=6825, ComSystemTemplateSystemSignalRef=DET_IDM_326
            DET_MTD_328_oRDR_DETECTION_325_328_oPCAN_RADAR_81972d2e_Tx: ComBitPosition=383, ComBitSize=1, ComSignalInitValue=0, ComSignalType=UINT8, ComHandleId=6834, ComSystemTemplateSystemSignalRef=DET_MTD_328
            DET_MTD_325_oRDR_DETECTION_325_328_oPCAN_RADAR_5c171002_Tx: ComBitPosition=47, ComBitSize=1, ComSignalInitValue=0, ComSignalType=UINT8, ComHandleId=6831, ComSystemTemplateSystemSignalRef=DET_MTD_325
            DET_PROB_1STAZHYPO_325_oRDR_DETECTION_325_328_oPCAN_RADAR_cfa3f8cf_Tx: ComBitPosition=103, ComBitSize=1, ComSignalInitValue=0, ComSignalType=BOOLEAN, ComHandleId=6835, ComSystemTemplateSystemSignalRef=DET_PROB_1STAZHYPO_325
            DET_IDM_325_oRDR_DETECTION_325_328_oPCAN_RADAR_3aa422d9_Tx: ComBitPosition=63, ComBitSize=1, ComSignalInitValue=0, ComSignalType=UINT8, ComHandleId=6824, ComSystemTemplateSystemSignalRef=DET_IDM_325
            DET_BELOW_RAIN_THOLD_328_oRDR_DETECTION_325_328_oPCAN_RADAR_dc16c6ee_Tx: ComBitPosition=375, ComBitSize=1, ComSignalInitValue=0, ComSignalType=UINT8, ComHandleId=6795, ComSystemTemplateSystemSignalRef=DET_BELOW_RAIN_THOLD_328
            DET_BELOW_RAIN_THOLD_326_oRDR_DETECTION_325_328_oPCAN_RADAR_6576803c_Tx: ComBitPosition=151, ComBitSize=1, ComSignalInitValue=0, ComSignalType=UINT8, ComHandleId=6793, ComSystemTemplateSystemSignalRef=DET_BELOW_RAIN_THOLD_326
        SG_Detections_197_200_oRDR_DETECTION_197_200_oPCAN_RADAR_f6bd2d5e_Tx: ComTransferProperty=TRIGGERED, ComHandleId=51, ComSystemTemplateSignalGroupRef=SG_Detections_197_200
          83 x ComGroupSignal, all with ComSignalEndianness=LITTLE_ENDIAN, ComTransferProperty=PENDING, ComSignalAccess=ACCESS_NEEDED_BY_SWC_OR_COM:
            DET_SNR_199_oRDR_DETECTION_197_200_oPCAN_RADAR_ba1a1596_Tx: ComBitPosition=344, ComBitSize=8, ComSignalInitValue=0, ComSignalType=UINT8, ComHandleId=4205, ComSystemTemplateSystemSignalRef=DET_SNR_199
            DET_BI_STATIC_FLAG_198_oRDR_DETECTION_197_200_oPCAN_RADAR_46555340_Tx: ComBitPosition=216, ComBitSize=1, ComSignalInitValue=0, ComSignalType=BOOLEAN, ComHandleId=4141, ComSystemTemplateSystemSignalRef=DET_BI_STATIC_FLAG_198
            DET_EXISTENCE_PROB_200_oRDR_DETECTION_197_200_oPCAN_RADAR_f5722af4_Tx: ComBitPosition=448, ComBitSize=6, ComSignalInitValue=0, ComSignalType=UINT8, ComHandleId=4163, ComSystemTemplateSystemSignalRef=DET_EXISTENCE_PROB_200
            DET_HVC_FLAG_197_oRDR_DETECTION_197_200_oPCAN_RADAR_5908f0e4_Tx: ComBitPosition=86, ComBitSize=1, ComSignalInitValue=0, ComSignalType=BOOLEAN, ComHandleId=4164, ComSystemTemplateSystemSignalRef=DET_HVC_FLAG_197
            DET_AZIMUTH_200_oRDR_DETECTION_197_200_oPCAN_RADAR_716718ed_Tx: ComBitPosition=424, ComBitSize=13, ComSignalInitValue=0, ComSignalType=UINT16, ComHandleId=4131, ComSystemTemplateSystemSignalRef=DET_AZIMUTH_200
            DET_BI_STATIC_FLAG_197_oRDR_DETECTION_197_200_oPCAN_RADAR_6a45c107_Tx: ComBitPosition=104, ComBitSize=1, ComSignalInitValue=0, ComSignalType=BOOLEAN, ComHandleId=4140, ComSystemTemplateSystemSignalRef=DET_BI_STATIC_FLAG_197
            DET_RANGE_198_oRDR_DETECTION_197_200_oPCAN_RADAR_00e2607e_Tx: ComBitPosition=136, ComBitSize=15, ComSignalInitValue=0, ComSignalType=UINT16, ComHandleId=4184, ComSystemTemplateSystemSignalRef=DET_RANGE_198
            DET_SNR_197_oRDR_DETECTION_197_200_oPCAN_RADAR_037a5344_Tx: ComBitPosition=120, ComBitSize=8, ComSignalInitValue=0, ComSignalType=UINT8, ComHandleId=4203, ComSystemTemplateSystemSignalRef=DET_SNR_197
            DET_AZIMUTH_ERR_198_oRDR_DETECTION_197_200_oPCAN_RADAR_b4cc8630_Tx: ComBitPosition=217, ComBitSize=7, ComSignalInitValue=0, ComSignalType=UINT8, ComHandleId=4133, ComSystemTemplateSystemSignalRef=DET_AZIMUTH_ERR_198
            DET_EXISTENCE_PROB_199_oRDR_DETECTION_197_200_oPCAN_RADAR_011cf549_Tx: ComBitPosition=336, ComBitSize=6, ComSignalInitValue=0, ComSignalType=UINT8, ComHandleId=4162, ComSystemTemplateSystemSignalRef=DET_EXISTENCE_PROB_199
            DET_CONFD_ELEVATION_197_oRDR_DETECTION_197_200_oPCAN_RADAR_3c1a8ab2_Tx: ComBitPosition=101, ComBitSize=2, ComSignalInitValue=0, ComSignalType=UINT8, ComHandleId=4148, ComSystemTemplateSystemSignalRef=DET_CONFD_ELEVATION_197
            DET_CONFD_ELEVATION_198_oRDR_DETECTION_197_200_oPCAN_RADAR_100a18f5_Tx: ComBitPosition=213, ComBitSize=2, ComSignalInitValue=0, ComSignalType=UINT8, ComHandleId=4149, ComSystemTemplateSystemSignalRef=DET_CONFD_ELEVATION_198
            DET_CONFD_AZIMUTH_197_oRDR_DETECTION_197_200_oPCAN_RADAR_3e8f8b48_Tx: ComBitPosition=118, ComBitSize=2, ComSignalInitValue=0, ComSignalType=UINT8, ComHandleId=4144, ComSystemTemplateSystemSignalRef=DET_CONFD_AZIMUTH_197
            DET_SUPER_RES_TARGET_200_oRDR_DETECTION_197_200_oPCAN_RADAR_7fede24e_Tx: ComBitPosition=423, ComBitSize=1, ComSignalInitValue=0, ComSignalType=BOOLEAN, ComHandleId=4210, ComSystemTemplateSystemSignalRef=DET_SUPER_RES_TARGET_200
            DET_ELEVATION_200_oRDR_DETECTION_197_200_oPCAN_RADAR_a0d4c7e1_Tx: ComBitPosition=408, ComBitSize=8, ComSignalInitValue=0, ComSignalType=UINT8, ComHandleId=4155, ComSystemTemplateSystemSignalRef=DET_ELEVATION_200
            DET_RANGE_VELOCITY_198_oRDR_DETECTION_197_200_oPCAN_RADAR_7544a25b_Tx: ComBitPosition=160, ComBitSize=15, ComSignalInitValue=16384, ComSignalType=UINT16, ComHandleId=4192, ComSystemTemplateSystemSignalRef=DET_RANGE_VELOCITY_198
            DET_RANGE_200_oRDR_DETECTION_197_200_oPCAN_RADAR_61fc6b56_Tx: ComBitPosition=360, ComBitSize=15, ComSignalInitValue=0, ComSignalType=UINT16, ComHandleId=4186, ComSystemTemplateSystemSignalRef=DET_RANGE_200
            DET_HVC_FLAG_198_oRDR_DETECTION_197_200_oPCAN_RADAR_751862a3_Tx: ComBitPosition=198, ComBitSize=1, ComSignalInitValue=0, ComSignalType=BOOLEAN, ComHandleId=4165, ComSystemTemplateSystemSignalRef=DET_HVC_FLAG_198
            DET_RANGE_VELOCITY_ERR_198_oRDR_DETECTION_197_200_oPCAN_RADAR_7aff59e9_Tx: ComBitPosition=176, ComBitSize=8, ComSignalInitValue=0, ComSignalType=UINT8, ComHandleId=4196, ComSystemTemplateSystemSignalRef=DET_RANGE_VELOCITY_ERR_198
            DET_CONFD_AZIMUTH_199_oRDR_DETECTION_197_200_oPCAN_RADAR_87efcd9a_Tx: ComBitPosition=342, ComBitSize=2, ComSignalInitValue=0, ComSignalType=UINT8, ComHandleId=4146, ComSystemTemplateSystemSignalRef=DET_CONFD_AZIMUTH_199
            DET_HVC_FLAG_200_oRDR_DETECTION_197_200_oPCAN_RADAR_1406698b_Tx: ComBitPosition=422, ComBitSize=1, ComSignalInitValue=0, ComSignalType=BOOLEAN, ComHandleId=4167, ComSystemTemplateSystemSignalRef=DET_HVC_FLAG_200
            DET_MH_CYCLE_COUNTER_197_200_oRDR_DETECTION_197_200_oPCAN_RADAR_f6405e62_Tx: ComBitPosition=16, ComBitSize=8, ComSignalInitValue=0, ComSignalType=UINT8, ComHandleId=4173, ComSystemTemplateSystemSignalRef=DET_MH_CYCLE_COUNTER_197_200
            DET_RCS_200_oRDR_DETECTION_197_200_oPCAN_RADAR_93da9e29_Tx: ComBitPosition=464, ComBitSize=8, ComSignalInitValue=128, ComSignalType=UINT8, ComHandleId=4202, ComSystemTemplateSystemSignalRef=DET_RCS_200
            DET_CONFD_AZIMUTH_200_oRDR_DETECTION_197_200_oPCAN_RADAR_73811227_Tx: ComBitPosition=454, ComBitSize=2, ComSignalInitValue=0, ComSignalType=UINT8, ComHandleId=4147, ComSystemTemplateSystemSignalRef=DET_CONFD_AZIMUTH_200
            DET_RANGE_199_oRDR_DETECTION_197_200_oPCAN_RADAR_9592b4eb_Tx: ComBitPosition=248, ComBitSize=15, ComSignalInitValue=0, ComSignalType=UINT16, ComHandleId=4185, ComSystemTemplateSystemSignalRef=DET_RANGE_199
            DET_RANGE_VELOCITY_ERR_199_oRDR_DETECTION_197_200_oPCAN_RADAR_ef8f8d7c_Tx: ComBitPosition=288, ComBitSize=8, ComSignalInitValue=0, ComSignalType=UINT8, ComHandleId=4197, ComSystemTemplateSystemSignalRef=DET_RANGE_VELOCITY_ERR_199
            DET_ELEVATION_ERR_198_oRDR_DETECTION_197_200_oPCAN_RADAR_46f354bc_Tx: ComBitPosition=192, ComBitSize=6, ComSignalInitValue=0, ComSignalType=UINT8, ComHandleId=4157, ComSystemTemplateSystemSignalRef=DET_ELEVATION_ERR_198
            DET_SUPER_RES_TARGET_198_oRDR_DETECTION_197_200_oPCAN_RADAR_1ef3e966_Tx: ComBitPosition=199, ComBitSize=1, ComSignalInitValue=0, ComSignalType=BOOLEAN, ComHandleId=4208, ComSystemTemplateSystemSignalRef=DET_SUPER_RES_TARGET_198
            DET_ELEVATION_197_oRDR_DETECTION_197_200_oPCAN_RADAR_edda5e8e_Tx: ComBitPosition=72, ComBitSize=8, ComSignalInitValue=0, ComSignalType=UINT8, ComHandleId=4152, ComSystemTemplateSystemSignalRef=DET_ELEVATION_197
            DET_AZIMUTH_197_oRDR_DETECTION_197_200_oPCAN_RADAR_3c698182_Tx: ComBitPosition=88, ComBitSize=13, ComSignalInitValue=0, ComSignalType=UINT16, ComHandleId=4128, ComSystemTemplateSystemSignalRef=DET_AZIMUTH_197
            DET_AZIMUTH_ERR_200_oRDR_DETECTION_197_200_oPCAN_RADAR_d5d28d18_Tx: ComBitPosition=441, ComBitSize=7, ComSignalInitValue=0, ComSignalType=UINT8, ComHandleId=4135, ComSystemTemplateSystemSignalRef=DET_AZIMUTH_ERR_200
            DET_EXISTENCE_PROB_197_oRDR_DETECTION_197_200_oPCAN_RADAR_b87cb39b_Tx: ComBitPosition=112, ComBitSize=6, ComSignalInitValue=0, ComSignalType=UINT8, ComHandleId=4160, ComSystemTemplateSystemSignalRef=DET_EXISTENCE_PROB_197
            DET_ELEVATION_ERR_197_oRDR_DETECTION_197_200_oPCAN_RADAR_6ae3c6fb_Tx: ComBitPosition=80, ComBitSize=6, ComSignalInitValue=0, ComSignalType=UINT8, ComHandleId=4156, ComSystemTemplateSystemSignalRef=DET_ELEVATION_ERR_197
            DET_RANGE_ERR_199_oRDR_DETECTION_197_200_oPCAN_RADAR_327a0e82_Tx: ComBitPosition=264, ComBitSize=7, ComSignalInitValue=0, ComSignalType=UINT8, ComHandleId=4189, ComSystemTemplateSystemSignalRef=DET_RANGE_ERR_199
            DET_BI_STATIC_FLAG_200_oRDR_DETECTION_197_200_oPCAN_RADAR_274b5868_Tx: ComBitPosition=440, ComBitSize=1, ComSignalInitValue=0, ComSignalType=BOOLEAN, ComHandleId=4143, ComSystemTemplateSystemSignalRef=DET_BI_STATIC_FLAG_200
            DET_RANGE_VELOCITY_197_oRDR_DETECTION_197_200_oPCAN_RADAR_5954301c_Tx: ComBitPosition=48, ComBitSize=15, ComSignalInitValue=16384, ComSignalType=UINT16, ComHandleId=4191, ComSystemTemplateSystemSignalRef=DET_RANGE_VELOCITY_197
            DET_EXISTENCE_PROB_198_oRDR_DETECTION_197_200_oPCAN_RADAR_946c21dc_Tx: ComBitPosition=224, ComBitSize=6, ComSignalInitValue=0, ComSignalType=UINT8, ComHandleId=4161, ComSystemTemplateSystemSignalRef=DET_EXISTENCE_PROB_198
            DET_AZIMUTH_199_oRDR_DETECTION_197_200_oPCAN_RADAR_8509c750_Tx: ComBitPosition=312, ComBitSize=13, ComSignalInitValue=0, ComSignalType=UINT16, ComHandleId=4130, ComSystemTemplateSystemSignalRef=DET_AZIMUTH_199
            DET_HVC_FLAG_199_oRDR_DETECTION_197_200_oPCAN_RADAR_e068b636_Tx: ComBitPosition=310, ComBitSize=1, ComSignalInitValue=0, ComSignalType=BOOLEAN, ComHandleId=4166, ComSystemTemplateSystemSignalRef=DET_HVC_FLAG_199
            DET_RANGE_VELOCITY_ERR_197_oRDR_DETECTION_197_200_oPCAN_RADAR_56efcbae_Tx: ComBitPosition=64, ComBitSize=8, ComSignalInitValue=0, ComSignalType=UINT8, ComHandleId=4195, ComSystemTemplateSystemSignalRef=DET_RANGE_VELOCITY_ERR_197
            DET_AZIMUTH_198_oRDR_DETECTION_197_200_oPCAN_RADAR_107913c5_Tx: ComBitPosition=200, ComBitSize=13, ComSignalInitValue=0, ComSignalType=UINT16, ComHandleId=4129, ComSystemTemplateSystemSignalRef=DET_AZIMUTH_198
            DET_RANGE_ERR_197_oRDR_DETECTION_197_200_oPCAN_RADAR_8b1a4850_Tx: ComBitPosition=40, ComBitSize=7, ComSignalInitValue=0, ComSignalType=UINT8, ComHandleId=4187, ComSystemTemplateSystemSignalRef=DET_RANGE_ERR_197
            DET_BI_STATIC_FLAG_199_oRDR_DETECTION_197_200_oPCAN_RADAR_d32587d5_Tx: ComBitPosition=328, ComBitSize=1, ComSignalInitValue=0, ComSignalType=BOOLEAN, ComHandleId=4142, ComSystemTemplateSystemSignalRef=DET_BI_STATIC_FLAG_199
            DET_RANGE_ERR_200_oRDR_DETECTION_197_200_oPCAN_RADAR_c614d13f_Tx: ComBitPosition=376, ComBitSize=7, ComSignalInitValue=0, ComSignalType=UINT8, ComHandleId=4190, ComSystemTemplateSystemSignalRef=DET_RANGE_ERR_200
            DET_RANGE_VELOCITY_199_oRDR_DETECTION_197_200_oPCAN_RADAR_e03476ce_Tx: ComBitPosition=272, ComBitSize=15, ComSignalInitValue=16384, ComSignalType=UINT16, ComHandleId=4193, ComSystemTemplateSystemSignalRef=DET_RANGE_VELOCITY_199
            DET_RCS_199_oRDR_DETECTION_197_200_oPCAN_RADAR_67b44194_Tx: ComBitPosition=352, ComBitSize=8, ComSignalInitValue=128, ComSignalType=UINT8, ComHandleId=4201, ComSystemTemplateSystemSignalRef=DET_RCS_199
            DET_SUPER_RES_TARGET_197_oRDR_DETECTION_197_200_oPCAN_RADAR_32e37b21_Tx: ComBitPosition=87, ComBitSize=1, ComSignalInitValue=0, ComSignalType=BOOLEAN, ComHandleId=4207, ComSystemTemplateSystemSignalRef=DET_SUPER_RES_TARGET_197
            DET_CONFD_AZIMUTH_198_oRDR_DETECTION_197_200_oPCAN_RADAR_129f190f_Tx: ComBitPosition=230, ComBitSize=2, ComSignalInitValue=0, ComSignalType=UINT8, ComHandleId=4145, ComSystemTemplateSystemSignalRef=DET_CONFD_AZIMUTH_198
            DET_MH_CRC16_197_200_oRDR_DETECTION_197_200_oPCAN_RADAR_7235ff55_Tx: ComBitPosition=0, ComBitSize=16, ComSignalInitValue=0, ComSignalType=UINT16, ComHandleId=4172, ComSystemTemplateSystemSignalRef=DET_MH_CRC16_197_200
            DET_RANGE_VELOCITY_200_oRDR_DETECTION_197_200_oPCAN_RADAR_145aa973_Tx: ComBitPosition=384, ComBitSize=15, ComSignalInitValue=16384, ComSignalType=UINT16, ComHandleId=4194, ComSystemTemplateSystemSignalRef=DET_RANGE_VELOCITY_200
            DET_RANGE_ERR_198_oRDR_DETECTION_197_200_oPCAN_RADAR_a70ada17_Tx: ComBitPosition=152, ComBitSize=7, ComSignalInitValue=0, ComSignalType=UINT8, ComHandleId=4188, ComSystemTemplateSystemSignalRef=DET_RANGE_ERR_198
            DET_AZIMUTH_ERR_197_oRDR_DETECTION_197_200_oPCAN_RADAR_98dc1477_Tx: ComBitPosition=105, ComBitSize=7, ComSignalInitValue=0, ComSignalType=UINT8, ComHandleId=4132, ComSystemTemplateSystemSignalRef=DET_AZIMUTH_ERR_197
            DET_MH_SCAN_INDEX_4LSB_197_200_oRDR_DETECTION_197_200_oPCAN_RADAR_3a6a7bee_Tx: ComBitPosition=476, ComBitSize=4, ComSignalInitValue=0, ComSignalType=UINT8, ComHandleId=4174, ComSystemTemplateSystemSignalRef=DET_MH_SCAN_INDEX_4LSB_197_200
            DET_ELEVATION_ERR_200_oRDR_DETECTION_197_200_oPCAN_RADAR_27ed5f94_Tx: ComBitPosition=416, ComBitSize=6, ComSignalInitValue=0, ComSignalType=UINT8, ComHandleId=4159, ComSystemTemplateSystemSignalRef=DET_ELEVATION_ERR_200
            DET_RANGE_VELOCITY_ERR_200_oRDR_DETECTION_197_200_oPCAN_RADAR_1be152c1_Tx: ComBitPosition=400, ComBitSize=8, ComSignalInitValue=0, ComSignalType=UINT8, ComHandleId=4198, ComSystemTemplateSystemSignalRef=DET_RANGE_VELOCITY_ERR_200
            DET_SNR_198_oRDR_DETECTION_197_200_oPCAN_RADAR_2f6ac103_Tx: ComBitPosition=232, ComBitSize=8, ComSignalInitValue=0, ComSignalType=UINT8, ComHandleId=4204, ComSystemTemplateSystemSignalRef=DET_SNR_198
            DET_SUPER_RES_TARGET_199_oRDR_DETECTION_197_200_oPCAN_RADAR_8b833df3_Tx: ComBitPosition=311, ComBitSize=1, ComSignalInitValue=0, ComSignalType=BOOLEAN, ComHandleId=4209, ComSystemTemplateSystemSignalRef=DET_SUPER_RES_TARGET_199
            DET_ELEVATION_199_oRDR_DETECTION_197_200_oPCAN_RADAR_54ba185c_Tx: ComBitPosition=296, ComBitSize=8, ComSignalInitValue=0, ComSignalType=UINT8, ComHandleId=4154, ComSystemTemplateSystemSignalRef=DET_ELEVATION_199
            DET_SNR_200_oRDR_DETECTION_197_200_oPCAN_RADAR_4e74ca2b_Tx: ComBitPosition=456, ComBitSize=8, ComSignalInitValue=0, ComSignalType=UINT8, ComHandleId=4206, ComSystemTemplateSystemSignalRef=DET_SNR_200
            DET_CONFD_ELEVATION_200_oRDR_DETECTION_197_200_oPCAN_RADAR_711413dd_Tx: ComBitPosition=437, ComBitSize=2, ComSignalInitValue=0, ComSignalType=UINT8, ComHandleId=4151, ComSystemTemplateSystemSignalRef=DET_CONFD_ELEVATION_200
            DET_RANGE_197_oRDR_DETECTION_197_200_oPCAN_RADAR_2cf2f239_Tx: ComBitPosition=24, ComBitSize=15, ComSignalInitValue=0, ComSignalType=UINT16, ComHandleId=4183, ComSystemTemplateSystemSignalRef=DET_RANGE_197
            DET_RCS_197_oRDR_DETECTION_197_200_oPCAN_RADAR_ded40746_Tx: ComBitPosition=128, ComBitSize=8, ComSignalInitValue=128, ComSignalType=UINT8, ComHandleId=4199, ComSystemTemplateSystemSignalRef=DET_RCS_197
            DET_RCS_198_oRDR_DETECTION_197_200_oPCAN_RADAR_f2c49501_Tx: ComBitPosition=240, ComBitSize=8, ComSignalInitValue=128, ComSignalType=UINT8, ComHandleId=4200, ComSystemTemplateSystemSignalRef=DET_RCS_198
            DET_AZIMUTH_ERR_199_oRDR_DETECTION_197_200_oPCAN_RADAR_21bc52a5_Tx: ComBitPosition=329, ComBitSize=7, ComSignalInitValue=0, ComSignalType=UINT8, ComHandleId=4134, ComSystemTemplateSystemSignalRef=DET_AZIMUTH_ERR_199
            DET_CONFD_ELEVATION_199_oRDR_DETECTION_197_200_oPCAN_RADAR_857acc60_Tx: ComBitPosition=325, ComBitSize=2, ComSignalInitValue=0, ComSignalType=UINT8, ComHandleId=4150, ComSystemTemplateSystemSignalRef=DET_CONFD_ELEVATION_199
            DET_ELEVATION_198_oRDR_DETECTION_197_200_oPCAN_RADAR_c1caccc9_Tx: ComBitPosition=184, ComBitSize=8, ComSignalInitValue=0, ComSignalType=UINT8, ComHandleId=4153, ComSystemTemplateSystemSignalRef=DET_ELEVATION_198
            DET_ELEVATION_ERR_199_oRDR_DETECTION_197_200_oPCAN_RADAR_d3838029_Tx: ComBitPosition=304, ComBitSize=6, ComSignalInitValue=0, ComSignalType=UINT8, ComHandleId=4158, ComSystemTemplateSystemSignalRef=DET_ELEVATION_ERR_199
            DET_IDM_197_oRDR_DETECTION_197_200_oPCAN_RADAR_d25acb59_Tx: ComBitPosition=63, ComBitSize=1, ComSignalInitValue=0, ComSignalType=UINT8, ComHandleId=4168, ComSystemTemplateSystemSignalRef=DET_IDM_197
            DET_PROB_1STAZHYPO_198_oRDR_DETECTION_197_200_oPCAN_RADAR_0b4d8308_Tx: ComBitPosition=215, ComBitSize=1, ComSignalInitValue=0, ComSignalType=BOOLEAN, ComHandleId=4180, ComSystemTemplateSystemSignalRef=DET_PROB_1STAZHYPO_198
            DET_BELOW_RAIN_THOLD_197_oRDR_DETECTION_197_200_oPCAN_RADAR_e9681242_Tx: ComBitPosition=39, ComBitSize=1, ComSignalInitValue=0, ComSignalType=UINT8, ComHandleId=4136, ComSystemTemplateSystemSignalRef=DET_BELOW_RAIN_THOLD_197
            DET_PROB_1STAZHYPO_199_oRDR_DETECTION_197_200_oPCAN_RADAR_9e3d579d_Tx: ComBitPosition=327, ComBitSize=1, ComSignalInitValue=0, ComSignalType=BOOLEAN, ComHandleId=4181, ComSystemTemplateSystemSignalRef=DET_PROB_1STAZHYPO_199
            DET_MTD_200_oRDR_DETECTION_197_200_oPCAN_RADAR_f9e760ed_Tx: ComBitPosition=383, ComBitSize=1, ComSignalInitValue=0, ComSignalType=UINT8, ComHandleId=4178, ComSystemTemplateSystemSignalRef=DET_MTD_200
            DET_PROB_1STAZHYPO_197_oRDR_DETECTION_197_200_oPCAN_RADAR_275d114f_Tx: ComBitPosition=103, ComBitSize=1, ComSignalInitValue=0, ComSignalType=BOOLEAN, ComHandleId=4179, ComSystemTemplateSystemSignalRef=DET_PROB_1STAZHYPO_197
            DET_BELOW_RAIN_THOLD_200_oRDR_DETECTION_197_200_oPCAN_RADAR_a4668b2d_Tx: ComBitPosition=375, ComBitSize=1, ComSignalInitValue=0, ComSignalType=UINT8, ComHandleId=4139, ComSystemTemplateSystemSignalRef=DET_BELOW_RAIN_THOLD_200
            DET_MTD_198_oRDR_DETECTION_197_200_oPCAN_RADAR_98f96bc5_Tx: ComBitPosition=159, ComBitSize=1, ComSignalInitValue=0, ComSignalType=UINT8, ComHandleId=4176, ComSystemTemplateSystemSignalRef=DET_MTD_198
            DET_IDM_199_oRDR_DETECTION_197_200_oPCAN_RADAR_6b3a8d8b_Tx: ComBitPosition=287, ComBitSize=1, ComSignalInitValue=0, ComSignalType=UINT8, ComHandleId=4170, ComSystemTemplateSystemSignalRef=DET_IDM_199
            DET_IDM_200_oRDR_DETECTION_197_200_oPCAN_RADAR_9f545236_Tx: ComBitPosition=399, ComBitSize=1, ComSignalInitValue=0, ComSignalType=UINT8, ComHandleId=4171, ComSystemTemplateSystemSignalRef=DET_IDM_200
            DET_BELOW_RAIN_THOLD_198_oRDR_DETECTION_197_200_oPCAN_RADAR_c5788005_Tx: ComBitPosition=151, ComBitSize=1, ComSignalInitValue=0, ComSignalType=UINT8, ComHandleId=4137, ComSystemTemplateSystemSignalRef=DET_BELOW_RAIN_THOLD_198
            DET_BELOW_RAIN_THOLD_199_oRDR_DETECTION_197_200_oPCAN_RADAR_50085490_Tx: ComBitPosition=263, ComBitSize=1, ComSignalInitValue=0, ComSignalType=UINT8, ComHandleId=4138, ComSystemTemplateSystemSignalRef=DET_BELOW_RAIN_THOLD_199
            DET_IDM_198_oRDR_DETECTION_197_200_oPCAN_RADAR_fe4a591e_Tx: ComBitPosition=175, ComBitSize=1, ComSignalInitValue=0, ComSignalType=UINT8, ComHandleId=4169, ComSystemTemplateSystemSignalRef=DET_IDM_198
            DET_MTD_199_oRDR_DETECTION_197_200_oPCAN_RADAR_0d89bf50_Tx: ComBitPosition=271, ComBitSize=1, ComSignalInitValue=0, ComSignalType=UINT8, ComHandleId=4177, ComSystemTemplateSystemSignalRef=DET_MTD_199
            DET_PROB_1STAZHYPO_200_oRDR_DETECTION_197_200_oPCAN_RADAR_6a538820_Tx: ComBitPosition=439, ComBitSize=1, ComSignalInitValue=0, ComSignalType=BOOLEAN, ComHandleId=4182, ComSystemTemplateSystemSignalRef=DET_PROB_1STAZHYPO_200
            DET_MTD_197_oRDR_DETECTION_197_200_oPCAN_RADAR_b4e9f982_Tx: ComBitPosition=47, ComBitSize=1, ComSignalInitValue=0, ComSignalType=UINT8, ComHandleId=4175, ComSystemTemplateSystemSignalRef=DET_MTD_197
        SG_Detections_249_252_oRDR_DETECTION_249_252_oPCAN_RADAR_d84a8050_Tx: ComTransferProperty=TRIGGERED, ComHandleId=64, ComSystemTemplateSignalGroupRef=SG_Detections_249_252
          83 x ComGroupSignal, all with ComSignalEndianness=LITTLE_ENDIAN, ComTransferProperty=PENDING, ComSignalAccess=ACCESS_NEEDED_BY_SWC_OR_COM:
            DET_AZIMUTH_249_oRDR_DETECTION_249_252_oPCAN_RADAR_0fc2411b_Tx: ComBitPosition=88, ComBitSize=13, ComSignalInitValue=0, ComSignalType=UINT16, ComHandleId=5207, ComSystemTemplateSystemSignalRef=DET_AZIMUTH_249
            DET_RANGE_ERR_249_oRDR_DETECTION_249_252_oPCAN_RADAR_b8b188c9_Tx: ComBitPosition=40, ComBitSize=7, ComSignalInitValue=0, ComSignalType=UINT8, ComHandleId=5266, ComSystemTemplateSystemSignalRef=DET_RANGE_ERR_249
            DET_HVC_FLAG_252_oRDR_DETECTION_249_252_oPCAN_RADAR_fe13edb2_Tx: ComBitPosition=422, ComBitSize=1, ComSignalInitValue=0, ComSignalType=BOOLEAN, ComHandleId=5246, ComSystemTemplateSystemSignalRef=DET_HVC_FLAG_252
            DET_ELEVATION_ERR_251_oRDR_DETECTION_249_252_oPCAN_RADAR_a918a053_Tx: ComBitPosition=304, ComBitSize=6, ComSignalInitValue=0, ComSignalType=UINT8, ComHandleId=5237, ComSystemTemplateSystemSignalRef=DET_ELEVATION_ERR_251
            DET_EXISTENCE_PROB_250_oRDR_DETECTION_249_252_oPCAN_RADAR_eef701a6_Tx: ComBitPosition=224, ComBitSize=6, ComSignalInitValue=0, ComSignalType=UINT8, ComHandleId=5240, ComSystemTemplateSystemSignalRef=DET_EXISTENCE_PROB_250
            DET_SUPER_RES_TARGET_250_oRDR_DETECTION_249_252_oPCAN_RADAR_6468c91c_Tx: ComBitPosition=199, ComBitSize=1, ComSignalInitValue=0, ComSignalType=BOOLEAN, ComHandleId=5287, ComSystemTemplateSystemSignalRef=DET_SUPER_RES_TARGET_250
            DET_RANGE_VELOCITY_249_oRDR_DETECTION_249_252_oPCAN_RADAR_6afff085_Tx: ComBitPosition=48, ComBitSize=15, ComSignalInitValue=16384, ComSignalType=UINT16, ComHandleId=5270, ComSystemTemplateSystemSignalRef=DET_RANGE_VELOCITY_249
            DET_CONFD_AZIMUTH_250_oRDR_DETECTION_249_252_oPCAN_RADAR_68043975_Tx: ComBitPosition=230, ComBitSize=2, ComSignalInitValue=0, ComSignalType=UINT8, ComHandleId=5224, ComSystemTemplateSystemSignalRef=DET_CONFD_AZIMUTH_250
            DET_RANGE_251_oRDR_DETECTION_249_252_oPCAN_RADAR_ef099491_Tx: ComBitPosition=248, ComBitSize=15, ComSignalInitValue=0, ComSignalType=UINT16, ComHandleId=5264, ComSystemTemplateSystemSignalRef=DET_RANGE_251
            DET_RANGE_ERR_251_oRDR_DETECTION_249_252_oPCAN_RADAR_48e12ef8_Tx: ComBitPosition=264, ComBitSize=7, ComSignalInitValue=0, ComSignalType=UINT8, ComHandleId=5268, ComSystemTemplateSystemSignalRef=DET_RANGE_ERR_251
            DET_MH_SCAN_INDEX_4LSB_249_252_oRDR_DETECTION_249_252_oPCAN_RADAR_149dd6e0_Tx: ComBitPosition=476, ComBitSize=4, ComSignalInitValue=0, ComSignalType=UINT8, ComHandleId=5253, ComSystemTemplateSystemSignalRef=DET_MH_SCAN_INDEX_4LSB_249_252
            DET_RANGE_252_oRDR_DETECTION_249_252_oPCAN_RADAR_8be9ef6f_Tx: ComBitPosition=360, ComBitSize=15, ComSignalInitValue=0, ComSignalType=UINT16, ComHandleId=5265, ComSystemTemplateSystemSignalRef=DET_RANGE_252
            DET_SUPER_RES_TARGET_251_oRDR_DETECTION_249_252_oPCAN_RADAR_f1181d89_Tx: ComBitPosition=311, ComBitSize=1, ComSignalInitValue=0, ComSignalType=BOOLEAN, ComHandleId=5288, ComSystemTemplateSystemSignalRef=DET_SUPER_RES_TARGET_251
            DET_CONFD_AZIMUTH_251_oRDR_DETECTION_249_252_oPCAN_RADAR_fd74ede0_Tx: ComBitPosition=342, ComBitSize=2, ComSignalInitValue=0, ComSignalType=UINT8, ComHandleId=5225, ComSystemTemplateSystemSignalRef=DET_CONFD_AZIMUTH_251
            DET_RANGE_ERR_250_oRDR_DETECTION_249_252_oPCAN_RADAR_dd91fa6d_Tx: ComBitPosition=152, ComBitSize=7, ComSignalInitValue=0, ComSignalType=UINT8, ComHandleId=5267, ComSystemTemplateSystemSignalRef=DET_RANGE_ERR_250
            DET_RANGE_250_oRDR_DETECTION_249_252_oPCAN_RADAR_7a794004_Tx: ComBitPosition=136, ComBitSize=15, ComSignalInitValue=0, ComSignalType=UINT16, ComHandleId=5263, ComSystemTemplateSystemSignalRef=DET_RANGE_250
            DET_BI_STATIC_FLAG_250_oRDR_DETECTION_249_252_oPCAN_RADAR_3cce733a_Tx: ComBitPosition=216, ComBitSize=1, ComSignalInitValue=0, ComSignalType=BOOLEAN, ComHandleId=5220, ComSystemTemplateSystemSignalRef=DET_BI_STATIC_FLAG_250
            DET_CONFD_ELEVATION_249_oRDR_DETECTION_249_252_oPCAN_RADAR_0fb14a2b_Tx: ComBitPosition=101, ComBitSize=2, ComSignalInitValue=0, ComSignalType=UINT8, ComHandleId=5227, ComSystemTemplateSystemSignalRef=DET_CONFD_ELEVATION_249
            DET_EXISTENCE_PROB_249_oRDR_DETECTION_249_252_oPCAN_RADAR_8bd77302_Tx: ComBitPosition=112, ComBitSize=6, ComSignalInitValue=0, ComSignalType=UINT8, ComHandleId=5239, ComSystemTemplateSystemSignalRef=DET_EXISTENCE_PROB_249
            DET_BI_STATIC_FLAG_251_oRDR_DETECTION_249_252_oPCAN_RADAR_a9bea7af_Tx: ComBitPosition=328, ComBitSize=1, ComSignalInitValue=0, ComSignalType=BOOLEAN, ComHandleId=5221, ComSystemTemplateSystemSignalRef=DET_BI_STATIC_FLAG_251
            DET_ELEVATION_251_oRDR_DETECTION_249_252_oPCAN_RADAR_2e213826_Tx: ComBitPosition=296, ComBitSize=8, ComSignalInitValue=0, ComSignalType=UINT8, ComHandleId=5233, ComSystemTemplateSystemSignalRef=DET_ELEVATION_251
            DET_SNR_250_oRDR_DETECTION_249_252_oPCAN_RADAR_55f1e179_Tx: ComBitPosition=232, ComBitSize=8, ComSignalInitValue=0, ComSignalType=UINT8, ComHandleId=5283, ComSystemTemplateSystemSignalRef=DET_SNR_250
            DET_SNR_252_oRDR_DETECTION_249_252_oPCAN_RADAR_a4614e12_Tx: ComBitPosition=456, ComBitSize=8, ComSignalInitValue=0, ComSignalType=UINT8, ComHandleId=5285, ComSystemTemplateSystemSignalRef=DET_SNR_252
            DET_CONFD_AZIMUTH_252_oRDR_DETECTION_249_252_oPCAN_RADAR_9994961e_Tx: ComBitPosition=454, ComBitSize=2, ComSignalInitValue=0, ComSignalType=UINT8, ComHandleId=5226, ComSystemTemplateSystemSignalRef=DET_CONFD_AZIMUTH_252
            DET_AZIMUTH_ERR_249_oRDR_DETECTION_249_252_oPCAN_RADAR_ab77d4ee_Tx: ComBitPosition=105, ComBitSize=7, ComSignalInitValue=0, ComSignalType=UINT8, ComHandleId=5211, ComSystemTemplateSystemSignalRef=DET_AZIMUTH_ERR_249
            DET_RANGE_VELOCITY_ERR_252_oRDR_DETECTION_249_252_oPCAN_RADAR_f1f4d6f8_Tx: ComBitPosition=400, ComBitSize=8, ComSignalInitValue=0, ComSignalType=UINT8, ComHandleId=5277, ComSystemTemplateSystemSignalRef=DET_RANGE_VELOCITY_ERR_252
            DET_SNR_251_oRDR_DETECTION_249_252_oPCAN_RADAR_c08135ec_Tx: ComBitPosition=344, ComBitSize=8, ComSignalInitValue=0, ComSignalType=UINT8, ComHandleId=5284, ComSystemTemplateSystemSignalRef=DET_SNR_251
            DET_AZIMUTH_251_oRDR_DETECTION_249_252_oPCAN_RADAR_ff92e72a_Tx: ComBitPosition=312, ComBitSize=13, ComSignalInitValue=0, ComSignalType=UINT16, ComHandleId=5209, ComSystemTemplateSystemSignalRef=DET_AZIMUTH_251
            DET_EXISTENCE_PROB_252_oRDR_DETECTION_249_252_oPCAN_RADAR_1f67aecd_Tx: ComBitPosition=448, ComBitSize=6, ComSignalInitValue=0, ComSignalType=UINT8, ComHandleId=5242, ComSystemTemplateSystemSignalRef=DET_EXISTENCE_PROB_252
            DET_AZIMUTH_ERR_252_oRDR_DETECTION_249_252_oPCAN_RADAR_3fc70921_Tx: ComBitPosition=441, ComBitSize=7, ComSignalInitValue=0, ComSignalType=UINT8, ComHandleId=5214, ComSystemTemplateSystemSignalRef=DET_AZIMUTH_ERR_252
            DET_RANGE_ERR_252_oRDR_DETECTION_249_252_oPCAN_RADAR_2c015506_Tx: ComBitPosition=376, ComBitSize=7, ComSignalInitValue=0, ComSignalType=UINT8, ComHandleId=5269, ComSystemTemplateSystemSignalRef=DET_RANGE_ERR_252
            DET_ELEVATION_250_oRDR_DETECTION_249_252_oPCAN_RADAR_bb51ecb3_Tx: ComBitPosition=184, ComBitSize=8, ComSignalInitValue=0, ComSignalType=UINT8, ComHandleId=5232, ComSystemTemplateSystemSignalRef=DET_ELEVATION_250
            DET_ELEVATION_ERR_250_oRDR_DETECTION_249_252_oPCAN_RADAR_3c6874c6_Tx: ComBitPosition=192, ComBitSize=6, ComSignalInitValue=0, ComSignalType=UINT8, ComHandleId=5236, ComSystemTemplateSystemSignalRef=DET_ELEVATION_ERR_250
            DET_HVC_FLAG_251_oRDR_DETECTION_249_252_oPCAN_RADAR_9af3964c_Tx: ComBitPosition=310, ComBitSize=1, ComSignalInitValue=0, ComSignalType=BOOLEAN, ComHandleId=5245, ComSystemTemplateSystemSignalRef=DET_HVC_FLAG_251
            DET_SUPER_RES_TARGET_249_oRDR_DETECTION_249_252_oPCAN_RADAR_0148bbb8_Tx: ComBitPosition=87, ComBitSize=1, ComSignalInitValue=0, ComSignalType=BOOLEAN, ComHandleId=5286, ComSystemTemplateSystemSignalRef=DET_SUPER_RES_TARGET_249
            DET_CONFD_ELEVATION_250_oRDR_DETECTION_249_252_oPCAN_RADAR_6a91388f_Tx: ComBitPosition=213, ComBitSize=2, ComSignalInitValue=0, ComSignalType=UINT8, ComHandleId=5228, ComSystemTemplateSystemSignalRef=DET_CONFD_ELEVATION_250
            DET_RANGE_VELOCITY_ERR_250_oRDR_DETECTION_249_252_oPCAN_RADAR_00647993_Tx: ComBitPosition=176, ComBitSize=8, ComSignalInitValue=0, ComSignalType=UINT8, ComHandleId=5275, ComSystemTemplateSystemSignalRef=DET_RANGE_VELOCITY_ERR_250
            DET_ELEVATION_249_oRDR_DETECTION_249_252_oPCAN_RADAR_de719e17_Tx: ComBitPosition=72, ComBitSize=8, ComSignalInitValue=0, ComSignalType=UINT8, ComHandleId=5231, ComSystemTemplateSystemSignalRef=DET_ELEVATION_249
            DET_HVC_FLAG_250_oRDR_DETECTION_249_252_oPCAN_RADAR_0f8342d9_Tx: ComBitPosition=198, ComBitSize=1, ComSignalInitValue=0, ComSignalType=BOOLEAN, ComHandleId=5244, ComSystemTemplateSystemSignalRef=DET_HVC_FLAG_250
            DET_MH_CRC16_249_252_oRDR_DETECTION_249_252_oPCAN_RADAR_5cc2525b_Tx: ComBitPosition=0, ComBitSize=16, ComSignalInitValue=0, ComSignalType=UINT16, ComHandleId=5251, ComSystemTemplateSystemSignalRef=DET_MH_CRC16_249_252
            DET_ELEVATION_ERR_249_oRDR_DETECTION_249_252_oPCAN_RADAR_59480662_Tx: ComBitPosition=80, ComBitSize=6, ComSignalInitValue=0, ComSignalType=UINT8, ComHandleId=5235, ComSystemTemplateSystemSignalRef=DET_ELEVATION_ERR_249
            DET_MH_CYCLE_COUNTER_249_252_oRDR_DETECTION_249_252_oPCAN_RADAR_d8b7f36c_Tx: ComBitPosition=16, ComBitSize=8, ComSignalInitValue=0, ComSignalType=UINT8, ComHandleId=5252, ComSystemTemplateSystemSignalRef=DET_MH_CYCLE_COUNTER_249_252
            DET_AZIMUTH_ERR_250_oRDR_DETECTION_249_252_oPCAN_RADAR_ce57a64a_Tx: ComBitPosition=217, ComBitSize=7, ComSignalInitValue=0, ComSignalType=UINT8, ComHandleId=5212, ComSystemTemplateSystemSignalRef=DET_AZIMUTH_ERR_250
            DET_SUPER_RES_TARGET_252_oRDR_DETECTION_249_252_oPCAN_RADAR_95f86677_Tx: ComBitPosition=423, ComBitSize=1, ComSignalInitValue=0, ComSignalType=BOOLEAN, ComHandleId=5289, ComSystemTemplateSystemSignalRef=DET_SUPER_RES_TARGET_252
            DET_RANGE_VELOCITY_252_oRDR_DETECTION_249_252_oPCAN_RADAR_fe4f2d4a_Tx: ComBitPosition=384, ComBitSize=15, ComSignalInitValue=16384, ComSignalType=UINT16, ComHandleId=5273, ComSystemTemplateSystemSignalRef=DET_RANGE_VELOCITY_252
            DET_HVC_FLAG_249_oRDR_DETECTION_249_252_oPCAN_RADAR_6aa3307d_Tx: ComBitPosition=86, ComBitSize=1, ComSignalInitValue=0, ComSignalType=BOOLEAN, ComHandleId=5243, ComSystemTemplateSystemSignalRef=DET_HVC_FLAG_249
            DET_CONFD_ELEVATION_251_oRDR_DETECTION_249_252_oPCAN_RADAR_ffe1ec1a_Tx: ComBitPosition=325, ComBitSize=2, ComSignalInitValue=0, ComSignalType=UINT8, ComHandleId=5229, ComSystemTemplateSystemSignalRef=DET_CONFD_ELEVATION_251
            DET_RANGE_VELOCITY_ERR_251_oRDR_DETECTION_249_252_oPCAN_RADAR_9514ad06_Tx: ComBitPosition=288, ComBitSize=8, ComSignalInitValue=0, ComSignalType=UINT8, ComHandleId=5276, ComSystemTemplateSystemSignalRef=DET_RANGE_VELOCITY_ERR_251
            DET_AZIMUTH_250_oRDR_DETECTION_249_252_oPCAN_RADAR_6ae233bf_Tx: ComBitPosition=200, ComBitSize=13, ComSignalInitValue=0, ComSignalType=UINT16, ComHandleId=5208, ComSystemTemplateSystemSignalRef=DET_AZIMUTH_250
            DET_BI_STATIC_FLAG_249_oRDR_DETECTION_249_252_oPCAN_RADAR_59ee019e_Tx: ComBitPosition=104, ComBitSize=1, ComSignalInitValue=0, ComSignalType=BOOLEAN, ComHandleId=5219, ComSystemTemplateSystemSignalRef=DET_BI_STATIC_FLAG_249
            DET_RCS_251_oRDR_DETECTION_249_252_oPCAN_RADAR_1d2f61ee_Tx: ComBitPosition=352, ComBitSize=8, ComSignalInitValue=128, ComSignalType=UINT8, ComHandleId=5280, ComSystemTemplateSystemSignalRef=DET_RCS_251
            DET_RCS_250_oRDR_DETECTION_249_252_oPCAN_RADAR_885fb57b_Tx: ComBitPosition=240, ComBitSize=8, ComSignalInitValue=128, ComSignalType=UINT8, ComHandleId=5279, ComSystemTemplateSystemSignalRef=DET_RCS_250
            DET_BI_STATIC_FLAG_252_oRDR_DETECTION_249_252_oPCAN_RADAR_cd5edc51_Tx: ComBitPosition=440, ComBitSize=1, ComSignalInitValue=0, ComSignalType=BOOLEAN, ComHandleId=5222, ComSystemTemplateSystemSignalRef=DET_BI_STATIC_FLAG_252
            DET_CONFD_ELEVATION_252_oRDR_DETECTION_249_252_oPCAN_RADAR_9b0197e4_Tx: ComBitPosition=437, ComBitSize=2, ComSignalInitValue=0, ComSignalType=UINT8, ComHandleId=5230, ComSystemTemplateSystemSignalRef=DET_CONFD_ELEVATION_252
            DET_AZIMUTH_ERR_251_oRDR_DETECTION_249_252_oPCAN_RADAR_5b2772df_Tx: ComBitPosition=329, ComBitSize=7, ComSignalInitValue=0, ComSignalType=UINT8, ComHandleId=5213, ComSystemTemplateSystemSignalRef=DET_AZIMUTH_ERR_251
            DET_ELEVATION_ERR_252_oRDR_DETECTION_249_252_oPCAN_RADAR_cdf8dbad_Tx: ComBitPosition=416, ComBitSize=6, ComSignalInitValue=0, ComSignalType=UINT8, ComHandleId=5238, ComSystemTemplateSystemSignalRef=DET_ELEVATION_ERR_252
            DET_RANGE_VELOCITY_251_oRDR_DETECTION_249_252_oPCAN_RADAR_9aaf56b4_Tx: ComBitPosition=272, ComBitSize=15, ComSignalInitValue=16384, ComSignalType=UINT16, ComHandleId=5272, ComSystemTemplateSystemSignalRef=DET_RANGE_VELOCITY_251
            DET_RANGE_VELOCITY_ERR_249_oRDR_DETECTION_249_252_oPCAN_RADAR_65440b37_Tx: ComBitPosition=64, ComBitSize=8, ComSignalInitValue=0, ComSignalType=UINT8, ComHandleId=5274, ComSystemTemplateSystemSignalRef=DET_RANGE_VELOCITY_ERR_249
            DET_ELEVATION_252_oRDR_DETECTION_249_252_oPCAN_RADAR_4ac143d8_Tx: ComBitPosition=408, ComBitSize=8, ComSignalInitValue=0, ComSignalType=UINT8, ComHandleId=5234, ComSystemTemplateSystemSignalRef=DET_ELEVATION_252
            DET_RCS_249_oRDR_DETECTION_249_252_oPCAN_RADAR_ed7fc7df_Tx: ComBitPosition=128, ComBitSize=8, ComSignalInitValue=128, ComSignalType=UINT8, ComHandleId=5278, ComSystemTemplateSystemSignalRef=DET_RCS_249
            DET_RCS_252_oRDR_DETECTION_249_252_oPCAN_RADAR_79cf1a10_Tx: ComBitPosition=464, ComBitSize=8, ComSignalInitValue=128, ComSignalType=UINT8, ComHandleId=5281, ComSystemTemplateSystemSignalRef=DET_RCS_252
            DET_AZIMUTH_252_oRDR_DETECTION_249_252_oPCAN_RADAR_9b729cd4_Tx: ComBitPosition=424, ComBitSize=13, ComSignalInitValue=0, ComSignalType=UINT16, ComHandleId=5210, ComSystemTemplateSystemSignalRef=DET_AZIMUTH_252
            DET_EXISTENCE_PROB_251_oRDR_DETECTION_249_252_oPCAN_RADAR_7b87d533_Tx: ComBitPosition=336, ComBitSize=6, ComSignalInitValue=0, ComSignalType=UINT8, ComHandleId=5241, ComSystemTemplateSystemSignalRef=DET_EXISTENCE_PROB_251
            DET_RANGE_249_oRDR_DETECTION_249_252_oPCAN_RADAR_1f5932a0_Tx: ComBitPosition=24, ComBitSize=15, ComSignalInitValue=0, ComSignalType=UINT16, ComHandleId=5262, ComSystemTemplateSystemSignalRef=DET_RANGE_249
            DET_CONFD_AZIMUTH_249_oRDR_DETECTION_249_252_oPCAN_RADAR_0d244bd1_Tx: ComBitPosition=118, ComBitSize=2, ComSignalInitValue=0, ComSignalType=UINT8, ComHandleId=5223, ComSystemTemplateSystemSignalRef=DET_CONFD_AZIMUTH_249
            DET_RANGE_VELOCITY_250_oRDR_DETECTION_249_252_oPCAN_RADAR_0fdf8221_Tx: ComBitPosition=160, ComBitSize=15, ComSignalInitValue=16384, ComSignalType=UINT16, ComHandleId=5271, ComSystemTemplateSystemSignalRef=DET_RANGE_VELOCITY_250
            DET_SNR_249_oRDR_DETECTION_249_252_oPCAN_RADAR_30d193dd_Tx: ComBitPosition=120, ComBitSize=8, ComSignalInitValue=0, ComSignalType=UINT8, ComHandleId=5282, ComSystemTemplateSystemSignalRef=DET_SNR_249
            DET_PROB_1STAZHYPO_252_oRDR_DETECTION_249_252_oPCAN_RADAR_80460c19_Tx: ComBitPosition=439, ComBitSize=1, ComSignalInitValue=0, ComSignalType=BOOLEAN, ComHandleId=5261, ComSystemTemplateSystemSignalRef=DET_PROB_1STAZHYPO_252
            DET_BELOW_RAIN_THOLD_250_oRDR_DETECTION_249_252_oPCAN_RADAR_bfe3a07f_Tx: ComBitPosition=151, ComBitSize=1, ComSignalInitValue=0, ComSignalType=UINT8, ComHandleId=5216, ComSystemTemplateSystemSignalRef=DET_BELOW_RAIN_THOLD_250
            DET_IDM_249_oRDR_DETECTION_249_252_oPCAN_RADAR_e1f10bc0_Tx: ComBitPosition=63, ComBitSize=1, ComSignalInitValue=0, ComSignalType=UINT8, ComHandleId=5247, ComSystemTemplateSystemSignalRef=DET_IDM_249
            DET_PROB_1STAZHYPO_251_oRDR_DETECTION_249_252_oPCAN_RADAR_e4a677e7_Tx: ComBitPosition=327, ComBitSize=1, ComSignalInitValue=0, ComSignalType=BOOLEAN, ComHandleId=5260, ComSystemTemplateSystemSignalRef=DET_PROB_1STAZHYPO_251
            DET_MTD_250_oRDR_DETECTION_249_252_oPCAN_RADAR_e2624bbf_Tx: ComBitPosition=159, ComBitSize=1, ComSignalInitValue=0, ComSignalType=UINT8, ComHandleId=5255, ComSystemTemplateSystemSignalRef=DET_MTD_250
            DET_IDM_250_oRDR_DETECTION_249_252_oPCAN_RADAR_84d17964_Tx: ComBitPosition=175, ComBitSize=1, ComSignalInitValue=0, ComSignalType=UINT8, ComHandleId=5248, ComSystemTemplateSystemSignalRef=DET_IDM_250
            DET_MTD_251_oRDR_DETECTION_249_252_oPCAN_RADAR_77129f2a_Tx: ComBitPosition=271, ComBitSize=1, ComSignalInitValue=0, ComSignalType=UINT8, ComHandleId=5256, ComSystemTemplateSystemSignalRef=DET_MTD_251
            DET_PROB_1STAZHYPO_249_oRDR_DETECTION_249_252_oPCAN_RADAR_14f6d1d6_Tx: ComBitPosition=103, ComBitSize=1, ComSignalInitValue=0, ComSignalType=BOOLEAN, ComHandleId=5258, ComSystemTemplateSystemSignalRef=DET_PROB_1STAZHYPO_249
            DET_PROB_1STAZHYPO_250_oRDR_DETECTION_249_252_oPCAN_RADAR_71d6a372_Tx: ComBitPosition=215, ComBitSize=1, ComSignalInitValue=0, ComSignalType=BOOLEAN, ComHandleId=5259, ComSystemTemplateSystemSignalRef=DET_PROB_1STAZHYPO_250
            DET_BELOW_RAIN_THOLD_251_oRDR_DETECTION_249_252_oPCAN_RADAR_2a9374ea_Tx: ComBitPosition=263, ComBitSize=1, ComSignalInitValue=0, ComSignalType=UINT8, ComHandleId=5217, ComSystemTemplateSystemSignalRef=DET_BELOW_RAIN_THOLD_251
            DET_MTD_252_oRDR_DETECTION_249_252_oPCAN_RADAR_13f2e4d4_Tx: ComBitPosition=383, ComBitSize=1, ComSignalInitValue=0, ComSignalType=UINT8, ComHandleId=5257, ComSystemTemplateSystemSignalRef=DET_MTD_252
            DET_BELOW_RAIN_THOLD_252_oRDR_DETECTION_249_252_oPCAN_RADAR_4e730f14_Tx: ComBitPosition=375, ComBitSize=1, ComSignalInitValue=0, ComSignalType=UINT8, ComHandleId=5218, ComSystemTemplateSystemSignalRef=DET_BELOW_RAIN_THOLD_252
            DET_IDM_251_oRDR_DETECTION_249_252_oPCAN_RADAR_11a1adf1_Tx: ComBitPosition=287, ComBitSize=1, ComSignalInitValue=0, ComSignalType=UINT8, ComHandleId=5249, ComSystemTemplateSystemSignalRef=DET_IDM_251
            DET_MTD_249_oRDR_DETECTION_249_252_oPCAN_RADAR_8742391b_Tx: ComBitPosition=47, ComBitSize=1, ComSignalInitValue=0, ComSignalType=UINT8, ComHandleId=5254, ComSystemTemplateSystemSignalRef=DET_MTD_249
            DET_IDM_252_oRDR_DETECTION_249_252_oPCAN_RADAR_7541d60f_Tx: ComBitPosition=399, ComBitSize=1, ComSignalInitValue=0, ComSignalType=UINT8, ComHandleId=5250, ComSystemTemplateSystemSignalRef=DET_IDM_252
            DET_BELOW_RAIN_THOLD_249_oRDR_DETECTION_249_252_oPCAN_RADAR_dac3d2db_Tx: ComBitPosition=39, ComBitSize=1, ComSignalInitValue=0, ComSignalType=UINT8, ComHandleId=5215, ComSystemTemplateSystemSignalRef=DET_BELOW_RAIN_THOLD_249
        SG_Detections_073_076_oRDR_DETECTION_073_076_oPCAN_RADAR_5a640d52_Tx: ComTransferProperty=TRIGGERED, ComHandleId=20, ComSystemTemplateSignalGroupRef=SG_Detections_073_076
          83 x ComGroupSignal, all with ComSignalEndianness=LITTLE_ENDIAN, ComTransferProperty=PENDING, ComSignalAccess=ACCESS_NEEDED_BY_SWC_OR_COM:
            DET_AZIMUTH_075_oRDR_DETECTION_073_076_oPCAN_RADAR_f87c7127_Tx: ComBitPosition=312, ComBitSize=13, ComSignalInitValue=0, ComSignalType=UINT16, ComHandleId=1557, ComSystemTemplateSystemSignalRef=DET_AZIMUTH_075
            DET_CONFD_ELEVATION_076_oRDR_DETECTION_073_076_oPCAN_RADAR_9cef01e9_Tx: ComBitPosition=437, ComBitSize=2, ComSignalInitValue=0, ComSignalType=UINT8, ComHandleId=1578, ComSystemTemplateSystemSignalRef=DET_CONFD_ELEVATION_076
            DET_CONFD_AZIMUTH_075_oRDR_DETECTION_073_076_oPCAN_RADAR_fa9a7bed_Tx: ComBitPosition=342, ComBitSize=2, ComSignalInitValue=0, ComSignalType=UINT8, ComHandleId=1573, ComSystemTemplateSystemSignalRef=DET_CONFD_AZIMUTH_075
            DET_RANGE_074_oRDR_DETECTION_073_076_oPCAN_RADAR_7d97d609_Tx: ComBitPosition=136, ComBitSize=15, ComSignalInitValue=0, ComSignalType=UINT16, ComHandleId=1611, ComSystemTemplateSystemSignalRef=DET_RANGE_074
            DET_RANGE_VELOCITY_ERR_073_oRDR_DETECTION_073_076_oPCAN_RADAR_5b3accf7_Tx: ComBitPosition=64, ComBitSize=8, ComSignalInitValue=0, ComSignalType=UINT8, ComHandleId=1622, ComSystemTemplateSystemSignalRef=DET_RANGE_VELOCITY_ERR_073
            DET_AZIMUTH_073_oRDR_DETECTION_073_076_oPCAN_RADAR_31bc86db_Tx: ComBitPosition=88, ComBitSize=13, ComSignalInitValue=0, ComSignalType=UINT16, ComHandleId=1555, ComSystemTemplateSystemSignalRef=DET_AZIMUTH_073
            DET_CONFD_ELEVATION_073_oRDR_DETECTION_073_076_oPCAN_RADAR_31cf8deb_Tx: ComBitPosition=101, ComBitSize=2, ComSignalInitValue=0, ComSignalType=UINT8, ComHandleId=1575, ComSystemTemplateSystemSignalRef=DET_CONFD_ELEVATION_073
            DET_CONFD_ELEVATION_075_oRDR_DETECTION_073_076_oPCAN_RADAR_f80f7a17_Tx: ComBitPosition=325, ComBitSize=2, ComSignalInitValue=0, ComSignalType=UINT8, ComHandleId=1577, ComSystemTemplateSystemSignalRef=DET_CONFD_ELEVATION_075
            DET_RANGE_076_oRDR_DETECTION_073_076_oPCAN_RADAR_8c077962_Tx: ComBitPosition=360, ComBitSize=15, ComSignalInitValue=0, ComSignalType=UINT16, ComHandleId=1613, ComSystemTemplateSystemSignalRef=DET_RANGE_076
            DET_SUPER_RES_TARGET_076_oRDR_DETECTION_073_076_oPCAN_RADAR_9216f07a_Tx: ComBitPosition=423, ComBitSize=1, ComSignalInitValue=0, ComSignalType=BOOLEAN, ComHandleId=1637, ComSystemTemplateSystemSignalRef=DET_SUPER_RES_TARGET_076
            DET_SNR_073_oRDR_DETECTION_073_076_oPCAN_RADAR_0eaf541d_Tx: ComBitPosition=120, ComBitSize=8, ComSignalInitValue=0, ComSignalType=UINT8, ComHandleId=1630, ComSystemTemplateSystemSignalRef=DET_SNR_073
            DET_AZIMUTH_ERR_075_oRDR_DETECTION_073_076_oPCAN_RADAR_5cc9e4d2_Tx: ComBitPosition=329, ComBitSize=7, ComSignalInitValue=0, ComSignalType=UINT8, ComHandleId=1561, ComSystemTemplateSystemSignalRef=DET_AZIMUTH_ERR_075
            DET_CONFD_AZIMUTH_076_oRDR_DETECTION_073_076_oPCAN_RADAR_9e7a0013_Tx: ComBitPosition=454, ComBitSize=2, ComSignalInitValue=0, ComSignalType=UINT8, ComHandleId=1574, ComSystemTemplateSystemSignalRef=DET_CONFD_AZIMUTH_076
            DET_BI_STATIC_FLAG_076_oRDR_DETECTION_073_076_oPCAN_RADAR_cab04a5c_Tx: ComBitPosition=440, ComBitSize=1, ComSignalInitValue=0, ComSignalType=BOOLEAN, ComHandleId=1570, ComSystemTemplateSystemSignalRef=DET_BI_STATIC_FLAG_076
            DET_EXISTENCE_PROB_076_oRDR_DETECTION_073_076_oPCAN_RADAR_188938c0_Tx: ComBitPosition=448, ComBitSize=6, ComSignalInitValue=0, ComSignalType=UINT8, ComHandleId=1590, ComSystemTemplateSystemSignalRef=DET_EXISTENCE_PROB_076
            DET_BI_STATIC_FLAG_074_oRDR_DETECTION_073_076_oPCAN_RADAR_3b20e537_Tx: ComBitPosition=216, ComBitSize=1, ComSignalInitValue=0, ComSignalType=BOOLEAN, ComHandleId=1568, ComSystemTemplateSystemSignalRef=DET_BI_STATIC_FLAG_074
            DET_RANGE_073_oRDR_DETECTION_073_076_oPCAN_RADAR_2127f560_Tx: ComBitPosition=24, ComBitSize=15, ComSignalInitValue=0, ComSignalType=UINT16, ComHandleId=1610, ComSystemTemplateSystemSignalRef=DET_RANGE_073
            DET_AZIMUTH_ERR_074_oRDR_DETECTION_073_076_oPCAN_RADAR_c9b93047_Tx: ComBitPosition=217, ComBitSize=7, ComSignalInitValue=0, ComSignalType=UINT8, ComHandleId=1560, ComSystemTemplateSystemSignalRef=DET_AZIMUTH_ERR_074
            DET_AZIMUTH_ERR_073_oRDR_DETECTION_073_076_oPCAN_RADAR_9509132e_Tx: ComBitPosition=105, ComBitSize=7, ComSignalInitValue=0, ComSignalType=UINT8, ComHandleId=1559, ComSystemTemplateSystemSignalRef=DET_AZIMUTH_ERR_073
            DET_RANGE_075_oRDR_DETECTION_073_076_oPCAN_RADAR_e8e7029c_Tx: ComBitPosition=248, ComBitSize=15, ComSignalInitValue=0, ComSignalType=UINT16, ComHandleId=1612, ComSystemTemplateSystemSignalRef=DET_RANGE_075
            DET_BI_STATIC_FLAG_075_oRDR_DETECTION_073_076_oPCAN_RADAR_ae5031a2_Tx: ComBitPosition=328, ComBitSize=1, ComSignalInitValue=0, ComSignalType=BOOLEAN, ComHandleId=1569, ComSystemTemplateSystemSignalRef=DET_BI_STATIC_FLAG_075
            DET_ELEVATION_ERR_073_oRDR_DETECTION_073_076_oPCAN_RADAR_6736c1a2_Tx: ComBitPosition=80, ComBitSize=6, ComSignalInitValue=0, ComSignalType=UINT8, ComHandleId=1583, ComSystemTemplateSystemSignalRef=DET_ELEVATION_ERR_073
            DET_RANGE_VELOCITY_076_oRDR_DETECTION_073_076_oPCAN_RADAR_f9a1bb47_Tx: ComBitPosition=384, ComBitSize=15, ComSignalInitValue=16384, ComSignalType=UINT16, ComHandleId=1621, ComSystemTemplateSystemSignalRef=DET_RANGE_VELOCITY_076
            DET_EXISTENCE_PROB_074_oRDR_DETECTION_073_076_oPCAN_RADAR_e91997ab_Tx: ComBitPosition=224, ComBitSize=6, ComSignalInitValue=0, ComSignalType=UINT8, ComHandleId=1588, ComSystemTemplateSystemSignalRef=DET_EXISTENCE_PROB_074
            DET_MH_SCAN_INDEX_4LSB_073_076_oRDR_DETECTION_073_076_oPCAN_RADAR_96b35be2_Tx: ComBitPosition=476, ComBitSize=4, ComSignalInitValue=0, ComSignalType=UINT8, ComHandleId=1601, ComSystemTemplateSystemSignalRef=DET_MH_SCAN_INDEX_4LSB_073_076
            DET_HVC_FLAG_075_oRDR_DETECTION_073_076_oPCAN_RADAR_9d1d0041_Tx: ComBitPosition=310, ComBitSize=1, ComSignalInitValue=0, ComSignalType=BOOLEAN, ComHandleId=1593, ComSystemTemplateSystemSignalRef=DET_HVC_FLAG_075
            DET_CONFD_AZIMUTH_073_oRDR_DETECTION_073_076_oPCAN_RADAR_335a8c11_Tx: ComBitPosition=118, ComBitSize=2, ComSignalInitValue=0, ComSignalType=UINT8, ComHandleId=1571, ComSystemTemplateSystemSignalRef=DET_CONFD_AZIMUTH_073
            DET_RANGE_ERR_076_oRDR_DETECTION_073_076_oPCAN_RADAR_2befc30b_Tx: ComBitPosition=376, ComBitSize=7, ComSignalInitValue=0, ComSignalType=UINT8, ComHandleId=1617, ComSystemTemplateSystemSignalRef=DET_RANGE_ERR_076
            DET_ELEVATION_ERR_075_oRDR_DETECTION_073_076_oPCAN_RADAR_aef6365e_Tx: ComBitPosition=304, ComBitSize=6, ComSignalInitValue=0, ComSignalType=UINT8, ComHandleId=1585, ComSystemTemplateSystemSignalRef=DET_ELEVATION_ERR_075
            DET_ELEVATION_ERR_076_oRDR_DETECTION_073_076_oPCAN_RADAR_ca164da0_Tx: ComBitPosition=416, ComBitSize=6, ComSignalInitValue=0, ComSignalType=UINT8, ComHandleId=1586, ComSystemTemplateSystemSignalRef=DET_ELEVATION_ERR_076
            DET_RCS_074_oRDR_DETECTION_073_076_oPCAN_RADAR_8fb12376_Tx: ComBitPosition=240, ComBitSize=8, ComSignalInitValue=128, ComSignalType=UINT8, ComHandleId=1627, ComSystemTemplateSystemSignalRef=DET_RCS_074
            DET_BI_STATIC_FLAG_073_oRDR_DETECTION_073_076_oPCAN_RADAR_6790c65e_Tx: ComBitPosition=104, ComBitSize=1, ComSignalInitValue=0, ComSignalType=BOOLEAN, ComHandleId=1567, ComSystemTemplateSystemSignalRef=DET_BI_STATIC_FLAG_073
            DET_SNR_075_oRDR_DETECTION_073_076_oPCAN_RADAR_c76fa3e1_Tx: ComBitPosition=344, ComBitSize=8, ComSignalInitValue=0, ComSignalType=UINT8, ComHandleId=1632, ComSystemTemplateSystemSignalRef=DET_SNR_075
            DET_RCS_073_oRDR_DETECTION_073_076_oPCAN_RADAR_d301001f_Tx: ComBitPosition=128, ComBitSize=8, ComSignalInitValue=128, ComSignalType=UINT8, ComHandleId=1626, ComSystemTemplateSystemSignalRef=DET_RCS_073
            DET_SUPER_RES_TARGET_075_oRDR_DETECTION_073_076_oPCAN_RADAR_f6f68b84_Tx: ComBitPosition=311, ComBitSize=1, ComSignalInitValue=0, ComSignalType=BOOLEAN, ComHandleId=1636, ComSystemTemplateSystemSignalRef=DET_SUPER_RES_TARGET_075
            DET_EXISTENCE_PROB_073_oRDR_DETECTION_073_076_oPCAN_RADAR_b5a9b4c2_Tx: ComBitPosition=112, ComBitSize=6, ComSignalInitValue=0, ComSignalType=UINT8, ComHandleId=1587, ComSystemTemplateSystemSignalRef=DET_EXISTENCE_PROB_073
            DET_SUPER_RES_TARGET_073_oRDR_DETECTION_073_076_oPCAN_RADAR_3f367c78_Tx: ComBitPosition=87, ComBitSize=1, ComSignalInitValue=0, ComSignalType=BOOLEAN, ComHandleId=1634, ComSystemTemplateSystemSignalRef=DET_SUPER_RES_TARGET_073
            DET_HVC_FLAG_073_oRDR_DETECTION_073_076_oPCAN_RADAR_54ddf7bd_Tx: ComBitPosition=86, ComBitSize=1, ComSignalInitValue=0, ComSignalType=BOOLEAN, ComHandleId=1591, ComSystemTemplateSystemSignalRef=DET_HVC_FLAG_073
            DET_HVC_FLAG_074_oRDR_DETECTION_073_076_oPCAN_RADAR_086dd4d4_Tx: ComBitPosition=198, ComBitSize=1, ComSignalInitValue=0, ComSignalType=BOOLEAN, ComHandleId=1592, ComSystemTemplateSystemSignalRef=DET_HVC_FLAG_074
            DET_HVC_FLAG_076_oRDR_DETECTION_073_076_oPCAN_RADAR_f9fd7bbf_Tx: ComBitPosition=422, ComBitSize=1, ComSignalInitValue=0, ComSignalType=BOOLEAN, ComHandleId=1594, ComSystemTemplateSystemSignalRef=DET_HVC_FLAG_076
            DET_RCS_076_oRDR_DETECTION_073_076_oPCAN_RADAR_7e218c1d_Tx: ComBitPosition=464, ComBitSize=8, ComSignalInitValue=128, ComSignalType=UINT8, ComHandleId=1629, ComSystemTemplateSystemSignalRef=DET_RCS_076
            DET_ELEVATION_ERR_074_oRDR_DETECTION_073_076_oPCAN_RADAR_3b86e2cb_Tx: ComBitPosition=192, ComBitSize=6, ComSignalInitValue=0, ComSignalType=UINT8, ComHandleId=1584, ComSystemTemplateSystemSignalRef=DET_ELEVATION_ERR_074
            DET_RANGE_VELOCITY_074_oRDR_DETECTION_073_076_oPCAN_RADAR_0831142c_Tx: ComBitPosition=160, ComBitSize=15, ComSignalInitValue=16384, ComSignalType=UINT16, ComHandleId=1619, ComSystemTemplateSystemSignalRef=DET_RANGE_VELOCITY_074
            DET_RANGE_ERR_073_oRDR_DETECTION_073_076_oPCAN_RADAR_86cf4f09_Tx: ComBitPosition=40, ComBitSize=7, ComSignalInitValue=0, ComSignalType=UINT8, ComHandleId=1614, ComSystemTemplateSystemSignalRef=DET_RANGE_ERR_073
            DET_AZIMUTH_076_oRDR_DETECTION_073_076_oPCAN_RADAR_9c9c0ad9_Tx: ComBitPosition=424, ComBitSize=13, ComSignalInitValue=0, ComSignalType=UINT16, ComHandleId=1558, ComSystemTemplateSystemSignalRef=DET_AZIMUTH_076
            DET_SUPER_RES_TARGET_074_oRDR_DETECTION_073_076_oPCAN_RADAR_63865f11_Tx: ComBitPosition=199, ComBitSize=1, ComSignalInitValue=0, ComSignalType=BOOLEAN, ComHandleId=1635, ComSystemTemplateSystemSignalRef=DET_SUPER_RES_TARGET_074
            DET_RANGE_VELOCITY_ERR_076_oRDR_DETECTION_073_076_oPCAN_RADAR_f61a40f5_Tx: ComBitPosition=400, ComBitSize=8, ComSignalInitValue=0, ComSignalType=UINT8, ComHandleId=1625, ComSystemTemplateSystemSignalRef=DET_RANGE_VELOCITY_ERR_076
            DET_AZIMUTH_ERR_076_oRDR_DETECTION_073_076_oPCAN_RADAR_38299f2c_Tx: ComBitPosition=441, ComBitSize=7, ComSignalInitValue=0, ComSignalType=UINT8, ComHandleId=1562, ComSystemTemplateSystemSignalRef=DET_AZIMUTH_ERR_076
            DET_RANGE_VELOCITY_073_oRDR_DETECTION_073_076_oPCAN_RADAR_54813745_Tx: ComBitPosition=48, ComBitSize=15, ComSignalInitValue=16384, ComSignalType=UINT16, ComHandleId=1618, ComSystemTemplateSystemSignalRef=DET_RANGE_VELOCITY_073
            DET_SNR_076_oRDR_DETECTION_073_076_oPCAN_RADAR_a38fd81f_Tx: ComBitPosition=456, ComBitSize=8, ComSignalInitValue=0, ComSignalType=UINT8, ComHandleId=1633, ComSystemTemplateSystemSignalRef=DET_SNR_076
            DET_ELEVATION_076_oRDR_DETECTION_073_076_oPCAN_RADAR_4d2fd5d5_Tx: ComBitPosition=408, ComBitSize=8, ComSignalInitValue=0, ComSignalType=UINT8, ComHandleId=1582, ComSystemTemplateSystemSignalRef=DET_ELEVATION_076
            DET_RANGE_VELOCITY_ERR_074_oRDR_DETECTION_073_076_oPCAN_RADAR_078aef9e_Tx: ComBitPosition=176, ComBitSize=8, ComSignalInitValue=0, ComSignalType=UINT8, ComHandleId=1623, ComSystemTemplateSystemSignalRef=DET_RANGE_VELOCITY_ERR_074
            DET_RANGE_VELOCITY_ERR_075_oRDR_DETECTION_073_076_oPCAN_RADAR_92fa3b0b_Tx: ComBitPosition=288, ComBitSize=8, ComSignalInitValue=0, ComSignalType=UINT8, ComHandleId=1624, ComSystemTemplateSystemSignalRef=DET_RANGE_VELOCITY_ERR_075
            DET_CONFD_AZIMUTH_074_oRDR_DETECTION_073_076_oPCAN_RADAR_6feaaf78_Tx: ComBitPosition=230, ComBitSize=2, ComSignalInitValue=0, ComSignalType=UINT8, ComHandleId=1572, ComSystemTemplateSystemSignalRef=DET_CONFD_AZIMUTH_074
            DET_CONFD_ELEVATION_074_oRDR_DETECTION_073_076_oPCAN_RADAR_6d7fae82_Tx: ComBitPosition=213, ComBitSize=2, ComSignalInitValue=0, ComSignalType=UINT8, ComHandleId=1576, ComSystemTemplateSystemSignalRef=DET_CONFD_ELEVATION_074
            DET_RANGE_ERR_075_oRDR_DETECTION_073_076_oPCAN_RADAR_4f0fb8f5_Tx: ComBitPosition=264, ComBitSize=7, ComSignalInitValue=0, ComSignalType=UINT8, ComHandleId=1616, ComSystemTemplateSystemSignalRef=DET_RANGE_ERR_075
            DET_RANGE_VELOCITY_075_oRDR_DETECTION_073_076_oPCAN_RADAR_9d41c0b9_Tx: ComBitPosition=272, ComBitSize=15, ComSignalInitValue=16384, ComSignalType=UINT16, ComHandleId=1620, ComSystemTemplateSystemSignalRef=DET_RANGE_VELOCITY_075
            DET_MH_CRC16_073_076_oRDR_DETECTION_073_076_oPCAN_RADAR_deecdf59_Tx: ComBitPosition=0, ComBitSize=16, ComSignalInitValue=0, ComSignalType=UINT16, ComHandleId=1599, ComSystemTemplateSystemSignalRef=DET_MH_CRC16_073_076
            DET_RANGE_ERR_074_oRDR_DETECTION_073_076_oPCAN_RADAR_da7f6c60_Tx: ComBitPosition=152, ComBitSize=7, ComSignalInitValue=0, ComSignalType=UINT8, ComHandleId=1615, ComSystemTemplateSystemSignalRef=DET_RANGE_ERR_074
            DET_ELEVATION_073_oRDR_DETECTION_073_076_oPCAN_RADAR_e00f59d7_Tx: ComBitPosition=72, ComBitSize=8, ComSignalInitValue=0, ComSignalType=UINT8, ComHandleId=1579, ComSystemTemplateSystemSignalRef=DET_ELEVATION_073
            DET_EXISTENCE_PROB_075_oRDR_DETECTION_073_076_oPCAN_RADAR_7c69433e_Tx: ComBitPosition=336, ComBitSize=6, ComSignalInitValue=0, ComSignalType=UINT8, ComHandleId=1589, ComSystemTemplateSystemSignalRef=DET_EXISTENCE_PROB_075
            DET_ELEVATION_074_oRDR_DETECTION_073_076_oPCAN_RADAR_bcbf7abe_Tx: ComBitPosition=184, ComBitSize=8, ComSignalInitValue=0, ComSignalType=UINT8, ComHandleId=1580, ComSystemTemplateSystemSignalRef=DET_ELEVATION_074
            DET_ELEVATION_075_oRDR_DETECTION_073_076_oPCAN_RADAR_29cfae2b_Tx: ComBitPosition=296, ComBitSize=8, ComSignalInitValue=0, ComSignalType=UINT8, ComHandleId=1581, ComSystemTemplateSystemSignalRef=DET_ELEVATION_075
            DET_MH_CYCLE_COUNTER_073_076_oRDR_DETECTION_073_076_oPCAN_RADAR_5a997e6e_Tx: ComBitPosition=16, ComBitSize=8, ComSignalInitValue=0, ComSignalType=UINT8, ComHandleId=1600, ComSystemTemplateSystemSignalRef=DET_MH_CYCLE_COUNTER_073_076
            DET_AZIMUTH_074_oRDR_DETECTION_073_076_oPCAN_RADAR_6d0ca5b2_Tx: ComBitPosition=200, ComBitSize=13, ComSignalInitValue=0, ComSignalType=UINT16, ComHandleId=1556, ComSystemTemplateSystemSignalRef=DET_AZIMUTH_074
            DET_SNR_074_oRDR_DETECTION_073_076_oPCAN_RADAR_521f7774_Tx: ComBitPosition=232, ComBitSize=8, ComSignalInitValue=0, ComSignalType=UINT8, ComHandleId=1631, ComSystemTemplateSystemSignalRef=DET_SNR_074
            DET_RCS_075_oRDR_DETECTION_073_076_oPCAN_RADAR_1ac1f7e3_Tx: ComBitPosition=352, ComBitSize=8, ComSignalInitValue=128, ComSignalType=UINT8, ComHandleId=1628, ComSystemTemplateSystemSignalRef=DET_RCS_075
            DET_IDM_075_oRDR_DETECTION_073_076_oPCAN_RADAR_164f3bfc_Tx: ComBitPosition=287, ComBitSize=1, ComSignalInitValue=0, ComSignalType=UINT8, ComHandleId=1597, ComSystemTemplateSystemSignalRef=DET_IDM_075
            DET_IDM_074_oRDR_DETECTION_073_076_oPCAN_RADAR_833fef69_Tx: ComBitPosition=175, ComBitSize=1, ComSignalInitValue=0, ComSignalType=UINT8, ComHandleId=1596, ComSystemTemplateSystemSignalRef=DET_IDM_074
            DET_MTD_076_oRDR_DETECTION_073_076_oPCAN_RADAR_141c72d9_Tx: ComBitPosition=383, ComBitSize=1, ComSignalInitValue=0, ComSignalType=UINT8, ComHandleId=1605, ComSystemTemplateSystemSignalRef=DET_MTD_076
            DET_MTD_075_oRDR_DETECTION_073_076_oPCAN_RADAR_70fc0927_Tx: ComBitPosition=271, ComBitSize=1, ComSignalInitValue=0, ComSignalType=UINT8, ComHandleId=1604, ComSystemTemplateSystemSignalRef=DET_MTD_075
            DET_PROB_1STAZHYPO_075_oRDR_DETECTION_073_076_oPCAN_RADAR_e348e1ea_Tx: ComBitPosition=327, ComBitSize=1, ComSignalInitValue=0, ComSignalType=BOOLEAN, ComHandleId=1608, ComSystemTemplateSystemSignalRef=DET_PROB_1STAZHYPO_075
            DET_BELOW_RAIN_THOLD_074_oRDR_DETECTION_073_076_oPCAN_RADAR_b80d3672_Tx: ComBitPosition=151, ComBitSize=1, ComSignalInitValue=0, ComSignalType=UINT8, ComHandleId=1564, ComSystemTemplateSystemSignalRef=DET_BELOW_RAIN_THOLD_074
            DET_MTD_074_oRDR_DETECTION_073_076_oPCAN_RADAR_e58cddb2_Tx: ComBitPosition=159, ComBitSize=1, ComSignalInitValue=0, ComSignalType=UINT8, ComHandleId=1603, ComSystemTemplateSystemSignalRef=DET_MTD_074
            DET_MTD_073_oRDR_DETECTION_073_076_oPCAN_RADAR_b93cfedb_Tx: ComBitPosition=47, ComBitSize=1, ComSignalInitValue=0, ComSignalType=UINT8, ComHandleId=1602, ComSystemTemplateSystemSignalRef=DET_MTD_073
            DET_BELOW_RAIN_THOLD_076_oRDR_DETECTION_073_076_oPCAN_RADAR_499d9919_Tx: ComBitPosition=375, ComBitSize=1, ComSignalInitValue=0, ComSignalType=UINT8, ComHandleId=1566, ComSystemTemplateSystemSignalRef=DET_BELOW_RAIN_THOLD_076
            DET_BELOW_RAIN_THOLD_073_oRDR_DETECTION_073_076_oPCAN_RADAR_e4bd151b_Tx: ComBitPosition=39, ComBitSize=1, ComSignalInitValue=0, ComSignalType=UINT8, ComHandleId=1563, ComSystemTemplateSystemSignalRef=DET_BELOW_RAIN_THOLD_073
            DET_PROB_1STAZHYPO_073_oRDR_DETECTION_073_076_oPCAN_RADAR_2a881616_Tx: ComBitPosition=103, ComBitSize=1, ComSignalInitValue=0, ComSignalType=BOOLEAN, ComHandleId=1606, ComSystemTemplateSystemSignalRef=DET_PROB_1STAZHYPO_073
            DET_PROB_1STAZHYPO_076_oRDR_DETECTION_073_076_oPCAN_RADAR_87a89a14_Tx: ComBitPosition=439, ComBitSize=1, ComSignalInitValue=0, ComSignalType=BOOLEAN, ComHandleId=1609, ComSystemTemplateSystemSignalRef=DET_PROB_1STAZHYPO_076
            DET_PROB_1STAZHYPO_074_oRDR_DETECTION_073_076_oPCAN_RADAR_7638357f_Tx: ComBitPosition=215, ComBitSize=1, ComSignalInitValue=0, ComSignalType=BOOLEAN, ComHandleId=1607, ComSystemTemplateSystemSignalRef=DET_PROB_1STAZHYPO_074
            DET_IDM_073_oRDR_DETECTION_073_076_oPCAN_RADAR_df8fcc00_Tx: ComBitPosition=63, ComBitSize=1, ComSignalInitValue=0, ComSignalType=UINT8, ComHandleId=1595, ComSystemTemplateSystemSignalRef=DET_IDM_073
            DET_IDM_076_oRDR_DETECTION_073_076_oPCAN_RADAR_72af4002_Tx: ComBitPosition=399, ComBitSize=1, ComSignalInitValue=0, ComSignalType=UINT8, ComHandleId=1598, ComSystemTemplateSystemSignalRef=DET_IDM_076
            DET_BELOW_RAIN_THOLD_075_oRDR_DETECTION_073_076_oPCAN_RADAR_2d7de2e7_Tx: ComBitPosition=263, ComBitSize=1, ComSignalInitValue=0, ComSignalType=UINT8, ComHandleId=1565, ComSystemTemplateSystemSignalRef=DET_BELOW_RAIN_THOLD_075
        SG_Detections_165_168_oRDR_DETECTION_165_168_oPCAN_RADAR_b3bd63bd_Tx: ComTransferProperty=TRIGGERED, ComHandleId=43, ComSystemTemplateSignalGroupRef=SG_Detections_165_168
          83 x ComGroupSignal, all with ComSignalEndianness=LITTLE_ENDIAN, ComTransferProperty=PENDING, ComSignalAccess=ACCESS_NEEDED_BY_SWC_OR_COM:
            DET_EXISTENCE_PROB_168_oRDR_DETECTION_165_168_oPCAN_RADAR_ed072370_Tx: ComBitPosition=448, ComBitSize=6, ComSignalInitValue=0, ComSignalType=UINT8, ComHandleId=3499, ComSystemTemplateSystemSignalRef=DET_EXISTENCE_PROB_168
            DET_SUPER_RES_TARGET_165_oRDR_DETECTION_165_168_oPCAN_RADAR_ba18d6e6_Tx: ComBitPosition=87, ComBitSize=1, ComSignalInitValue=0, ComSignalType=BOOLEAN, ComHandleId=3543, ComSystemTemplateSystemSignalRef=DET_SUPER_RES_TARGET_165
            DET_HVC_FLAG_165_oRDR_DETECTION_165_168_oPCAN_RADAR_d1f35d23_Tx: ComBitPosition=86, ComBitSize=1, ComSignalInitValue=0, ComSignalType=BOOLEAN, ComHandleId=3500, ComSystemTemplateSystemSignalRef=DET_HVC_FLAG_165
            DET_ELEVATION_ERR_166_oRDR_DETECTION_165_168_oPCAN_RADAR_86f810c2_Tx: ComBitPosition=192, ComBitSize=6, ComSignalInitValue=0, ComSignalType=UINT8, ComHandleId=3493, ComSystemTemplateSystemSignalRef=DET_ELEVATION_ERR_166
            DET_EXISTENCE_PROB_165_oRDR_DETECTION_165_168_oPCAN_RADAR_30871e5c_Tx: ComBitPosition=112, ComBitSize=6, ComSignalInitValue=0, ComSignalType=UINT8, ComHandleId=3496, ComSystemTemplateSystemSignalRef=DET_EXISTENCE_PROB_165
            DET_AZIMUTH_ERR_168_oRDR_DETECTION_165_168_oPCAN_RADAR_cda7849c_Tx: ComBitPosition=441, ComBitSize=7, ComSignalInitValue=0, ComSignalType=UINT8, ComHandleId=3471, ComSystemTemplateSystemSignalRef=DET_AZIMUTH_ERR_168
            DET_RANGE_ERR_168_oRDR_DETECTION_165_168_oPCAN_RADAR_de61d8bb_Tx: ComBitPosition=376, ComBitSize=7, ComSignalInitValue=0, ComSignalType=UINT8, ComHandleId=3526, ComSystemTemplateSystemSignalRef=DET_RANGE_ERR_168
            DET_RANGE_ERR_167_oRDR_DETECTION_165_168_oPCAN_RADAR_f2714afc_Tx: ComBitPosition=264, ComBitSize=7, ComSignalInitValue=0, ComSignalType=UINT8, ComHandleId=3525, ComSystemTemplateSystemSignalRef=DET_RANGE_ERR_167
            DET_RANGE_ERR_166_oRDR_DETECTION_165_168_oPCAN_RADAR_67019e69_Tx: ComBitPosition=152, ComBitSize=7, ComSignalInitValue=0, ComSignalType=UINT8, ComHandleId=3524, ComSystemTemplateSystemSignalRef=DET_RANGE_ERR_166
            DET_CONFD_ELEVATION_166_oRDR_DETECTION_165_168_oPCAN_RADAR_d0015c8b_Tx: ComBitPosition=213, ComBitSize=2, ComSignalInitValue=0, ComSignalType=UINT8, ComHandleId=3485, ComSystemTemplateSystemSignalRef=DET_CONFD_ELEVATION_166
            DET_HVC_FLAG_166_oRDR_DETECTION_165_168_oPCAN_RADAR_b51326dd_Tx: ComBitPosition=198, ComBitSize=1, ComSignalInitValue=0, ComSignalType=BOOLEAN, ComHandleId=3501, ComSystemTemplateSystemSignalRef=DET_HVC_FLAG_166
            DET_AZIMUTH_ERR_166_oRDR_DETECTION_165_168_oPCAN_RADAR_74c7c24e_Tx: ComBitPosition=217, ComBitSize=7, ComSignalInitValue=0, ComSignalType=UINT8, ComHandleId=3469, ComSystemTemplateSystemSignalRef=DET_AZIMUTH_ERR_166
            DET_RANGE_168_oRDR_DETECTION_165_168_oPCAN_RADAR_798962d2_Tx: ComBitPosition=360, ComBitSize=15, ComSignalInitValue=0, ComSignalType=UINT16, ComHandleId=3522, ComSystemTemplateSystemSignalRef=DET_RANGE_168
            DET_AZIMUTH_167_oRDR_DETECTION_165_168_oPCAN_RADAR_4502832e_Tx: ComBitPosition=312, ComBitSize=13, ComSignalInitValue=0, ComSignalType=UINT16, ComHandleId=3466, ComSystemTemplateSystemSignalRef=DET_AZIMUTH_167
            DET_ELEVATION_ERR_168_oRDR_DETECTION_165_168_oPCAN_RADAR_3f985610_Tx: ComBitPosition=416, ComBitSize=6, ComSignalInitValue=0, ComSignalType=UINT8, ComHandleId=3495, ComSystemTemplateSystemSignalRef=DET_ELEVATION_ERR_168
            DET_RCS_167_oRDR_DETECTION_165_168_oPCAN_RADAR_a7bf05ea_Tx: ComBitPosition=352, ComBitSize=8, ComSignalInitValue=128, ComSignalType=UINT8, ComHandleId=3537, ComSystemTemplateSystemSignalRef=DET_RCS_167
            DET_MH_CYCLE_COUNTER_165_168_oRDR_DETECTION_165_168_oPCAN_RADAR_b3401081_Tx: ComBitPosition=16, ComBitSize=8, ComSignalInitValue=0, ComSignalType=UINT8, ComHandleId=3509, ComSystemTemplateSystemSignalRef=DET_MH_CYCLE_COUNTER_165_168
            DET_SNR_167_oRDR_DETECTION_165_168_oPCAN_RADAR_7a1151e8_Tx: ComBitPosition=344, ComBitSize=8, ComSignalInitValue=0, ComSignalType=UINT8, ComHandleId=3541, ComSystemTemplateSystemSignalRef=DET_SNR_167
            DET_ELEVATION_165_oRDR_DETECTION_165_168_oPCAN_RADAR_6521f349_Tx: ComBitPosition=72, ComBitSize=8, ComSignalInitValue=0, ComSignalType=UINT8, ComHandleId=3488, ComSystemTemplateSystemSignalRef=DET_ELEVATION_165
            DET_MH_CRC16_165_168_oRDR_DETECTION_165_168_oPCAN_RADAR_3735b1b6_Tx: ComBitPosition=0, ComBitSize=16, ComSignalInitValue=0, ComSignalType=UINT16, ComHandleId=3508, ComSystemTemplateSystemSignalRef=DET_MH_CRC16_165_168
            DET_SUPER_RES_TARGET_166_oRDR_DETECTION_165_168_oPCAN_RADAR_def8ad18_Tx: ComBitPosition=199, ComBitSize=1, ComSignalInitValue=0, ComSignalType=BOOLEAN, ComHandleId=3544, ComSystemTemplateSystemSignalRef=DET_SUPER_RES_TARGET_166
            DET_ELEVATION_168_oRDR_DETECTION_165_168_oPCAN_RADAR_b8a1ce65_Tx: ComBitPosition=408, ComBitSize=8, ComSignalInitValue=0, ComSignalType=UINT8, ComHandleId=3491, ComSystemTemplateSystemSignalRef=DET_ELEVATION_168
            DET_HVC_FLAG_167_oRDR_DETECTION_165_168_oPCAN_RADAR_2063f248_Tx: ComBitPosition=310, ComBitSize=1, ComSignalInitValue=0, ComSignalType=BOOLEAN, ComHandleId=3502, ComSystemTemplateSystemSignalRef=DET_HVC_FLAG_167
            DET_CONFD_AZIMUTH_165_oRDR_DETECTION_165_168_oPCAN_RADAR_b674268f_Tx: ComBitPosition=118, ComBitSize=2, ComSignalInitValue=0, ComSignalType=UINT8, ComHandleId=3480, ComSystemTemplateSystemSignalRef=DET_CONFD_AZIMUTH_165
            DET_CONFD_ELEVATION_165_oRDR_DETECTION_165_168_oPCAN_RADAR_b4e12775_Tx: ComBitPosition=101, ComBitSize=2, ComSignalInitValue=0, ComSignalType=UINT8, ComHandleId=3484, ComSystemTemplateSystemSignalRef=DET_CONFD_ELEVATION_165
            DET_RANGE_VELOCITY_165_oRDR_DETECTION_165_168_oPCAN_RADAR_d1af9ddb_Tx: ComBitPosition=48, ComBitSize=15, ComSignalInitValue=16384, ComSignalType=UINT16, ComHandleId=3527, ComSystemTemplateSystemSignalRef=DET_RANGE_VELOCITY_165
            DET_AZIMUTH_ERR_165_oRDR_DETECTION_165_168_oPCAN_RADAR_1027b9b0_Tx: ComBitPosition=105, ComBitSize=7, ComSignalInitValue=0, ComSignalType=UINT8, ComHandleId=3468, ComSystemTemplateSystemSignalRef=DET_AZIMUTH_ERR_165
            DET_RANGE_VELOCITY_ERR_165_oRDR_DETECTION_165_168_oPCAN_RADAR_de146669_Tx: ComBitPosition=64, ComBitSize=8, ComSignalInitValue=0, ComSignalType=UINT8, ComHandleId=3531, ComSystemTemplateSystemSignalRef=DET_RANGE_VELOCITY_ERR_165
            DET_CONFD_AZIMUTH_166_oRDR_DETECTION_165_168_oPCAN_RADAR_d2945d71_Tx: ComBitPosition=230, ComBitSize=2, ComSignalInitValue=0, ComSignalType=UINT8, ComHandleId=3481, ComSystemTemplateSystemSignalRef=DET_CONFD_AZIMUTH_166
            DET_EXISTENCE_PROB_166_oRDR_DETECTION_165_168_oPCAN_RADAR_546765a2_Tx: ComBitPosition=224, ComBitSize=6, ComSignalInitValue=0, ComSignalType=UINT8, ComHandleId=3497, ComSystemTemplateSystemSignalRef=DET_EXISTENCE_PROB_166
            DET_RANGE_166_oRDR_DETECTION_165_168_oPCAN_RADAR_c0e92400_Tx: ComBitPosition=136, ComBitSize=15, ComSignalInitValue=0, ComSignalType=UINT16, ComHandleId=3520, ComSystemTemplateSystemSignalRef=DET_RANGE_166
            DET_RANGE_VELOCITY_ERR_167_oRDR_DETECTION_165_168_oPCAN_RADAR_2f84c902_Tx: ComBitPosition=288, ComBitSize=8, ComSignalInitValue=0, ComSignalType=UINT8, ComHandleId=3533, ComSystemTemplateSystemSignalRef=DET_RANGE_VELOCITY_ERR_167
            DET_AZIMUTH_168_oRDR_DETECTION_165_168_oPCAN_RADAR_69121169_Tx: ComBitPosition=424, ComBitSize=13, ComSignalInitValue=0, ComSignalType=UINT16, ComHandleId=3467, ComSystemTemplateSystemSignalRef=DET_AZIMUTH_168
            DET_RANGE_VELOCITY_168_oRDR_DETECTION_165_168_oPCAN_RADAR_0c2fa0f7_Tx: ComBitPosition=384, ComBitSize=15, ComSignalInitValue=16384, ComSignalType=UINT16, ComHandleId=3530, ComSystemTemplateSystemSignalRef=DET_RANGE_VELOCITY_168
            DET_SNR_166_oRDR_DETECTION_165_168_oPCAN_RADAR_ef61857d_Tx: ComBitPosition=232, ComBitSize=8, ComSignalInitValue=0, ComSignalType=UINT8, ComHandleId=3540, ComSystemTemplateSystemSignalRef=DET_SNR_166
            DET_AZIMUTH_165_oRDR_DETECTION_165_168_oPCAN_RADAR_b4922c45_Tx: ComBitPosition=88, ComBitSize=13, ComSignalInitValue=0, ComSignalType=UINT16, ComHandleId=3464, ComSystemTemplateSystemSignalRef=DET_AZIMUTH_165
            DET_RANGE_VELOCITY_167_oRDR_DETECTION_165_168_oPCAN_RADAR_203f32b0_Tx: ComBitPosition=272, ComBitSize=15, ComSignalInitValue=16384, ComSignalType=UINT16, ComHandleId=3529, ComSystemTemplateSystemSignalRef=DET_RANGE_VELOCITY_167
            DET_HVC_FLAG_168_oRDR_DETECTION_165_168_oPCAN_RADAR_0c73600f_Tx: ComBitPosition=422, ComBitSize=1, ComSignalInitValue=0, ComSignalType=BOOLEAN, ComHandleId=3503, ComSystemTemplateSystemSignalRef=DET_HVC_FLAG_168
            DET_ELEVATION_166_oRDR_DETECTION_165_168_oPCAN_RADAR_01c188b7_Tx: ComBitPosition=184, ComBitSize=8, ComSignalInitValue=0, ComSignalType=UINT8, ComHandleId=3489, ComSystemTemplateSystemSignalRef=DET_ELEVATION_166
            DET_MH_SCAN_INDEX_4LSB_165_168_oRDR_DETECTION_165_168_oPCAN_RADAR_7f6a350d_Tx: ComBitPosition=476, ComBitSize=4, ComSignalInitValue=0, ComSignalType=UINT8, ComHandleId=3510, ComSystemTemplateSystemSignalRef=DET_MH_SCAN_INDEX_4LSB_165_168
            DET_RCS_166_oRDR_DETECTION_165_168_oPCAN_RADAR_32cfd17f_Tx: ComBitPosition=240, ComBitSize=8, ComSignalInitValue=128, ComSignalType=UINT8, ComHandleId=3536, ComSystemTemplateSystemSignalRef=DET_RCS_166
            DET_AZIMUTH_ERR_167_oRDR_DETECTION_165_168_oPCAN_RADAR_e1b716db_Tx: ComBitPosition=329, ComBitSize=7, ComSignalInitValue=0, ComSignalType=UINT8, ComHandleId=3470, ComSystemTemplateSystemSignalRef=DET_AZIMUTH_ERR_167
            DET_SUPER_RES_TARGET_168_oRDR_DETECTION_165_168_oPCAN_RADAR_6798ebca_Tx: ComBitPosition=423, ComBitSize=1, ComSignalInitValue=0, ComSignalType=BOOLEAN, ComHandleId=3546, ComSystemTemplateSystemSignalRef=DET_SUPER_RES_TARGET_168
            DET_ELEVATION_167_oRDR_DETECTION_165_168_oPCAN_RADAR_94b15c22_Tx: ComBitPosition=296, ComBitSize=8, ComSignalInitValue=0, ComSignalType=UINT8, ComHandleId=3490, ComSystemTemplateSystemSignalRef=DET_ELEVATION_167
            DET_RANGE_167_oRDR_DETECTION_165_168_oPCAN_RADAR_5599f095_Tx: ComBitPosition=248, ComBitSize=15, ComSignalInitValue=0, ComSignalType=UINT16, ComHandleId=3521, ComSystemTemplateSystemSignalRef=DET_RANGE_167
            DET_RCS_165_oRDR_DETECTION_165_168_oPCAN_RADAR_562faa81_Tx: ComBitPosition=128, ComBitSize=8, ComSignalInitValue=128, ComSignalType=UINT8, ComHandleId=3535, ComSystemTemplateSystemSignalRef=DET_RCS_165
            DET_RANGE_VELOCITY_ERR_166_oRDR_DETECTION_165_168_oPCAN_RADAR_baf41d97_Tx: ComBitPosition=176, ComBitSize=8, ComSignalInitValue=0, ComSignalType=UINT8, ComHandleId=3532, ComSystemTemplateSystemSignalRef=DET_RANGE_VELOCITY_ERR_166
            DET_ELEVATION_ERR_167_oRDR_DETECTION_165_168_oPCAN_RADAR_1388c457_Tx: ComBitPosition=304, ComBitSize=6, ComSignalInitValue=0, ComSignalType=UINT8, ComHandleId=3494, ComSystemTemplateSystemSignalRef=DET_ELEVATION_ERR_167
            DET_BI_STATIC_FLAG_167_oRDR_DETECTION_165_168_oPCAN_RADAR_132ec3ab_Tx: ComBitPosition=328, ComBitSize=1, ComSignalInitValue=0, ComSignalType=BOOLEAN, ComHandleId=3478, ComSystemTemplateSystemSignalRef=DET_BI_STATIC_FLAG_167
            DET_BI_STATIC_FLAG_165_oRDR_DETECTION_165_168_oPCAN_RADAR_e2be6cc0_Tx: ComBitPosition=104, ComBitSize=1, ComSignalInitValue=0, ComSignalType=BOOLEAN, ComHandleId=3476, ComSystemTemplateSystemSignalRef=DET_BI_STATIC_FLAG_165
            DET_BI_STATIC_FLAG_166_oRDR_DETECTION_165_168_oPCAN_RADAR_865e173e_Tx: ComBitPosition=216, ComBitSize=1, ComSignalInitValue=0, ComSignalType=BOOLEAN, ComHandleId=3477, ComSystemTemplateSystemSignalRef=DET_BI_STATIC_FLAG_166
            DET_ELEVATION_ERR_165_oRDR_DETECTION_165_168_oPCAN_RADAR_e2186b3c_Tx: ComBitPosition=80, ComBitSize=6, ComSignalInitValue=0, ComSignalType=UINT8, ComHandleId=3492, ComSystemTemplateSystemSignalRef=DET_ELEVATION_ERR_165
            DET_RANGE_165_oRDR_DETECTION_165_168_oPCAN_RADAR_a4095ffe_Tx: ComBitPosition=24, ComBitSize=15, ComSignalInitValue=0, ComSignalType=UINT16, ComHandleId=3519, ComSystemTemplateSystemSignalRef=DET_RANGE_165
            DET_AZIMUTH_166_oRDR_DETECTION_165_168_oPCAN_RADAR_d07257bb_Tx: ComBitPosition=200, ComBitSize=13, ComSignalInitValue=0, ComSignalType=UINT16, ComHandleId=3465, ComSystemTemplateSystemSignalRef=DET_AZIMUTH_166
            DET_EXISTENCE_PROB_167_oRDR_DETECTION_165_168_oPCAN_RADAR_c117b137_Tx: ComBitPosition=336, ComBitSize=6, ComSignalInitValue=0, ComSignalType=UINT8, ComHandleId=3498, ComSystemTemplateSystemSignalRef=DET_EXISTENCE_PROB_167
            DET_RCS_168_oRDR_DETECTION_165_168_oPCAN_RADAR_8baf97ad_Tx: ComBitPosition=464, ComBitSize=8, ComSignalInitValue=128, ComSignalType=UINT8, ComHandleId=3538, ComSystemTemplateSystemSignalRef=DET_RCS_168
            DET_BI_STATIC_FLAG_168_oRDR_DETECTION_165_168_oPCAN_RADAR_3f3e51ec_Tx: ComBitPosition=440, ComBitSize=1, ComSignalInitValue=0, ComSignalType=BOOLEAN, ComHandleId=3479, ComSystemTemplateSystemSignalRef=DET_BI_STATIC_FLAG_168
            DET_CONFD_AZIMUTH_168_oRDR_DETECTION_165_168_oPCAN_RADAR_6bf41ba3_Tx: ComBitPosition=454, ComBitSize=2, ComSignalInitValue=0, ComSignalType=UINT8, ComHandleId=3483, ComSystemTemplateSystemSignalRef=DET_CONFD_AZIMUTH_168
            DET_CONFD_AZIMUTH_167_oRDR_DETECTION_165_168_oPCAN_RADAR_47e489e4_Tx: ComBitPosition=342, ComBitSize=2, ComSignalInitValue=0, ComSignalType=UINT8, ComHandleId=3482, ComSystemTemplateSystemSignalRef=DET_CONFD_AZIMUTH_167
            DET_RANGE_VELOCITY_166_oRDR_DETECTION_165_168_oPCAN_RADAR_b54fe625_Tx: ComBitPosition=160, ComBitSize=15, ComSignalInitValue=16384, ComSignalType=UINT16, ComHandleId=3528, ComSystemTemplateSystemSignalRef=DET_RANGE_VELOCITY_166
            DET_SNR_165_oRDR_DETECTION_165_168_oPCAN_RADAR_8b81fe83_Tx: ComBitPosition=120, ComBitSize=8, ComSignalInitValue=0, ComSignalType=UINT8, ComHandleId=3539, ComSystemTemplateSystemSignalRef=DET_SNR_165
            DET_SUPER_RES_TARGET_167_oRDR_DETECTION_165_168_oPCAN_RADAR_4b88798d_Tx: ComBitPosition=311, ComBitSize=1, ComSignalInitValue=0, ComSignalType=BOOLEAN, ComHandleId=3545, ComSystemTemplateSystemSignalRef=DET_SUPER_RES_TARGET_167
            DET_RANGE_ERR_165_oRDR_DETECTION_165_168_oPCAN_RADAR_03e1e597_Tx: ComBitPosition=40, ComBitSize=7, ComSignalInitValue=0, ComSignalType=UINT8, ComHandleId=3523, ComSystemTemplateSystemSignalRef=DET_RANGE_ERR_165
            DET_RANGE_VELOCITY_ERR_168_oRDR_DETECTION_165_168_oPCAN_RADAR_03945b45_Tx: ComBitPosition=400, ComBitSize=8, ComSignalInitValue=0, ComSignalType=UINT8, ComHandleId=3534, ComSystemTemplateSystemSignalRef=DET_RANGE_VELOCITY_ERR_168
            DET_CONFD_ELEVATION_168_oRDR_DETECTION_165_168_oPCAN_RADAR_69611a59_Tx: ComBitPosition=437, ComBitSize=2, ComSignalInitValue=0, ComSignalType=UINT8, ComHandleId=3487, ComSystemTemplateSystemSignalRef=DET_CONFD_ELEVATION_168
            DET_CONFD_ELEVATION_167_oRDR_DETECTION_165_168_oPCAN_RADAR_4571881e_Tx: ComBitPosition=325, ComBitSize=2, ComSignalInitValue=0, ComSignalType=UINT8, ComHandleId=3486, ComSystemTemplateSystemSignalRef=DET_CONFD_ELEVATION_167
            DET_SNR_168_oRDR_DETECTION_165_168_oPCAN_RADAR_5601c3af_Tx: ComBitPosition=456, ComBitSize=8, ComSignalInitValue=0, ComSignalType=UINT8, ComHandleId=3542, ComSystemTemplateSystemSignalRef=DET_SNR_168
            DET_MTD_165_oRDR_DETECTION_165_168_oPCAN_RADAR_3c125445_Tx: ComBitPosition=47, ComBitSize=1, ComSignalInitValue=0, ComSignalType=UINT8, ComHandleId=3511, ComSystemTemplateSystemSignalRef=DET_MTD_165
            DET_BELOW_RAIN_THOLD_165_oRDR_DETECTION_165_168_oPCAN_RADAR_6193bf85_Tx: ComBitPosition=39, ComBitSize=1, ComSignalInitValue=0, ComSignalType=UINT8, ComHandleId=3472, ComSystemTemplateSystemSignalRef=DET_BELOW_RAIN_THOLD_165
            DET_IDM_168_oRDR_DETECTION_165_168_oPCAN_RADAR_87215bb2_Tx: ComBitPosition=399, ComBitSize=1, ComSignalInitValue=0, ComSignalType=UINT8, ComHandleId=3507, ComSystemTemplateSystemSignalRef=DET_IDM_168
            DET_MTD_166_oRDR_DETECTION_165_168_oPCAN_RADAR_58f22fbb_Tx: ComBitPosition=159, ComBitSize=1, ComSignalInitValue=0, ComSignalType=UINT8, ComHandleId=3512, ComSystemTemplateSystemSignalRef=DET_MTD_166
            DET_IDM_167_oRDR_DETECTION_165_168_oPCAN_RADAR_ab31c9f5_Tx: ComBitPosition=287, ComBitSize=1, ComSignalInitValue=0, ComSignalType=UINT8, ComHandleId=3506, ComSystemTemplateSystemSignalRef=DET_IDM_167
            DET_BELOW_RAIN_THOLD_166_oRDR_DETECTION_165_168_oPCAN_RADAR_0573c47b_Tx: ComBitPosition=151, ComBitSize=1, ComSignalInitValue=0, ComSignalType=UINT8, ComHandleId=3473, ComSystemTemplateSystemSignalRef=DET_BELOW_RAIN_THOLD_166
            DET_BELOW_RAIN_THOLD_167_oRDR_DETECTION_165_168_oPCAN_RADAR_900310ee_Tx: ComBitPosition=263, ComBitSize=1, ComSignalInitValue=0, ComSignalType=UINT8, ComHandleId=3474, ComSystemTemplateSystemSignalRef=DET_BELOW_RAIN_THOLD_167
            DET_MTD_168_oRDR_DETECTION_165_168_oPCAN_RADAR_e1926969_Tx: ComBitPosition=383, ComBitSize=1, ComSignalInitValue=0, ComSignalType=UINT8, ComHandleId=3514, ComSystemTemplateSystemSignalRef=DET_MTD_168
            DET_IDM_166_oRDR_DETECTION_165_168_oPCAN_RADAR_3e411d60_Tx: ComBitPosition=175, ComBitSize=1, ComSignalInitValue=0, ComSignalType=UINT8, ComHandleId=3505, ComSystemTemplateSystemSignalRef=DET_IDM_166
            DET_PROB_1STAZHYPO_165_oRDR_DETECTION_165_168_oPCAN_RADAR_afa6bc88_Tx: ComBitPosition=103, ComBitSize=1, ComSignalInitValue=0, ComSignalType=BOOLEAN, ComHandleId=3515, ComSystemTemplateSystemSignalRef=DET_PROB_1STAZHYPO_165
            DET_PROB_1STAZHYPO_167_oRDR_DETECTION_165_168_oPCAN_RADAR_5e3613e3_Tx: ComBitPosition=327, ComBitSize=1, ComSignalInitValue=0, ComSignalType=BOOLEAN, ComHandleId=3517, ComSystemTemplateSystemSignalRef=DET_PROB_1STAZHYPO_167
            DET_PROB_1STAZHYPO_168_oRDR_DETECTION_165_168_oPCAN_RADAR_722681a4_Tx: ComBitPosition=439, ComBitSize=1, ComSignalInitValue=0, ComSignalType=BOOLEAN, ComHandleId=3518, ComSystemTemplateSystemSignalRef=DET_PROB_1STAZHYPO_168
            DET_BELOW_RAIN_THOLD_168_oRDR_DETECTION_165_168_oPCAN_RADAR_bc1382a9_Tx: ComBitPosition=375, ComBitSize=1, ComSignalInitValue=0, ComSignalType=UINT8, ComHandleId=3475, ComSystemTemplateSystemSignalRef=DET_BELOW_RAIN_THOLD_168
            DET_PROB_1STAZHYPO_166_oRDR_DETECTION_165_168_oPCAN_RADAR_cb46c776_Tx: ComBitPosition=215, ComBitSize=1, ComSignalInitValue=0, ComSignalType=BOOLEAN, ComHandleId=3516, ComSystemTemplateSystemSignalRef=DET_PROB_1STAZHYPO_166
            DET_MTD_167_oRDR_DETECTION_165_168_oPCAN_RADAR_cd82fb2e_Tx: ComBitPosition=271, ComBitSize=1, ComSignalInitValue=0, ComSignalType=UINT8, ComHandleId=3513, ComSystemTemplateSystemSignalRef=DET_MTD_167
            DET_IDM_165_oRDR_DETECTION_165_168_oPCAN_RADAR_5aa1669e_Tx: ComBitPosition=63, ComBitSize=1, ComSignalInitValue=0, ComSignalType=UINT8, ComHandleId=3504, ComSystemTemplateSystemSignalRef=DET_IDM_165
        SG_RadarStatus1_oRDR_STATUS_001_oPCAN_RADAR_4935b1b8_Tx: ComTransferProperty=PENDING, ComHandleId=107, ComSystemTemplateSignalGroupRef=SG_RadarStatus1
          46 x ComGroupSignal, all with ComSignalEndianness=LITTLE_ENDIAN, ComTransferProperty=PENDING, ComSignalAccess=ACCESS_NEEDED_BY_SWC_OR_COM:
            STS_SENSOR_MOUNT_POS_Z_oRDR_STATUS_001_oPCAN_RADAR_92521e70_Tx: ComBitPosition=328, ComBitSize=16, ComSignalInitValue=0, ComSignalType=UINT16, ComHandleId=8459, ComSystemTemplateSystemSignalRef=STS_SENSOR_MOUNT_POS_Z
            STS_SW_VERSION_FIELD2_oRDR_STATUS_001_oPCAN_RADAR_9e884e29_Tx: ComBitPosition=176, ComBitSize=8, ComSignalInitValue=0, ComSignalType=UINT8, ComHandleId=8472, ComSystemTemplateSystemSignalRef=STS_SW_VERSION_FIELD2
            STS_TIME_SINCE_POWER_ON_oRDR_STATUS_001_oPCAN_RADAR_b1d9cbc7_Tx: ComBitPosition=392, ComBitSize=32, ComSignalInitValue=0, ComSignalType=UINT32, ComHandleId=8475, ComSystemTemplateSystemSignalRef=STS_TIME_SINCE_POWER_ON
            STS_USC_CAL_VER_MAJOR_oRDR_STATUS_001_oPCAN_RADAR_25e52183_Tx: ComBitPosition=24, ComBitSize=16, ComSignalInitValue=0, ComSignalType=UINT16, ComHandleId=8476, ComSystemTemplateSystemSignalRef=STS_USC_CAL_VER_MAJOR
            STS_SENSOR_MOUNT_ORNT_ROLL_oRDR_STATUS_001_oPCAN_RADAR_c9a4f171_Tx: ComBitPosition=280, ComBitSize=14, ComSignalInitValue=0, ComSignalType=UINT16, ComHandleId=8455, ComSystemTemplateSystemSignalRef=STS_SENSOR_MOUNT_ORNT_ROLL
            STS_PLATFORM_VARIANT_oRDR_STATUS_001_oPCAN_RADAR_df303069_Tx: ComBitPosition=162, ComBitSize=5, ComSignalInitValue=0, ComSignalType=UINT8, ComHandleId=8450, ComSystemTemplateSystemSignalRef=STS_PLATFORM_VARIANT
            STS_USC_SECTION_COMPTBLITY_oRDR_STATUS_001_oPCAN_RADAR_71711001_Tx: ComBitPosition=56, ComBitSize=16, ComSignalInitValue=0, ComSignalType=UINT16, ComHandleId=8478, ComSystemTemplateSystemSignalRef=STS_USC_SECTION_COMPTBLITY
            STS_SERIAL_NUMBER_SEQUENCE_oRDR_STATUS_001_oPCAN_RADAR_c239676f_Tx: ComBitPosition=148, ComBitSize=14, ComSignalInitValue=1234, ComSignalType=UINT16, ComHandleId=8462, ComSystemTemplateSystemSignalRef=STS_SERIAL_NUMBER_SEQUENCE
            STS_SENSOR_HEIGHT_oRDR_STATUS_001_oPCAN_RADAR_d61d9b04_Tx: ComBitPosition=344, ComBitSize=32, ComSignalInitValue=0, ComSignalType=UINT32, ComHandleId=8453, ComSystemTemplateSystemSignalRef=STS_SENSOR_HEIGHT
            STS_SMC_SECTION_COMPTBLITY_oRDR_STATUS_001_oPCAN_RADAR_735f172e_Tx: ComBitPosition=488, ComBitSize=16, ComSignalInitValue=0, ComSignalType=UINT16, ComHandleId=8468, ComSystemTemplateSystemSignalRef=STS_SMC_SECTION_COMPTBLITY
            STS_PBL_VERSION_FIELD1_oRDR_STATUS_001_oPCAN_RADAR_41398822_Tx: ComBitPosition=200, ComBitSize=8, ComSignalInitValue=0, ComSignalType=UINT8, ComHandleId=8444, ComSystemTemplateSystemSignalRef=STS_PBL_VERSION_FIELD1
            STS_SERIAL_NUM_JULIAN_YEAR_oRDR_STATUS_001_oPCAN_RADAR_1d761a02_Tx: ComBitPosition=145, ComBitSize=3, ComSignalInitValue=0, ComSignalType=UINT8, ComHandleId=8464, ComSystemTemplateSystemSignalRef=STS_SERIAL_NUM_JULIAN_YEAR
            STS_PBL_VERSION_FIELD4_oRDR_STATUS_001_oPCAN_RADAR_755033d7_Tx: ComBitPosition=224, ComBitSize=8, ComSignalInitValue=0, ComSignalType=UINT8, ComHandleId=8447, ComSystemTemplateSystemSignalRef=STS_PBL_VERSION_FIELD4
            STS_USC_CAL_VER_MINOR_oRDR_STATUS_001_oPCAN_RADAR_fd6eb693_Tx: ComBitPosition=40, ComBitSize=16, ComSignalInitValue=0, ComSignalType=UINT16, ComHandleId=8477, ComSystemTemplateSystemSignalRef=STS_USC_CAL_VER_MINOR
            STS_PCAN_PROTOCOL_VER_MAJOR_oRDR_STATUS_001_oPCAN_RADAR_1a19377a_Tx: ComBitPosition=120, ComBitSize=8, ComSignalInitValue=0, ComSignalType=UINT8, ComHandleId=8448, ComSystemTemplateSystemSignalRef=STS_PCAN_PROTOCOL_VER_MAJOR
            STS_SW_VERSION_FIELD4_oRDR_STATUS_001_oPCAN_RADAR_0fe99eb0_Tx: ComBitPosition=192, ComBitSize=8, ComSignalInitValue=0, ComSignalType=UINT8, ComHandleId=8474, ComSystemTemplateSystemSignalRef=STS_SW_VERSION_FIELD4
            STS_HARDWARE_VERSION_oRDR_STATUS_001_oPCAN_RADAR_2d912d77_Tx: ComBitPosition=112, ComBitSize=3, ComSignalInitValue=0, ComSignalType=UINT8, ComHandleId=8439, ComSystemTemplateSystemSignalRef=STS_HARDWARE_VERSION
            STS_PCAN_PROTOCOL_VER_MINOR_oRDR_STATUS_001_oPCAN_RADAR_c292a06a_Tx: ComBitPosition=128, ComBitSize=8, ComSignalInitValue=0, ComSignalType=UINT8, ComHandleId=8449, ComSystemTemplateSystemSignalRef=STS_PCAN_PROTOCOL_VER_MINOR
            STS_SENSOR_MOUNT_ORNT_PITCH_oRDR_STATUS_001_oPCAN_RADAR_ce18ff05_Tx: ComBitPosition=264, ComBitSize=14, ComSignalInitValue=0, ComSignalType=SINT16, ComHandleId=8454, ComSystemTemplateSystemSignalRef=STS_SENSOR_MOUNT_ORNT_PITCH
            STS_SENSOR_MOUNT_ORNT_YAW_oRDR_STATUS_001_oPCAN_RADAR_4c33f1ef_Tx: ComBitPosition=232, ComBitSize=14, ComSignalInitValue=0, ComSignalType=SINT16, ComHandleId=8456, ComSystemTemplateSystemSignalRef=STS_SENSOR_MOUNT_ORNT_YAW
            STS_PBL_VERSION_FIELD2_oRDR_STATUS_001_oPCAN_RADAR_e431e34e_Tx: ComBitPosition=208, ComBitSize=8, ComSignalInitValue=0, ComSignalType=UINT8, ComHandleId=8445, ComSystemTemplateSystemSignalRef=STS_PBL_VERSION_FIELD2
            STS_SW_VERSION_FIELD1_oRDR_STATUS_001_oPCAN_RADAR_3b802545_Tx: ComBitPosition=168, ComBitSize=8, ComSignalInitValue=0, ComSignalType=UINT8, ComHandleId=8471, ComSystemTemplateSystemSignalRef=STS_SW_VERSION_FIELD1
            STS_PBL_VERSION_FIELD3_oRDR_STATUS_001_oPCAN_RADAR_87363a6a_Tx: ComBitPosition=216, ComBitSize=8, ComSignalInitValue=0, ComSignalType=UINT8, ComHandleId=8446, ComSystemTemplateSystemSignalRef=STS_PBL_VERSION_FIELD3
            STS_MH_001_CYCLE_COUNTER_oRDR_STATUS_001_oPCAN_RADAR_50a8eb37_Tx: ComBitPosition=16, ComBitSize=8, ComSignalInitValue=0, ComSignalType=UINT8, ComHandleId=8443, ComSystemTemplateSystemSignalRef=STS_MH_001_CYCLE_COUNTER
            STS_SENSOR_MOUNT_POS_X_oRDR_STATUS_001_oPCAN_RADAR_545dac38_Tx: ComBitPosition=296, ComBitSize=14, ComSignalInitValue=8192, ComSignalType=UINT16, ComHandleId=8457, ComSystemTemplateSystemSignalRef=STS_SENSOR_MOUNT_POS_X
            STS_SMC_CAL_VER_MAJOR_oRDR_STATUS_001_oPCAN_RADAR_e3a30457_Tx: ComBitPosition=72, ComBitSize=16, ComSignalInitValue=0, ComSignalType=UINT16, ComHandleId=8465, ComSystemTemplateSystemSignalRef=STS_SMC_CAL_VER_MAJOR
            STS_SENSOR_MOUNT_POS_Y_oRDR_STATUS_001_oPCAN_RADAR_375a751c_Tx: ComBitPosition=312, ComBitSize=16, ComSignalInitValue=0, ComSignalType=UINT16, ComHandleId=8458, ComSystemTemplateSystemSignalRef=STS_SENSOR_MOUNT_POS_Y
            STS_SERIAL_NUM_JULIAN_DAY_oRDR_STATUS_001_oPCAN_RADAR_1b351b71_Tx: ComBitPosition=136, ComBitSize=9, ComSignalInitValue=365, ComSignalType=UINT16, ComHandleId=8463, ComSystemTemplateSystemSignalRef=STS_SERIAL_NUM_JULIAN_DAY
            STS_SW_VERSION_FIELD3_oRDR_STATUS_001_oPCAN_RADAR_fd8f970d_Tx: ComBitPosition=184, ComBitSize=8, ComSignalInitValue=0, ComSignalType=UINT8, ComHandleId=8473, ComSystemTemplateSystemSignalRef=STS_SW_VERSION_FIELD3
            STS_MH_001_CRC16_oRDR_STATUS_001_oPCAN_RADAR_0ffb3f46_Tx: ComBitPosition=0, ComBitSize=16, ComSignalInitValue=0, ComSignalType=UINT16, ComHandleId=8442, ComSystemTemplateSystemSignalRef=STS_MH_001_CRC16
            STS_DET_DBC_BASE_VER_MAJOR_oRDR_STATUS_001_oPCAN_RADAR_63ce1143_Tx: ComBitPosition=376, ComBitSize=8, ComSignalInitValue=0, ComSignalType=UINT8, ComHandleId=8436, ComSystemTemplateSystemSignalRef=STS_DET_DBC_BASE_VER_MAJOR
            STS_SMC_CAL_VER_MINOR_oRDR_STATUS_001_oPCAN_RADAR_3b289347_Tx: ComBitPosition=88, ComBitSize=16, ComSignalInitValue=0, ComSignalType=UINT16, ComHandleId=8466, ComSystemTemplateSystemSignalRef=STS_SMC_CAL_VER_MINOR
            STS_SENSOR_POSITION_oRDR_STATUS_001_oPCAN_RADAR_5946d50e_Tx: ComBitPosition=115, ComBitSize=3, ComSignalInitValue=0, ComSignalType=UINT8, ComHandleId=8461, ComSystemTemplateSystemSignalRef=STS_SENSOR_POSITION
            STS_DET_DBC_BASE_VER_MINOR_oRDR_STATUS_001_oPCAN_RADAR_bb458653_Tx: ComBitPosition=384, ComBitSize=8, ComSignalInitValue=0, ComSignalType=UINT8, ComHandleId=8437, ComSystemTemplateSystemSignalRef=STS_DET_DBC_BASE_VER_MINOR
            STS_SMC_PLATFROM_VERSION_oRDR_STATUS_001_oPCAN_RADAR_4cdd916f_Tx: ComBitPosition=104, ComBitSize=8, ComSignalInitValue=0, ComSignalType=UINT8, ComHandleId=8467, ComSystemTemplateSystemSignalRef=STS_SMC_PLATFROM_VERSION
            STS_DIST_FRNT_BMPR_TO_RR_AXL_oRDR_STATUS_001_oPCAN_RADAR_c8135b01_Tx: ComBitPosition=248, ComBitSize=13, ComSignalInitValue=0, ComSignalType=UINT16, ComHandleId=8438, ComSystemTemplateSystemSignalRef=STS_DIST_FRNT_BMPR_TO_RR_AXL
            STS_MAIN_CORE_TIME_INST_oRDR_STATUS_001_oPCAN_RADAR_471c051a_Tx: ComBitPosition=440, ComBitSize=8, ComSignalInitValue=0, ComSignalType=UINT8, ComHandleId=8440, ComSystemTemplateSystemSignalRef=STS_MAIN_CORE_TIME_INST
            STS_SP_CORE_TIME_INST_oRDR_STATUS_001_oPCAN_RADAR_9eae4180_Tx: ComBitPosition=480, ComBitSize=8, ComSignalInitValue=0, ComSignalType=UINT8, ComHandleId=8469, ComSystemTemplateSystemSignalRef=STS_SP_CORE_TIME_INST
            STS_AF_TIME_INST_oRDR_STATUS_001_oPCAN_RADAR_0e5415de_Tx: ComBitPosition=424, ComBitSize=8, ComSignalInitValue=0, ComSignalType=UINT8, ComHandleId=8434, ComSystemTemplateSystemSignalRef=STS_AF_TIME_INST
            STS_MAIN_CORE_TIME_PEAK_oRDR_STATUS_001_oPCAN_RADAR_fec39efe_Tx: ComBitPosition=448, ComBitSize=8, ComSignalInitValue=0, ComSignalType=UINT8, ComHandleId=8441, ComSystemTemplateSystemSignalRef=STS_MAIN_CORE_TIME_PEAK
            STS_RDD_CORE_TIME_INST_oRDR_STATUS_001_oPCAN_RADAR_38fa4a94_Tx: ComBitPosition=456, ComBitSize=8, ComSignalInitValue=0, ComSignalType=UINT8, ComHandleId=8451, ComSystemTemplateSystemSignalRef=STS_RDD_CORE_TIME_INST
            STS_AF_TIME_PEAK_oRDR_STATUS_001_oPCAN_RADAR_b78b8e3a_Tx: ComBitPosition=432, ComBitSize=8, ComSignalInitValue=0, ComSignalType=UINT8, ComHandleId=8435, ComSystemTemplateSystemSignalRef=STS_AF_TIME_PEAK
            STS_RDD_CORE_TIME_PEAK_oRDR_STATUS_001_oPCAN_RADAR_8125d170_Tx: ComBitPosition=464, ComBitSize=8, ComSignalInitValue=0, ComSignalType=UINT8, ComHandleId=8452, ComSystemTemplateSystemSignalRef=STS_RDD_CORE_TIME_PEAK
            STS_VIN_Status_oRDR_STATUS_001_oPCAN_RADAR_cde190ae_Tx: ComBitPosition=118, ComBitSize=2, ComSignalInitValue=0, ComSignalType=UINT8, ComHandleId=8479, ComSystemTemplateSystemSignalRef=STS_VIN_Status
            STS_SENSOR_POLARITY_oRDR_STATUS_001_oPCAN_RADAR_2123e19b_Tx: ComBitPosition=246, ComBitSize=1, ComSignalInitValue=0, ComSignalType=BOOLEAN, ComHandleId=8460, ComSystemTemplateSystemSignalRef=STS_SENSOR_POLARITY
            STS_SP_CORE_TIME_PEAK_oRDR_STATUS_001_oPCAN_RADAR_2771da64_Tx: ComBitPosition=472, ComBitSize=8, ComSignalInitValue=0, ComSignalType=UINT8, ComHandleId=8470, ComSystemTemplateSystemSignalRef=STS_SP_CORE_TIME_PEAK
        SG_Detections_357_360_oRDR_DETECTION_357_360_oPCAN_RADAR_44459c4e_Tx: ComTransferProperty=TRIGGERED, ComHandleId=91, ComSystemTemplateSignalGroupRef=SG_Detections_357_360
          83 x ComGroupSignal, all with ComSignalEndianness=LITTLE_ENDIAN, ComTransferProperty=PENDING, ComSignalAccess=ACCESS_NEEDED_BY_SWC_OR_COM:
            DET_AZIMUTH_359_oRDR_DETECTION_357_360_oPCAN_RADAR_dee82eb1_Tx: ComBitPosition=312, ComBitSize=13, ComSignalInitValue=0, ComSignalType=UINT16, ComHandleId=7450, ComSystemTemplateSystemSignalRef=DET_AZIMUTH_359
            DET_RANGE_357_oRDR_DETECTION_357_360_oPCAN_RADAR_77131bd8_Tx: ComBitPosition=24, ComBitSize=15, ComSignalInitValue=0, ComSignalType=UINT16, ComHandleId=7503, ComSystemTemplateSystemSignalRef=DET_RANGE_357
            DET_RANGE_VELOCITY_ERR_360_oRDR_DETECTION_357_360_oPCAN_RADAR_0bdf3e46_Tx: ComBitPosition=400, ComBitSize=8, ComSignalInitValue=0, ComSignalType=UINT8, ComHandleId=7518, ComSystemTemplateSystemSignalRef=DET_RANGE_VELOCITY_ERR_360
            DET_AZIMUTH_ERR_360_oRDR_DETECTION_357_360_oPCAN_RADAR_c5ece19f_Tx: ComBitPosition=441, ComBitSize=7, ComSignalInitValue=0, ComSignalType=UINT8, ComHandleId=7455, ComSystemTemplateSystemSignalRef=DET_AZIMUTH_ERR_360
            DET_CONFD_AZIMUTH_357_oRDR_DETECTION_357_360_oPCAN_RADAR_656e62a9_Tx: ComBitPosition=118, ComBitSize=2, ComSignalInitValue=0, ComSignalType=UINT8, ComHandleId=7464, ComSystemTemplateSystemSignalRef=DET_CONFD_AZIMUTH_357
            DET_RANGE_VELOCITY_ERR_359_oRDR_DETECTION_357_360_oPCAN_RADAR_b46e649d_Tx: ComBitPosition=288, ComBitSize=8, ComSignalInitValue=0, ComSignalType=UINT8, ComHandleId=7517, ComSystemTemplateSystemSignalRef=DET_RANGE_VELOCITY_ERR_359
            DET_HVC_FLAG_357_oRDR_DETECTION_357_360_oPCAN_RADAR_02e91905_Tx: ComBitPosition=86, ComBitSize=1, ComSignalInitValue=0, ComSignalType=BOOLEAN, ComHandleId=7484, ComSystemTemplateSystemSignalRef=DET_HVC_FLAG_357
            DET_AZIMUTH_357_oRDR_DETECTION_357_360_oPCAN_RADAR_67886863_Tx: ComBitPosition=88, ComBitSize=13, ComSignalInitValue=0, ComSignalType=UINT16, ComHandleId=7448, ComSystemTemplateSystemSignalRef=DET_AZIMUTH_357
            DET_RCS_357_oRDR_DETECTION_357_360_oPCAN_RADAR_8535eea7_Tx: ComBitPosition=128, ComBitSize=8, ComSignalInitValue=128, ComSignalType=UINT8, ComHandleId=7519, ComSystemTemplateSystemSignalRef=DET_RCS_357
            DET_CONFD_ELEVATION_358_oRDR_DETECTION_357_360_oPCAN_RADAR_4bebf114_Tx: ComBitPosition=213, ComBitSize=2, ComSignalInitValue=0, ComSignalType=UINT8, ComHandleId=7469, ComSystemTemplateSystemSignalRef=DET_CONFD_ELEVATION_358
            DET_SNR_357_oRDR_DETECTION_357_360_oPCAN_RADAR_589bbaa5_Tx: ComBitPosition=120, ComBitSize=8, ComSignalInitValue=0, ComSignalType=UINT8, ComHandleId=7523, ComSystemTemplateSystemSignalRef=DET_SNR_357
            DET_RANGE_ERR_357_oRDR_DETECTION_357_360_oPCAN_RADAR_d0fba1b1_Tx: ComBitPosition=40, ComBitSize=7, ComSignalInitValue=0, ComSignalType=UINT8, ComHandleId=7507, ComSystemTemplateSystemSignalRef=DET_RANGE_ERR_357
            DET_MH_CRC16_357_360_oRDR_DETECTION_357_360_oPCAN_RADAR_c0cd4e45_Tx: ComBitPosition=0, ComBitSize=16, ComSignalInitValue=0, ComSignalType=UINT16, ComHandleId=7492, ComSystemTemplateSystemSignalRef=DET_MH_CRC16_357_360
            DET_BI_STATIC_FLAG_357_oRDR_DETECTION_357_360_oPCAN_RADAR_31a428e6_Tx: ComBitPosition=104, ComBitSize=1, ComSignalInitValue=0, ComSignalType=BOOLEAN, ComHandleId=7460, ComSystemTemplateSystemSignalRef=DET_BI_STATIC_FLAG_357
            DET_RANGE_VELOCITY_359_oRDR_DETECTION_357_360_oPCAN_RADAR_bbd59f2f_Tx: ComBitPosition=272, ComBitSize=15, ComSignalInitValue=16384, ComSignalType=UINT16, ComHandleId=7513, ComSystemTemplateSystemSignalRef=DET_RANGE_VELOCITY_359
            DET_SNR_359_oRDR_DETECTION_357_360_oPCAN_RADAR_e1fbfc77_Tx: ComBitPosition=344, ComBitSize=8, ComSignalInitValue=0, ComSignalType=UINT8, ComHandleId=7525, ComSystemTemplateSystemSignalRef=DET_SNR_359
            DET_RANGE_360_oRDR_DETECTION_357_360_oPCAN_RADAR_71c207d1_Tx: ComBitPosition=360, ComBitSize=15, ComSignalInitValue=0, ComSignalType=UINT16, ComHandleId=7506, ComSystemTemplateSystemSignalRef=DET_RANGE_360
            DET_SNR_360_oRDR_DETECTION_357_360_oPCAN_RADAR_5e4aa6ac_Tx: ComBitPosition=456, ComBitSize=8, ComSignalInitValue=0, ComSignalType=UINT8, ComHandleId=7526, ComSystemTemplateSystemSignalRef=DET_SNR_360
            DET_RCS_359_oRDR_DETECTION_357_360_oPCAN_RADAR_3c55a875_Tx: ComBitPosition=352, ComBitSize=8, ComSignalInitValue=128, ComSignalType=UINT8, ComHandleId=7521, ComSystemTemplateSystemSignalRef=DET_RCS_359
            DET_RANGE_ERR_359_oRDR_DETECTION_357_360_oPCAN_RADAR_699be763_Tx: ComBitPosition=264, ComBitSize=7, ComSignalInitValue=0, ComSignalType=UINT8, ComHandleId=7509, ComSystemTemplateSystemSignalRef=DET_RANGE_ERR_359
            DET_SUPER_RES_TARGET_360_oRDR_DETECTION_357_360_oPCAN_RADAR_6fd38ec9_Tx: ComBitPosition=423, ComBitSize=1, ComSignalInitValue=0, ComSignalType=BOOLEAN, ComHandleId=7530, ComSystemTemplateSystemSignalRef=DET_SUPER_RES_TARGET_360
            DET_ELEVATION_ERR_358_oRDR_DETECTION_357_360_oPCAN_RADAR_1d12bd5d_Tx: ComBitPosition=192, ComBitSize=6, ComSignalInitValue=0, ComSignalType=UINT8, ComHandleId=7477, ComSystemTemplateSystemSignalRef=DET_ELEVATION_ERR_358
            DET_RANGE_VELOCITY_358_oRDR_DETECTION_357_360_oPCAN_RADAR_2ea54bba_Tx: ComBitPosition=160, ComBitSize=15, ComSignalInitValue=16384, ComSignalType=UINT16, ComHandleId=7512, ComSystemTemplateSystemSignalRef=DET_RANGE_VELOCITY_358
            DET_SUPER_RES_TARGET_357_oRDR_DETECTION_357_360_oPCAN_RADAR_690292c0_Tx: ComBitPosition=87, ComBitSize=1, ComSignalInitValue=0, ComSignalType=BOOLEAN, ComHandleId=7527, ComSystemTemplateSystemSignalRef=DET_SUPER_RES_TARGET_357
            DET_ELEVATION_ERR_357_oRDR_DETECTION_357_360_oPCAN_RADAR_31022f1a_Tx: ComBitPosition=80, ComBitSize=6, ComSignalInitValue=0, ComSignalType=UINT8, ComHandleId=7476, ComSystemTemplateSystemSignalRef=DET_ELEVATION_ERR_357
            DET_ELEVATION_ERR_360_oRDR_DETECTION_357_360_oPCAN_RADAR_37d33313_Tx: ComBitPosition=416, ComBitSize=6, ComSignalInitValue=0, ComSignalType=UINT8, ComHandleId=7479, ComSystemTemplateSystemSignalRef=DET_ELEVATION_ERR_360
            DET_SNR_358_oRDR_DETECTION_357_360_oPCAN_RADAR_748b28e2_Tx: ComBitPosition=232, ComBitSize=8, ComSignalInitValue=0, ComSignalType=UINT8, ComHandleId=7524, ComSystemTemplateSystemSignalRef=DET_SNR_358
            DET_RANGE_VELOCITY_360_oRDR_DETECTION_357_360_oPCAN_RADAR_0464c5f4_Tx: ComBitPosition=384, ComBitSize=15, ComSignalInitValue=16384, ComSignalType=UINT16, ComHandleId=7514, ComSystemTemplateSystemSignalRef=DET_RANGE_VELOCITY_360
            DET_CONFD_ELEVATION_360_oRDR_DETECTION_357_360_oPCAN_RADAR_612a7f5a_Tx: ComBitPosition=437, ComBitSize=2, ComSignalInitValue=0, ComSignalType=UINT8, ComHandleId=7471, ComSystemTemplateSystemSignalRef=DET_CONFD_ELEVATION_360
            DET_BI_STATIC_FLAG_360_oRDR_DETECTION_357_360_oPCAN_RADAR_377534ef_Tx: ComBitPosition=440, ComBitSize=1, ComSignalInitValue=0, ComSignalType=BOOLEAN, ComHandleId=7463, ComSystemTemplateSystemSignalRef=DET_BI_STATIC_FLAG_360
            DET_AZIMUTH_358_oRDR_DETECTION_357_360_oPCAN_RADAR_4b98fa24_Tx: ComBitPosition=200, ComBitSize=13, ComSignalInitValue=0, ComSignalType=UINT16, ComHandleId=7449, ComSystemTemplateSystemSignalRef=DET_AZIMUTH_358
            DET_RANGE_VELOCITY_ERR_358_oRDR_DETECTION_357_360_oPCAN_RADAR_211eb008_Tx: ComBitPosition=176, ComBitSize=8, ComSignalInitValue=0, ComSignalType=UINT8, ComHandleId=7516, ComSystemTemplateSystemSignalRef=DET_RANGE_VELOCITY_ERR_358
            DET_HVC_FLAG_358_oRDR_DETECTION_357_360_oPCAN_RADAR_2ef98b42_Tx: ComBitPosition=198, ComBitSize=1, ComSignalInitValue=0, ComSignalType=BOOLEAN, ComHandleId=7485, ComSystemTemplateSystemSignalRef=DET_HVC_FLAG_358
            DET_EXISTENCE_PROB_360_oRDR_DETECTION_357_360_oPCAN_RADAR_e54c4673_Tx: ComBitPosition=448, ComBitSize=6, ComSignalInitValue=0, ComSignalType=UINT8, ComHandleId=7483, ComSystemTemplateSystemSignalRef=DET_EXISTENCE_PROB_360
            DET_ELEVATION_357_oRDR_DETECTION_357_360_oPCAN_RADAR_b63bb76f_Tx: ComBitPosition=72, ComBitSize=8, ComSignalInitValue=0, ComSignalType=UINT8, ComHandleId=7472, ComSystemTemplateSystemSignalRef=DET_ELEVATION_357
            DET_AZIMUTH_ERR_358_oRDR_DETECTION_357_360_oPCAN_RADAR_ef2d6fd1_Tx: ComBitPosition=217, ComBitSize=7, ComSignalInitValue=0, ComSignalType=UINT8, ComHandleId=7453, ComSystemTemplateSystemSignalRef=DET_AZIMUTH_ERR_358
            DET_CONFD_ELEVATION_359_oRDR_DETECTION_357_360_oPCAN_RADAR_de9b2581_Tx: ComBitPosition=325, ComBitSize=2, ComSignalInitValue=0, ComSignalType=UINT8, ComHandleId=7470, ComSystemTemplateSystemSignalRef=DET_CONFD_ELEVATION_359
            DET_CONFD_ELEVATION_357_oRDR_DETECTION_357_360_oPCAN_RADAR_67fb6353_Tx: ComBitPosition=101, ComBitSize=2, ComSignalInitValue=0, ComSignalType=UINT8, ComHandleId=7468, ComSystemTemplateSystemSignalRef=DET_CONFD_ELEVATION_357
            DET_ELEVATION_360_oRDR_DETECTION_357_360_oPCAN_RADAR_b0eaab66_Tx: ComBitPosition=408, ComBitSize=8, ComSignalInitValue=0, ComSignalType=UINT8, ComHandleId=7475, ComSystemTemplateSystemSignalRef=DET_ELEVATION_360
            DET_RANGE_ERR_360_oRDR_DETECTION_357_360_oPCAN_RADAR_d62abdb8_Tx: ComBitPosition=376, ComBitSize=7, ComSignalInitValue=0, ComSignalType=UINT8, ComHandleId=7510, ComSystemTemplateSystemSignalRef=DET_RANGE_ERR_360
            DET_MH_CYCLE_COUNTER_357_360_oRDR_DETECTION_357_360_oPCAN_RADAR_44b8ef72_Tx: ComBitPosition=16, ComBitSize=8, ComSignalInitValue=0, ComSignalType=UINT8, ComHandleId=7493, ComSystemTemplateSystemSignalRef=DET_MH_CYCLE_COUNTER_357_360
            DET_BI_STATIC_FLAG_359_oRDR_DETECTION_357_360_oPCAN_RADAR_88c46e34_Tx: ComBitPosition=328, ComBitSize=1, ComSignalInitValue=0, ComSignalType=BOOLEAN, ComHandleId=7462, ComSystemTemplateSystemSignalRef=DET_BI_STATIC_FLAG_359
            DET_CONFD_AZIMUTH_360_oRDR_DETECTION_357_360_oPCAN_RADAR_63bf7ea0_Tx: ComBitPosition=454, ComBitSize=2, ComSignalInitValue=0, ComSignalType=UINT8, ComHandleId=7467, ComSystemTemplateSystemSignalRef=DET_CONFD_AZIMUTH_360
            DET_EXISTENCE_PROB_358_oRDR_DETECTION_357_360_oPCAN_RADAR_cf8dc83d_Tx: ComBitPosition=224, ComBitSize=6, ComSignalInitValue=0, ComSignalType=UINT8, ComHandleId=7481, ComSystemTemplateSystemSignalRef=DET_EXISTENCE_PROB_358
            DET_RCS_360_oRDR_DETECTION_357_360_oPCAN_RADAR_83e4f2ae_Tx: ComBitPosition=464, ComBitSize=8, ComSignalInitValue=128, ComSignalType=UINT8, ComHandleId=7522, ComSystemTemplateSystemSignalRef=DET_RCS_360
            DET_HVC_FLAG_359_oRDR_DETECTION_357_360_oPCAN_RADAR_bb895fd7_Tx: ComBitPosition=310, ComBitSize=1, ComSignalInitValue=0, ComSignalType=BOOLEAN, ComHandleId=7486, ComSystemTemplateSystemSignalRef=DET_HVC_FLAG_359
            DET_ELEVATION_ERR_359_oRDR_DETECTION_357_360_oPCAN_RADAR_886269c8_Tx: ComBitPosition=304, ComBitSize=6, ComSignalInitValue=0, ComSignalType=UINT8, ComHandleId=7478, ComSystemTemplateSystemSignalRef=DET_ELEVATION_ERR_359
            DET_HVC_FLAG_360_oRDR_DETECTION_357_360_oPCAN_RADAR_0438050c_Tx: ComBitPosition=422, ComBitSize=1, ComSignalInitValue=0, ComSignalType=BOOLEAN, ComHandleId=7487, ComSystemTemplateSystemSignalRef=DET_HVC_FLAG_360
            DET_SUPER_RES_TARGET_358_oRDR_DETECTION_357_360_oPCAN_RADAR_45120087_Tx: ComBitPosition=199, ComBitSize=1, ComSignalInitValue=0, ComSignalType=BOOLEAN, ComHandleId=7528, ComSystemTemplateSystemSignalRef=DET_SUPER_RES_TARGET_358
            DET_AZIMUTH_ERR_359_oRDR_DETECTION_357_360_oPCAN_RADAR_7a5dbb44_Tx: ComBitPosition=329, ComBitSize=7, ComSignalInitValue=0, ComSignalType=UINT8, ComHandleId=7454, ComSystemTemplateSystemSignalRef=DET_AZIMUTH_ERR_359
            DET_RANGE_358_oRDR_DETECTION_357_360_oPCAN_RADAR_5b03899f_Tx: ComBitPosition=136, ComBitSize=15, ComSignalInitValue=0, ComSignalType=UINT16, ComHandleId=7504, ComSystemTemplateSystemSignalRef=DET_RANGE_358
            DET_AZIMUTH_ERR_357_oRDR_DETECTION_357_360_oPCAN_RADAR_c33dfd96_Tx: ComBitPosition=105, ComBitSize=7, ComSignalInitValue=0, ComSignalType=UINT8, ComHandleId=7452, ComSystemTemplateSystemSignalRef=DET_AZIMUTH_ERR_357
            DET_CONFD_AZIMUTH_358_oRDR_DETECTION_357_360_oPCAN_RADAR_497ef0ee_Tx: ComBitPosition=230, ComBitSize=2, ComSignalInitValue=0, ComSignalType=UINT8, ComHandleId=7465, ComSystemTemplateSystemSignalRef=DET_CONFD_AZIMUTH_358
            DET_RANGE_359_oRDR_DETECTION_357_360_oPCAN_RADAR_ce735d0a_Tx: ComBitPosition=248, ComBitSize=15, ComSignalInitValue=0, ComSignalType=UINT16, ComHandleId=7505, ComSystemTemplateSystemSignalRef=DET_RANGE_359
            DET_ELEVATION_359_oRDR_DETECTION_357_360_oPCAN_RADAR_0f5bf1bd_Tx: ComBitPosition=296, ComBitSize=8, ComSignalInitValue=0, ComSignalType=UINT8, ComHandleId=7474, ComSystemTemplateSystemSignalRef=DET_ELEVATION_359
            DET_RANGE_ERR_358_oRDR_DETECTION_357_360_oPCAN_RADAR_fceb33f6_Tx: ComBitPosition=152, ComBitSize=7, ComSignalInitValue=0, ComSignalType=UINT8, ComHandleId=7508, ComSystemTemplateSystemSignalRef=DET_RANGE_ERR_358
            DET_SUPER_RES_TARGET_359_oRDR_DETECTION_357_360_oPCAN_RADAR_d062d412_Tx: ComBitPosition=311, ComBitSize=1, ComSignalInitValue=0, ComSignalType=BOOLEAN, ComHandleId=7529, ComSystemTemplateSystemSignalRef=DET_SUPER_RES_TARGET_359
            DET_AZIMUTH_360_oRDR_DETECTION_357_360_oPCAN_RADAR_6159746a_Tx: ComBitPosition=424, ComBitSize=13, ComSignalInitValue=0, ComSignalType=UINT16, ComHandleId=7451, ComSystemTemplateSystemSignalRef=DET_AZIMUTH_360
            DET_BI_STATIC_FLAG_358_oRDR_DETECTION_357_360_oPCAN_RADAR_1db4baa1_Tx: ComBitPosition=216, ComBitSize=1, ComSignalInitValue=0, ComSignalType=BOOLEAN, ComHandleId=7461, ComSystemTemplateSystemSignalRef=DET_BI_STATIC_FLAG_358
            DET_RANGE_VELOCITY_ERR_357_oRDR_DETECTION_357_360_oPCAN_RADAR_0d0e224f_Tx: ComBitPosition=64, ComBitSize=8, ComSignalInitValue=0, ComSignalType=UINT8, ComHandleId=7515, ComSystemTemplateSystemSignalRef=DET_RANGE_VELOCITY_ERR_357
            DET_EXISTENCE_PROB_359_oRDR_DETECTION_357_360_oPCAN_RADAR_5afd1ca8_Tx: ComBitPosition=336, ComBitSize=6, ComSignalInitValue=0, ComSignalType=UINT8, ComHandleId=7482, ComSystemTemplateSystemSignalRef=DET_EXISTENCE_PROB_359
            DET_ELEVATION_358_oRDR_DETECTION_357_360_oPCAN_RADAR_9a2b2528_Tx: ComBitPosition=184, ComBitSize=8, ComSignalInitValue=0, ComSignalType=UINT8, ComHandleId=7473, ComSystemTemplateSystemSignalRef=DET_ELEVATION_358
            DET_EXISTENCE_PROB_357_oRDR_DETECTION_357_360_oPCAN_RADAR_e39d5a7a_Tx: ComBitPosition=112, ComBitSize=6, ComSignalInitValue=0, ComSignalType=UINT8, ComHandleId=7480, ComSystemTemplateSystemSignalRef=DET_EXISTENCE_PROB_357
            DET_RCS_358_oRDR_DETECTION_357_360_oPCAN_RADAR_a9257ce0_Tx: ComBitPosition=240, ComBitSize=8, ComSignalInitValue=128, ComSignalType=UINT8, ComHandleId=7520, ComSystemTemplateSystemSignalRef=DET_RCS_358
            DET_MH_SCAN_INDEX_4LSB_357_360_oRDR_DETECTION_357_360_oPCAN_RADAR_8892cafe_Tx: ComBitPosition=476, ComBitSize=4, ComSignalInitValue=0, ComSignalType=UINT8, ComHandleId=7494, ComSystemTemplateSystemSignalRef=DET_MH_SCAN_INDEX_4LSB_357_360
            DET_RANGE_VELOCITY_357_oRDR_DETECTION_357_360_oPCAN_RADAR_02b5d9fd_Tx: ComBitPosition=48, ComBitSize=15, ComSignalInitValue=16384, ComSignalType=UINT16, ComHandleId=7511, ComSystemTemplateSystemSignalRef=DET_RANGE_VELOCITY_357
            DET_CONFD_AZIMUTH_359_oRDR_DETECTION_357_360_oPCAN_RADAR_dc0e247b_Tx: ComBitPosition=342, ComBitSize=2, ComSignalInitValue=0, ComSignalType=UINT8, ComHandleId=7466, ComSystemTemplateSystemSignalRef=DET_CONFD_AZIMUTH_359
            DET_IDM_358_oRDR_DETECTION_357_360_oPCAN_RADAR_a5abb0ff_Tx: ComBitPosition=175, ComBitSize=1, ComSignalInitValue=0, ComSignalType=UINT8, ComHandleId=7489, ComSystemTemplateSystemSignalRef=DET_IDM_358
            DET_BELOW_RAIN_THOLD_357_oRDR_DETECTION_357_360_oPCAN_RADAR_b289fba3_Tx: ComBitPosition=39, ComBitSize=1, ComSignalInitValue=0, ComSignalType=UINT8, ComHandleId=7456, ComSystemTemplateSystemSignalRef=DET_BELOW_RAIN_THOLD_357
            DET_IDM_360_oRDR_DETECTION_357_360_oPCAN_RADAR_8f6a3eb1_Tx: ComBitPosition=399, ComBitSize=1, ComSignalInitValue=0, ComSignalType=UINT8, ComHandleId=7491, ComSystemTemplateSystemSignalRef=DET_IDM_360
            DET_MTD_357_oRDR_DETECTION_357_360_oPCAN_RADAR_ef081063_Tx: ComBitPosition=47, ComBitSize=1, ComSignalInitValue=0, ComSignalType=UINT8, ComHandleId=7495, ComSystemTemplateSystemSignalRef=DET_MTD_357
            DET_BELOW_RAIN_THOLD_358_oRDR_DETECTION_357_360_oPCAN_RADAR_9e9969e4_Tx: ComBitPosition=151, ComBitSize=1, ComSignalInitValue=0, ComSignalType=UINT8, ComHandleId=7457, ComSystemTemplateSystemSignalRef=DET_BELOW_RAIN_THOLD_358
            DET_BELOW_RAIN_THOLD_359_oRDR_DETECTION_357_360_oPCAN_RADAR_0be9bd71_Tx: ComBitPosition=263, ComBitSize=1, ComSignalInitValue=0, ComSignalType=UINT8, ComHandleId=7458, ComSystemTemplateSystemSignalRef=DET_BELOW_RAIN_THOLD_359
            DET_BELOW_RAIN_THOLD_360_oRDR_DETECTION_357_360_oPCAN_RADAR_b458e7aa_Tx: ComBitPosition=375, ComBitSize=1, ComSignalInitValue=0, ComSignalType=UINT8, ComHandleId=7459, ComSystemTemplateSystemSignalRef=DET_BELOW_RAIN_THOLD_360
            DET_PROB_1STAZHYPO_360_oRDR_DETECTION_357_360_oPCAN_RADAR_7a6de4a7_Tx: ComBitPosition=439, ComBitSize=1, ComSignalInitValue=0, ComSignalType=BOOLEAN, ComHandleId=7502, ComSystemTemplateSystemSignalRef=DET_PROB_1STAZHYPO_360
            DET_PROB_1STAZHYPO_358_oRDR_DETECTION_357_360_oPCAN_RADAR_50ac6ae9_Tx: ComBitPosition=215, ComBitSize=1, ComSignalInitValue=0, ComSignalType=BOOLEAN, ComHandleId=7500, ComSystemTemplateSystemSignalRef=DET_PROB_1STAZHYPO_358
            DET_PROB_1STAZHYPO_357_oRDR_DETECTION_357_360_oPCAN_RADAR_7cbcf8ae_Tx: ComBitPosition=103, ComBitSize=1, ComSignalInitValue=0, ComSignalType=BOOLEAN, ComHandleId=7499, ComSystemTemplateSystemSignalRef=DET_PROB_1STAZHYPO_357
            DET_PROB_1STAZHYPO_359_oRDR_DETECTION_357_360_oPCAN_RADAR_c5dcbe7c_Tx: ComBitPosition=327, ComBitSize=1, ComSignalInitValue=0, ComSignalType=BOOLEAN, ComHandleId=7501, ComSystemTemplateSystemSignalRef=DET_PROB_1STAZHYPO_359
            DET_MTD_360_oRDR_DETECTION_357_360_oPCAN_RADAR_e9d90c6a_Tx: ComBitPosition=383, ComBitSize=1, ComSignalInitValue=0, ComSignalType=UINT8, ComHandleId=7498, ComSystemTemplateSystemSignalRef=DET_MTD_360
            DET_IDM_359_oRDR_DETECTION_357_360_oPCAN_RADAR_30db646a_Tx: ComBitPosition=287, ComBitSize=1, ComSignalInitValue=0, ComSignalType=UINT8, ComHandleId=7490, ComSystemTemplateSystemSignalRef=DET_IDM_359
            DET_MTD_359_oRDR_DETECTION_357_360_oPCAN_RADAR_566856b1_Tx: ComBitPosition=271, ComBitSize=1, ComSignalInitValue=0, ComSignalType=UINT8, ComHandleId=7497, ComSystemTemplateSystemSignalRef=DET_MTD_359
            DET_MTD_358_oRDR_DETECTION_357_360_oPCAN_RADAR_c3188224_Tx: ComBitPosition=159, ComBitSize=1, ComSignalInitValue=0, ComSignalType=UINT8, ComHandleId=7496, ComSystemTemplateSystemSignalRef=DET_MTD_358
            DET_IDM_357_oRDR_DETECTION_357_360_oPCAN_RADAR_89bb22b8_Tx: ComBitPosition=63, ComBitSize=1, ComSignalInitValue=0, ComSignalType=UINT8, ComHandleId=7488, ComSystemTemplateSystemSignalRef=DET_IDM_357
        SG_Detections_337_340_oRDR_DETECTION_337_340_oPCAN_RADAR_6c24a51c_Tx: ComTransferProperty=TRIGGERED, ComHandleId=86, ComSystemTemplateSignalGroupRef=SG_Detections_337_340
          83 x ComGroupSignal, all with ComSignalEndianness=LITTLE_ENDIAN, ComTransferProperty=PENDING, ComSignalAccess=ACCESS_NEEDED_BY_SWC_OR_COM:
            DET_MH_CYCLE_COUNTER_337_340_oRDR_DETECTION_337_340_oPCAN_RADAR_6cd9d620_Tx: ComBitPosition=16, ComBitSize=8, ComSignalInitValue=0, ComSignalType=UINT8, ComHandleId=7078, ComSystemTemplateSystemSignalRef=DET_MH_CYCLE_COUNTER_337_340
            DET_AZIMUTH_ERR_337_oRDR_DETECTION_337_340_oPCAN_RADAR_98edfb7e_Tx: ComBitPosition=105, ComBitSize=7, ComSignalInitValue=0, ComSignalType=UINT8, ComHandleId=7037, ComSystemTemplateSystemSignalRef=DET_AZIMUTH_ERR_337
            DET_RANGE_VELOCITY_ERR_340_oRDR_DETECTION_337_340_oPCAN_RADAR_3e5c6e11_Tx: ComBitPosition=400, ComBitSize=8, ComSignalInitValue=0, ComSignalType=UINT8, ComHandleId=7103, ComSystemTemplateSystemSignalRef=DET_RANGE_VELOCITY_ERR_340
            DET_AZIMUTH_339_oRDR_DETECTION_337_340_oPCAN_RADAR_85382859_Tx: ComBitPosition=312, ComBitSize=13, ComSignalInitValue=0, ComSignalType=UINT16, ComHandleId=7035, ComSystemTemplateSystemSignalRef=DET_AZIMUTH_339
            DET_CONFD_ELEVATION_339_oRDR_DETECTION_337_340_oPCAN_RADAR_854b2369_Tx: ComBitPosition=325, ComBitSize=2, ComSignalInitValue=0, ComSignalType=UINT8, ComHandleId=7055, ComSystemTemplateSystemSignalRef=DET_CONFD_ELEVATION_339
            DET_SNR_337_oRDR_DETECTION_337_340_oPCAN_RADAR_034bbc4d_Tx: ComBitPosition=120, ComBitSize=8, ComSignalInitValue=0, ComSignalType=UINT8, ComHandleId=7108, ComSystemTemplateSystemSignalRef=DET_SNR_337
            DET_CONFD_AZIMUTH_340_oRDR_DETECTION_337_340_oPCAN_RADAR_563c2ef7_Tx: ComBitPosition=454, ComBitSize=2, ComSignalInitValue=0, ComSignalType=UINT8, ComHandleId=7052, ComSystemTemplateSystemSignalRef=DET_CONFD_AZIMUTH_340
            DET_SNR_338_oRDR_DETECTION_337_340_oPCAN_RADAR_2f5b2e0a_Tx: ComBitPosition=232, ComBitSize=8, ComSignalInitValue=0, ComSignalType=UINT8, ComHandleId=7109, ComSystemTemplateSystemSignalRef=DET_SNR_338
            DET_RANGE_338_oRDR_DETECTION_337_340_oPCAN_RADAR_00d38f77_Tx: ComBitPosition=136, ComBitSize=15, ComSignalInitValue=0, ComSignalType=UINT16, ComHandleId=7089, ComSystemTemplateSystemSignalRef=DET_RANGE_338
            DET_MH_CRC16_337_340_oRDR_DETECTION_337_340_oPCAN_RADAR_e8ac7717_Tx: ComBitPosition=0, ComBitSize=16, ComSignalInitValue=0, ComSignalType=UINT16, ComHandleId=7077, ComSystemTemplateSystemSignalRef=DET_MH_CRC16_337_340
            DET_EXISTENCE_PROB_340_oRDR_DETECTION_337_340_oPCAN_RADAR_d0cf1624_Tx: ComBitPosition=448, ComBitSize=6, ComSignalInitValue=0, ComSignalType=UINT8, ComHandleId=7068, ComSystemTemplateSystemSignalRef=DET_EXISTENCE_PROB_340
            DET_AZIMUTH_337_oRDR_DETECTION_337_340_oPCAN_RADAR_3c586e8b_Tx: ComBitPosition=88, ComBitSize=13, ComSignalInitValue=0, ComSignalType=UINT16, ComHandleId=7033, ComSystemTemplateSystemSignalRef=DET_AZIMUTH_337
            DET_BI_STATIC_FLAG_338_oRDR_DETECTION_337_340_oPCAN_RADAR_4664bc49_Tx: ComBitPosition=216, ComBitSize=1, ComSignalInitValue=0, ComSignalType=BOOLEAN, ComHandleId=7046, ComSystemTemplateSystemSignalRef=DET_BI_STATIC_FLAG_338
            DET_EXISTENCE_PROB_339_oRDR_DETECTION_337_340_oPCAN_RADAR_012d1a40_Tx: ComBitPosition=336, ComBitSize=6, ComSignalInitValue=0, ComSignalType=UINT8, ComHandleId=7067, ComSystemTemplateSystemSignalRef=DET_EXISTENCE_PROB_339
            DET_RANGE_ERR_337_oRDR_DETECTION_337_340_oPCAN_RADAR_8b2ba759_Tx: ComBitPosition=40, ComBitSize=7, ComSignalInitValue=0, ComSignalType=UINT8, ComHandleId=7092, ComSystemTemplateSystemSignalRef=DET_RANGE_ERR_337
            DET_SUPER_RES_TARGET_338_oRDR_DETECTION_337_340_oPCAN_RADAR_1ec2066f_Tx: ComBitPosition=199, ComBitSize=1, ComSignalInitValue=0, ComSignalType=BOOLEAN, ComHandleId=7113, ComSystemTemplateSystemSignalRef=DET_SUPER_RES_TARGET_338
            DET_CONFD_AZIMUTH_338_oRDR_DETECTION_337_340_oPCAN_RADAR_12aef606_Tx: ComBitPosition=230, ComBitSize=2, ComSignalInitValue=0, ComSignalType=UINT8, ComHandleId=7050, ComSystemTemplateSystemSignalRef=DET_CONFD_AZIMUTH_338
            DET_SUPER_RES_TARGET_339_oRDR_DETECTION_337_340_oPCAN_RADAR_8bb2d2fa_Tx: ComBitPosition=311, ComBitSize=1, ComSignalInitValue=0, ComSignalType=BOOLEAN, ComHandleId=7114, ComSystemTemplateSystemSignalRef=DET_SUPER_RES_TARGET_339
            DET_RCS_337_oRDR_DETECTION_337_340_oPCAN_RADAR_dee5e84f_Tx: ComBitPosition=128, ComBitSize=8, ComSignalInitValue=128, ComSignalType=UINT8, ComHandleId=7104, ComSystemTemplateSystemSignalRef=DET_RCS_337
            DET_RANGE_ERR_340_oRDR_DETECTION_337_340_oPCAN_RADAR_e3a9edef_Tx: ComBitPosition=376, ComBitSize=7, ComSignalInitValue=0, ComSignalType=UINT8, ComHandleId=7095, ComSystemTemplateSystemSignalRef=DET_RANGE_ERR_340
            DET_CONFD_ELEVATION_338_oRDR_DETECTION_337_340_oPCAN_RADAR_103bf7fc_Tx: ComBitPosition=213, ComBitSize=2, ComSignalInitValue=0, ComSignalType=UINT8, ComHandleId=7054, ComSystemTemplateSystemSignalRef=DET_CONFD_ELEVATION_338
            DET_RANGE_VELOCITY_340_oRDR_DETECTION_337_340_oPCAN_RADAR_31e795a3_Tx: ComBitPosition=384, ComBitSize=15, ComSignalInitValue=16384, ComSignalType=UINT16, ComHandleId=7099, ComSystemTemplateSystemSignalRef=DET_RANGE_VELOCITY_340
            DET_ELEVATION_ERR_340_oRDR_DETECTION_337_340_oPCAN_RADAR_02506344_Tx: ComBitPosition=416, ComBitSize=6, ComSignalInitValue=0, ComSignalType=UINT8, ComHandleId=7064, ComSystemTemplateSystemSignalRef=DET_ELEVATION_ERR_340
            DET_BI_STATIC_FLAG_340_oRDR_DETECTION_337_340_oPCAN_RADAR_02f664b8_Tx: ComBitPosition=440, ComBitSize=1, ComSignalInitValue=0, ComSignalType=BOOLEAN, ComHandleId=7048, ComSystemTemplateSystemSignalRef=DET_BI_STATIC_FLAG_340
            DET_CONFD_ELEVATION_337_oRDR_DETECTION_337_340_oPCAN_RADAR_3c2b65bb_Tx: ComBitPosition=101, ComBitSize=2, ComSignalInitValue=0, ComSignalType=UINT8, ComHandleId=7053, ComSystemTemplateSystemSignalRef=DET_CONFD_ELEVATION_337
            DET_HVC_FLAG_340_oRDR_DETECTION_337_340_oPCAN_RADAR_31bb555b_Tx: ComBitPosition=422, ComBitSize=1, ComSignalInitValue=0, ComSignalType=BOOLEAN, ComHandleId=7072, ComSystemTemplateSystemSignalRef=DET_HVC_FLAG_340
            DET_SUPER_RES_TARGET_337_oRDR_DETECTION_337_340_oPCAN_RADAR_32d29428_Tx: ComBitPosition=87, ComBitSize=1, ComSignalInitValue=0, ComSignalType=BOOLEAN, ComHandleId=7112, ComSystemTemplateSystemSignalRef=DET_SUPER_RES_TARGET_337
            DET_AZIMUTH_ERR_340_oRDR_DETECTION_337_340_oPCAN_RADAR_f06fb1c8_Tx: ComBitPosition=441, ComBitSize=7, ComSignalInitValue=0, ComSignalType=UINT8, ComHandleId=7040, ComSystemTemplateSystemSignalRef=DET_AZIMUTH_ERR_340
            DET_RANGE_ERR_338_oRDR_DETECTION_337_340_oPCAN_RADAR_a73b351e_Tx: ComBitPosition=152, ComBitSize=7, ComSignalInitValue=0, ComSignalType=UINT8, ComHandleId=7093, ComSystemTemplateSystemSignalRef=DET_RANGE_ERR_338
            DET_SUPER_RES_TARGET_340_oRDR_DETECTION_337_340_oPCAN_RADAR_5a50de9e_Tx: ComBitPosition=423, ComBitSize=1, ComSignalInitValue=0, ComSignalType=BOOLEAN, ComHandleId=7115, ComSystemTemplateSystemSignalRef=DET_SUPER_RES_TARGET_340
            DET_ELEVATION_337_oRDR_DETECTION_337_340_oPCAN_RADAR_edebb187_Tx: ComBitPosition=72, ComBitSize=8, ComSignalInitValue=0, ComSignalType=UINT8, ComHandleId=7057, ComSystemTemplateSystemSignalRef=DET_ELEVATION_337
            DET_RANGE_VELOCITY_ERR_339_oRDR_DETECTION_337_340_oPCAN_RADAR_efbe6275_Tx: ComBitPosition=288, ComBitSize=8, ComSignalInitValue=0, ComSignalType=UINT8, ComHandleId=7102, ComSystemTemplateSystemSignalRef=DET_RANGE_VELOCITY_ERR_339
            DET_RANGE_337_oRDR_DETECTION_337_340_oPCAN_RADAR_2cc31d30_Tx: ComBitPosition=24, ComBitSize=15, ComSignalInitValue=0, ComSignalType=UINT16, ComHandleId=7088, ComSystemTemplateSystemSignalRef=DET_RANGE_337
            DET_ELEVATION_ERR_337_oRDR_DETECTION_337_340_oPCAN_RADAR_6ad229f2_Tx: ComBitPosition=80, ComBitSize=6, ComSignalInitValue=0, ComSignalType=UINT8, ComHandleId=7061, ComSystemTemplateSystemSignalRef=DET_ELEVATION_ERR_337
            DET_RANGE_VELOCITY_ERR_337_oRDR_DETECTION_337_340_oPCAN_RADAR_56de24a7_Tx: ComBitPosition=64, ComBitSize=8, ComSignalInitValue=0, ComSignalType=UINT8, ComHandleId=7100, ComSystemTemplateSystemSignalRef=DET_RANGE_VELOCITY_ERR_337
            DET_ELEVATION_338_oRDR_DETECTION_337_340_oPCAN_RADAR_c1fb23c0_Tx: ComBitPosition=184, ComBitSize=8, ComSignalInitValue=0, ComSignalType=UINT8, ComHandleId=7058, ComSystemTemplateSystemSignalRef=DET_ELEVATION_338
            DET_ELEVATION_ERR_338_oRDR_DETECTION_337_340_oPCAN_RADAR_46c2bbb5_Tx: ComBitPosition=192, ComBitSize=6, ComSignalInitValue=0, ComSignalType=UINT8, ComHandleId=7062, ComSystemTemplateSystemSignalRef=DET_ELEVATION_ERR_338
            DET_HVC_FLAG_339_oRDR_DETECTION_337_340_oPCAN_RADAR_e059593f_Tx: ComBitPosition=310, ComBitSize=1, ComSignalInitValue=0, ComSignalType=BOOLEAN, ComHandleId=7071, ComSystemTemplateSystemSignalRef=DET_HVC_FLAG_339
            DET_RANGE_VELOCITY_337_oRDR_DETECTION_337_340_oPCAN_RADAR_5965df15_Tx: ComBitPosition=48, ComBitSize=15, ComSignalInitValue=16384, ComSignalType=UINT16, ComHandleId=7096, ComSystemTemplateSystemSignalRef=DET_RANGE_VELOCITY_337
            DET_RANGE_VELOCITY_338_oRDR_DETECTION_337_340_oPCAN_RADAR_75754d52_Tx: ComBitPosition=160, ComBitSize=15, ComSignalInitValue=16384, ComSignalType=UINT16, ComHandleId=7097, ComSystemTemplateSystemSignalRef=DET_RANGE_VELOCITY_338
            DET_SNR_340_oRDR_DETECTION_337_340_oPCAN_RADAR_6bc9f6fb_Tx: ComBitPosition=456, ComBitSize=8, ComSignalInitValue=0, ComSignalType=UINT8, ComHandleId=7111, ComSystemTemplateSystemSignalRef=DET_SNR_340
            DET_RANGE_VELOCITY_ERR_338_oRDR_DETECTION_337_340_oPCAN_RADAR_7aceb6e0_Tx: ComBitPosition=176, ComBitSize=8, ComSignalInitValue=0, ComSignalType=UINT8, ComHandleId=7101, ComSystemTemplateSystemSignalRef=DET_RANGE_VELOCITY_ERR_338
            DET_RANGE_339_oRDR_DETECTION_337_340_oPCAN_RADAR_95a35be2_Tx: ComBitPosition=248, ComBitSize=15, ComSignalInitValue=0, ComSignalType=UINT16, ComHandleId=7090, ComSystemTemplateSystemSignalRef=DET_RANGE_339
            DET_RANGE_340_oRDR_DETECTION_337_340_oPCAN_RADAR_44415786_Tx: ComBitPosition=360, ComBitSize=15, ComSignalInitValue=0, ComSignalType=UINT16, ComHandleId=7091, ComSystemTemplateSystemSignalRef=DET_RANGE_340
            DET_RCS_338_oRDR_DETECTION_337_340_oPCAN_RADAR_f2f57a08_Tx: ComBitPosition=240, ComBitSize=8, ComSignalInitValue=128, ComSignalType=UINT8, ComHandleId=7105, ComSystemTemplateSystemSignalRef=DET_RCS_338
            DET_HVC_FLAG_337_oRDR_DETECTION_337_340_oPCAN_RADAR_59391fed_Tx: ComBitPosition=86, ComBitSize=1, ComSignalInitValue=0, ComSignalType=BOOLEAN, ComHandleId=7069, ComSystemTemplateSystemSignalRef=DET_HVC_FLAG_337
            DET_CONFD_AZIMUTH_337_oRDR_DETECTION_337_340_oPCAN_RADAR_3ebe6441_Tx: ComBitPosition=118, ComBitSize=2, ComSignalInitValue=0, ComSignalType=UINT8, ComHandleId=7049, ComSystemTemplateSystemSignalRef=DET_CONFD_AZIMUTH_337
            DET_ELEVATION_339_oRDR_DETECTION_337_340_oPCAN_RADAR_548bf755_Tx: ComBitPosition=296, ComBitSize=8, ComSignalInitValue=0, ComSignalType=UINT8, ComHandleId=7059, ComSystemTemplateSystemSignalRef=DET_ELEVATION_339
            DET_AZIMUTH_338_oRDR_DETECTION_337_340_oPCAN_RADAR_1048fccc_Tx: ComBitPosition=200, ComBitSize=13, ComSignalInitValue=0, ComSignalType=UINT16, ComHandleId=7034, ComSystemTemplateSystemSignalRef=DET_AZIMUTH_338
            DET_EXISTENCE_PROB_337_oRDR_DETECTION_337_340_oPCAN_RADAR_b84d5c92_Tx: ComBitPosition=112, ComBitSize=6, ComSignalInitValue=0, ComSignalType=UINT8, ComHandleId=7065, ComSystemTemplateSystemSignalRef=DET_EXISTENCE_PROB_337
            DET_RANGE_VELOCITY_339_oRDR_DETECTION_337_340_oPCAN_RADAR_e00599c7_Tx: ComBitPosition=272, ComBitSize=15, ComSignalInitValue=16384, ComSignalType=UINT16, ComHandleId=7098, ComSystemTemplateSystemSignalRef=DET_RANGE_VELOCITY_339
            DET_RCS_340_oRDR_DETECTION_337_340_oPCAN_RADAR_b667a2f9_Tx: ComBitPosition=464, ComBitSize=8, ComSignalInitValue=128, ComSignalType=UINT8, ComHandleId=7107, ComSystemTemplateSystemSignalRef=DET_RCS_340
            DET_AZIMUTH_340_oRDR_DETECTION_337_340_oPCAN_RADAR_54da243d_Tx: ComBitPosition=424, ComBitSize=13, ComSignalInitValue=0, ComSignalType=UINT16, ComHandleId=7036, ComSystemTemplateSystemSignalRef=DET_AZIMUTH_340
            DET_EXISTENCE_PROB_338_oRDR_DETECTION_337_340_oPCAN_RADAR_945dced5_Tx: ComBitPosition=224, ComBitSize=6, ComSignalInitValue=0, ComSignalType=UINT8, ComHandleId=7066, ComSystemTemplateSystemSignalRef=DET_EXISTENCE_PROB_338
            DET_BI_STATIC_FLAG_339_oRDR_DETECTION_337_340_oPCAN_RADAR_d31468dc_Tx: ComBitPosition=328, ComBitSize=1, ComSignalInitValue=0, ComSignalType=BOOLEAN, ComHandleId=7047, ComSystemTemplateSystemSignalRef=DET_BI_STATIC_FLAG_339
            DET_AZIMUTH_ERR_339_oRDR_DETECTION_337_340_oPCAN_RADAR_218dbdac_Tx: ComBitPosition=329, ComBitSize=7, ComSignalInitValue=0, ComSignalType=UINT8, ComHandleId=7039, ComSystemTemplateSystemSignalRef=DET_AZIMUTH_ERR_339
            DET_CONFD_ELEVATION_340_oRDR_DETECTION_337_340_oPCAN_RADAR_54a92f0d_Tx: ComBitPosition=437, ComBitSize=2, ComSignalInitValue=0, ComSignalType=UINT8, ComHandleId=7056, ComSystemTemplateSystemSignalRef=DET_CONFD_ELEVATION_340
            DET_HVC_FLAG_338_oRDR_DETECTION_337_340_oPCAN_RADAR_75298daa_Tx: ComBitPosition=198, ComBitSize=1, ComSignalInitValue=0, ComSignalType=BOOLEAN, ComHandleId=7070, ComSystemTemplateSystemSignalRef=DET_HVC_FLAG_338
            DET_ELEVATION_340_oRDR_DETECTION_337_340_oPCAN_RADAR_8569fb31_Tx: ComBitPosition=408, ComBitSize=8, ComSignalInitValue=0, ComSignalType=UINT8, ComHandleId=7060, ComSystemTemplateSystemSignalRef=DET_ELEVATION_340
            DET_RCS_339_oRDR_DETECTION_337_340_oPCAN_RADAR_6785ae9d_Tx: ComBitPosition=352, ComBitSize=8, ComSignalInitValue=128, ComSignalType=UINT8, ComHandleId=7106, ComSystemTemplateSystemSignalRef=DET_RCS_339
            DET_AZIMUTH_ERR_338_oRDR_DETECTION_337_340_oPCAN_RADAR_b4fd6939_Tx: ComBitPosition=217, ComBitSize=7, ComSignalInitValue=0, ComSignalType=UINT8, ComHandleId=7038, ComSystemTemplateSystemSignalRef=DET_AZIMUTH_ERR_338
            DET_RANGE_ERR_339_oRDR_DETECTION_337_340_oPCAN_RADAR_324be18b_Tx: ComBitPosition=264, ComBitSize=7, ComSignalInitValue=0, ComSignalType=UINT8, ComHandleId=7094, ComSystemTemplateSystemSignalRef=DET_RANGE_ERR_339
            DET_MH_SCAN_INDEX_4LSB_337_340_oRDR_DETECTION_337_340_oPCAN_RADAR_a0f3f3ac_Tx: ComBitPosition=476, ComBitSize=4, ComSignalInitValue=0, ComSignalType=UINT8, ComHandleId=7079, ComSystemTemplateSystemSignalRef=DET_MH_SCAN_INDEX_4LSB_337_340
            DET_SNR_339_oRDR_DETECTION_337_340_oPCAN_RADAR_ba2bfa9f_Tx: ComBitPosition=344, ComBitSize=8, ComSignalInitValue=0, ComSignalType=UINT8, ComHandleId=7110, ComSystemTemplateSystemSignalRef=DET_SNR_339
            DET_ELEVATION_ERR_339_oRDR_DETECTION_337_340_oPCAN_RADAR_d3b26f20_Tx: ComBitPosition=304, ComBitSize=6, ComSignalInitValue=0, ComSignalType=UINT8, ComHandleId=7063, ComSystemTemplateSystemSignalRef=DET_ELEVATION_ERR_339
            DET_BI_STATIC_FLAG_337_oRDR_DETECTION_337_340_oPCAN_RADAR_6a742e0e_Tx: ComBitPosition=104, ComBitSize=1, ComSignalInitValue=0, ComSignalType=BOOLEAN, ComHandleId=7045, ComSystemTemplateSystemSignalRef=DET_BI_STATIC_FLAG_337
            DET_CONFD_AZIMUTH_339_oRDR_DETECTION_337_340_oPCAN_RADAR_87de2293_Tx: ComBitPosition=342, ComBitSize=2, ComSignalInitValue=0, ComSignalType=UINT8, ComHandleId=7051, ComSystemTemplateSystemSignalRef=DET_CONFD_AZIMUTH_339
            DET_MTD_338_oRDR_DETECTION_337_340_oPCAN_RADAR_98c884cc_Tx: ComBitPosition=159, ComBitSize=1, ComSignalInitValue=0, ComSignalType=UINT8, ComHandleId=7081, ComSystemTemplateSystemSignalRef=DET_MTD_338
            DET_PROB_1STAZHYPO_339_oRDR_DETECTION_337_340_oPCAN_RADAR_9e0cb894_Tx: ComBitPosition=327, ComBitSize=1, ComSignalInitValue=0, ComSignalType=BOOLEAN, ComHandleId=7086, ComSystemTemplateSystemSignalRef=DET_PROB_1STAZHYPO_339
            DET_BELOW_RAIN_THOLD_339_oRDR_DETECTION_337_340_oPCAN_RADAR_5039bb99_Tx: ComBitPosition=263, ComBitSize=1, ComSignalInitValue=0, ComSignalType=UINT8, ComHandleId=7043, ComSystemTemplateSystemSignalRef=DET_BELOW_RAIN_THOLD_339
            DET_IDM_340_oRDR_DETECTION_337_340_oPCAN_RADAR_bae96ee6_Tx: ComBitPosition=399, ComBitSize=1, ComSignalInitValue=0, ComSignalType=UINT8, ComHandleId=7076, ComSystemTemplateSystemSignalRef=DET_IDM_340
            DET_PROB_1STAZHYPO_338_oRDR_DETECTION_337_340_oPCAN_RADAR_0b7c6c01_Tx: ComBitPosition=215, ComBitSize=1, ComSignalInitValue=0, ComSignalType=BOOLEAN, ComHandleId=7085, ComSystemTemplateSystemSignalRef=DET_PROB_1STAZHYPO_338
            DET_IDM_337_oRDR_DETECTION_337_340_oPCAN_RADAR_d26b2450_Tx: ComBitPosition=63, ComBitSize=1, ComSignalInitValue=0, ComSignalType=UINT8, ComHandleId=7073, ComSystemTemplateSystemSignalRef=DET_IDM_337
            DET_MTD_339_oRDR_DETECTION_337_340_oPCAN_RADAR_0db85059_Tx: ComBitPosition=271, ComBitSize=1, ComSignalInitValue=0, ComSignalType=UINT8, ComHandleId=7082, ComSystemTemplateSystemSignalRef=DET_MTD_339
            DET_PROB_1STAZHYPO_337_oRDR_DETECTION_337_340_oPCAN_RADAR_276cfe46_Tx: ComBitPosition=103, ComBitSize=1, ComSignalInitValue=0, ComSignalType=BOOLEAN, ComHandleId=7084, ComSystemTemplateSystemSignalRef=DET_PROB_1STAZHYPO_337
            DET_BELOW_RAIN_THOLD_337_oRDR_DETECTION_337_340_oPCAN_RADAR_e959fd4b_Tx: ComBitPosition=39, ComBitSize=1, ComSignalInitValue=0, ComSignalType=UINT8, ComHandleId=7041, ComSystemTemplateSystemSignalRef=DET_BELOW_RAIN_THOLD_337
            DET_MTD_340_oRDR_DETECTION_337_340_oPCAN_RADAR_dc5a5c3d_Tx: ComBitPosition=383, ComBitSize=1, ComSignalInitValue=0, ComSignalType=UINT8, ComHandleId=7083, ComSystemTemplateSystemSignalRef=DET_MTD_340
            DET_MTD_337_oRDR_DETECTION_337_340_oPCAN_RADAR_b4d8168b_Tx: ComBitPosition=47, ComBitSize=1, ComSignalInitValue=0, ComSignalType=UINT8, ComHandleId=7080, ComSystemTemplateSystemSignalRef=DET_MTD_337
            DET_PROB_1STAZHYPO_340_oRDR_DETECTION_337_340_oPCAN_RADAR_4feeb4f0_Tx: ComBitPosition=439, ComBitSize=1, ComSignalInitValue=0, ComSignalType=BOOLEAN, ComHandleId=7087, ComSystemTemplateSystemSignalRef=DET_PROB_1STAZHYPO_340
            DET_BELOW_RAIN_THOLD_338_oRDR_DETECTION_337_340_oPCAN_RADAR_c5496f0c_Tx: ComBitPosition=151, ComBitSize=1, ComSignalInitValue=0, ComSignalType=UINT8, ComHandleId=7042, ComSystemTemplateSystemSignalRef=DET_BELOW_RAIN_THOLD_338
            DET_BELOW_RAIN_THOLD_340_oRDR_DETECTION_337_340_oPCAN_RADAR_81dbb7fd_Tx: ComBitPosition=375, ComBitSize=1, ComSignalInitValue=0, ComSignalType=UINT8, ComHandleId=7044, ComSystemTemplateSystemSignalRef=DET_BELOW_RAIN_THOLD_340
            DET_IDM_338_oRDR_DETECTION_337_340_oPCAN_RADAR_fe7bb617_Tx: ComBitPosition=175, ComBitSize=1, ComSignalInitValue=0, ComSignalType=UINT8, ComHandleId=7074, ComSystemTemplateSystemSignalRef=DET_IDM_338
            DET_IDM_339_oRDR_DETECTION_337_340_oPCAN_RADAR_6b0b6282_Tx: ComBitPosition=287, ComBitSize=1, ComSignalInitValue=0, ComSignalType=UINT8, ComHandleId=7075, ComSystemTemplateSystemSignalRef=DET_IDM_339
        SG_Detections_293_296_oRDR_DETECTION_293_296_oPCAN_RADAR_557c2994_Tx: ComTransferProperty=TRIGGERED, ComHandleId=75, ComSystemTemplateSignalGroupRef=SG_Detections_293_296
          83 x ComGroupSignal, all with ComSignalEndianness=LITTLE_ENDIAN, ComTransferProperty=PENDING, ComSignalAccess=ACCESS_NEEDED_BY_SWC_OR_COM:
            DET_RANGE_ERR_294_oRDR_DETECTION_293_296_oPCAN_RADAR_7cffb232_Tx: ComBitPosition=152, ComBitSize=7, ComSignalInitValue=0, ComSignalType=UINT8, ComHandleId=6180, ComSystemTemplateSystemSignalRef=DET_RANGE_ERR_294
            DET_CONFD_ELEVATION_295_oRDR_DETECTION_293_296_oPCAN_RADAR_5e8fa445_Tx: ComBitPosition=325, ComBitSize=2, ComSignalInitValue=0, ComSignalType=UINT8, ComHandleId=6142, ComSystemTemplateSystemSignalRef=DET_CONFD_ELEVATION_295
            DET_RANGE_VELOCITY_295_oRDR_DETECTION_293_296_oPCAN_RADAR_3bc11eeb_Tx: ComBitPosition=272, ComBitSize=15, ComSignalInitValue=16384, ComSignalType=UINT16, ComHandleId=6185, ComSystemTemplateSystemSignalRef=DET_RANGE_VELOCITY_295
            DET_CONFD_ELEVATION_294_oRDR_DETECTION_293_296_oPCAN_RADAR_cbff70d0_Tx: ComBitPosition=213, ComBitSize=2, ComSignalInitValue=0, ComSignalType=UINT8, ComHandleId=6141, ComSystemTemplateSystemSignalRef=DET_CONFD_ELEVATION_294
            DET_HVC_FLAG_295_oRDR_DETECTION_293_296_oPCAN_RADAR_3b9dde13_Tx: ComBitPosition=310, ComBitSize=1, ComSignalInitValue=0, ComSignalType=BOOLEAN, ComHandleId=6158, ComSystemTemplateSystemSignalRef=DET_HVC_FLAG_295
            DET_HVC_FLAG_293_oRDR_DETECTION_293_296_oPCAN_RADAR_f25d29ef_Tx: ComBitPosition=86, ComBitSize=1, ComSignalInitValue=0, ComSignalType=BOOLEAN, ComHandleId=6156, ComSystemTemplateSystemSignalRef=DET_HVC_FLAG_293
            DET_AZIMUTH_ERR_296_oRDR_DETECTION_293_296_oPCAN_RADAR_9ea9417e_Tx: ComBitPosition=441, ComBitSize=7, ComSignalInitValue=0, ComSignalType=UINT8, ComHandleId=6127, ComSystemTemplateSystemSignalRef=DET_AZIMUTH_ERR_296
            DET_RANGE_VELOCITY_296_oRDR_DETECTION_293_296_oPCAN_RADAR_5f216515_Tx: ComBitPosition=384, ComBitSize=15, ComSignalInitValue=16384, ComSignalType=UINT16, ComHandleId=6186, ComSystemTemplateSystemSignalRef=DET_RANGE_VELOCITY_296
            DET_CONFD_ELEVATION_293_oRDR_DETECTION_293_296_oPCAN_RADAR_974f53b9_Tx: ComBitPosition=101, ComBitSize=2, ComSignalInitValue=0, ComSignalType=UINT8, ComHandleId=6140, ComSystemTemplateSystemSignalRef=DET_CONFD_ELEVATION_293
            DET_RCS_294_oRDR_DETECTION_293_296_oPCAN_RADAR_2931fd24_Tx: ComBitPosition=240, ComBitSize=8, ComSignalInitValue=128, ComSignalType=UINT8, ComHandleId=6192, ComSystemTemplateSystemSignalRef=DET_RCS_294
            DET_SUPER_RES_TARGET_295_oRDR_DETECTION_293_296_oPCAN_RADAR_507655d6_Tx: ComBitPosition=311, ComBitSize=1, ComSignalInitValue=0, ComSignalType=BOOLEAN, ComHandleId=6201, ComSystemTemplateSystemSignalRef=DET_SUPER_RES_TARGET_295
            DET_CONFD_AZIMUTH_295_oRDR_DETECTION_293_296_oPCAN_RADAR_5c1aa5bf_Tx: ComBitPosition=342, ComBitSize=2, ComSignalInitValue=0, ComSignalType=UINT8, ComHandleId=6138, ComSystemTemplateSystemSignalRef=DET_CONFD_AZIMUTH_295
            DET_MH_SCAN_INDEX_4LSB_293_296_oRDR_DETECTION_293_296_oPCAN_RADAR_99ab7f24_Tx: ComBitPosition=476, ComBitSize=4, ComSignalInitValue=0, ComSignalType=UINT8, ComHandleId=6166, ComSystemTemplateSystemSignalRef=DET_MH_SCAN_INDEX_4LSB_293_296
            DET_AZIMUTH_296_oRDR_DETECTION_293_296_oPCAN_RADAR_3a1cd48b_Tx: ComBitPosition=424, ComBitSize=13, ComSignalInitValue=0, ComSignalType=UINT16, ComHandleId=6123, ComSystemTemplateSystemSignalRef=DET_AZIMUTH_296
            DET_MH_CRC16_293_296_oRDR_DETECTION_293_296_oPCAN_RADAR_d1f4fb9f_Tx: ComBitPosition=0, ComBitSize=16, ComSignalInitValue=0, ComSignalType=UINT16, ComHandleId=6164, ComSystemTemplateSystemSignalRef=DET_MH_CRC16_293_296
            DET_RANGE_VELOCITY_293_oRDR_DETECTION_293_296_oPCAN_RADAR_f201e917_Tx: ComBitPosition=48, ComBitSize=15, ComSignalInitValue=16384, ComSignalType=UINT16, ComHandleId=6183, ComSystemTemplateSystemSignalRef=DET_RANGE_VELOCITY_293
            DET_BI_STATIC_FLAG_293_oRDR_DETECTION_293_296_oPCAN_RADAR_c110180c_Tx: ComBitPosition=104, ComBitSize=1, ComSignalInitValue=0, ComSignalType=BOOLEAN, ComHandleId=6132, ComSystemTemplateSystemSignalRef=DET_BI_STATIC_FLAG_293
            DET_RANGE_VELOCITY_ERR_296_oRDR_DETECTION_293_296_oPCAN_RADAR_509a9ea7_Tx: ComBitPosition=400, ComBitSize=8, ComSignalInitValue=0, ComSignalType=UINT8, ComHandleId=6190, ComSystemTemplateSystemSignalRef=DET_RANGE_VELOCITY_ERR_296
            DET_ELEVATION_ERR_294_oRDR_DETECTION_293_296_oPCAN_RADAR_9d063c99_Tx: ComBitPosition=192, ComBitSize=6, ComSignalInitValue=0, ComSignalType=UINT8, ComHandleId=6149, ComSystemTemplateSystemSignalRef=DET_ELEVATION_ERR_294
            DET_CONFD_AZIMUTH_296_oRDR_DETECTION_293_296_oPCAN_RADAR_38fade41_Tx: ComBitPosition=454, ComBitSize=2, ComSignalInitValue=0, ComSignalType=UINT8, ComHandleId=6139, ComSystemTemplateSystemSignalRef=DET_CONFD_AZIMUTH_296
            DET_SUPER_RES_TARGET_294_oRDR_DETECTION_293_296_oPCAN_RADAR_c5068143_Tx: ComBitPosition=199, ComBitSize=1, ComSignalInitValue=0, ComSignalType=BOOLEAN, ComHandleId=6200, ComSystemTemplateSystemSignalRef=DET_SUPER_RES_TARGET_294
            DET_CONFD_ELEVATION_296_oRDR_DETECTION_293_296_oPCAN_RADAR_3a6fdfbb_Tx: ComBitPosition=437, ComBitSize=2, ComSignalInitValue=0, ComSignalType=UINT8, ComHandleId=6143, ComSystemTemplateSystemSignalRef=DET_CONFD_ELEVATION_296
            DET_SUPER_RES_TARGET_293_oRDR_DETECTION_293_296_oPCAN_RADAR_99b6a22a_Tx: ComBitPosition=87, ComBitSize=1, ComSignalInitValue=0, ComSignalType=BOOLEAN, ComHandleId=6199, ComSystemTemplateSystemSignalRef=DET_SUPER_RES_TARGET_293
            DET_BI_STATIC_FLAG_296_oRDR_DETECTION_293_296_oPCAN_RADAR_6c30940e_Tx: ComBitPosition=440, ComBitSize=1, ComSignalInitValue=0, ComSignalType=BOOLEAN, ComHandleId=6135, ComSystemTemplateSystemSignalRef=DET_BI_STATIC_FLAG_296
            DET_AZIMUTH_294_oRDR_DETECTION_293_296_oPCAN_RADAR_cb8c7be0_Tx: ComBitPosition=200, ComBitSize=13, ComSignalInitValue=0, ComSignalType=UINT16, ComHandleId=6121, ComSystemTemplateSystemSignalRef=DET_AZIMUTH_294
            DET_EXISTENCE_PROB_293_oRDR_DETECTION_293_296_oPCAN_RADAR_13296a90_Tx: ComBitPosition=112, ComBitSize=6, ComSignalInitValue=0, ComSignalType=UINT8, ComHandleId=6152, ComSystemTemplateSystemSignalRef=DET_EXISTENCE_PROB_293
            DET_HVC_FLAG_294_oRDR_DETECTION_293_296_oPCAN_RADAR_aeed0a86_Tx: ComBitPosition=198, ComBitSize=1, ComSignalInitValue=0, ComSignalType=BOOLEAN, ComHandleId=6157, ComSystemTemplateSystemSignalRef=DET_HVC_FLAG_294
            DET_RCS_295_oRDR_DETECTION_293_296_oPCAN_RADAR_bc4129b1_Tx: ComBitPosition=352, ComBitSize=8, ComSignalInitValue=128, ComSignalType=UINT8, ComHandleId=6193, ComSystemTemplateSystemSignalRef=DET_RCS_295
            DET_AZIMUTH_293_oRDR_DETECTION_293_296_oPCAN_RADAR_973c5889_Tx: ComBitPosition=88, ComBitSize=13, ComSignalInitValue=0, ComSignalType=UINT16, ComHandleId=6120, ComSystemTemplateSystemSignalRef=DET_AZIMUTH_293
            DET_AZIMUTH_ERR_293_oRDR_DETECTION_293_296_oPCAN_RADAR_3389cd7c_Tx: ComBitPosition=105, ComBitSize=7, ComSignalInitValue=0, ComSignalType=UINT8, ComHandleId=6124, ComSystemTemplateSystemSignalRef=DET_AZIMUTH_ERR_293
            DET_RANGE_VELOCITY_ERR_293_oRDR_DETECTION_293_296_oPCAN_RADAR_fdba12a5_Tx: ComBitPosition=64, ComBitSize=8, ComSignalInitValue=0, ComSignalType=UINT8, ComHandleId=6187, ComSystemTemplateSystemSignalRef=DET_RANGE_VELOCITY_ERR_293
            DET_CONFD_AZIMUTH_294_oRDR_DETECTION_293_296_oPCAN_RADAR_c96a712a_Tx: ComBitPosition=230, ComBitSize=2, ComSignalInitValue=0, ComSignalType=UINT8, ComHandleId=6137, ComSystemTemplateSystemSignalRef=DET_CONFD_AZIMUTH_294
            DET_RCS_293_oRDR_DETECTION_293_296_oPCAN_RADAR_7581de4d_Tx: ComBitPosition=128, ComBitSize=8, ComSignalInitValue=128, ComSignalType=UINT8, ComHandleId=6191, ComSystemTemplateSystemSignalRef=DET_RCS_293
            DET_RANGE_VELOCITY_294_oRDR_DETECTION_293_296_oPCAN_RADAR_aeb1ca7e_Tx: ComBitPosition=160, ComBitSize=15, ComSignalInitValue=16384, ComSignalType=UINT16, ComHandleId=6184, ComSystemTemplateSystemSignalRef=DET_RANGE_VELOCITY_294
            DET_RANGE_ERR_296_oRDR_DETECTION_293_296_oPCAN_RADAR_8d6f1d59_Tx: ComBitPosition=376, ComBitSize=7, ComSignalInitValue=0, ComSignalType=UINT8, ComHandleId=6182, ComSystemTemplateSystemSignalRef=DET_RANGE_ERR_296
            DET_RANGE_ERR_295_oRDR_DETECTION_293_296_oPCAN_RADAR_e98f66a7_Tx: ComBitPosition=264, ComBitSize=7, ComSignalInitValue=0, ComSignalType=UINT8, ComHandleId=6181, ComSystemTemplateSystemSignalRef=DET_RANGE_ERR_295
            DET_ELEVATION_293_oRDR_DETECTION_293_296_oPCAN_RADAR_468f8785_Tx: ComBitPosition=72, ComBitSize=8, ComSignalInitValue=0, ComSignalType=UINT8, ComHandleId=6144, ComSystemTemplateSystemSignalRef=DET_ELEVATION_293
            DET_CONFD_AZIMUTH_293_oRDR_DETECTION_293_296_oPCAN_RADAR_95da5243_Tx: ComBitPosition=118, ComBitSize=2, ComSignalInitValue=0, ComSignalType=UINT8, ComHandleId=6136, ComSystemTemplateSystemSignalRef=DET_CONFD_AZIMUTH_293
            DET_SNR_294_oRDR_DETECTION_293_296_oPCAN_RADAR_f49fa926_Tx: ComBitPosition=232, ComBitSize=8, ComSignalInitValue=0, ComSignalType=UINT8, ComHandleId=6196, ComSystemTemplateSystemSignalRef=DET_SNR_294
            DET_ELEVATION_295_oRDR_DETECTION_293_296_oPCAN_RADAR_8f4f7079_Tx: ComBitPosition=296, ComBitSize=8, ComSignalInitValue=0, ComSignalType=UINT8, ComHandleId=6146, ComSystemTemplateSystemSignalRef=DET_ELEVATION_295
            DET_AZIMUTH_295_oRDR_DETECTION_293_296_oPCAN_RADAR_5efcaf75_Tx: ComBitPosition=312, ComBitSize=13, ComSignalInitValue=0, ComSignalType=UINT16, ComHandleId=6122, ComSystemTemplateSystemSignalRef=DET_AZIMUTH_295
            DET_BI_STATIC_FLAG_294_oRDR_DETECTION_293_296_oPCAN_RADAR_9da03b65_Tx: ComBitPosition=216, ComBitSize=1, ComSignalInitValue=0, ComSignalType=BOOLEAN, ComHandleId=6133, ComSystemTemplateSystemSignalRef=DET_BI_STATIC_FLAG_294
            DET_SNR_293_oRDR_DETECTION_293_296_oPCAN_RADAR_a82f8a4f_Tx: ComBitPosition=120, ComBitSize=8, ComSignalInitValue=0, ComSignalType=UINT8, ComHandleId=6195, ComSystemTemplateSystemSignalRef=DET_SNR_293
            DET_ELEVATION_296_oRDR_DETECTION_293_296_oPCAN_RADAR_ebaf0b87_Tx: ComBitPosition=408, ComBitSize=8, ComSignalInitValue=0, ComSignalType=UINT8, ComHandleId=6147, ComSystemTemplateSystemSignalRef=DET_ELEVATION_296
            DET_RANGE_VELOCITY_ERR_295_oRDR_DETECTION_293_296_oPCAN_RADAR_347ae559_Tx: ComBitPosition=288, ComBitSize=8, ComSignalInitValue=0, ComSignalType=UINT8, ComHandleId=6189, ComSystemTemplateSystemSignalRef=DET_RANGE_VELOCITY_ERR_295
            DET_EXISTENCE_PROB_294_oRDR_DETECTION_293_296_oPCAN_RADAR_4f9949f9_Tx: ComBitPosition=224, ComBitSize=6, ComSignalInitValue=0, ComSignalType=UINT8, ComHandleId=6153, ComSystemTemplateSystemSignalRef=DET_EXISTENCE_PROB_294
            DET_RANGE_295_oRDR_DETECTION_293_296_oPCAN_RADAR_4e67dcce_Tx: ComBitPosition=248, ComBitSize=15, ComSignalInitValue=0, ComSignalType=UINT16, ComHandleId=6177, ComSystemTemplateSystemSignalRef=DET_RANGE_295
            DET_EXISTENCE_PROB_296_oRDR_DETECTION_293_296_oPCAN_RADAR_be09e692_Tx: ComBitPosition=448, ComBitSize=6, ComSignalInitValue=0, ComSignalType=UINT8, ComHandleId=6155, ComSystemTemplateSystemSignalRef=DET_EXISTENCE_PROB_296
            DET_ELEVATION_ERR_295_oRDR_DETECTION_293_296_oPCAN_RADAR_0876e80c_Tx: ComBitPosition=304, ComBitSize=6, ComSignalInitValue=0, ComSignalType=UINT8, ComHandleId=6150, ComSystemTemplateSystemSignalRef=DET_ELEVATION_ERR_295
            DET_AZIMUTH_ERR_294_oRDR_DETECTION_293_296_oPCAN_RADAR_6f39ee15_Tx: ComBitPosition=217, ComBitSize=7, ComSignalInitValue=0, ComSignalType=UINT8, ComHandleId=6125, ComSystemTemplateSystemSignalRef=DET_AZIMUTH_ERR_294
            DET_ELEVATION_ERR_293_oRDR_DETECTION_293_296_oPCAN_RADAR_c1b61ff0_Tx: ComBitPosition=80, ComBitSize=6, ComSignalInitValue=0, ComSignalType=UINT8, ComHandleId=6148, ComSystemTemplateSystemSignalRef=DET_ELEVATION_ERR_293
            DET_RANGE_296_oRDR_DETECTION_293_296_oPCAN_RADAR_2a87a730_Tx: ComBitPosition=360, ComBitSize=15, ComSignalInitValue=0, ComSignalType=UINT16, ComHandleId=6178, ComSystemTemplateSystemSignalRef=DET_RANGE_296
            DET_BI_STATIC_FLAG_295_oRDR_DETECTION_293_296_oPCAN_RADAR_08d0eff0_Tx: ComBitPosition=328, ComBitSize=1, ComSignalInitValue=0, ComSignalType=BOOLEAN, ComHandleId=6134, ComSystemTemplateSystemSignalRef=DET_BI_STATIC_FLAG_295
            DET_EXISTENCE_PROB_295_oRDR_DETECTION_293_296_oPCAN_RADAR_dae99d6c_Tx: ComBitPosition=336, ComBitSize=6, ComSignalInitValue=0, ComSignalType=UINT8, ComHandleId=6154, ComSystemTemplateSystemSignalRef=DET_EXISTENCE_PROB_295
            DET_RANGE_293_oRDR_DETECTION_293_296_oPCAN_RADAR_87a72b32_Tx: ComBitPosition=24, ComBitSize=15, ComSignalInitValue=0, ComSignalType=UINT16, ComHandleId=6175, ComSystemTemplateSystemSignalRef=DET_RANGE_293
            DET_RANGE_ERR_293_oRDR_DETECTION_293_296_oPCAN_RADAR_204f915b_Tx: ComBitPosition=40, ComBitSize=7, ComSignalInitValue=0, ComSignalType=UINT8, ComHandleId=6179, ComSystemTemplateSystemSignalRef=DET_RANGE_ERR_293
            DET_AZIMUTH_ERR_295_oRDR_DETECTION_293_296_oPCAN_RADAR_fa493a80_Tx: ComBitPosition=329, ComBitSize=7, ComSignalInitValue=0, ComSignalType=UINT8, ComHandleId=6126, ComSystemTemplateSystemSignalRef=DET_AZIMUTH_ERR_295
            DET_RANGE_VELOCITY_ERR_294_oRDR_DETECTION_293_296_oPCAN_RADAR_a10a31cc_Tx: ComBitPosition=176, ComBitSize=8, ComSignalInitValue=0, ComSignalType=UINT8, ComHandleId=6188, ComSystemTemplateSystemSignalRef=DET_RANGE_VELOCITY_ERR_294
            DET_RCS_296_oRDR_DETECTION_293_296_oPCAN_RADAR_d8a1524f_Tx: ComBitPosition=464, ComBitSize=8, ComSignalInitValue=128, ComSignalType=UINT8, ComHandleId=6194, ComSystemTemplateSystemSignalRef=DET_RCS_296
            DET_RANGE_294_oRDR_DETECTION_293_296_oPCAN_RADAR_db17085b_Tx: ComBitPosition=136, ComBitSize=15, ComSignalInitValue=0, ComSignalType=UINT16, ComHandleId=6176, ComSystemTemplateSystemSignalRef=DET_RANGE_294
            DET_SNR_295_oRDR_DETECTION_293_296_oPCAN_RADAR_61ef7db3_Tx: ComBitPosition=344, ComBitSize=8, ComSignalInitValue=0, ComSignalType=UINT8, ComHandleId=6197, ComSystemTemplateSystemSignalRef=DET_SNR_295
            DET_ELEVATION_294_oRDR_DETECTION_293_296_oPCAN_RADAR_1a3fa4ec_Tx: ComBitPosition=184, ComBitSize=8, ComSignalInitValue=0, ComSignalType=UINT8, ComHandleId=6145, ComSystemTemplateSystemSignalRef=DET_ELEVATION_294
            DET_MH_CYCLE_COUNTER_293_296_oRDR_DETECTION_293_296_oPCAN_RADAR_55815aa8_Tx: ComBitPosition=16, ComBitSize=8, ComSignalInitValue=0, ComSignalType=UINT8, ComHandleId=6165, ComSystemTemplateSystemSignalRef=DET_MH_CYCLE_COUNTER_293_296
            DET_ELEVATION_ERR_296_oRDR_DETECTION_293_296_oPCAN_RADAR_6c9693f2_Tx: ComBitPosition=416, ComBitSize=6, ComSignalInitValue=0, ComSignalType=UINT8, ComHandleId=6151, ComSystemTemplateSystemSignalRef=DET_ELEVATION_ERR_296
            DET_SUPER_RES_TARGET_296_oRDR_DETECTION_293_296_oPCAN_RADAR_34962e28_Tx: ComBitPosition=423, ComBitSize=1, ComSignalInitValue=0, ComSignalType=BOOLEAN, ComHandleId=6202, ComSystemTemplateSystemSignalRef=DET_SUPER_RES_TARGET_296
            DET_SNR_296_oRDR_DETECTION_293_296_oPCAN_RADAR_050f064d_Tx: ComBitPosition=456, ComBitSize=8, ComSignalInitValue=0, ComSignalType=UINT8, ComHandleId=6198, ComSystemTemplateSystemSignalRef=DET_SNR_296
            DET_HVC_FLAG_296_oRDR_DETECTION_293_296_oPCAN_RADAR_5f7da5ed_Tx: ComBitPosition=422, ComBitSize=1, ComSignalInitValue=0, ComSignalType=BOOLEAN, ComHandleId=6159, ComSystemTemplateSystemSignalRef=DET_HVC_FLAG_296
            DET_BELOW_RAIN_THOLD_295_oRDR_DETECTION_293_296_oPCAN_RADAR_8bfd3cb5_Tx: ComBitPosition=263, ComBitSize=1, ComSignalInitValue=0, ComSignalType=UINT8, ComHandleId=6130, ComSystemTemplateSystemSignalRef=DET_BELOW_RAIN_THOLD_295
            DET_PROB_1STAZHYPO_296_oRDR_DETECTION_293_296_oPCAN_RADAR_21284446_Tx: ComBitPosition=439, ComBitSize=1, ComSignalInitValue=0, ComSignalType=BOOLEAN, ComHandleId=6174, ComSystemTemplateSystemSignalRef=DET_PROB_1STAZHYPO_296
            DET_BELOW_RAIN_THOLD_294_oRDR_DETECTION_293_296_oPCAN_RADAR_1e8de820_Tx: ComBitPosition=151, ComBitSize=1, ComSignalInitValue=0, ComSignalType=UINT8, ComHandleId=6129, ComSystemTemplateSystemSignalRef=DET_BELOW_RAIN_THOLD_294
            DET_IDM_294_oRDR_DETECTION_293_296_oPCAN_RADAR_25bf313b_Tx: ComBitPosition=175, ComBitSize=1, ComSignalInitValue=0, ComSignalType=UINT8, ComHandleId=6161, ComSystemTemplateSystemSignalRef=DET_IDM_294
            DET_MTD_294_oRDR_DETECTION_293_296_oPCAN_RADAR_430c03e0_Tx: ComBitPosition=159, ComBitSize=1, ComSignalInitValue=0, ComSignalType=UINT8, ComHandleId=6168, ComSystemTemplateSystemSignalRef=DET_MTD_294
            DET_IDM_293_oRDR_DETECTION_293_296_oPCAN_RADAR_790f1252_Tx: ComBitPosition=63, ComBitSize=1, ComSignalInitValue=0, ComSignalType=UINT8, ComHandleId=6160, ComSystemTemplateSystemSignalRef=DET_IDM_293
            DET_BELOW_RAIN_THOLD_296_oRDR_DETECTION_293_296_oPCAN_RADAR_ef1d474b_Tx: ComBitPosition=375, ComBitSize=1, ComSignalInitValue=0, ComSignalType=UINT8, ComHandleId=6131, ComSystemTemplateSystemSignalRef=DET_BELOW_RAIN_THOLD_296
            DET_IDM_296_oRDR_DETECTION_293_296_oPCAN_RADAR_d42f9e50_Tx: ComBitPosition=399, ComBitSize=1, ComSignalInitValue=0, ComSignalType=UINT8, ComHandleId=6163, ComSystemTemplateSystemSignalRef=DET_IDM_296
            DET_BELOW_RAIN_THOLD_293_oRDR_DETECTION_293_296_oPCAN_RADAR_423dcb49_Tx: ComBitPosition=39, ComBitSize=1, ComSignalInitValue=0, ComSignalType=UINT8, ComHandleId=6128, ComSystemTemplateSystemSignalRef=DET_BELOW_RAIN_THOLD_293
            DET_PROB_1STAZHYPO_295_oRDR_DETECTION_293_296_oPCAN_RADAR_45c83fb8_Tx: ComBitPosition=327, ComBitSize=1, ComSignalInitValue=0, ComSignalType=BOOLEAN, ComHandleId=6173, ComSystemTemplateSystemSignalRef=DET_PROB_1STAZHYPO_295
            DET_PROB_1STAZHYPO_293_oRDR_DETECTION_293_296_oPCAN_RADAR_8c08c844_Tx: ComBitPosition=103, ComBitSize=1, ComSignalInitValue=0, ComSignalType=BOOLEAN, ComHandleId=6171, ComSystemTemplateSystemSignalRef=DET_PROB_1STAZHYPO_293
            DET_IDM_295_oRDR_DETECTION_293_296_oPCAN_RADAR_b0cfe5ae_Tx: ComBitPosition=287, ComBitSize=1, ComSignalInitValue=0, ComSignalType=UINT8, ComHandleId=6162, ComSystemTemplateSystemSignalRef=DET_IDM_295
            DET_PROB_1STAZHYPO_294_oRDR_DETECTION_293_296_oPCAN_RADAR_d0b8eb2d_Tx: ComBitPosition=215, ComBitSize=1, ComSignalInitValue=0, ComSignalType=BOOLEAN, ComHandleId=6172, ComSystemTemplateSystemSignalRef=DET_PROB_1STAZHYPO_294
            DET_MTD_296_oRDR_DETECTION_293_296_oPCAN_RADAR_b29cac8b_Tx: ComBitPosition=383, ComBitSize=1, ComSignalInitValue=0, ComSignalType=UINT8, ComHandleId=6170, ComSystemTemplateSystemSignalRef=DET_MTD_296
            DET_MTD_295_oRDR_DETECTION_293_296_oPCAN_RADAR_d67cd775_Tx: ComBitPosition=271, ComBitSize=1, ComSignalInitValue=0, ComSignalType=UINT8, ComHandleId=6169, ComSystemTemplateSystemSignalRef=DET_MTD_295
            DET_MTD_293_oRDR_DETECTION_293_296_oPCAN_RADAR_1fbc2089_Tx: ComBitPosition=47, ComBitSize=1, ComSignalInitValue=0, ComSignalType=UINT8, ComHandleId=6167, ComSystemTemplateSystemSignalRef=DET_MTD_293
