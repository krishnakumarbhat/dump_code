[part 3 of 20: package /ActiveEcuC]
AUTOSAR XML (schema 00053)
package /ActiveEcuC  (continued)
  module config Com: implementation-config-variant=VARIANT-PRE-COMPILE, module-description=Com_Impl  (continued)
    ComConfig: ComConfigurationId=0, ComRxImmediateNotificationCacheSize=0, ComRxDeferredNotificationCacheSize=1  (continued)
      SG_TrackerObject009_oRDR_TRACKER_OBJ_009_oPCAN_RADAR_00de2201_Tx (ComSignalGroup):
        ComTransferProperty = TRIGGERED
        ComSignalGroupAccess = ACCESS_NEEDED_BY_SWC_OR_COM
        ComHandleId = 118
        ComSignalGroupArrayAccess = true
        ComSystemTemplateSignalGroupRef = SG_TrackerObject009
        49 x ComGroupSignal, all with ComSignalEndianness=BIG_ENDIAN, ComSignalInitValue=0, ComTransferProperty=PENDING, ComSignalAccess=ACCESS_NEEDED_BY_SWC_OR_COM:
          OBJ_DIMENSION_LENGTH_ERR_009_oRDR_TRACKER_OBJ_009_oPCAN_RADAR_f2d6c632_Tx: ComBitPosition=41, ComBitSize=10, ComSignalType=UINT16, ComHandleId=8940, ComSystemTemplateSystemSignalRef=OBJ_DIMENSION_LENGTH_ERR_009
          OBJ_CLS_TYPE5_009_oRDR_TRACKER_OBJ_009_oPCAN_RADAR_d0007747_Tx: ComBitPosition=287, ComBitSize=4, ComSignalType=UINT8, ComHandleId=8935, ComSystemTemplateSystemSignalRef=OBJ_CLS_TYPE5_009
          OBJ_YAW_RATE_ERR_009_oRDR_TRACKER_OBJ_009_oPCAN_RADAR_0b24fc09_Tx: ComBitPosition=388, ComBitSize=5, ComSignalType=UINT8, ComHandleId=8969, ComSystemTemplateSystemSignalRef=OBJ_YAW_RATE_ERR_009
          OBJ_ACCELERATION_LONG_ERR_009_oRDR_TRACKER_OBJ_009_oPCAN_RADAR_c4abe662_Tx: ComBitPosition=215, ComBitSize=8, ComSignalType=UINT8, ComHandleId=8924, ComSystemTemplateSystemSignalRef=OBJ_ACCELERATION_LONG_ERR_009
          OBJ_VELOCITY_LAT_ERR_009_oRDR_TRACKER_OBJ_009_oPCAN_RADAR_c9357a83_Tx: ComBitPosition=151, ComBitSize=8, ComSignalType=UINT8, ComHandleId=8963, ComSystemTemplateSystemSignalRef=OBJ_VELOCITY_LAT_ERR_009
          OBJ_VELOCITY_LONG_ERR_009_oRDR_TRACKER_OBJ_009_oPCAN_RADAR_25b74543_Tx: ComBitPosition=143, ComBitSize=8, ComSignalType=UINT8, ComHandleId=8965, ComSystemTemplateSystemSignalRef=OBJ_VELOCITY_LONG_ERR_009
          OBJ_RCS_009_oRDR_TRACKER_OBJ_009_oPCAN_RADAR_9b6319f2_Tx: ComBitPosition=351, ComBitSize=7, ComSignalType=UINT8, ComHandleId=8955, ComSystemTemplateSystemSignalRef=OBJ_RCS_009
          OBJ_CLS_TYPE2_PROB_009_oRDR_TRACKER_OBJ_009_oPCAN_RADAR_eadc46f2_Tx: ComBitPosition=311, ComBitSize=8, ComSignalType=UINT8, ComHandleId=8930, ComSystemTemplateSystemSignalRef=OBJ_CLS_TYPE2_PROB_009
          OBJ_CLS_TYPE4_009_oRDR_TRACKER_OBJ_009_oPCAN_RADAR_5d888aa5_Tx: ComBitPosition=275, ComBitSize=4, ComSignalType=UINT8, ComHandleId=8933, ComSystemTemplateSystemSignalRef=OBJ_CLS_TYPE4_009
          OBJ_CLS_TYPE1_PROB_009_oRDR_TRACKER_OBJ_009_oPCAN_RADAR_23e85dff_Tx: ComBitPosition=303, ComBitSize=8, ComSignalType=UINT8, ComHandleId=8928, ComSystemTemplateSystemSignalRef=OBJ_CLS_TYPE1_PROB_009
          OBJ_CLS_TYPE5_PROB_009_oRDR_TRACKER_OBJ_009_oPCAN_RADAR_e4d68052_Tx: ComBitPosition=335, ComBitSize=8, ComSignalType=UINT8, ComHandleId=8936, ComSystemTemplateSystemSignalRef=OBJ_CLS_TYPE5_PROB_009
          OBJ_DIMENSION_WIDTH_ERR_009_oRDR_TRACKER_OBJ_009_oPCAN_RADAR_0a42e90d_Tx: ComBitPosition=23, ComBitSize=6, ComSignalType=UINT8, ComHandleId=8942, ComSystemTemplateSystemSignalRef=OBJ_DIMENSION_WIDTH_ERR_009
          OBJ_VELOCITY_LAT_009_oRDR_TRACKER_OBJ_009_oPCAN_RADAR_fdcf0ad2_Tx: ComBitPosition=126, ComBitSize=15, ComSignalType=UINT16, ComHandleId=8962, ComSystemTemplateSystemSignalRef=OBJ_VELOCITY_LAT_009
          OBJ_CLS_TYPE6_009_oRDR_TRACKER_OBJ_009_oPCAN_RADAR_9de87720_Tx: ComBitPosition=282, ComBitSize=4, ComSignalType=UINT8, ComHandleId=8937, ComSystemTemplateSystemSignalRef=OBJ_CLS_TYPE6_009
          OBJ_POS_LAT_009_oRDR_TRACKER_OBJ_009_oPCAN_RADAR_b9ac4ff5_Tx: ComBitPosition=79, ComBitSize=16, ComSignalType=UINT16, ComHandleId=8951, ComSystemTemplateSystemSignalRef=OBJ_POS_LAT_009
          OBJ_VEH_TRACK_FLAG_009_oRDR_TRACKER_OBJ_009_oPCAN_RADAR_d5e6ee24_Tx: ComBitPosition=10, ComBitSize=1, ComSignalType=BOOLEAN, ComHandleId=8960, ComSystemTemplateSystemSignalRef=OBJ_VEH_TRACK_FLAG_009
          OBJ_VELOCITY_LONG_009_oRDR_TRACKER_OBJ_009_oPCAN_RADAR_ad427214_Tx: ComBitPosition=110, ComBitSize=15, ComSignalType=UINT16, ComHandleId=8964, ComSystemTemplateSystemSignalRef=OBJ_VELOCITY_LONG_009
          OBJ_CLS_TYPE3_009_oRDR_TRACKER_OBJ_009_oPCAN_RADAR_4bd07789_Tx: ComBitPosition=279, ComBitSize=4, ComSignalType=UINT8, ComHandleId=8931, ComSystemTemplateSystemSignalRef=OBJ_CLS_TYPE3_009
          OBJ_CLS_TYPE4_PROB_009_oRDR_TRACKER_OBJ_009_oPCAN_RADAR_a3c576a9_Tx: ComBitPosition=327, ComBitSize=8, ComSignalType=UINT8, ComHandleId=8934, ComSystemTemplateSystemSignalRef=OBJ_CLS_TYPE4_PROB_009
          OBJ_CLS_TYPE2_009_oRDR_TRACKER_OBJ_009_oPCAN_RADAR_c6588a6b_Tx: ComBitPosition=267, ComBitSize=4, ComSignalType=UINT8, ComHandleId=8929, ComSystemTemplateSystemSignalRef=OBJ_CLS_TYPE2_009
          OBJ_DIMENSION_WIDTH_009_oRDR_TRACKER_OBJ_009_oPCAN_RADAR_eae02ee5_Tx: ComBitPosition=17, ComBitSize=10, ComSignalType=UINT16, ComHandleId=8941, ComSystemTemplateSystemSignalRef=OBJ_DIMENSION_WIDTH_009
          OBJ_EXISTENCE_PROB_009_oRDR_TRACKER_OBJ_009_oPCAN_RADAR_e15caad8_Tx: ComBitPosition=229, ComBitSize=14, ComSignalType=UINT16, ComHandleId=8943, ComSystemTemplateSystemSignalRef=OBJ_EXISTENCE_PROB_009
          OBJ_ACCELERATION_LAT_ERR_009_oRDR_TRACKER_OBJ_009_oPCAN_RADAR_db0e43c8_Tx: ComBitPosition=223, ComBitSize=8, ComSignalType=UINT8, ComHandleId=8922, ComSystemTemplateSystemSignalRef=OBJ_ACCELERATION_LAT_ERR_009
          OBJ_YAW_ANGLE_009_oRDR_TRACKER_OBJ_009_oPCAN_RADAR_11734e92_Tx: ComBitPosition=155, ComBitSize=12, ComSignalType=UINT16, ComHandleId=8966, ComSystemTemplateSystemSignalRef=OBJ_YAW_ANGLE_009
          OBJ_MEASUREMENT_STATUS_009_oRDR_TRACKER_OBJ_009_oPCAN_RADAR_e4d2e7cf_Tx: ComBitPosition=14, ComBitSize=3, ComSignalType=UINT8, ComHandleId=8946, ComSystemTemplateSystemSignalRef=OBJ_MEASUREMENT_STATUS_009
          OBJ_MOVEMENT_STATUS_009_oRDR_TRACKER_OBJ_009_oPCAN_RADAR_cb7c7283_Tx: ComBitPosition=196, ComBitSize=3, ComSignalType=UINT8, ComHandleId=8949, ComSystemTemplateSystemSignalRef=OBJ_MOVEMENT_STATUS_009
          OBJ_YAW_ANGLE_ERR_009_oRDR_TRACKER_OBJ_009_oPCAN_RADAR_c47e4845_Tx: ComBitPosition=175, ComBitSize=7, ComSignalType=UINT8, ComHandleId=8967, ComSystemTemplateSystemSignalRef=OBJ_YAW_ANGLE_ERR_009
          OBJ_POS_LONG_ERR_009_oRDR_TRACKER_OBJ_009_oPCAN_RADAR_2418e120_Tx: ComBitPosition=95, ComBitSize=8, ComSignalType=UINT8, ComHandleId=8954, ComSystemTemplateSystemSignalRef=OBJ_POS_LONG_ERR_009
          OBJ_REF_PT_LAT_OFFSET_009_oRDR_TRACKER_OBJ_009_oPCAN_RADAR_6e5e7287_Tx: ComBitPosition=370, ComBitSize=14, ComSignalType=UINT16, ComHandleId=8956, ComSystemTemplateSystemSignalRef=OBJ_REF_PT_LAT_OFFSET_009
          OBJ_CLS_TYPE3_PROB_009_oRDR_TRACKER_OBJ_009_oPCAN_RADAR_adcfb009_Tx: ComBitPosition=319, ComBitSize=8, ComSignalType=UINT8, ComHandleId=8932, ComSystemTemplateSystemSignalRef=OBJ_CLS_TYPE3_PROB_009
          OBJ_ACCELERATION_LAT_009_oRDR_TRACKER_OBJ_009_oPCAN_RADAR_0efa7976_Tx: ComBitPosition=177, ComBitSize=10, ComSignalType=UINT16, ComHandleId=8921, ComSystemTemplateSystemSignalRef=OBJ_ACCELERATION_LAT_009
          OBJ_ID_009_oRDR_TRACKER_OBJ_009_oPCAN_RADAR_9b009572_Tx: ComBitPosition=7, ComBitSize=8, ComSignalType=UINT8, ComHandleId=8945, ComSystemTemplateSystemSignalRef=OBJ_ID_009
          OBJ_DIMENSION_LENGTH_009_oRDR_TRACKER_OBJ_009_oPCAN_RADAR_c92ed948_Tx: ComBitPosition=37, ComBitSize=12, ComSignalType=UINT16, ComHandleId=8939, ComSystemTemplateSystemSignalRef=OBJ_DIMENSION_LENGTH_009
          OBJ_CLS_TYPE6_PROB_009_oRDR_TRACKER_OBJ_009_oPCAN_RADAR_2de29b5f_Tx: ComBitPosition=343, ComBitSize=8, ComSignalType=UINT8, ComHandleId=8938, ComSystemTemplateSystemSignalRef=OBJ_CLS_TYPE6_PROB_009
          OBJ_POS_LONG_009_oRDR_TRACKER_OBJ_009_oPCAN_RADAR_080ca43a_Tx: ComBitPosition=63, ComBitSize=16, ComSignalType=UINT16, ComHandleId=8953, ComSystemTemplateSystemSignalRef=OBJ_POS_LONG_009
          OBJ_POS_ERR_CRR_COEF_009_oRDR_TRACKER_OBJ_009_oPCAN_RADAR_5b03b2b9_Tx: ComBitPosition=415, ComBitSize=8, ComSignalType=UINT8, ComHandleId=8950, ComSystemTemplateSystemSignalRef=OBJ_POS_ERR_CRR_COEF_009
          OBJ_VELOCITY_ERR_CRR_COEF_009_oRDR_TRACKER_OBJ_009_oPCAN_RADAR_f2798f58_Tx: ComBitPosition=423, ComBitSize=8, ComSignalType=UINT8, ComHandleId=8961, ComSystemTemplateSystemSignalRef=OBJ_VELOCITY_ERR_CRR_COEF_009
          OBJ_YAW_RATE_009_oRDR_TRACKER_OBJ_009_oPCAN_RADAR_34fc6bd5_Tx: ComBitPosition=399, ComBitSize=10, ComSignalType=UINT16, ComHandleId=8968, ComSystemTemplateSystemSignalRef=OBJ_YAW_RATE_009
          OBJ_ACCEL_ERR_CRR_COEF_009_oRDR_TRACKER_OBJ_009_oPCAN_RADAR_6408c704_Tx: ComBitPosition=431, ComBitSize=8, ComSignalType=UINT8, ComHandleId=8925, ComSystemTemplateSystemSignalRef=OBJ_ACCEL_ERR_CRR_COEF_009
          OBJ_ACCELERATION_LONG_009_oRDR_TRACKER_OBJ_009_oPCAN_RADAR_7c0a2096_Tx: ComBitPosition=193, ComBitSize=10, ComSignalType=UINT16, ComHandleId=8923, ComSystemTemplateSystemSignalRef=OBJ_ACCELERATION_LONG_009
          OBJ_ALIVE_TIME_009_oRDR_TRACKER_OBJ_009_oPCAN_RADAR_1c6b6b2a_Tx: ComBitPosition=255, ComBitSize=16, ComSignalType=UINT16, ComHandleId=8926, ComSystemTemplateSystemSignalRef=OBJ_ALIVE_TIME_009
          OBJ_CLS_TYPE1_009_oRDR_TRACKER_OBJ_009_oPCAN_RADAR_8bb08a0c_Tx: ComBitPosition=271, ComBitSize=4, ComSignalType=UINT8, ComHandleId=8927, ComSystemTemplateSystemSignalRef=OBJ_CLS_TYPE1_009
          OBJ_POS_LAT_ERR_009_oRDR_TRACKER_OBJ_009_oPCAN_RADAR_bde01fc2_Tx: ComBitPosition=103, ComBitSize=8, ComSignalType=UINT8, ComHandleId=8952, ComSystemTemplateSystemSignalRef=OBJ_POS_LAT_ERR_009
          OBJ_TIMESTAMP_OFFSET_009_oRDR_TRACKER_OBJ_009_oPCAN_RADAR_9bcf19a4_Tx: ComBitPosition=247, ComBitSize=8, ComSignalType=UINT8, ComHandleId=8958, ComSystemTemplateSystemSignalRef=OBJ_TIMESTAMP_OFFSET_009
          OBJ_REF_PT_LONG_OFFSET_009_oRDR_TRACKER_OBJ_009_oPCAN_RADAR_210c8284_Tx: ComBitPosition=357, ComBitSize=14, ComSignalType=UINT16, ComHandleId=8957, ComSystemTemplateSystemSignalRef=OBJ_REF_PT_LONG_OFFSET_009
          OBJ_GROUP_ID_009_oRDR_TRACKER_OBJ_009_oPCAN_RADAR_682ebe75_Tx: ComBitPosition=405, ComBitSize=6, ComSignalType=UINT8, ComHandleId=8944, ComSystemTemplateSystemSignalRef=OBJ_GROUP_ID_009
          OBJ_TRACK_MOTION_MODEL_009_oRDR_TRACKER_OBJ_009_oPCAN_RADAR_57cc1879_Tx: ComBitPosition=9, ComBitSize=2, ComSignalType=UINT8, ComHandleId=8959, ComSystemTemplateSystemSignalRef=OBJ_TRACK_MOTION_MODEL_009
          OBJ_MH_CYCLE_COUNTER_009_oRDR_TRACKER_OBJ_009_oPCAN_RADAR_e9560a12_Tx: ComBitPosition=487, ComBitSize=8, ComSignalType=UINT8, ComHandleId=8948, ComSystemTemplateSystemSignalRef=OBJ_MH_CYCLE_COUNTER_009
          OBJ_MH_CRC16_009_oRDR_TRACKER_OBJ_009_oPCAN_RADAR_98b250f3_Tx: ComBitPosition=495, ComBitSize=16, ComSignalType=UINT16, ComHandleId=8947, ComSystemTemplateSystemSignalRef=OBJ_MH_CRC16_009
      4 x ComIPdu, all with ComIPduDirection=SEND, ComIPduType=NORMAL, ComIPduCancellationSupport=false, ComIPduSignalProcessing=DEFERRED, ComIPduChannelRef=CN_PCAN_RADAR_458ff0f1, ComIPduGroupRef=RDR01_oPCAN_RADAR_Tx_b6bdb067 if post-build-variant-condition{matching-criterion=RDR_POS, value=0}, ComIPduMainFunctionRef=ComMainFunctionTx_Event, ComIPduGroupRef=RDR02_oPCAN_RADAR_Tx_9f750495 if post-build-variant-condition{matching-criterion=RDR_POS, value=1}, ComIPduGroupRef=RDR03_oPCAN_RADAR_Tx_311d9504 if post-build-variant-condition{matching-criterion=RDR_POS, value=2}, ComIPduGroupRef=RDR04_oPCAN_RADAR_Tx_cce46d71 if post-build-variant-condition{matching-criterion=RDR_POS, value=3}, ComIPduGroupRef=RDR05_oPCAN_RADAR_Tx_628cfce0 if post-build-variant-condition{matching-criterion=RDR_POS, value=4}, ComIPduGroupRef=RDR06_oPCAN_RADAR_Tx_4b444812 if post-build-variant-condition{matching-criterion=RDR_POS, value=5}, ComIPduGroupRef=RDR07_oPCAN_RADAR_Tx_e52cd983 if post-build-variant-condition{matching-criterion=RDR_POS, value=6}, ComIPduGroupRef=RDR08_oPCAN_RADAR_Tx_6bc6beb9 if post-build-variant-condition{matching-criterion=RDR_POS, value=7}:
        RDR_TRACKER_OBJ_042_oPCAN_RADAR_8ae11883_Tx: ComIPduHandleId=152, ComIPduSignalGroupRef=SG_TrackerObject042_oRDR_TRACKER_OBJ_042_oPCAN_RADAR_e4c43db0_Tx, ComPduIdRef=RDR_TRACKER_OBJ_042_oPCAN_RADAR_8ae11883_Tx
          ComTxIPdu: ComMinimumDelayTime=0, ComTxIPduUnusedAreasDefault=0
            ComTxModeTrue
              ComTxMode: ComTxModeMode=DIRECT, ComTxModeNumberOfRepetitions=0
            ComTxModeFalse
              ComTxMode: ComTxModeMode=NONE
        RDR_DETECTION_073_076_oPCAN_RADAR_80c18568_Tx: ComIPduHandleId=24, ComIPduSignalGroupRef=SG_Detections_073_076_oRDR_DETECTION_073_076_oPCAN_RADAR_5a640d52_Tx, ComPduIdRef=RDR_DETECTION_073_076_oPCAN_RADAR_80c18568_Tx
          ComTxIPdu: ComMinimumDelayTime=0, ComTxIPduUnusedAreasDefault=0
            ComTxModeTrue
              ComTxMode: ComTxModeMode=DIRECT, ComTxModeNumberOfRepetitions=0
            ComTxModeFalse
              ComTxMode: ComTxModeMode=NONE
        RDR_DETECTION_149_152_oPCAN_RADAR_17a572d8_Tx: ComIPduHandleId=43, ComIPduSignalGroupRef=SG_Detections_149_152_oRDR_DETECTION_149_152_oPCAN_RADAR_1fb2e794_Tx, ComPduIdRef=RDR_DETECTION_149_152_oPCAN_RADAR_17a572d8_Tx
          ComTxIPdu: ComMinimumDelayTime=0, ComTxIPduUnusedAreasDefault=0
            ComTxModeTrue
              ComTxMode: ComTxModeMode=DIRECT, ComTxModeNumberOfRepetitions=0
            ComTxModeFalse
              ComTxMode: ComTxModeMode=NONE
        RDR_DETECTION_133_136_oPCAN_RADAR_fcdc86c5_Tx: ComIPduHandleId=39, ComIPduSignalGroupRef=SG_Detections_133_136_oRDR_DETECTION_133_136_oPCAN_RADAR_72276f4a_Tx, ComPduIdRef=RDR_DETECTION_133_136_oPCAN_RADAR_fcdc86c5_Tx
          ComTxIPdu: ComMinimumDelayTime=0, ComTxIPduUnusedAreasDefault=0
            ComTxModeTrue
              ComTxMode: ComTxModeMode=DIRECT, ComTxModeNumberOfRepetitions=0
            ComTxModeFalse
              ComTxMode: ComTxModeMode=NONE
      SG_TrackerObject025_oRDR_TRACKER_OBJ_025_oPCAN_RADAR_522dbdaf_Tx (ComSignalGroup):
        ComTransferProperty = TRIGGERED
        ComSignalGroupAccess = ACCESS_NEEDED_BY_SWC_OR_COM
        ComHandleId = 134
        ComSignalGroupArrayAccess = true
        ComSystemTemplateSignalGroupRef = SG_TrackerObject025
        49 x ComGroupSignal, all with ComSignalEndianness=BIG_ENDIAN, ComSignalInitValue=0, ComTransferProperty=PENDING, ComSignalAccess=ACCESS_NEEDED_BY_SWC_OR_COM:
          OBJ_RCS_025_oRDR_TRACKER_OBJ_025_oPCAN_RADAR_c990865c_Tx: ComBitPosition=351, ComBitSize=7, ComSignalType=UINT8, ComHandleId=9739, ComSystemTemplateSystemSignalRef=OBJ_RCS_025
          OBJ_CLS_TYPE2_025_oRDR_TRACKER_OBJ_025_oPCAN_RADAR_94ab15c5_Tx: ComBitPosition=267, ComBitSize=4, ComSignalType=UINT8, ComHandleId=9713, ComSystemTemplateSystemSignalRef=OBJ_CLS_TYPE2_025
          OBJ_REF_PT_LONG_OFFSET_025_oRDR_TRACKER_OBJ_025_oPCAN_RADAR_73ff1d2a_Tx: ComBitPosition=357, ComBitSize=14, ComSignalType=UINT16, ComHandleId=9741, ComSystemTemplateSystemSignalRef=OBJ_REF_PT_LONG_OFFSET_025
          OBJ_POS_LAT_025_oRDR_TRACKER_OBJ_025_oPCAN_RADAR_eb5fd05b_Tx: ComBitPosition=79, ComBitSize=16, ComSignalType=UINT16, ComHandleId=9735, ComSystemTemplateSystemSignalRef=OBJ_POS_LAT_025
          OBJ_VEH_TRACK_FLAG_025_oRDR_TRACKER_OBJ_025_oPCAN_RADAR_8715718a_Tx: ComBitPosition=10, ComBitSize=1, ComSignalType=BOOLEAN, ComHandleId=9744, ComSystemTemplateSystemSignalRef=OBJ_VEH_TRACK_FLAG_025
          OBJ_CLS_TYPE1_PROB_025_oRDR_TRACKER_OBJ_025_oPCAN_RADAR_711bc251_Tx: ComBitPosition=303, ComBitSize=8, ComSignalType=UINT8, ComHandleId=9712, ComSystemTemplateSystemSignalRef=OBJ_CLS_TYPE1_PROB_025
          OBJ_GROUP_ID_025_oRDR_TRACKER_OBJ_025_oPCAN_RADAR_3add21db_Tx: ComBitPosition=405, ComBitSize=6, ComSignalType=UINT8, ComHandleId=9728, ComSystemTemplateSystemSignalRef=OBJ_GROUP_ID_025
          OBJ_YAW_RATE_025_oRDR_TRACKER_OBJ_025_oPCAN_RADAR_660ff47b_Tx: ComBitPosition=399, ComBitSize=10, ComSignalType=UINT16, ComHandleId=9752, ComSystemTemplateSystemSignalRef=OBJ_YAW_RATE_025
          OBJ_CLS_TYPE5_025_oRDR_TRACKER_OBJ_025_oPCAN_RADAR_82f3e8e9_Tx: ComBitPosition=287, ComBitSize=4, ComSignalType=UINT8, ComHandleId=9719, ComSystemTemplateSystemSignalRef=OBJ_CLS_TYPE5_025
          OBJ_CLS_TYPE6_PROB_025_oRDR_TRACKER_OBJ_025_oPCAN_RADAR_7f1104f1_Tx: ComBitPosition=343, ComBitSize=8, ComSignalType=UINT8, ComHandleId=9722, ComSystemTemplateSystemSignalRef=OBJ_CLS_TYPE6_PROB_025
          OBJ_POS_LONG_ERR_025_oRDR_TRACKER_OBJ_025_oPCAN_RADAR_76eb7e8e_Tx: ComBitPosition=95, ComBitSize=8, ComSignalType=UINT8, ComHandleId=9738, ComSystemTemplateSystemSignalRef=OBJ_POS_LONG_ERR_025
          OBJ_VELOCITY_LONG_025_oRDR_TRACKER_OBJ_025_oPCAN_RADAR_ffb1edba_Tx: ComBitPosition=110, ComBitSize=15, ComSignalType=UINT16, ComHandleId=9748, ComSystemTemplateSystemSignalRef=OBJ_VELOCITY_LONG_025
          OBJ_CLS_TYPE5_PROB_025_oRDR_TRACKER_OBJ_025_oPCAN_RADAR_b6251ffc_Tx: ComBitPosition=335, ComBitSize=8, ComSignalType=UINT8, ComHandleId=9720, ComSystemTemplateSystemSignalRef=OBJ_CLS_TYPE5_PROB_025
          OBJ_POS_LONG_025_oRDR_TRACKER_OBJ_025_oPCAN_RADAR_5aff3b94_Tx: ComBitPosition=63, ComBitSize=16, ComSignalType=UINT16, ComHandleId=9737, ComSystemTemplateSystemSignalRef=OBJ_POS_LONG_025
          OBJ_CLS_TYPE1_025_oRDR_TRACKER_OBJ_025_oPCAN_RADAR_d94315a2_Tx: ComBitPosition=271, ComBitSize=4, ComSignalType=UINT8, ComHandleId=9711, ComSystemTemplateSystemSignalRef=OBJ_CLS_TYPE1_025
          OBJ_YAW_ANGLE_ERR_025_oRDR_TRACKER_OBJ_025_oPCAN_RADAR_968dd7eb_Tx: ComBitPosition=175, ComBitSize=7, ComSignalType=UINT8, ComHandleId=9751, ComSystemTemplateSystemSignalRef=OBJ_YAW_ANGLE_ERR_025
          OBJ_CLS_TYPE2_PROB_025_oRDR_TRACKER_OBJ_025_oPCAN_RADAR_b82fd95c_Tx: ComBitPosition=311, ComBitSize=8, ComSignalType=UINT8, ComHandleId=9714, ComSystemTemplateSystemSignalRef=OBJ_CLS_TYPE2_PROB_025
          OBJ_MOVEMENT_STATUS_025_oRDR_TRACKER_OBJ_025_oPCAN_RADAR_998fed2d_Tx: ComBitPosition=196, ComBitSize=3, ComSignalType=UINT8, ComHandleId=9733, ComSystemTemplateSystemSignalRef=OBJ_MOVEMENT_STATUS_025
          OBJ_TRACK_MOTION_MODEL_025_oRDR_TRACKER_OBJ_025_oPCAN_RADAR_053f87d7_Tx: ComBitPosition=9, ComBitSize=2, ComSignalType=UINT8, ComHandleId=9743, ComSystemTemplateSystemSignalRef=OBJ_TRACK_MOTION_MODEL_025
          OBJ_VELOCITY_ERR_CRR_COEF_025_oRDR_TRACKER_OBJ_025_oPCAN_RADAR_a08a10f6_Tx: ComBitPosition=423, ComBitSize=8, ComSignalType=UINT8, ComHandleId=9745, ComSystemTemplateSystemSignalRef=OBJ_VELOCITY_ERR_CRR_COEF_025
          OBJ_EXISTENCE_PROB_025_oRDR_TRACKER_OBJ_025_oPCAN_RADAR_b3af3576_Tx: ComBitPosition=229, ComBitSize=14, ComSignalType=UINT16, ComHandleId=9727, ComSystemTemplateSystemSignalRef=OBJ_EXISTENCE_PROB_025
          OBJ_VELOCITY_LAT_ERR_025_oRDR_TRACKER_OBJ_025_oPCAN_RADAR_9bc6e52d_Tx: ComBitPosition=151, ComBitSize=8, ComSignalType=UINT8, ComHandleId=9747, ComSystemTemplateSystemSignalRef=OBJ_VELOCITY_LAT_ERR_025
          OBJ_REF_PT_LAT_OFFSET_025_oRDR_TRACKER_OBJ_025_oPCAN_RADAR_3caded29_Tx: ComBitPosition=370, ComBitSize=14, ComSignalType=UINT16, ComHandleId=9740, ComSystemTemplateSystemSignalRef=OBJ_REF_PT_LAT_OFFSET_025
          OBJ_ACCELERATION_LONG_025_oRDR_TRACKER_OBJ_025_oPCAN_RADAR_2ef9bf38_Tx: ComBitPosition=193, ComBitSize=10, ComSignalType=UINT16, ComHandleId=9707, ComSystemTemplateSystemSignalRef=OBJ_ACCELERATION_LONG_025
          OBJ_ALIVE_TIME_025_oRDR_TRACKER_OBJ_025_oPCAN_RADAR_4e98f484_Tx: ComBitPosition=255, ComBitSize=16, ComSignalType=UINT16, ComHandleId=9710, ComSystemTemplateSystemSignalRef=OBJ_ALIVE_TIME_025
          OBJ_DIMENSION_WIDTH_ERR_025_oRDR_TRACKER_OBJ_025_oPCAN_RADAR_58b176a3_Tx: ComBitPosition=23, ComBitSize=6, ComSignalType=UINT8, ComHandleId=9726, ComSystemTemplateSystemSignalRef=OBJ_DIMENSION_WIDTH_ERR_025
          OBJ_POS_ERR_CRR_COEF_025_oRDR_TRACKER_OBJ_025_oPCAN_RADAR_09f02d17_Tx: ComBitPosition=415, ComBitSize=8, ComSignalType=UINT8, ComHandleId=9734, ComSystemTemplateSystemSignalRef=OBJ_POS_ERR_CRR_COEF_025
          OBJ_YAW_ANGLE_025_oRDR_TRACKER_OBJ_025_oPCAN_RADAR_4380d13c_Tx: ComBitPosition=155, ComBitSize=12, ComSignalType=UINT16, ComHandleId=9750, ComSystemTemplateSystemSignalRef=OBJ_YAW_ANGLE_025
          OBJ_CLS_TYPE3_PROB_025_oRDR_TRACKER_OBJ_025_oPCAN_RADAR_ff3c2fa7_Tx: ComBitPosition=319, ComBitSize=8, ComSignalType=UINT8, ComHandleId=9716, ComSystemTemplateSystemSignalRef=OBJ_CLS_TYPE3_PROB_025
          OBJ_CLS_TYPE4_025_oRDR_TRACKER_OBJ_025_oPCAN_RADAR_0f7b150b_Tx: ComBitPosition=275, ComBitSize=4, ComSignalType=UINT8, ComHandleId=9717, ComSystemTemplateSystemSignalRef=OBJ_CLS_TYPE4_025
          OBJ_DIMENSION_LENGTH_ERR_025_oRDR_TRACKER_OBJ_025_oPCAN_RADAR_a025599c_Tx: ComBitPosition=41, ComBitSize=10, ComSignalType=UINT16, ComHandleId=9724, ComSystemTemplateSystemSignalRef=OBJ_DIMENSION_LENGTH_ERR_025
          OBJ_TIMESTAMP_OFFSET_025_oRDR_TRACKER_OBJ_025_oPCAN_RADAR_c93c860a_Tx: ComBitPosition=247, ComBitSize=8, ComSignalType=UINT8, ComHandleId=9742, ComSystemTemplateSystemSignalRef=OBJ_TIMESTAMP_OFFSET_025
          OBJ_MEASUREMENT_STATUS_025_oRDR_TRACKER_OBJ_025_oPCAN_RADAR_b6217861_Tx: ComBitPosition=14, ComBitSize=3, ComSignalType=UINT8, ComHandleId=9730, ComSystemTemplateSystemSignalRef=OBJ_MEASUREMENT_STATUS_025
          OBJ_CLS_TYPE4_PROB_025_oRDR_TRACKER_OBJ_025_oPCAN_RADAR_f136e907_Tx: ComBitPosition=327, ComBitSize=8, ComSignalType=UINT8, ComHandleId=9718, ComSystemTemplateSystemSignalRef=OBJ_CLS_TYPE4_PROB_025
          OBJ_CLS_TYPE6_025_oRDR_TRACKER_OBJ_025_oPCAN_RADAR_cf1be88e_Tx: ComBitPosition=282, ComBitSize=4, ComSignalType=UINT8, ComHandleId=9721, ComSystemTemplateSystemSignalRef=OBJ_CLS_TYPE6_025
          OBJ_DIMENSION_WIDTH_025_oRDR_TRACKER_OBJ_025_oPCAN_RADAR_b813b14b_Tx: ComBitPosition=17, ComBitSize=10, ComSignalType=UINT16, ComHandleId=9725, ComSystemTemplateSystemSignalRef=OBJ_DIMENSION_WIDTH_025
          OBJ_CLS_TYPE3_025_oRDR_TRACKER_OBJ_025_oPCAN_RADAR_1923e827_Tx: ComBitPosition=279, ComBitSize=4, ComSignalType=UINT8, ComHandleId=9715, ComSystemTemplateSystemSignalRef=OBJ_CLS_TYPE3_025
          OBJ_ACCELERATION_LAT_025_oRDR_TRACKER_OBJ_025_oPCAN_RADAR_5c09e6d8_Tx: ComBitPosition=177, ComBitSize=10, ComSignalType=UINT16, ComHandleId=9705, ComSystemTemplateSystemSignalRef=OBJ_ACCELERATION_LAT_025
          OBJ_VELOCITY_LAT_025_oRDR_TRACKER_OBJ_025_oPCAN_RADAR_af3c957c_Tx: ComBitPosition=126, ComBitSize=15, ComSignalType=UINT16, ComHandleId=9746, ComSystemTemplateSystemSignalRef=OBJ_VELOCITY_LAT_025
          OBJ_POS_LAT_ERR_025_oRDR_TRACKER_OBJ_025_oPCAN_RADAR_ef13806c_Tx: ComBitPosition=103, ComBitSize=8, ComSignalType=UINT8, ComHandleId=9736, ComSystemTemplateSystemSignalRef=OBJ_POS_LAT_ERR_025
          OBJ_YAW_RATE_ERR_025_oRDR_TRACKER_OBJ_025_oPCAN_RADAR_59d763a7_Tx: ComBitPosition=388, ComBitSize=5, ComSignalType=UINT8, ComHandleId=9753, ComSystemTemplateSystemSignalRef=OBJ_YAW_RATE_ERR_025
          OBJ_VELOCITY_LONG_ERR_025_oRDR_TRACKER_OBJ_025_oPCAN_RADAR_7744daed_Tx: ComBitPosition=143, ComBitSize=8, ComSignalType=UINT8, ComHandleId=9749, ComSystemTemplateSystemSignalRef=OBJ_VELOCITY_LONG_ERR_025
          OBJ_DIMENSION_LENGTH_025_oRDR_TRACKER_OBJ_025_oPCAN_RADAR_9bdd46e6_Tx: ComBitPosition=37, ComBitSize=12, ComSignalType=UINT16, ComHandleId=9723, ComSystemTemplateSystemSignalRef=OBJ_DIMENSION_LENGTH_025
          OBJ_ACCELERATION_LONG_ERR_025_oRDR_TRACKER_OBJ_025_oPCAN_RADAR_965879cc_Tx: ComBitPosition=215, ComBitSize=8, ComSignalType=UINT8, ComHandleId=9708, ComSystemTemplateSystemSignalRef=OBJ_ACCELERATION_LONG_ERR_025
          OBJ_ACCELERATION_LAT_ERR_025_oRDR_TRACKER_OBJ_025_oPCAN_RADAR_89fddc66_Tx: ComBitPosition=223, ComBitSize=8, ComSignalType=UINT8, ComHandleId=9706, ComSystemTemplateSystemSignalRef=OBJ_ACCELERATION_LAT_ERR_025
          OBJ_ACCEL_ERR_CRR_COEF_025_oRDR_TRACKER_OBJ_025_oPCAN_RADAR_36fb58aa_Tx: ComBitPosition=431, ComBitSize=8, ComSignalType=UINT8, ComHandleId=9709, ComSystemTemplateSystemSignalRef=OBJ_ACCEL_ERR_CRR_COEF_025
          OBJ_ID_025_oRDR_TRACKER_OBJ_025_oPCAN_RADAR_c9f30adc_Tx: ComBitPosition=7, ComBitSize=8, ComSignalType=UINT8, ComHandleId=9729, ComSystemTemplateSystemSignalRef=OBJ_ID_025
          OBJ_MH_CYCLE_COUNTER_025_oRDR_TRACKER_OBJ_025_oPCAN_RADAR_bba595bc_Tx: ComBitPosition=487, ComBitSize=8, ComSignalType=UINT8, ComHandleId=9732, ComSystemTemplateSystemSignalRef=OBJ_MH_CYCLE_COUNTER_025
          OBJ_MH_CRC16_025_oRDR_TRACKER_OBJ_025_oPCAN_RADAR_ca41cf5d_Tx: ComBitPosition=495, ComBitSize=16, ComSignalType=UINT16, ComHandleId=9731, ComSystemTemplateSystemSignalRef=OBJ_MH_CRC16_025
      SG_TrackerObject016_oRDR_TRACKER_OBJ_016_oPCAN_RADAR_75d339f9_Tx (ComSignalGroup):
        ComTransferProperty = TRIGGERED
        ComSignalGroupAccess = ACCESS_NEEDED_BY_SWC_OR_COM
        ComHandleId = 125
        ComSignalGroupArrayAccess = true
        ComSystemTemplateSignalGroupRef = SG_TrackerObject016
        49 x ComGroupSignal, all with ComSignalEndianness=BIG_ENDIAN, ComSignalInitValue=0, ComTransferProperty=PENDING, ComSignalAccess=ACCESS_NEEDED_BY_SWC_OR_COM:
          OBJ_YAW_ANGLE_016_oRDR_TRACKER_OBJ_016_oPCAN_RADAR_647e556a_Tx: ComBitPosition=155, ComBitSize=12, ComSignalType=UINT16, ComHandleId=9309, ComSystemTemplateSystemSignalRef=OBJ_YAW_ANGLE_016
          OBJ_CLS_TYPE1_PROB_016_oRDR_TRACKER_OBJ_016_oPCAN_RADAR_56e54607_Tx: ComBitPosition=303, ComBitSize=8, ComSignalType=UINT8, ComHandleId=9271, ComSystemTemplateSystemSignalRef=OBJ_CLS_TYPE1_PROB_016
          OBJ_CLS_TYPE3_PROB_016_oRDR_TRACKER_OBJ_016_oPCAN_RADAR_d8c2abf1_Tx: ComBitPosition=319, ComBitSize=8, ComSignalType=UINT8, ComHandleId=9275, ComSystemTemplateSystemSignalRef=OBJ_CLS_TYPE3_PROB_016
          OBJ_CLS_TYPE4_PROB_016_oRDR_TRACKER_OBJ_016_oPCAN_RADAR_d6c86d51_Tx: ComBitPosition=327, ComBitSize=8, ComSignalType=UINT8, ComHandleId=9277, ComSystemTemplateSystemSignalRef=OBJ_CLS_TYPE4_PROB_016
          OBJ_TIMESTAMP_OFFSET_016_oRDR_TRACKER_OBJ_016_oPCAN_RADAR_eec2025c_Tx: ComBitPosition=247, ComBitSize=8, ComSignalType=UINT8, ComHandleId=9301, ComSystemTemplateSystemSignalRef=OBJ_TIMESTAMP_OFFSET_016
          OBJ_VELOCITY_LONG_ERR_016_oRDR_TRACKER_OBJ_016_oPCAN_RADAR_50ba5ebb_Tx: ComBitPosition=143, ComBitSize=8, ComSignalType=UINT8, ComHandleId=9308, ComSystemTemplateSystemSignalRef=OBJ_VELOCITY_LONG_ERR_016
          OBJ_ACCELERATION_LONG_ERR_016_oRDR_TRACKER_OBJ_016_oPCAN_RADAR_b1a6fd9a_Tx: ComBitPosition=215, ComBitSize=8, ComSignalType=UINT8, ComHandleId=9267, ComSystemTemplateSystemSignalRef=OBJ_ACCELERATION_LONG_ERR_016
          OBJ_DIMENSION_WIDTH_ERR_016_oRDR_TRACKER_OBJ_016_oPCAN_RADAR_7f4ff2f5_Tx: ComBitPosition=23, ComBitSize=6, ComSignalType=UINT8, ComHandleId=9285, ComSystemTemplateSystemSignalRef=OBJ_DIMENSION_WIDTH_ERR_016
          OBJ_RCS_016_oRDR_TRACKER_OBJ_016_oPCAN_RADAR_ee6e020a_Tx: ComBitPosition=351, ComBitSize=7, ComSignalType=UINT8, ComHandleId=9298, ComSystemTemplateSystemSignalRef=OBJ_RCS_016
          OBJ_VELOCITY_LAT_ERR_016_oRDR_TRACKER_OBJ_016_oPCAN_RADAR_bc38617b_Tx: ComBitPosition=151, ComBitSize=8, ComSignalType=UINT8, ComHandleId=9306, ComSystemTemplateSystemSignalRef=OBJ_VELOCITY_LAT_ERR_016
          OBJ_ACCELERATION_LAT_ERR_016_oRDR_TRACKER_OBJ_016_oPCAN_RADAR_ae035830_Tx: ComBitPosition=223, ComBitSize=8, ComSignalType=UINT8, ComHandleId=9265, ComSystemTemplateSystemSignalRef=OBJ_ACCELERATION_LAT_ERR_016
          OBJ_POS_ERR_CRR_COEF_016_oRDR_TRACKER_OBJ_016_oPCAN_RADAR_2e0ea941_Tx: ComBitPosition=415, ComBitSize=8, ComSignalType=UINT8, ComHandleId=9293, ComSystemTemplateSystemSignalRef=OBJ_POS_ERR_CRR_COEF_016
          OBJ_YAW_RATE_ERR_016_oRDR_TRACKER_OBJ_016_oPCAN_RADAR_7e29e7f1_Tx: ComBitPosition=388, ComBitSize=5, ComSignalType=UINT8, ComHandleId=9312, ComSystemTemplateSystemSignalRef=OBJ_YAW_RATE_ERR_016
          OBJ_ALIVE_TIME_016_oRDR_TRACKER_OBJ_016_oPCAN_RADAR_696670d2_Tx: ComBitPosition=255, ComBitSize=16, ComSignalType=UINT16, ComHandleId=9269, ComSystemTemplateSystemSignalRef=OBJ_ALIVE_TIME_016
          OBJ_REF_PT_LONG_OFFSET_016_oRDR_TRACKER_OBJ_016_oPCAN_RADAR_5401997c_Tx: ComBitPosition=357, ComBitSize=14, ComSignalType=UINT16, ComHandleId=9300, ComSystemTemplateSystemSignalRef=OBJ_REF_PT_LONG_OFFSET_016
          OBJ_VEH_TRACK_FLAG_016_oRDR_TRACKER_OBJ_016_oPCAN_RADAR_a0ebf5dc_Tx: ComBitPosition=10, ComBitSize=1, ComSignalType=BOOLEAN, ComHandleId=9303, ComSystemTemplateSystemSignalRef=OBJ_VEH_TRACK_FLAG_016
          OBJ_ID_016_oRDR_TRACKER_OBJ_016_oPCAN_RADAR_ee0d8e8a_Tx: ComBitPosition=7, ComBitSize=8, ComSignalType=UINT8, ComHandleId=9288, ComSystemTemplateSystemSignalRef=OBJ_ID_016
          OBJ_TRACK_MOTION_MODEL_016_oRDR_TRACKER_OBJ_016_oPCAN_RADAR_22c10381_Tx: ComBitPosition=9, ComBitSize=2, ComSignalType=UINT8, ComHandleId=9302, ComSystemTemplateSystemSignalRef=OBJ_TRACK_MOTION_MODEL_016
          OBJ_CLS_TYPE4_016_oRDR_TRACKER_OBJ_016_oPCAN_RADAR_2885915d_Tx: ComBitPosition=275, ComBitSize=4, ComSignalType=UINT8, ComHandleId=9276, ComSystemTemplateSystemSignalRef=OBJ_CLS_TYPE4_016
          OBJ_MOVEMENT_STATUS_016_oRDR_TRACKER_OBJ_016_oPCAN_RADAR_be71697b_Tx: ComBitPosition=196, ComBitSize=3, ComSignalType=UINT8, ComHandleId=9292, ComSystemTemplateSystemSignalRef=OBJ_MOVEMENT_STATUS_016
          OBJ_POS_LAT_016_oRDR_TRACKER_OBJ_016_oPCAN_RADAR_cca1540d_Tx: ComBitPosition=79, ComBitSize=16, ComSignalType=UINT16, ComHandleId=9294, ComSystemTemplateSystemSignalRef=OBJ_POS_LAT_016
          OBJ_VELOCITY_ERR_CRR_COEF_016_oRDR_TRACKER_OBJ_016_oPCAN_RADAR_877494a0_Tx: ComBitPosition=423, ComBitSize=8, ComSignalType=UINT8, ComHandleId=9304, ComSystemTemplateSystemSignalRef=OBJ_VELOCITY_ERR_CRR_COEF_016
          OBJ_VELOCITY_LONG_016_oRDR_TRACKER_OBJ_016_oPCAN_RADAR_d84f69ec_Tx: ComBitPosition=110, ComBitSize=15, ComSignalType=UINT16, ComHandleId=9307, ComSystemTemplateSystemSignalRef=OBJ_VELOCITY_LONG_016
          OBJ_ACCELERATION_LONG_016_oRDR_TRACKER_OBJ_016_oPCAN_RADAR_09073b6e_Tx: ComBitPosition=193, ComBitSize=10, ComSignalType=UINT16, ComHandleId=9266, ComSystemTemplateSystemSignalRef=OBJ_ACCELERATION_LONG_016
          OBJ_VELOCITY_LAT_016_oRDR_TRACKER_OBJ_016_oPCAN_RADAR_88c2112a_Tx: ComBitPosition=126, ComBitSize=15, ComSignalType=UINT16, ComHandleId=9305, ComSystemTemplateSystemSignalRef=OBJ_VELOCITY_LAT_016
          OBJ_ACCEL_ERR_CRR_COEF_016_oRDR_TRACKER_OBJ_016_oPCAN_RADAR_1105dcfc_Tx: ComBitPosition=431, ComBitSize=8, ComSignalType=UINT8, ComHandleId=9268, ComSystemTemplateSystemSignalRef=OBJ_ACCEL_ERR_CRR_COEF_016
          OBJ_CLS_TYPE2_PROB_016_oRDR_TRACKER_OBJ_016_oPCAN_RADAR_9fd15d0a_Tx: ComBitPosition=311, ComBitSize=8, ComSignalType=UINT8, ComHandleId=9273, ComSystemTemplateSystemSignalRef=OBJ_CLS_TYPE2_PROB_016
          OBJ_CLS_TYPE5_PROB_016_oRDR_TRACKER_OBJ_016_oPCAN_RADAR_91db9baa_Tx: ComBitPosition=335, ComBitSize=8, ComSignalType=UINT8, ComHandleId=9279, ComSystemTemplateSystemSignalRef=OBJ_CLS_TYPE5_PROB_016
          OBJ_EXISTENCE_PROB_016_oRDR_TRACKER_OBJ_016_oPCAN_RADAR_9451b120_Tx: ComBitPosition=229, ComBitSize=14, ComSignalType=UINT16, ComHandleId=9286, ComSystemTemplateSystemSignalRef=OBJ_EXISTENCE_PROB_016
          OBJ_DIMENSION_WIDTH_016_oRDR_TRACKER_OBJ_016_oPCAN_RADAR_9fed351d_Tx: ComBitPosition=17, ComBitSize=10, ComSignalType=UINT16, ComHandleId=9284, ComSystemTemplateSystemSignalRef=OBJ_DIMENSION_WIDTH_016
          OBJ_DIMENSION_LENGTH_016_oRDR_TRACKER_OBJ_016_oPCAN_RADAR_bc23c2b0_Tx: ComBitPosition=37, ComBitSize=12, ComSignalType=UINT16, ComHandleId=9282, ComSystemTemplateSystemSignalRef=OBJ_DIMENSION_LENGTH_016
          OBJ_CLS_TYPE3_016_oRDR_TRACKER_OBJ_016_oPCAN_RADAR_3edd6c71_Tx: ComBitPosition=279, ComBitSize=4, ComSignalType=UINT8, ComHandleId=9274, ComSystemTemplateSystemSignalRef=OBJ_CLS_TYPE3_016
          OBJ_YAW_RATE_016_oRDR_TRACKER_OBJ_016_oPCAN_RADAR_41f1702d_Tx: ComBitPosition=399, ComBitSize=10, ComSignalType=UINT16, ComHandleId=9311, ComSystemTemplateSystemSignalRef=OBJ_YAW_RATE_016
          OBJ_REF_PT_LAT_OFFSET_016_oRDR_TRACKER_OBJ_016_oPCAN_RADAR_1b53697f_Tx: ComBitPosition=370, ComBitSize=14, ComSignalType=UINT16, ComHandleId=9299, ComSystemTemplateSystemSignalRef=OBJ_REF_PT_LAT_OFFSET_016
          OBJ_YAW_ANGLE_ERR_016_oRDR_TRACKER_OBJ_016_oPCAN_RADAR_b17353bd_Tx: ComBitPosition=175, ComBitSize=7, ComSignalType=UINT8, ComHandleId=9310, ComSystemTemplateSystemSignalRef=OBJ_YAW_ANGLE_ERR_016
          OBJ_CLS_TYPE6_016_oRDR_TRACKER_OBJ_016_oPCAN_RADAR_e8e56cd8_Tx: ComBitPosition=282, ComBitSize=4, ComSignalType=UINT8, ComHandleId=9280, ComSystemTemplateSystemSignalRef=OBJ_CLS_TYPE6_016
          OBJ_DIMENSION_LENGTH_ERR_016_oRDR_TRACKER_OBJ_016_oPCAN_RADAR_87dbddca_Tx: ComBitPosition=41, ComBitSize=10, ComSignalType=UINT16, ComHandleId=9283, ComSystemTemplateSystemSignalRef=OBJ_DIMENSION_LENGTH_ERR_016
          OBJ_CLS_TYPE1_016_oRDR_TRACKER_OBJ_016_oPCAN_RADAR_febd91f4_Tx: ComBitPosition=271, ComBitSize=4, ComSignalType=UINT8, ComHandleId=9270, ComSystemTemplateSystemSignalRef=OBJ_CLS_TYPE1_016
          OBJ_CLS_TYPE6_PROB_016_oRDR_TRACKER_OBJ_016_oPCAN_RADAR_58ef80a7_Tx: ComBitPosition=343, ComBitSize=8, ComSignalType=UINT8, ComHandleId=9281, ComSystemTemplateSystemSignalRef=OBJ_CLS_TYPE6_PROB_016
          OBJ_POS_LAT_ERR_016_oRDR_TRACKER_OBJ_016_oPCAN_RADAR_c8ed043a_Tx: ComBitPosition=103, ComBitSize=8, ComSignalType=UINT8, ComHandleId=9295, ComSystemTemplateSystemSignalRef=OBJ_POS_LAT_ERR_016
          OBJ_CLS_TYPE5_016_oRDR_TRACKER_OBJ_016_oPCAN_RADAR_a50d6cbf_Tx: ComBitPosition=287, ComBitSize=4, ComSignalType=UINT8, ComHandleId=9278, ComSystemTemplateSystemSignalRef=OBJ_CLS_TYPE5_016
          OBJ_POS_LONG_016_oRDR_TRACKER_OBJ_016_oPCAN_RADAR_7d01bfc2_Tx: ComBitPosition=63, ComBitSize=16, ComSignalType=UINT16, ComHandleId=9296, ComSystemTemplateSystemSignalRef=OBJ_POS_LONG_016
          OBJ_ACCELERATION_LAT_016_oRDR_TRACKER_OBJ_016_oPCAN_RADAR_7bf7628e_Tx: ComBitPosition=177, ComBitSize=10, ComSignalType=UINT16, ComHandleId=9264, ComSystemTemplateSystemSignalRef=OBJ_ACCELERATION_LAT_016
          OBJ_POS_LONG_ERR_016_oRDR_TRACKER_OBJ_016_oPCAN_RADAR_5115fad8_Tx: ComBitPosition=95, ComBitSize=8, ComSignalType=UINT8, ComHandleId=9297, ComSystemTemplateSystemSignalRef=OBJ_POS_LONG_ERR_016
          OBJ_MEASUREMENT_STATUS_016_oRDR_TRACKER_OBJ_016_oPCAN_RADAR_91dffc37_Tx: ComBitPosition=14, ComBitSize=3, ComSignalType=UINT8, ComHandleId=9289, ComSystemTemplateSystemSignalRef=OBJ_MEASUREMENT_STATUS_016
          OBJ_CLS_TYPE2_016_oRDR_TRACKER_OBJ_016_oPCAN_RADAR_b3559193_Tx: ComBitPosition=267, ComBitSize=4, ComSignalType=UINT8, ComHandleId=9272, ComSystemTemplateSystemSignalRef=OBJ_CLS_TYPE2_016
          OBJ_GROUP_ID_016_oRDR_TRACKER_OBJ_016_oPCAN_RADAR_1d23a58d_Tx: ComBitPosition=405, ComBitSize=6, ComSignalType=UINT8, ComHandleId=9287, ComSystemTemplateSystemSignalRef=OBJ_GROUP_ID_016
          OBJ_MH_CYCLE_COUNTER_016_oRDR_TRACKER_OBJ_016_oPCAN_RADAR_9c5b11ea_Tx: ComBitPosition=487, ComBitSize=8, ComSignalType=UINT8, ComHandleId=9291, ComSystemTemplateSystemSignalRef=OBJ_MH_CYCLE_COUNTER_016
          OBJ_MH_CRC16_016_oRDR_TRACKER_OBJ_016_oPCAN_RADAR_edbf4b0b_Tx: ComBitPosition=495, ComBitSize=16, ComSignalType=UINT16, ComHandleId=9290, ComSystemTemplateSystemSignalRef=OBJ_MH_CRC16_016
      RDR_DETECTION_009_012_oPCAN_RADAR_6bb87175_Tx (ComIPdu):
        ComIPduDirection = SEND
        ComIPduType = NORMAL
        ComIPduCancellationSupport = false
        ComIPduHandleId = 8
        ComIPduSignalProcessing = DEFERRED
        ComIPduChannelRef = CN_PCAN_RADAR_458ff0f1
        ComIPduGroupRef = RDR01_oPCAN_RADAR_Tx_b6bdb067 if post-build-variant-condition{matching-criterion=RDR_POS, value=0}
        ComIPduSignalGroupRef = SG_Detections_009_012_oRDR_DETECTION_009_012_oPCAN_RADAR_37f1858c_Tx
        ComPduIdRef = RDR_DETECTION_009_012_oPCAN_RADAR_6bb87175_Tx
        ComIPduMainFunctionRef = ComMainFunctionTx_Event
        ComIPduGroupRef = RDR02_oPCAN_RADAR_Tx_9f750495 if post-build-variant-condition{matching-criterion=RDR_POS, value=1}
        ComIPduGroupRef = RDR03_oPCAN_RADAR_Tx_311d9504 if post-build-variant-condition{matching-criterion=RDR_POS, value=2}
        ComIPduGroupRef = RDR04_oPCAN_RADAR_Tx_cce46d71 if post-build-variant-condition{matching-criterion=RDR_POS, value=3}
        ComIPduGroupRef = RDR05_oPCAN_RADAR_Tx_628cfce0 if post-build-variant-condition{matching-criterion=RDR_POS, value=4}
        ComIPduGroupRef = RDR06_oPCAN_RADAR_Tx_4b444812 if post-build-variant-condition{matching-criterion=RDR_POS, value=5}
        ComIPduGroupRef = RDR07_oPCAN_RADAR_Tx_e52cd983 if post-build-variant-condition{matching-criterion=RDR_POS, value=6}
        ComIPduGroupRef = RDR08_oPCAN_RADAR_Tx_6bc6beb9 if post-build-variant-condition{matching-criterion=RDR_POS, value=7}
        ComTxIPdu: ComMinimumDelayTime=0, ComTxIPduUnusedAreasDefault=0
          ComTxModeTrue
            ComTxMode: ComTxModeMode=DIRECT, ComTxModeNumberOfRepetitions=0
          ComTxModeFalse
            ComTxMode: ComTxModeMode=NONE
      RDR_DETECTION_105_108_oPCAN_RADAR_37e9c5c4_Tx (ComIPdu):
        ComIPduDirection = SEND
        ComIPduType = NORMAL
        ComIPduCancellationSupport = false
        ComIPduHandleId = 32
        ComIPduSignalProcessing = DEFERRED
        ComIPduChannelRef = CN_PCAN_RADAR_458ff0f1
        ComIPduGroupRef = RDR01_oPCAN_RADAR_Tx_b6bdb067 if post-build-variant-condition{matching-criterion=RDR_POS, value=0}
        ComIPduSignalGroupRef = SG_Detections_105_108_oRDR_DETECTION_105_108_oPCAN_RADAR_ec23834b_Tx
        ComPduIdRef = RDR_DETECTION_105_108_oPCAN_RADAR_37e9c5c4_Tx
        ComIPduMainFunctionRef = ComMainFunctionTx_Event
        ComIPduGroupRef = RDR02_oPCAN_RADAR_Tx_9f750495 if post-build-variant-condition{matching-criterion=RDR_POS, value=1}
        ComIPduGroupRef = RDR03_oPCAN_RADAR_Tx_311d9504 if post-build-variant-condition{matching-criterion=RDR_POS, value=2}
        ComIPduGroupRef = RDR04_oPCAN_RADAR_Tx_cce46d71 if post-build-variant-condition{matching-criterion=RDR_POS, value=3}
        ComIPduGroupRef = RDR05_oPCAN_RADAR_Tx_628cfce0 if post-build-variant-condition{matching-criterion=RDR_POS, value=4}
        ComIPduGroupRef = RDR06_oPCAN_RADAR_Tx_4b444812 if post-build-variant-condition{matching-criterion=RDR_POS, value=5}
        ComIPduGroupRef = RDR07_oPCAN_RADAR_Tx_e52cd983 if post-build-variant-condition{matching-criterion=RDR_POS, value=6}
        ComIPduGroupRef = RDR08_oPCAN_RADAR_Tx_6bc6beb9 if post-build-variant-condition{matching-criterion=RDR_POS, value=7}
        ComTxIPdu: ComMinimumDelayTime=0, ComTxIPduUnusedAreasDefault=0
          ComTxModeTrue
            ComTxMode: ComTxModeMode=DIRECT, ComTxModeNumberOfRepetitions=0
          ComTxModeFalse
            ComTxMode: ComTxModeMode=NONE
      SG_TrackerObject015_oRDR_TRACKER_OBJ_015_oPCAN_RADAR_a59fa66d_Tx (ComSignalGroup):
        ComTransferProperty = TRIGGERED
        ComSignalGroupAccess = ACCESS_NEEDED_BY_SWC_OR_COM
        ComHandleId = 124
        ComSignalGroupArrayAccess = true
        ComSystemTemplateSignalGroupRef = SG_TrackerObject015
        49 x ComGroupSignal, all with ComSignalEndianness=BIG_ENDIAN, ComSignalInitValue=0, ComTransferProperty=PENDING, ComSignalAccess=ACCESS_NEEDED_BY_SWC_OR_COM:
          OBJ_YAW_RATE_ERR_015_oRDR_TRACKER_OBJ_015_oPCAN_RADAR_ae657865_Tx: ComBitPosition=388, ComBitSize=5, ComSignalType=UINT8, ComHandleId=9263, ComSystemTemplateSystemSignalRef=OBJ_YAW_RATE_ERR_015
          OBJ_EXISTENCE_PROB_015_oRDR_TRACKER_OBJ_015_oPCAN_RADAR_441d2eb4_Tx: ComBitPosition=229, ComBitSize=14, ComSignalType=UINT16, ComHandleId=9237, ComSystemTemplateSystemSignalRef=OBJ_EXISTENCE_PROB_015
          OBJ_ACCELERATION_LONG_015_oRDR_TRACKER_OBJ_015_oPCAN_RADAR_d94ba4fa_Tx: ComBitPosition=193, ComBitSize=10, ComSignalType=UINT16, ComHandleId=9217, ComSystemTemplateSystemSignalRef=OBJ_ACCELERATION_LONG_015
          OBJ_ACCELERATION_LONG_ERR_015_oRDR_TRACKER_OBJ_015_oPCAN_RADAR_61ea620e_Tx: ComBitPosition=215, ComBitSize=8, ComSignalType=UINT8, ComHandleId=9218, ComSystemTemplateSystemSignalRef=OBJ_ACCELERATION_LONG_ERR_015
          OBJ_CLS_TYPE5_015_oRDR_TRACKER_OBJ_015_oPCAN_RADAR_7541f32b_Tx: ComBitPosition=287, ComBitSize=4, ComSignalType=UINT8, ComHandleId=9229, ComSystemTemplateSystemSignalRef=OBJ_CLS_TYPE5_015
          OBJ_ID_015_oRDR_TRACKER_OBJ_015_oPCAN_RADAR_3e41111e_Tx: ComBitPosition=7, ComBitSize=8, ComSignalType=UINT8, ComHandleId=9239, ComSystemTemplateSystemSignalRef=OBJ_ID_015
          OBJ_ACCELERATION_LAT_015_oRDR_TRACKER_OBJ_015_oPCAN_RADAR_abbbfd1a_Tx: ComBitPosition=177, ComBitSize=10, ComSignalType=UINT16, ComHandleId=9215, ComSystemTemplateSystemSignalRef=OBJ_ACCELERATION_LAT_015
          OBJ_POS_LAT_ERR_015_oRDR_TRACKER_OBJ_015_oPCAN_RADAR_18a19bae_Tx: ComBitPosition=103, ComBitSize=8, ComSignalType=UINT8, ComHandleId=9246, ComSystemTemplateSystemSignalRef=OBJ_POS_LAT_ERR_015
          OBJ_CLS_TYPE3_015_oRDR_TRACKER_OBJ_015_oPCAN_RADAR_ee91f3e5_Tx: ComBitPosition=279, ComBitSize=4, ComSignalType=UINT8, ComHandleId=9225, ComSystemTemplateSystemSignalRef=OBJ_CLS_TYPE3_015
          OBJ_REF_PT_LAT_OFFSET_015_oRDR_TRACKER_OBJ_015_oPCAN_RADAR_cb1ff6eb_Tx: ComBitPosition=370, ComBitSize=14, ComSignalType=UINT16, ComHandleId=9250, ComSystemTemplateSystemSignalRef=OBJ_REF_PT_LAT_OFFSET_015
          OBJ_TRACK_MOTION_MODEL_015_oRDR_TRACKER_OBJ_015_oPCAN_RADAR_f28d9c15_Tx: ComBitPosition=9, ComBitSize=2, ComSignalType=UINT8, ComHandleId=9253, ComSystemTemplateSystemSignalRef=OBJ_TRACK_MOTION_MODEL_015
          OBJ_CLS_TYPE1_015_oRDR_TRACKER_OBJ_015_oPCAN_RADAR_2ef10e60_Tx: ComBitPosition=271, ComBitSize=4, ComSignalType=UINT8, ComHandleId=9221, ComSystemTemplateSystemSignalRef=OBJ_CLS_TYPE1_015
          OBJ_DIMENSION_WIDTH_015_oRDR_TRACKER_OBJ_015_oPCAN_RADAR_4fa1aa89_Tx: ComBitPosition=17, ComBitSize=10, ComSignalType=UINT16, ComHandleId=9235, ComSystemTemplateSystemSignalRef=OBJ_DIMENSION_WIDTH_015
          OBJ_VELOCITY_LAT_ERR_015_oRDR_TRACKER_OBJ_015_oPCAN_RADAR_6c74feef_Tx: ComBitPosition=151, ComBitSize=8, ComSignalType=UINT8, ComHandleId=9257, ComSystemTemplateSystemSignalRef=OBJ_VELOCITY_LAT_ERR_015
          OBJ_CLS_TYPE6_PROB_015_oRDR_TRACKER_OBJ_015_oPCAN_RADAR_88a31f33_Tx: ComBitPosition=343, ComBitSize=8, ComSignalType=UINT8, ComHandleId=9232, ComSystemTemplateSystemSignalRef=OBJ_CLS_TYPE6_PROB_015
          OBJ_VELOCITY_ERR_CRR_COEF_015_oRDR_TRACKER_OBJ_015_oPCAN_RADAR_57380b34_Tx: ComBitPosition=423, ComBitSize=8, ComSignalType=UINT8, ComHandleId=9255, ComSystemTemplateSystemSignalRef=OBJ_VELOCITY_ERR_CRR_COEF_015
          OBJ_MOVEMENT_STATUS_015_oRDR_TRACKER_OBJ_015_oPCAN_RADAR_6e3df6ef_Tx: ComBitPosition=196, ComBitSize=3, ComSignalType=UINT8, ComHandleId=9243, ComSystemTemplateSystemSignalRef=OBJ_MOVEMENT_STATUS_015
          OBJ_YAW_ANGLE_015_oRDR_TRACKER_OBJ_015_oPCAN_RADAR_b432cafe_Tx: ComBitPosition=155, ComBitSize=12, ComSignalType=UINT16, ComHandleId=9260, ComSystemTemplateSystemSignalRef=OBJ_YAW_ANGLE_015
          OBJ_ALIVE_TIME_015_oRDR_TRACKER_OBJ_015_oPCAN_RADAR_b92aef46_Tx: ComBitPosition=255, ComBitSize=16, ComSignalType=UINT16, ComHandleId=9220, ComSystemTemplateSystemSignalRef=OBJ_ALIVE_TIME_015
          OBJ_GROUP_ID_015_oRDR_TRACKER_OBJ_015_oPCAN_RADAR_cd6f3a19_Tx: ComBitPosition=405, ComBitSize=6, ComSignalType=UINT8, ComHandleId=9238, ComSystemTemplateSystemSignalRef=OBJ_GROUP_ID_015
          OBJ_ACCEL_ERR_CRR_COEF_015_oRDR_TRACKER_OBJ_015_oPCAN_RADAR_c1494368_Tx: ComBitPosition=431, ComBitSize=8, ComSignalType=UINT8, ComHandleId=9219, ComSystemTemplateSystemSignalRef=OBJ_ACCEL_ERR_CRR_COEF_015
          OBJ_CLS_TYPE1_PROB_015_oRDR_TRACKER_OBJ_015_oPCAN_RADAR_86a9d993_Tx: ComBitPosition=303, ComBitSize=8, ComSignalType=UINT8, ComHandleId=9222, ComSystemTemplateSystemSignalRef=OBJ_CLS_TYPE1_PROB_015
          OBJ_ACCELERATION_LAT_ERR_015_oRDR_TRACKER_OBJ_015_oPCAN_RADAR_7e4fc7a4_Tx: ComBitPosition=223, ComBitSize=8, ComSignalType=UINT8, ComHandleId=9216, ComSystemTemplateSystemSignalRef=OBJ_ACCELERATION_LAT_ERR_015
          OBJ_DIMENSION_LENGTH_015_oRDR_TRACKER_OBJ_015_oPCAN_RADAR_6c6f5d24_Tx: ComBitPosition=37, ComBitSize=12, ComSignalType=UINT16, ComHandleId=9233, ComSystemTemplateSystemSignalRef=OBJ_DIMENSION_LENGTH_015
          OBJ_POS_LONG_ERR_015_oRDR_TRACKER_OBJ_015_oPCAN_RADAR_8159654c_Tx: ComBitPosition=95, ComBitSize=8, ComSignalType=UINT8, ComHandleId=9248, ComSystemTemplateSystemSignalRef=OBJ_POS_LONG_ERR_015
          OBJ_VELOCITY_LONG_015_oRDR_TRACKER_OBJ_015_oPCAN_RADAR_0803f678_Tx: ComBitPosition=110, ComBitSize=15, ComSignalType=UINT16, ComHandleId=9258, ComSystemTemplateSystemSignalRef=OBJ_VELOCITY_LONG_015
          OBJ_DIMENSION_WIDTH_ERR_015_oRDR_TRACKER_OBJ_015_oPCAN_RADAR_af036d61_Tx: ComBitPosition=23, ComBitSize=6, ComSignalType=UINT8, ComHandleId=9236, ComSystemTemplateSystemSignalRef=OBJ_DIMENSION_WIDTH_ERR_015
          OBJ_POS_ERR_CRR_COEF_015_oRDR_TRACKER_OBJ_015_oPCAN_RADAR_fe4236d5_Tx: ComBitPosition=415, ComBitSize=8, ComSignalType=UINT8, ComHandleId=9244, ComSystemTemplateSystemSignalRef=OBJ_POS_ERR_CRR_COEF_015
          OBJ_RCS_015_oRDR_TRACKER_OBJ_015_oPCAN_RADAR_3e229d9e_Tx: ComBitPosition=351, ComBitSize=7, ComSignalType=UINT8, ComHandleId=9249, ComSystemTemplateSystemSignalRef=OBJ_RCS_015
          OBJ_CLS_TYPE5_PROB_015_oRDR_TRACKER_OBJ_015_oPCAN_RADAR_4197043e_Tx: ComBitPosition=335, ComBitSize=8, ComSignalType=UINT8, ComHandleId=9230, ComSystemTemplateSystemSignalRef=OBJ_CLS_TYPE5_PROB_015
          OBJ_DIMENSION_LENGTH_ERR_015_oRDR_TRACKER_OBJ_015_oPCAN_RADAR_5797425e_Tx: ComBitPosition=41, ComBitSize=10, ComSignalType=UINT16, ComHandleId=9234, ComSystemTemplateSystemSignalRef=OBJ_DIMENSION_LENGTH_ERR_015
          OBJ_CLS_TYPE2_PROB_015_oRDR_TRACKER_OBJ_015_oPCAN_RADAR_4f9dc29e_Tx: ComBitPosition=311, ComBitSize=8, ComSignalType=UINT8, ComHandleId=9224, ComSystemTemplateSystemSignalRef=OBJ_CLS_TYPE2_PROB_015
          OBJ_CLS_TYPE6_015_oRDR_TRACKER_OBJ_015_oPCAN_RADAR_38a9f34c_Tx: ComBitPosition=282, ComBitSize=4, ComSignalType=UINT8, ComHandleId=9231, ComSystemTemplateSystemSignalRef=OBJ_CLS_TYPE6_015
          OBJ_MEASUREMENT_STATUS_015_oRDR_TRACKER_OBJ_015_oPCAN_RADAR_419363a3_Tx: ComBitPosition=14, ComBitSize=3, ComSignalType=UINT8, ComHandleId=9240, ComSystemTemplateSystemSignalRef=OBJ_MEASUREMENT_STATUS_015
          OBJ_CLS_TYPE4_PROB_015_oRDR_TRACKER_OBJ_015_oPCAN_RADAR_0684f2c5_Tx: ComBitPosition=327, ComBitSize=8, ComSignalType=UINT8, ComHandleId=9228, ComSystemTemplateSystemSignalRef=OBJ_CLS_TYPE4_PROB_015
          OBJ_TIMESTAMP_OFFSET_015_oRDR_TRACKER_OBJ_015_oPCAN_RADAR_3e8e9dc8_Tx: ComBitPosition=247, ComBitSize=8, ComSignalType=UINT8, ComHandleId=9252, ComSystemTemplateSystemSignalRef=OBJ_TIMESTAMP_OFFSET_015
          OBJ_VEH_TRACK_FLAG_015_oRDR_TRACKER_OBJ_015_oPCAN_RADAR_70a76a48_Tx: ComBitPosition=10, ComBitSize=1, ComSignalType=BOOLEAN, ComHandleId=9254, ComSystemTemplateSystemSignalRef=OBJ_VEH_TRACK_FLAG_015
          OBJ_YAW_ANGLE_ERR_015_oRDR_TRACKER_OBJ_015_oPCAN_RADAR_613fcc29_Tx: ComBitPosition=175, ComBitSize=7, ComSignalType=UINT8, ComHandleId=9261, ComSystemTemplateSystemSignalRef=OBJ_YAW_ANGLE_ERR_015
          OBJ_POS_LONG_015_oRDR_TRACKER_OBJ_015_oPCAN_RADAR_ad4d2056_Tx: ComBitPosition=63, ComBitSize=16, ComSignalType=UINT16, ComHandleId=9247, ComSystemTemplateSystemSignalRef=OBJ_POS_LONG_015
          OBJ_POS_LAT_015_oRDR_TRACKER_OBJ_015_oPCAN_RADAR_1cedcb99_Tx: ComBitPosition=79, ComBitSize=16, ComSignalType=UINT16, ComHandleId=9245, ComSystemTemplateSystemSignalRef=OBJ_POS_LAT_015
          OBJ_REF_PT_LONG_OFFSET_015_oRDR_TRACKER_OBJ_015_oPCAN_RADAR_844d06e8_Tx: ComBitPosition=357, ComBitSize=14, ComSignalType=UINT16, ComHandleId=9251, ComSystemTemplateSystemSignalRef=OBJ_REF_PT_LONG_OFFSET_015
          OBJ_CLS_TYPE2_015_oRDR_TRACKER_OBJ_015_oPCAN_RADAR_63190e07_Tx: ComBitPosition=267, ComBitSize=4, ComSignalType=UINT8, ComHandleId=9223, ComSystemTemplateSystemSignalRef=OBJ_CLS_TYPE2_015
          OBJ_VELOCITY_LONG_ERR_015_oRDR_TRACKER_OBJ_015_oPCAN_RADAR_80f6c12f_Tx: ComBitPosition=143, ComBitSize=8, ComSignalType=UINT8, ComHandleId=9259, ComSystemTemplateSystemSignalRef=OBJ_VELOCITY_LONG_ERR_015
          OBJ_YAW_RATE_015_oRDR_TRACKER_OBJ_015_oPCAN_RADAR_91bdefb9_Tx: ComBitPosition=399, ComBitSize=10, ComSignalType=UINT16, ComHandleId=9262, ComSystemTemplateSystemSignalRef=OBJ_YAW_RATE_015
          OBJ_CLS_TYPE4_015_oRDR_TRACKER_OBJ_015_oPCAN_RADAR_f8c90ec9_Tx: ComBitPosition=275, ComBitSize=4, ComSignalType=UINT8, ComHandleId=9227, ComSystemTemplateSystemSignalRef=OBJ_CLS_TYPE4_015
          OBJ_CLS_TYPE3_PROB_015_oRDR_TRACKER_OBJ_015_oPCAN_RADAR_088e3465_Tx: ComBitPosition=319, ComBitSize=8, ComSignalType=UINT8, ComHandleId=9226, ComSystemTemplateSystemSignalRef=OBJ_CLS_TYPE3_PROB_015
          OBJ_VELOCITY_LAT_015_oRDR_TRACKER_OBJ_015_oPCAN_RADAR_588e8ebe_Tx: ComBitPosition=126, ComBitSize=15, ComSignalType=UINT16, ComHandleId=9256, ComSystemTemplateSystemSignalRef=OBJ_VELOCITY_LAT_015
          OBJ_MH_CYCLE_COUNTER_015_oRDR_TRACKER_OBJ_015_oPCAN_RADAR_4c178e7e_Tx: ComBitPosition=487, ComBitSize=8, ComSignalType=UINT8, ComHandleId=9242, ComSystemTemplateSystemSignalRef=OBJ_MH_CYCLE_COUNTER_015
          OBJ_MH_CRC16_015_oRDR_TRACKER_OBJ_015_oPCAN_RADAR_3df3d49f_Tx: ComBitPosition=495, ComBitSize=16, ComSignalType=UINT16, ComHandleId=9241, ComSystemTemplateSystemSignalRef=OBJ_MH_CRC16_015
      RDR_TRACKER_OBJ_039_oPCAN_RADAR_08e50de0_Tx (ComIPdu):
        ComIPduDirection = SEND
        ComIPduType = NORMAL
        ComIPduCancellationSupport = false
        ComIPduHandleId = 149
        ComIPduSignalProcessing = DEFERRED
        ComIPduChannelRef = CN_PCAN_RADAR_458ff0f1
        ComIPduGroupRef = RDR01_oPCAN_RADAR_Tx_b6bdb067 if post-build-variant-condition{matching-criterion=RDR_POS, value=0}
        ComIPduSignalGroupRef = SG_TrackerObject039_oRDR_TRACKER_OBJ_039_oPCAN_RADAR_f76c39c3_Tx
        ComPduIdRef = RDR_TRACKER_OBJ_039_oPCAN_RADAR_08e50de0_Tx
        ComIPduMainFunctionRef = ComMainFunctionTx_Event
        ComIPduGroupRef = RDR02_oPCAN_RADAR_Tx_9f750495 if post-build-variant-condition{matching-criterion=RDR_POS, value=1}
        ComIPduGroupRef = RDR03_oPCAN_RADAR_Tx_311d9504 if post-build-variant-condition{matching-criterion=RDR_POS, value=2}
        ComIPduGroupRef = RDR04_oPCAN_RADAR_Tx_cce46d71 if post-build-variant-condition{matching-criterion=RDR_POS, value=3}
        ComIPduGroupRef = RDR05_oPCAN_RADAR_Tx_628cfce0 if post-build-variant-condition{matching-criterion=RDR_POS, value=4}
        ComIPduGroupRef = RDR06_oPCAN_RADAR_Tx_4b444812 if post-build-variant-condition{matching-criterion=RDR_POS, value=5}
        ComIPduGroupRef = RDR07_oPCAN_RADAR_Tx_e52cd983 if post-build-variant-condition{matching-criterion=RDR_POS, value=6}
        ComIPduGroupRef = RDR08_oPCAN_RADAR_Tx_6bc6beb9 if post-build-variant-condition{matching-criterion=RDR_POS, value=7}
        ComTxIPdu: ComMinimumDelayTime=0, ComTxIPduUnusedAreasDefault=0
          ComTxModeTrue
            ComTxMode: ComTxModeMode=DIRECT, ComTxModeNumberOfRepetitions=0
          ComTxModeFalse
            ComTxMode: ComTxModeMode=NONE
      SG_TrackerObject028_oRDR_TRACKER_OBJ_028_oPCAN_RADAR_5ce947ce_Tx (ComSignalGroup):
        ComTransferProperty = TRIGGERED
        ComSignalGroupAccess = ACCESS_NEEDED_BY_SWC_OR_COM
        ComHandleId = 137
        ComSignalGroupArrayAccess = true
        ComSystemTemplateSignalGroupRef = SG_TrackerObject028
        49 x ComGroupSignal, all with ComSignalEndianness=BIG_ENDIAN, ComSignalInitValue=0, ComTransferProperty=PENDING, ComSignalAccess=ACCESS_NEEDED_BY_SWC_OR_COM:
          OBJ_YAW_RATE_ERR_028_oRDR_TRACKER_OBJ_028_oPCAN_RADAR_571399c6_Tx: ComBitPosition=388, ComBitSize=5, ComSignalType=UINT8, ComHandleId=9900, ComSystemTemplateSystemSignalRef=OBJ_YAW_RATE_ERR_028
          OBJ_ACCELERATION_LAT_028_oRDR_TRACKER_OBJ_028_oPCAN_RADAR_52cd1cb9_Tx: ComBitPosition=177, ComBitSize=10, ComSignalType=UINT16, ComHandleId=9852, ComSystemTemplateSystemSignalRef=OBJ_ACCELERATION_LAT_028
          OBJ_CLS_TYPE2_PROB_028_oRDR_TRACKER_OBJ_028_oPCAN_RADAR_b6eb233d_Tx: ComBitPosition=311, ComBitSize=8, ComSignalType=UINT8, ComHandleId=9861, ComSystemTemplateSystemSignalRef=OBJ_CLS_TYPE2_PROB_028
          OBJ_YAW_ANGLE_028_oRDR_TRACKER_OBJ_028_oPCAN_RADAR_4d442b5d_Tx: ComBitPosition=155, ComBitSize=12, ComSignalType=UINT16, ComHandleId=9897, ComSystemTemplateSystemSignalRef=OBJ_YAW_ANGLE_028
          OBJ_CLS_TYPE4_PROB_028_oRDR_TRACKER_OBJ_028_oPCAN_RADAR_fff21366_Tx: ComBitPosition=327, ComBitSize=8, ComSignalType=UINT8, ComHandleId=9865, ComSystemTemplateSystemSignalRef=OBJ_CLS_TYPE4_PROB_028
          OBJ_CLS_TYPE5_PROB_028_oRDR_TRACKER_OBJ_028_oPCAN_RADAR_b8e1e59d_Tx: ComBitPosition=335, ComBitSize=8, ComSignalType=UINT8, ComHandleId=9867, ComSystemTemplateSystemSignalRef=OBJ_CLS_TYPE5_PROB_028
          OBJ_REF_PT_LAT_OFFSET_028_oRDR_TRACKER_OBJ_028_oPCAN_RADAR_32691748_Tx: ComBitPosition=370, ComBitSize=14, ComSignalType=UINT16, ComHandleId=9887, ComSystemTemplateSystemSignalRef=OBJ_REF_PT_LAT_OFFSET_028
          OBJ_YAW_RATE_028_oRDR_TRACKER_OBJ_028_oPCAN_RADAR_68cb0e1a_Tx: ComBitPosition=399, ComBitSize=10, ComSignalType=UINT16, ComHandleId=9899, ComSystemTemplateSystemSignalRef=OBJ_YAW_RATE_028
          OBJ_CLS_TYPE3_028_oRDR_TRACKER_OBJ_028_oPCAN_RADAR_17e71246_Tx: ComBitPosition=279, ComBitSize=4, ComSignalType=UINT8, ComHandleId=9862, ComSystemTemplateSystemSignalRef=OBJ_CLS_TYPE3_028
          OBJ_TIMESTAMP_OFFSET_028_oRDR_TRACKER_OBJ_028_oPCAN_RADAR_c7f87c6b_Tx: ComBitPosition=247, ComBitSize=8, ComSignalType=UINT8, ComHandleId=9889, ComSystemTemplateSystemSignalRef=OBJ_TIMESTAMP_OFFSET_028
          OBJ_DIMENSION_WIDTH_ERR_028_oRDR_TRACKER_OBJ_028_oPCAN_RADAR_56758cc2_Tx: ComBitPosition=23, ComBitSize=6, ComSignalType=UINT8, ComHandleId=9873, ComSystemTemplateSystemSignalRef=OBJ_DIMENSION_WIDTH_ERR_028
          OBJ_REF_PT_LONG_OFFSET_028_oRDR_TRACKER_OBJ_028_oPCAN_RADAR_7d3be74b_Tx: ComBitPosition=357, ComBitSize=14, ComSignalType=UINT16, ComHandleId=9888, ComSystemTemplateSystemSignalRef=OBJ_REF_PT_LONG_OFFSET_028
          OBJ_DIMENSION_LENGTH_028_oRDR_TRACKER_OBJ_028_oPCAN_RADAR_9519bc87_Tx: ComBitPosition=37, ComBitSize=12, ComSignalType=UINT16, ComHandleId=9870, ComSystemTemplateSystemSignalRef=OBJ_DIMENSION_LENGTH_028
          OBJ_VELOCITY_LONG_028_oRDR_TRACKER_OBJ_028_oPCAN_RADAR_f17517db_Tx: ComBitPosition=110, ComBitSize=15, ComSignalType=UINT16, ComHandleId=9895, ComSystemTemplateSystemSignalRef=OBJ_VELOCITY_LONG_028
          OBJ_DIMENSION_LENGTH_ERR_028_oRDR_TRACKER_OBJ_028_oPCAN_RADAR_aee1a3fd_Tx: ComBitPosition=41, ComBitSize=10, ComSignalType=UINT16, ComHandleId=9871, ComSystemTemplateSystemSignalRef=OBJ_DIMENSION_LENGTH_ERR_028
          OBJ_CLS_TYPE2_028_oRDR_TRACKER_OBJ_028_oPCAN_RADAR_9a6fefa4_Tx: ComBitPosition=267, ComBitSize=4, ComSignalType=UINT8, ComHandleId=9860, ComSystemTemplateSystemSignalRef=OBJ_CLS_TYPE2_028
          OBJ_VEH_TRACK_FLAG_028_oRDR_TRACKER_OBJ_028_oPCAN_RADAR_89d18beb_Tx: ComBitPosition=10, ComBitSize=1, ComSignalType=BOOLEAN, ComHandleId=9891, ComSystemTemplateSystemSignalRef=OBJ_VEH_TRACK_FLAG_028
          OBJ_CLS_TYPE5_028_oRDR_TRACKER_OBJ_028_oPCAN_RADAR_8c371288_Tx: ComBitPosition=287, ComBitSize=4, ComSignalType=UINT8, ComHandleId=9866, ComSystemTemplateSystemSignalRef=OBJ_CLS_TYPE5_028
          OBJ_CLS_TYPE1_PROB_028_oRDR_TRACKER_OBJ_028_oPCAN_RADAR_7fdf3830_Tx: ComBitPosition=303, ComBitSize=8, ComSignalType=UINT8, ComHandleId=9859, ComSystemTemplateSystemSignalRef=OBJ_CLS_TYPE1_PROB_028
          OBJ_VELOCITY_LAT_028_oRDR_TRACKER_OBJ_028_oPCAN_RADAR_a1f86f1d_Tx: ComBitPosition=126, ComBitSize=15, ComSignalType=UINT16, ComHandleId=9893, ComSystemTemplateSystemSignalRef=OBJ_VELOCITY_LAT_028
          OBJ_ALIVE_TIME_028_oRDR_TRACKER_OBJ_028_oPCAN_RADAR_405c0ee5_Tx: ComBitPosition=255, ComBitSize=16, ComSignalType=UINT16, ComHandleId=9857, ComSystemTemplateSystemSignalRef=OBJ_ALIVE_TIME_028
          OBJ_CLS_TYPE1_028_oRDR_TRACKER_OBJ_028_oPCAN_RADAR_d787efc3_Tx: ComBitPosition=271, ComBitSize=4, ComSignalType=UINT8, ComHandleId=9858, ComSystemTemplateSystemSignalRef=OBJ_CLS_TYPE1_028
          OBJ_POS_LONG_ERR_028_oRDR_TRACKER_OBJ_028_oPCAN_RADAR_782f84ef_Tx: ComBitPosition=95, ComBitSize=8, ComSignalType=UINT8, ComHandleId=9885, ComSystemTemplateSystemSignalRef=OBJ_POS_LONG_ERR_028
          OBJ_VELOCITY_LAT_ERR_028_oRDR_TRACKER_OBJ_028_oPCAN_RADAR_95021f4c_Tx: ComBitPosition=151, ComBitSize=8, ComSignalType=UINT8, ComHandleId=9894, ComSystemTemplateSystemSignalRef=OBJ_VELOCITY_LAT_ERR_028
          OBJ_ACCEL_ERR_CRR_COEF_028_oRDR_TRACKER_OBJ_028_oPCAN_RADAR_383fa2cb_Tx: ComBitPosition=431, ComBitSize=8, ComSignalType=UINT8, ComHandleId=9856, ComSystemTemplateSystemSignalRef=OBJ_ACCEL_ERR_CRR_COEF_028
          OBJ_CLS_TYPE6_PROB_028_oRDR_TRACKER_OBJ_028_oPCAN_RADAR_71d5fe90_Tx: ComBitPosition=343, ComBitSize=8, ComSignalType=UINT8, ComHandleId=9869, ComSystemTemplateSystemSignalRef=OBJ_CLS_TYPE6_PROB_028
          OBJ_CLS_TYPE3_PROB_028_oRDR_TRACKER_OBJ_028_oPCAN_RADAR_f1f8d5c6_Tx: ComBitPosition=319, ComBitSize=8, ComSignalType=UINT8, ComHandleId=9863, ComSystemTemplateSystemSignalRef=OBJ_CLS_TYPE3_PROB_028
          OBJ_MOVEMENT_STATUS_028_oRDR_TRACKER_OBJ_028_oPCAN_RADAR_974b174c_Tx: ComBitPosition=196, ComBitSize=3, ComSignalType=UINT8, ComHandleId=9880, ComSystemTemplateSystemSignalRef=OBJ_MOVEMENT_STATUS_028
          OBJ_ID_028_oRDR_TRACKER_OBJ_028_oPCAN_RADAR_c737f0bd_Tx: ComBitPosition=7, ComBitSize=8, ComSignalType=UINT8, ComHandleId=9876, ComSystemTemplateSystemSignalRef=OBJ_ID_028
          OBJ_ACCELERATION_LONG_028_oRDR_TRACKER_OBJ_028_oPCAN_RADAR_203d4559_Tx: ComBitPosition=193, ComBitSize=10, ComSignalType=UINT16, ComHandleId=9854, ComSystemTemplateSystemSignalRef=OBJ_ACCELERATION_LONG_028
          OBJ_DIMENSION_WIDTH_028_oRDR_TRACKER_OBJ_028_oPCAN_RADAR_b6d74b2a_Tx: ComBitPosition=17, ComBitSize=10, ComSignalType=UINT16, ComHandleId=9872, ComSystemTemplateSystemSignalRef=OBJ_DIMENSION_WIDTH_028
          OBJ_POS_LAT_028_oRDR_TRACKER_OBJ_028_oPCAN_RADAR_e59b2a3a_Tx: ComBitPosition=79, ComBitSize=16, ComSignalType=UINT16, ComHandleId=9882, ComSystemTemplateSystemSignalRef=OBJ_POS_LAT_028
          OBJ_POS_LAT_ERR_028_oRDR_TRACKER_OBJ_028_oPCAN_RADAR_e1d77a0d_Tx: ComBitPosition=103, ComBitSize=8, ComSignalType=UINT8, ComHandleId=9883, ComSystemTemplateSystemSignalRef=OBJ_POS_LAT_ERR_028
          OBJ_POS_LONG_028_oRDR_TRACKER_OBJ_028_oPCAN_RADAR_543bc1f5_Tx: ComBitPosition=63, ComBitSize=16, ComSignalType=UINT16, ComHandleId=9884, ComSystemTemplateSystemSignalRef=OBJ_POS_LONG_028
          OBJ_YAW_ANGLE_ERR_028_oRDR_TRACKER_OBJ_028_oPCAN_RADAR_98492d8a_Tx: ComBitPosition=175, ComBitSize=7, ComSignalType=UINT8, ComHandleId=9898, ComSystemTemplateSystemSignalRef=OBJ_YAW_ANGLE_ERR_028
          OBJ_CLS_TYPE4_028_oRDR_TRACKER_OBJ_028_oPCAN_RADAR_01bfef6a_Tx: ComBitPosition=275, ComBitSize=4, ComSignalType=UINT8, ComHandleId=9864, ComSystemTemplateSystemSignalRef=OBJ_CLS_TYPE4_028
          OBJ_CLS_TYPE6_028_oRDR_TRACKER_OBJ_028_oPCAN_RADAR_c1df12ef_Tx: ComBitPosition=282, ComBitSize=4, ComSignalType=UINT8, ComHandleId=9868, ComSystemTemplateSystemSignalRef=OBJ_CLS_TYPE6_028
          OBJ_VELOCITY_LONG_ERR_028_oRDR_TRACKER_OBJ_028_oPCAN_RADAR_7980208c_Tx: ComBitPosition=143, ComBitSize=8, ComSignalType=UINT8, ComHandleId=9896, ComSystemTemplateSystemSignalRef=OBJ_VELOCITY_LONG_ERR_028
          OBJ_ACCELERATION_LAT_ERR_028_oRDR_TRACKER_OBJ_028_oPCAN_RADAR_87392607_Tx: ComBitPosition=223, ComBitSize=8, ComSignalType=UINT8, ComHandleId=9853, ComSystemTemplateSystemSignalRef=OBJ_ACCELERATION_LAT_ERR_028
          OBJ_ACCELERATION_LONG_ERR_028_oRDR_TRACKER_OBJ_028_oPCAN_RADAR_989c83ad_Tx: ComBitPosition=215, ComBitSize=8, ComSignalType=UINT8, ComHandleId=9855, ComSystemTemplateSystemSignalRef=OBJ_ACCELERATION_LONG_ERR_028
          OBJ_MEASUREMENT_STATUS_028_oRDR_TRACKER_OBJ_028_oPCAN_RADAR_b8e58200_Tx: ComBitPosition=14, ComBitSize=3, ComSignalType=UINT8, ComHandleId=9877, ComSystemTemplateSystemSignalRef=OBJ_MEASUREMENT_STATUS_028
          OBJ_EXISTENCE_PROB_028_oRDR_TRACKER_OBJ_028_oPCAN_RADAR_bd6bcf17_Tx: ComBitPosition=229, ComBitSize=14, ComSignalType=UINT16, ComHandleId=9874, ComSystemTemplateSystemSignalRef=OBJ_EXISTENCE_PROB_028
          OBJ_VELOCITY_ERR_CRR_COEF_028_oRDR_TRACKER_OBJ_028_oPCAN_RADAR_ae4eea97_Tx: ComBitPosition=423, ComBitSize=8, ComSignalType=UINT8, ComHandleId=9892, ComSystemTemplateSystemSignalRef=OBJ_VELOCITY_ERR_CRR_COEF_028
          OBJ_GROUP_ID_028_oRDR_TRACKER_OBJ_028_oPCAN_RADAR_3419dbba_Tx: ComBitPosition=405, ComBitSize=6, ComSignalType=UINT8, ComHandleId=9875, ComSystemTemplateSystemSignalRef=OBJ_GROUP_ID_028
          OBJ_POS_ERR_CRR_COEF_028_oRDR_TRACKER_OBJ_028_oPCAN_RADAR_0734d776_Tx: ComBitPosition=415, ComBitSize=8, ComSignalType=UINT8, ComHandleId=9881, ComSystemTemplateSystemSignalRef=OBJ_POS_ERR_CRR_COEF_028
          OBJ_RCS_028_oRDR_TRACKER_OBJ_028_oPCAN_RADAR_c7547c3d_Tx: ComBitPosition=351, ComBitSize=7, ComSignalType=UINT8, ComHandleId=9886, ComSystemTemplateSystemSignalRef=OBJ_RCS_028
          OBJ_TRACK_MOTION_MODEL_028_oRDR_TRACKER_OBJ_028_oPCAN_RADAR_0bfb7db6_Tx: ComBitPosition=9, ComBitSize=2, ComSignalType=UINT8, ComHandleId=9890, ComSystemTemplateSystemSignalRef=OBJ_TRACK_MOTION_MODEL_028
          OBJ_MH_CRC16_028_oRDR_TRACKER_OBJ_028_oPCAN_RADAR_c485353c_Tx: ComBitPosition=495, ComBitSize=16, ComSignalType=UINT16, ComHandleId=9878, ComSystemTemplateSystemSignalRef=OBJ_MH_CRC16_028
          OBJ_MH_CYCLE_COUNTER_028_oRDR_TRACKER_OBJ_028_oPCAN_RADAR_b5616fdd_Tx: ComBitPosition=487, ComBitSize=8, ComSignalType=UINT8, ComHandleId=9879, ComSystemTemplateSystemSignalRef=OBJ_MH_CYCLE_COUNTER_028
      RDR_DETECTION_217_220_oPCAN_RADAR_05c118f2_Tx (ComIPdu):
        ComIPduDirection = SEND
        ComIPduType = NORMAL
        ComIPduCancellationSupport = false
        ComIPduHandleId = 60
        ComIPduSignalProcessing = DEFERRED
        ComIPduChannelRef = CN_PCAN_RADAR_458ff0f1
        ComIPduGroupRef = RDR01_oPCAN_RADAR_Tx_b6bdb067 if post-build-variant-condition{matching-criterion=RDR_POS, value=0}
        ComIPduSignalGroupRef = SG_Detections_217_220_oRDR_DETECTION_217_220_oPCAN_RADAR_6c06fe56_Tx
        ComPduIdRef = RDR_DETECTION_217_220_oPCAN_RADAR_05c118f2_Tx
        ComIPduMainFunctionRef = ComMainFunctionTx_Event
        ComIPduGroupRef = RDR02_oPCAN_RADAR_Tx_9f750495 if post-build-variant-condition{matching-criterion=RDR_POS, value=1}
        ComIPduGroupRef = RDR03_oPCAN_RADAR_Tx_311d9504 if post-build-variant-condition{matching-criterion=RDR_POS, value=2}
        ComIPduGroupRef = RDR04_oPCAN_RADAR_Tx_cce46d71 if post-build-variant-condition{matching-criterion=RDR_POS, value=3}
        ComIPduGroupRef = RDR05_oPCAN_RADAR_Tx_628cfce0 if post-build-variant-condition{matching-criterion=RDR_POS, value=4}
        ComIPduGroupRef = RDR06_oPCAN_RADAR_Tx_4b444812 if post-build-variant-condition{matching-criterion=RDR_POS, value=5}
        ComIPduGroupRef = RDR07_oPCAN_RADAR_Tx_e52cd983 if post-build-variant-condition{matching-criterion=RDR_POS, value=6}
        ComIPduGroupRef = RDR08_oPCAN_RADAR_Tx_6bc6beb9 if post-build-variant-condition{matching-criterion=RDR_POS, value=7}
        ComTxIPdu: ComMinimumDelayTime=0, ComTxIPduUnusedAreasDefault=0
          ComTxModeTrue
            ComTxMode: ComTxModeMode=DIRECT, ComTxModeNumberOfRepetitions=0
          ComTxModeFalse
            ComTxMode: ComTxModeMode=NONE
      RDR_DETECTION_213_216_oPCAN_RADAR_aa4dc53b_Tx (ComIPdu):
        ComIPduDirection = SEND
        ComIPduType = NORMAL
        ComIPduCancellationSupport = false
        ComIPduHandleId = 59
        ComIPduSignalProcessing = DEFERRED
        ComIPduChannelRef = CN_PCAN_RADAR_458ff0f1
        ComIPduGroupRef = RDR01_oPCAN_RADAR_Tx_b6bdb067 if post-build-variant-condition{matching-criterion=RDR_POS, value=0}
        ComIPduSignalGroupRef = SG_Detections_213_216_oRDR_DETECTION_213_216_oPCAN_RADAR_80aaa8dc_Tx
        ComPduIdRef = RDR_DETECTION_213_216_oPCAN_RADAR_aa4dc53b_Tx
        ComIPduMainFunctionRef = ComMainFunctionTx_Event
        ComIPduGroupRef = RDR02_oPCAN_RADAR_Tx_9f750495 if post-build-variant-condition{matching-criterion=RDR_POS, value=1}
        ComIPduGroupRef = RDR03_oPCAN_RADAR_Tx_311d9504 if post-build-variant-condition{matching-criterion=RDR_POS, value=2}
        ComIPduGroupRef = RDR04_oPCAN_RADAR_Tx_cce46d71 if post-build-variant-condition{matching-criterion=RDR_POS, value=3}
        ComIPduGroupRef = RDR05_oPCAN_RADAR_Tx_628cfce0 if post-build-variant-condition{matching-criterion=RDR_POS, value=4}
        ComIPduGroupRef = RDR06_oPCAN_RADAR_Tx_4b444812 if post-build-variant-condition{matching-criterion=RDR_POS, value=5}
        ComIPduGroupRef = RDR07_oPCAN_RADAR_Tx_e52cd983 if post-build-variant-condition{matching-criterion=RDR_POS, value=6}
        ComIPduGroupRef = RDR08_oPCAN_RADAR_Tx_6bc6beb9 if post-build-variant-condition{matching-criterion=RDR_POS, value=7}
        ComTxIPdu: ComMinimumDelayTime=0, ComTxIPduUnusedAreasDefault=0
          ComTxModeTrue
            ComTxMode: ComTxModeMode=DIRECT, ComTxModeNumberOfRepetitions=0
          ComTxModeFalse
            ComTxMode: ComTxModeMode=NONE
      SG_TrackerObject014_oRDR_TRACKER_OBJ_014_oPCAN_RADAR_5c8b2ede_Tx (ComSignalGroup):
        ComTransferProperty = TRIGGERED
        ComSignalGroupAccess = ACCESS_NEEDED_BY_SWC_OR_COM
        ComHandleId = 123
        ComSignalGroupArrayAccess = true
        ComSystemTemplateSignalGroupRef = SG_TrackerObject014
        49 x ComGroupSignal, all with ComSignalEndianness=BIG_ENDIAN, ComSignalInitValue=0, ComTransferProperty=PENDING, ComSignalAccess=ACCESS_NEEDED_BY_SWC_OR_COM:
          OBJ_VELOCITY_LONG_ERR_014_oRDR_TRACKER_OBJ_014_oPCAN_RADAR_79e2499c_Tx: ComBitPosition=143, ComBitSize=8, ComSignalType=UINT8, ComHandleId=9210, ComSystemTemplateSystemSignalRef=OBJ_VELOCITY_LONG_ERR_014
          OBJ_RCS_014_oRDR_TRACKER_OBJ_014_oPCAN_RADAR_c736152d_Tx: ComBitPosition=351, ComBitSize=7, ComSignalType=UINT8, ComHandleId=9200, ComSystemTemplateSystemSignalRef=OBJ_RCS_014
          OBJ_ACCEL_ERR_CRR_COEF_014_oRDR_TRACKER_OBJ_014_oPCAN_RADAR_385dcbdb_Tx: ComBitPosition=431, ComBitSize=8, ComSignalType=UINT8, ComHandleId=9170, ComSystemTemplateSystemSignalRef=OBJ_ACCEL_ERR_CRR_COEF_014
          OBJ_POS_LONG_ERR_014_oRDR_TRACKER_OBJ_014_oPCAN_RADAR_784dedff_Tx: ComBitPosition=95, ComBitSize=8, ComSignalType=UINT8, ComHandleId=9199, ComSystemTemplateSystemSignalRef=OBJ_POS_LONG_ERR_014
          OBJ_REF_PT_LONG_OFFSET_014_oRDR_TRACKER_OBJ_014_oPCAN_RADAR_7d598e5b_Tx: ComBitPosition=357, ComBitSize=14, ComSignalType=UINT16, ComHandleId=9202, ComSystemTemplateSystemSignalRef=OBJ_REF_PT_LONG_OFFSET_014
          OBJ_VELOCITY_LAT_014_oRDR_TRACKER_OBJ_014_oPCAN_RADAR_a19a060d_Tx: ComBitPosition=126, ComBitSize=15, ComSignalType=UINT16, ComHandleId=9207, ComSystemTemplateSystemSignalRef=OBJ_VELOCITY_LAT_014
          OBJ_YAW_ANGLE_014_oRDR_TRACKER_OBJ_014_oPCAN_RADAR_4d26424d_Tx: ComBitPosition=155, ComBitSize=12, ComSignalType=UINT16, ComHandleId=9211, ComSystemTemplateSystemSignalRef=OBJ_YAW_ANGLE_014
          OBJ_MEASUREMENT_STATUS_014_oRDR_TRACKER_OBJ_014_oPCAN_RADAR_b887eb10_Tx: ComBitPosition=14, ComBitSize=3, ComSignalType=UINT8, ComHandleId=9191, ComSystemTemplateSystemSignalRef=OBJ_MEASUREMENT_STATUS_014
          OBJ_TIMESTAMP_OFFSET_014_oRDR_TRACKER_OBJ_014_oPCAN_RADAR_c79a157b_Tx: ComBitPosition=247, ComBitSize=8, ComSignalType=UINT8, ComHandleId=9203, ComSystemTemplateSystemSignalRef=OBJ_TIMESTAMP_OFFSET_014
          OBJ_REF_PT_LAT_OFFSET_014_oRDR_TRACKER_OBJ_014_oPCAN_RADAR_320b7e58_Tx: ComBitPosition=370, ComBitSize=14, ComSignalType=UINT16, ComHandleId=9201, ComSystemTemplateSystemSignalRef=OBJ_REF_PT_LAT_OFFSET_014
          OBJ_CLS_TYPE3_014_oRDR_TRACKER_OBJ_014_oPCAN_RADAR_17857b56_Tx: ComBitPosition=279, ComBitSize=4, ComSignalType=UINT8, ComHandleId=9176, ComSystemTemplateSystemSignalRef=OBJ_CLS_TYPE3_014
          OBJ_DIMENSION_LENGTH_ERR_014_oRDR_TRACKER_OBJ_014_oPCAN_RADAR_ae83caed_Tx: ComBitPosition=41, ComBitSize=10, ComSignalType=UINT16, ComHandleId=9185, ComSystemTemplateSystemSignalRef=OBJ_DIMENSION_LENGTH_ERR_014
          OBJ_CLS_TYPE6_PROB_014_oRDR_TRACKER_OBJ_014_oPCAN_RADAR_71b79780_Tx: ComBitPosition=343, ComBitSize=8, ComSignalType=UINT8, ComHandleId=9183, ComSystemTemplateSystemSignalRef=OBJ_CLS_TYPE6_PROB_014
          OBJ_POS_LAT_ERR_014_oRDR_TRACKER_OBJ_014_oPCAN_RADAR_e1b5131d_Tx: ComBitPosition=103, ComBitSize=8, ComSignalType=UINT8, ComHandleId=9197, ComSystemTemplateSystemSignalRef=OBJ_POS_LAT_ERR_014
          OBJ_CLS_TYPE1_014_oRDR_TRACKER_OBJ_014_oPCAN_RADAR_d7e586d3_Tx: ComBitPosition=271, ComBitSize=4, ComSignalType=UINT8, ComHandleId=9172, ComSystemTemplateSystemSignalRef=OBJ_CLS_TYPE1_014
          OBJ_POS_LONG_014_oRDR_TRACKER_OBJ_014_oPCAN_RADAR_5459a8e5_Tx: ComBitPosition=63, ComBitSize=16, ComSignalType=UINT16, ComHandleId=9198, ComSystemTemplateSystemSignalRef=OBJ_POS_LONG_014
          OBJ_VELOCITY_LAT_ERR_014_oRDR_TRACKER_OBJ_014_oPCAN_RADAR_9560765c_Tx: ComBitPosition=151, ComBitSize=8, ComSignalType=UINT8, ComHandleId=9208, ComSystemTemplateSystemSignalRef=OBJ_VELOCITY_LAT_ERR_014
          OBJ_DIMENSION_WIDTH_014_oRDR_TRACKER_OBJ_014_oPCAN_RADAR_b6b5223a_Tx: ComBitPosition=17, ComBitSize=10, ComSignalType=UINT16, ComHandleId=9186, ComSystemTemplateSystemSignalRef=OBJ_DIMENSION_WIDTH_014
          OBJ_ACCELERATION_LONG_014_oRDR_TRACKER_OBJ_014_oPCAN_RADAR_205f2c49_Tx: ComBitPosition=193, ComBitSize=10, ComSignalType=UINT16, ComHandleId=9168, ComSystemTemplateSystemSignalRef=OBJ_ACCELERATION_LONG_014
          OBJ_ID_014_oRDR_TRACKER_OBJ_014_oPCAN_RADAR_c75599ad_Tx: ComBitPosition=7, ComBitSize=8, ComSignalType=UINT8, ComHandleId=9190, ComSystemTemplateSystemSignalRef=OBJ_ID_014
          OBJ_CLS_TYPE2_014_oRDR_TRACKER_OBJ_014_oPCAN_RADAR_9a0d86b4_Tx: ComBitPosition=267, ComBitSize=4, ComSignalType=UINT8, ComHandleId=9174, ComSystemTemplateSystemSignalRef=OBJ_CLS_TYPE2_014
          OBJ_CLS_TYPE4_014_oRDR_TRACKER_OBJ_014_oPCAN_RADAR_01dd867a_Tx: ComBitPosition=275, ComBitSize=4, ComSignalType=UINT8, ComHandleId=9178, ComSystemTemplateSystemSignalRef=OBJ_CLS_TYPE4_014
          OBJ_DIMENSION_WIDTH_ERR_014_oRDR_TRACKER_OBJ_014_oPCAN_RADAR_5617e5d2_Tx: ComBitPosition=23, ComBitSize=6, ComSignalType=UINT8, ComHandleId=9187, ComSystemTemplateSystemSignalRef=OBJ_DIMENSION_WIDTH_ERR_014
          OBJ_VELOCITY_LONG_014_oRDR_TRACKER_OBJ_014_oPCAN_RADAR_f1177ecb_Tx: ComBitPosition=110, ComBitSize=15, ComSignalType=UINT16, ComHandleId=9209, ComSystemTemplateSystemSignalRef=OBJ_VELOCITY_LONG_014
          OBJ_VELOCITY_ERR_CRR_COEF_014_oRDR_TRACKER_OBJ_014_oPCAN_RADAR_ae2c8387_Tx: ComBitPosition=423, ComBitSize=8, ComSignalType=UINT8, ComHandleId=9206, ComSystemTemplateSystemSignalRef=OBJ_VELOCITY_ERR_CRR_COEF_014
          OBJ_ACCELERATION_LAT_ERR_014_oRDR_TRACKER_OBJ_014_oPCAN_RADAR_875b4f17_Tx: ComBitPosition=223, ComBitSize=8, ComSignalType=UINT8, ComHandleId=9167, ComSystemTemplateSystemSignalRef=OBJ_ACCELERATION_LAT_ERR_014
          OBJ_ACCELERATION_LAT_014_oRDR_TRACKER_OBJ_014_oPCAN_RADAR_52af75a9_Tx: ComBitPosition=177, ComBitSize=10, ComSignalType=UINT16, ComHandleId=9166, ComSystemTemplateSystemSignalRef=OBJ_ACCELERATION_LAT_014
          OBJ_ACCELERATION_LONG_ERR_014_oRDR_TRACKER_OBJ_014_oPCAN_RADAR_98feeabd_Tx: ComBitPosition=215, ComBitSize=8, ComSignalType=UINT8, ComHandleId=9169, ComSystemTemplateSystemSignalRef=OBJ_ACCELERATION_LONG_ERR_014
          OBJ_CLS_TYPE6_014_oRDR_TRACKER_OBJ_014_oPCAN_RADAR_c1bd7bff_Tx: ComBitPosition=282, ComBitSize=4, ComSignalType=UINT8, ComHandleId=9182, ComSystemTemplateSystemSignalRef=OBJ_CLS_TYPE6_014
          OBJ_CLS_TYPE2_PROB_014_oRDR_TRACKER_OBJ_014_oPCAN_RADAR_b6894a2d_Tx: ComBitPosition=311, ComBitSize=8, ComSignalType=UINT8, ComHandleId=9175, ComSystemTemplateSystemSignalRef=OBJ_CLS_TYPE2_PROB_014
          OBJ_EXISTENCE_PROB_014_oRDR_TRACKER_OBJ_014_oPCAN_RADAR_bd09a607_Tx: ComBitPosition=229, ComBitSize=14, ComSignalType=UINT16, ComHandleId=9188, ComSystemTemplateSystemSignalRef=OBJ_EXISTENCE_PROB_014
          OBJ_ALIVE_TIME_014_oRDR_TRACKER_OBJ_014_oPCAN_RADAR_403e67f5_Tx: ComBitPosition=255, ComBitSize=16, ComSignalType=UINT16, ComHandleId=9171, ComSystemTemplateSystemSignalRef=OBJ_ALIVE_TIME_014
          OBJ_CLS_TYPE4_PROB_014_oRDR_TRACKER_OBJ_014_oPCAN_RADAR_ff907a76_Tx: ComBitPosition=327, ComBitSize=8, ComSignalType=UINT8, ComHandleId=9179, ComSystemTemplateSystemSignalRef=OBJ_CLS_TYPE4_PROB_014
          OBJ_POS_ERR_CRR_COEF_014_oRDR_TRACKER_OBJ_014_oPCAN_RADAR_0756be66_Tx: ComBitPosition=415, ComBitSize=8, ComSignalType=UINT8, ComHandleId=9195, ComSystemTemplateSystemSignalRef=OBJ_POS_ERR_CRR_COEF_014
          OBJ_POS_LAT_014_oRDR_TRACKER_OBJ_014_oPCAN_RADAR_e5f9432a_Tx: ComBitPosition=79, ComBitSize=16, ComSignalType=UINT16, ComHandleId=9196, ComSystemTemplateSystemSignalRef=OBJ_POS_LAT_014
          OBJ_GROUP_ID_014_oRDR_TRACKER_OBJ_014_oPCAN_RADAR_347bb2aa_Tx: ComBitPosition=405, ComBitSize=6, ComSignalType=UINT8, ComHandleId=9189, ComSystemTemplateSystemSignalRef=OBJ_GROUP_ID_014
          OBJ_CLS_TYPE3_PROB_014_oRDR_TRACKER_OBJ_014_oPCAN_RADAR_f19abcd6_Tx: ComBitPosition=319, ComBitSize=8, ComSignalType=UINT8, ComHandleId=9177, ComSystemTemplateSystemSignalRef=OBJ_CLS_TYPE3_PROB_014
          OBJ_MOVEMENT_STATUS_014_oRDR_TRACKER_OBJ_014_oPCAN_RADAR_97297e5c_Tx: ComBitPosition=196, ComBitSize=3, ComSignalType=UINT8, ComHandleId=9194, ComSystemTemplateSystemSignalRef=OBJ_MOVEMENT_STATUS_014
          OBJ_YAW_RATE_ERR_014_oRDR_TRACKER_OBJ_014_oPCAN_RADAR_5771f0d6_Tx: ComBitPosition=388, ComBitSize=5, ComSignalType=UINT8, ComHandleId=9214, ComSystemTemplateSystemSignalRef=OBJ_YAW_RATE_ERR_014
          OBJ_CLS_TYPE1_PROB_014_oRDR_TRACKER_OBJ_014_oPCAN_RADAR_7fbd5120_Tx: ComBitPosition=303, ComBitSize=8, ComSignalType=UINT8, ComHandleId=9173, ComSystemTemplateSystemSignalRef=OBJ_CLS_TYPE1_PROB_014
          OBJ_CLS_TYPE5_PROB_014_oRDR_TRACKER_OBJ_014_oPCAN_RADAR_b8838c8d_Tx: ComBitPosition=335, ComBitSize=8, ComSignalType=UINT8, ComHandleId=9181, ComSystemTemplateSystemSignalRef=OBJ_CLS_TYPE5_PROB_014
          OBJ_DIMENSION_LENGTH_014_oRDR_TRACKER_OBJ_014_oPCAN_RADAR_957bd597_Tx: ComBitPosition=37, ComBitSize=12, ComSignalType=UINT16, ComHandleId=9184, ComSystemTemplateSystemSignalRef=OBJ_DIMENSION_LENGTH_014
          OBJ_CLS_TYPE5_014_oRDR_TRACKER_OBJ_014_oPCAN_RADAR_8c557b98_Tx: ComBitPosition=287, ComBitSize=4, ComSignalType=UINT8, ComHandleId=9180, ComSystemTemplateSystemSignalRef=OBJ_CLS_TYPE5_014
          OBJ_YAW_RATE_014_oRDR_TRACKER_OBJ_014_oPCAN_RADAR_68a9670a_Tx: ComBitPosition=399, ComBitSize=10, ComSignalType=UINT16, ComHandleId=9213, ComSystemTemplateSystemSignalRef=OBJ_YAW_RATE_014
          OBJ_TRACK_MOTION_MODEL_014_oRDR_TRACKER_OBJ_014_oPCAN_RADAR_0b9914a6_Tx: ComBitPosition=9, ComBitSize=2, ComSignalType=UINT8, ComHandleId=9204, ComSystemTemplateSystemSignalRef=OBJ_TRACK_MOTION_MODEL_014
          OBJ_YAW_ANGLE_ERR_014_oRDR_TRACKER_OBJ_014_oPCAN_RADAR_982b449a_Tx: ComBitPosition=175, ComBitSize=7, ComSignalType=UINT8, ComHandleId=9212, ComSystemTemplateSystemSignalRef=OBJ_YAW_ANGLE_ERR_014
          OBJ_VEH_TRACK_FLAG_014_oRDR_TRACKER_OBJ_014_oPCAN_RADAR_89b3e2fb_Tx: ComBitPosition=10, ComBitSize=1, ComSignalType=BOOLEAN, ComHandleId=9205, ComSystemTemplateSystemSignalRef=OBJ_VEH_TRACK_FLAG_014
          OBJ_MH_CRC16_014_oRDR_TRACKER_OBJ_014_oPCAN_RADAR_c4e75c2c_Tx: ComBitPosition=495, ComBitSize=16, ComSignalType=UINT16, ComHandleId=9192, ComSystemTemplateSystemSignalRef=OBJ_MH_CRC16_014
          OBJ_MH_CYCLE_COUNTER_014_oRDR_TRACKER_OBJ_014_oPCAN_RADAR_b50306cd_Tx: ComBitPosition=487, ComBitSize=8, ComSignalType=UINT8, ComHandleId=9193, ComSystemTemplateSystemSignalRef=OBJ_MH_CYCLE_COUNTER_014
      RDR_DETECTION_085_088_oPCAN_RADAR_7df82e4e_Tx (ComIPdu):
        ComIPduDirection = SEND
        ComIPduType = NORMAL
        ComIPduCancellationSupport = false
        ComIPduHandleId = 27
        ComIPduSignalProcessing = DEFERRED
        ComIPduChannelRef = CN_PCAN_RADAR_458ff0f1
        ComIPduGroupRef = RDR01_oPCAN_RADAR_Tx_b6bdb067 if post-build-variant-condition{matching-criterion=RDR_POS, value=0}
        ComIPduSignalGroupRef = SG_Detections_085_088_oRDR_DETECTION_085_088_oPCAN_RADAR_7b5d20bf_Tx
        ComPduIdRef = RDR_DETECTION_085_088_oPCAN_RADAR_7df82e4e_Tx
        ComIPduMainFunctionRef = ComMainFunctionTx_Event
        ComIPduGroupRef = RDR02_oPCAN_RADAR_Tx_9f750495 if post-build-variant-condition{matching-criterion=RDR_POS, value=1}
        ComIPduGroupRef = RDR03_oPCAN_RADAR_Tx_311d9504 if post-build-variant-condition{matching-criterion=RDR_POS, value=2}
        ComIPduGroupRef = RDR04_oPCAN_RADAR_Tx_cce46d71 if post-build-variant-condition{matching-criterion=RDR_POS, value=3}
        ComIPduGroupRef = RDR05_oPCAN_RADAR_Tx_628cfce0 if post-build-variant-condition{matching-criterion=RDR_POS, value=4}
        ComIPduGroupRef = RDR06_oPCAN_RADAR_Tx_4b444812 if post-build-variant-condition{matching-criterion=RDR_POS, value=5}
        ComIPduGroupRef = RDR07_oPCAN_RADAR_Tx_e52cd983 if post-build-variant-condition{matching-criterion=RDR_POS, value=6}
        ComIPduGroupRef = RDR08_oPCAN_RADAR_Tx_6bc6beb9 if post-build-variant-condition{matching-criterion=RDR_POS, value=7}
        ComTxIPdu: ComMinimumDelayTime=0, ComTxIPduUnusedAreasDefault=0
          ComTxModeTrue
            ComTxMode: ComTxModeMode=DIRECT, ComTxModeNumberOfRepetitions=0
          ComTxModeFalse
            ComTxMode: ComTxModeMode=NONE
      SG_TrackerObject034_oRDR_TRACKER_OBJ_034_oPCAN_RADAR_f9a8c3a2_Tx (ComSignalGroup):
        ComTransferProperty = TRIGGERED
        ComSignalGroupAccess = ACCESS_NEEDED_BY_SWC_OR_COM
        ComHandleId = 143
        ComSignalGroupArrayAccess = true
        ComSystemTemplateSignalGroupRef = SG_TrackerObject034
        49 x ComGroupSignal, all with ComSignalEndianness=BIG_ENDIAN, ComSignalInitValue=0, ComTransferProperty=PENDING, ComSignalAccess=ACCESS_NEEDED_BY_SWC_OR_COM:
          OBJ_TRACK_MOTION_MODEL_034_oRDR_TRACKER_OBJ_034_oPCAN_RADAR_aebaf9da_Tx: ComBitPosition=9, ComBitSize=2, ComSignalType=UINT8, ComHandleId=10184, ComSystemTemplateSystemSignalRef=OBJ_TRACK_MOTION_MODEL_034
          OBJ_CLS_TYPE2_034_oRDR_TRACKER_OBJ_034_oPCAN_RADAR_3f2e6bc8_Tx: ComBitPosition=267, ComBitSize=4, ComSignalType=UINT8, ComHandleId=10154, ComSystemTemplateSystemSignalRef=OBJ_CLS_TYPE2_034
          OBJ_TIMESTAMP_OFFSET_034_oRDR_TRACKER_OBJ_034_oPCAN_RADAR_62b9f807_Tx: ComBitPosition=247, ComBitSize=8, ComSignalType=UINT8, ComHandleId=10183, ComSystemTemplateSystemSignalRef=OBJ_TIMESTAMP_OFFSET_034
          OBJ_CLS_TYPE4_034_oRDR_TRACKER_OBJ_034_oPCAN_RADAR_a4fe6b06_Tx: ComBitPosition=275, ComBitSize=4, ComSignalType=UINT8, ComHandleId=10158, ComSystemTemplateSystemSignalRef=OBJ_CLS_TYPE4_034
          OBJ_CLS_TYPE5_PROB_034_oRDR_TRACKER_OBJ_034_oPCAN_RADAR_1da061f1_Tx: ComBitPosition=335, ComBitSize=8, ComSignalType=UINT8, ComHandleId=10161, ComSystemTemplateSystemSignalRef=OBJ_CLS_TYPE5_PROB_034
          OBJ_VEH_TRACK_FLAG_034_oRDR_TRACKER_OBJ_034_oPCAN_RADAR_2c900f87_Tx: ComBitPosition=10, ComBitSize=1, ComSignalType=BOOLEAN, ComHandleId=10185, ComSystemTemplateSystemSignalRef=OBJ_VEH_TRACK_FLAG_034
          OBJ_YAW_ANGLE_034_oRDR_TRACKER_OBJ_034_oPCAN_RADAR_e805af31_Tx: ComBitPosition=155, ComBitSize=12, ComSignalType=UINT16, ComHandleId=10191, ComSystemTemplateSystemSignalRef=OBJ_YAW_ANGLE_034
          OBJ_ACCELERATION_LONG_034_oRDR_TRACKER_OBJ_034_oPCAN_RADAR_857cc135_Tx: ComBitPosition=193, ComBitSize=10, ComSignalType=UINT16, ComHandleId=10148, ComSystemTemplateSystemSignalRef=OBJ_ACCELERATION_LONG_034
          OBJ_RCS_034_oRDR_TRACKER_OBJ_034_oPCAN_RADAR_6215f851_Tx: ComBitPosition=351, ComBitSize=7, ComSignalType=UINT8, ComHandleId=10180, ComSystemTemplateSystemSignalRef=OBJ_RCS_034
          OBJ_MOVEMENT_STATUS_034_oRDR_TRACKER_OBJ_034_oPCAN_RADAR_320a9320_Tx: ComBitPosition=196, ComBitSize=3, ComSignalType=UINT8, ComHandleId=10174, ComSystemTemplateSystemSignalRef=OBJ_MOVEMENT_STATUS_034
          OBJ_EXISTENCE_PROB_034_oRDR_TRACKER_OBJ_034_oPCAN_RADAR_182a4b7b_Tx: ComBitPosition=229, ComBitSize=14, ComSignalType=UINT16, ComHandleId=10168, ComSystemTemplateSystemSignalRef=OBJ_EXISTENCE_PROB_034
          OBJ_CLS_TYPE6_034_oRDR_TRACKER_OBJ_034_oPCAN_RADAR_649e9683_Tx: ComBitPosition=282, ComBitSize=4, ComSignalType=UINT8, ComHandleId=10162, ComSystemTemplateSystemSignalRef=OBJ_CLS_TYPE6_034
          OBJ_REF_PT_LONG_OFFSET_034_oRDR_TRACKER_OBJ_034_oPCAN_RADAR_d87a6327_Tx: ComBitPosition=357, ComBitSize=14, ComSignalType=UINT16, ComHandleId=10182, ComSystemTemplateSystemSignalRef=OBJ_REF_PT_LONG_OFFSET_034
          OBJ_VELOCITY_ERR_CRR_COEF_034_oRDR_TRACKER_OBJ_034_oPCAN_RADAR_0b0f6efb_Tx: ComBitPosition=423, ComBitSize=8, ComSignalType=UINT8, ComHandleId=10186, ComSystemTemplateSystemSignalRef=OBJ_VELOCITY_ERR_CRR_COEF_034
          OBJ_VELOCITY_LAT_034_oRDR_TRACKER_OBJ_034_oPCAN_RADAR_04b9eb71_Tx: ComBitPosition=126, ComBitSize=15, ComSignalType=UINT16, ComHandleId=10187, ComSystemTemplateSystemSignalRef=OBJ_VELOCITY_LAT_034
          OBJ_DIMENSION_LENGTH_ERR_034_oRDR_TRACKER_OBJ_034_oPCAN_RADAR_0ba02791_Tx: ComBitPosition=41, ComBitSize=10, ComSignalType=UINT16, ComHandleId=10165, ComSystemTemplateSystemSignalRef=OBJ_DIMENSION_LENGTH_ERR_034
          OBJ_VELOCITY_LONG_ERR_034_oRDR_TRACKER_OBJ_034_oPCAN_RADAR_dcc1a4e0_Tx: ComBitPosition=143, ComBitSize=8, ComSignalType=UINT8, ComHandleId=10190, ComSystemTemplateSystemSignalRef=OBJ_VELOCITY_LONG_ERR_034
          OBJ_ACCELERATION_LAT_034_oRDR_TRACKER_OBJ_034_oPCAN_RADAR_f78c98d5_Tx: ComBitPosition=177, ComBitSize=10, ComSignalType=UINT16, ComHandleId=10146, ComSystemTemplateSystemSignalRef=OBJ_ACCELERATION_LAT_034
          OBJ_ID_034_oRDR_TRACKER_OBJ_034_oPCAN_RADAR_627674d1_Tx: ComBitPosition=7, ComBitSize=8, ComSignalType=UINT8, ComHandleId=10170, ComSystemTemplateSystemSignalRef=OBJ_ID_034
          OBJ_ALIVE_TIME_034_oRDR_TRACKER_OBJ_034_oPCAN_RADAR_e51d8a89_Tx: ComBitPosition=255, ComBitSize=16, ComSignalType=UINT16, ComHandleId=10151, ComSystemTemplateSystemSignalRef=OBJ_ALIVE_TIME_034
          OBJ_VELOCITY_LAT_ERR_034_oRDR_TRACKER_OBJ_034_oPCAN_RADAR_30439b20_Tx: ComBitPosition=151, ComBitSize=8, ComSignalType=UINT8, ComHandleId=10188, ComSystemTemplateSystemSignalRef=OBJ_VELOCITY_LAT_ERR_034
          OBJ_CLS_TYPE3_PROB_034_oRDR_TRACKER_OBJ_034_oPCAN_RADAR_54b951aa_Tx: ComBitPosition=319, ComBitSize=8, ComSignalType=UINT8, ComHandleId=10157, ComSystemTemplateSystemSignalRef=OBJ_CLS_TYPE3_PROB_034
          OBJ_POS_LONG_034_oRDR_TRACKER_OBJ_034_oPCAN_RADAR_f17a4599_Tx: ComBitPosition=63, ComBitSize=16, ComSignalType=UINT16, ComHandleId=10178, ComSystemTemplateSystemSignalRef=OBJ_POS_LONG_034
          OBJ_POS_ERR_CRR_COEF_034_oRDR_TRACKER_OBJ_034_oPCAN_RADAR_a275531a_Tx: ComBitPosition=415, ComBitSize=8, ComSignalType=UINT8, ComHandleId=10175, ComSystemTemplateSystemSignalRef=OBJ_POS_ERR_CRR_COEF_034
          OBJ_POS_LAT_ERR_034_oRDR_TRACKER_OBJ_034_oPCAN_RADAR_4496fe61_Tx: ComBitPosition=103, ComBitSize=8, ComSignalType=UINT8, ComHandleId=10177, ComSystemTemplateSystemSignalRef=OBJ_POS_LAT_ERR_034
          OBJ_REF_PT_LAT_OFFSET_034_oRDR_TRACKER_OBJ_034_oPCAN_RADAR_97289324_Tx: ComBitPosition=370, ComBitSize=14, ComSignalType=UINT16, ComHandleId=10181, ComSystemTemplateSystemSignalRef=OBJ_REF_PT_LAT_OFFSET_034
          OBJ_ACCEL_ERR_CRR_COEF_034_oRDR_TRACKER_OBJ_034_oPCAN_RADAR_9d7e26a7_Tx: ComBitPosition=431, ComBitSize=8, ComSignalType=UINT8, ComHandleId=10150, ComSystemTemplateSystemSignalRef=OBJ_ACCEL_ERR_CRR_COEF_034
          OBJ_ACCELERATION_LAT_ERR_034_oRDR_TRACKER_OBJ_034_oPCAN_RADAR_2278a26b_Tx: ComBitPosition=223, ComBitSize=8, ComSignalType=UINT8, ComHandleId=10147, ComSystemTemplateSystemSignalRef=OBJ_ACCELERATION_LAT_ERR_034
          OBJ_POS_LONG_ERR_034_oRDR_TRACKER_OBJ_034_oPCAN_RADAR_dd6e0083_Tx: ComBitPosition=95, ComBitSize=8, ComSignalType=UINT8, ComHandleId=10179, ComSystemTemplateSystemSignalRef=OBJ_POS_LONG_ERR_034
          OBJ_CLS_TYPE1_PROB_034_oRDR_TRACKER_OBJ_034_oPCAN_RADAR_da9ebc5c_Tx: ComBitPosition=303, ComBitSize=8, ComSignalType=UINT8, ComHandleId=10153, ComSystemTemplateSystemSignalRef=OBJ_CLS_TYPE1_PROB_034
          OBJ_VELOCITY_LONG_034_oRDR_TRACKER_OBJ_034_oPCAN_RADAR_543493b7_Tx: ComBitPosition=110, ComBitSize=15, ComSignalType=UINT16, ComHandleId=10189, ComSystemTemplateSystemSignalRef=OBJ_VELOCITY_LONG_034
          OBJ_DIMENSION_WIDTH_034_oRDR_TRACKER_OBJ_034_oPCAN_RADAR_1396cf46_Tx: ComBitPosition=17, ComBitSize=10, ComSignalType=UINT16, ComHandleId=10166, ComSystemTemplateSystemSignalRef=OBJ_DIMENSION_WIDTH_034
          OBJ_CLS_TYPE4_PROB_034_oRDR_TRACKER_OBJ_034_oPCAN_RADAR_5ab3970a_Tx: ComBitPosition=327, ComBitSize=8, ComSignalType=UINT8, ComHandleId=10159, ComSystemTemplateSystemSignalRef=OBJ_CLS_TYPE4_PROB_034
          OBJ_CLS_TYPE5_034_oRDR_TRACKER_OBJ_034_oPCAN_RADAR_297696e4_Tx: ComBitPosition=287, ComBitSize=4, ComSignalType=UINT8, ComHandleId=10160, ComSystemTemplateSystemSignalRef=OBJ_CLS_TYPE5_034
          OBJ_YAW_RATE_034_oRDR_TRACKER_OBJ_034_oPCAN_RADAR_cd8a8a76_Tx: ComBitPosition=399, ComBitSize=10, ComSignalType=UINT16, ComHandleId=10193, ComSystemTemplateSystemSignalRef=OBJ_YAW_RATE_034
          OBJ_DIMENSION_LENGTH_034_oRDR_TRACKER_OBJ_034_oPCAN_RADAR_305838eb_Tx: ComBitPosition=37, ComBitSize=12, ComSignalType=UINT16, ComHandleId=10164, ComSystemTemplateSystemSignalRef=OBJ_DIMENSION_LENGTH_034
          OBJ_MEASUREMENT_STATUS_034_oRDR_TRACKER_OBJ_034_oPCAN_RADAR_1da4066c_Tx: ComBitPosition=14, ComBitSize=3, ComSignalType=UINT8, ComHandleId=10171, ComSystemTemplateSystemSignalRef=OBJ_MEASUREMENT_STATUS_034
          OBJ_ACCELERATION_LONG_ERR_034_oRDR_TRACKER_OBJ_034_oPCAN_RADAR_3ddd07c1_Tx: ComBitPosition=215, ComBitSize=8, ComSignalType=UINT8, ComHandleId=10149, ComSystemTemplateSystemSignalRef=OBJ_ACCELERATION_LONG_ERR_034
          OBJ_CLS_TYPE6_PROB_034_oRDR_TRACKER_OBJ_034_oPCAN_RADAR_d4947afc_Tx: ComBitPosition=343, ComBitSize=8, ComSignalType=UINT8, ComHandleId=10163, ComSystemTemplateSystemSignalRef=OBJ_CLS_TYPE6_PROB_034
          OBJ_GROUP_ID_034_oRDR_TRACKER_OBJ_034_oPCAN_RADAR_91585fd6_Tx: ComBitPosition=405, ComBitSize=6, ComSignalType=UINT8, ComHandleId=10169, ComSystemTemplateSystemSignalRef=OBJ_GROUP_ID_034
          OBJ_POS_LAT_034_oRDR_TRACKER_OBJ_034_oPCAN_RADAR_40daae56_Tx: ComBitPosition=79, ComBitSize=16, ComSignalType=UINT16, ComHandleId=10176, ComSystemTemplateSystemSignalRef=OBJ_POS_LAT_034
          OBJ_CLS_TYPE3_034_oRDR_TRACKER_OBJ_034_oPCAN_RADAR_b2a6962a_Tx: ComBitPosition=279, ComBitSize=4, ComSignalType=UINT8, ComHandleId=10156, ComSystemTemplateSystemSignalRef=OBJ_CLS_TYPE3_034
          OBJ_CLS_TYPE1_034_oRDR_TRACKER_OBJ_034_oPCAN_RADAR_72c66baf_Tx: ComBitPosition=271, ComBitSize=4, ComSignalType=UINT8, ComHandleId=10152, ComSystemTemplateSystemSignalRef=OBJ_CLS_TYPE1_034
          OBJ_DIMENSION_WIDTH_ERR_034_oRDR_TRACKER_OBJ_034_oPCAN_RADAR_f33408ae_Tx: ComBitPosition=23, ComBitSize=6, ComSignalType=UINT8, ComHandleId=10167, ComSystemTemplateSystemSignalRef=OBJ_DIMENSION_WIDTH_ERR_034
          OBJ_YAW_ANGLE_ERR_034_oRDR_TRACKER_OBJ_034_oPCAN_RADAR_3d08a9e6_Tx: ComBitPosition=175, ComBitSize=7, ComSignalType=UINT8, ComHandleId=10192, ComSystemTemplateSystemSignalRef=OBJ_YAW_ANGLE_ERR_034
          OBJ_YAW_RATE_ERR_034_oRDR_TRACKER_OBJ_034_oPCAN_RADAR_f2521daa_Tx: ComBitPosition=388, ComBitSize=5, ComSignalType=UINT8, ComHandleId=10194, ComSystemTemplateSystemSignalRef=OBJ_YAW_RATE_ERR_034
          OBJ_CLS_TYPE2_PROB_034_oRDR_TRACKER_OBJ_034_oPCAN_RADAR_13aaa751_Tx: ComBitPosition=311, ComBitSize=8, ComSignalType=UINT8, ComHandleId=10155, ComSystemTemplateSystemSignalRef=OBJ_CLS_TYPE2_PROB_034
          OBJ_MH_CYCLE_COUNTER_034_oRDR_TRACKER_OBJ_034_oPCAN_RADAR_1020ebb1_Tx: ComBitPosition=487, ComBitSize=8, ComSignalType=UINT8, ComHandleId=10173, ComSystemTemplateSystemSignalRef=OBJ_MH_CYCLE_COUNTER_034
          OBJ_MH_CRC16_034_oRDR_TRACKER_OBJ_034_oPCAN_RADAR_61c4b150_Tx: ComBitPosition=495, ComBitSize=16, ComSignalType=UINT16, ComHandleId=10172, ComSystemTemplateSystemSignalRef=OBJ_MH_CRC16_034
      5 x ComIPdu, all with ComIPduDirection=SEND, ComIPduType=NORMAL, ComIPduCancellationSupport=false, ComIPduSignalProcessing=DEFERRED, ComIPduChannelRef=CN_PCAN_RADAR_458ff0f1, ComIPduGroupRef=RDR01_oPCAN_RADAR_Tx_b6bdb067 if post-build-variant-condition{matching-criterion=RDR_POS, value=0}, ComIPduMainFunctionRef=ComMainFunctionTx_Event, ComIPduGroupRef=RDR02_oPCAN_RADAR_Tx_9f750495 if post-build-variant-condition{matching-criterion=RDR_POS, value=1}, ComIPduGroupRef=RDR03_oPCAN_RADAR_Tx_311d9504 if post-build-variant-condition{matching-criterion=RDR_POS, value=2}, ComIPduGroupRef=RDR04_oPCAN_RADAR_Tx_cce46d71 if post-build-variant-condition{matching-criterion=RDR_POS, value=3}, ComIPduGroupRef=RDR05_oPCAN_RADAR_Tx_628cfce0 if post-build-variant-condition{matching-criterion=RDR_POS, value=4}, ComIPduGroupRef=RDR06_oPCAN_RADAR_Tx_4b444812 if post-build-variant-condition{matching-criterion=RDR_POS, value=5}, ComIPduGroupRef=RDR07_oPCAN_RADAR_Tx_e52cd983 if post-build-variant-condition{matching-criterion=RDR_POS, value=6}, ComIPduGroupRef=RDR08_oPCAN_RADAR_Tx_6bc6beb9 if post-build-variant-condition{matching-criterion=RDR_POS, value=7}:
        RDR_DETECTION_281_284_oPCAN_RADAR_4878071a_Tx: ComIPduHandleId=76, ComIPduSignalGroupRef=SG_Detections_281_284_oRDR_DETECTION_281_284_oPCAN_RADAR_8fce5195_Tx, ComPduIdRef=RDR_DETECTION_281_284_oPCAN_RADAR_4878071a_Tx
          ComTxIPdu: ComMinimumDelayTime=0, ComTxIPduUnusedAreasDefault=0
            ComTxModeTrue
              ComTxMode: ComTxModeMode=DIRECT, ComTxModeNumberOfRepetitions=0
            ComTxModeFalse
              ComTxMode: ComTxModeMode=NONE
        RDR_TRACKER_OBJ_002_oPCAN_RADAR_934d9798_Tx: ComIPduHandleId=112, ComIPduSignalGroupRef=SG_TrackerObject002_oRDR_TRACKER_OBJ_002_oPCAN_RADAR_75f2e109_Tx, ComPduIdRef=RDR_TRACKER_OBJ_002_oPCAN_RADAR_934d9798_Tx
          ComTxIPdu: ComMinimumDelayTime=0, ComTxIPduUnusedAreasDefault=0
            ComTxModeTrue
              ComTxMode: ComTxModeMode=DIRECT, ComTxModeNumberOfRepetitions=0
            ComTxModeFalse
              ComTxMode: ComTxModeMode=NONE
        RDR_TRACKER_OBJ_046_oPCAN_RADAR_4a587215_Tx: ComIPduHandleId=156, ComIPduSignalGroupRef=SG_TrackerObject046_oRDR_TRACKER_OBJ_046_oPCAN_RADAR_b67413fe_Tx, ComPduIdRef=RDR_TRACKER_OBJ_046_oPCAN_RADAR_4a587215_Tx
          ComTxIPdu: ComMinimumDelayTime=0, ComTxIPduUnusedAreasDefault=0
            ComTxModeTrue
              ComTxMode: ComTxModeMode=DIRECT, ComTxModeNumberOfRepetitions=0
            ComTxModeFalse
              ComTxMode: ComTxModeMode=NONE
        RDR_TRACKER_OBJ_019_oPCAN_RADAR_e98bc94d_Tx: ComIPduHandleId=129, ComIPduSignalGroupRef=SG_TrackerObject019_oRDR_TRACKER_OBJ_019_oPCAN_RADAR_524fd4bf_Tx, ComPduIdRef=RDR_TRACKER_OBJ_019_oPCAN_RADAR_e98bc94d_Tx
          ComTxIPdu: ComMinimumDelayTime=0, ComTxIPduUnusedAreasDefault=0
            ComTxModeTrue
              ComTxMode: ComTxModeMode=DIRECT, ComTxModeNumberOfRepetitions=0
            ComTxModeFalse
              ComTxMode: ComTxModeMode=NONE
        RDR_DETECTION_285_288_oPCAN_RADAR_a1ca992e_Tx: ComIPduHandleId=77, ComIPduSignalGroupRef=SG_Detections_285_288_oRDR_DETECTION_285_288_oPCAN_RADAR_fe0d65c7_Tx, ComPduIdRef=RDR_DETECTION_285_288_oPCAN_RADAR_a1ca992e_Tx
          ComTxIPdu: ComMinimumDelayTime=0, ComTxIPduUnusedAreasDefault=0
            ComTxModeTrue
              ComTxMode: ComTxModeMode=DIRECT, ComTxModeNumberOfRepetitions=0
            ComTxModeFalse
              ComTxMode: ComTxModeMode=NONE
      SG_TrackerObject050_oRDR_TRACKER_OBJ_050_oPCAN_RADAR_9f0ddc29_Tx (ComSignalGroup):
        ComTransferProperty = TRIGGERED
        ComSignalGroupAccess = ACCESS_NEEDED_BY_SWC_OR_COM
        ComHandleId = 159
        ComSignalGroupArrayAccess = true
        ComSystemTemplateSignalGroupRef = SG_TrackerObject050
        49 x ComGroupSignal, all with ComSignalEndianness=BIG_ENDIAN, ComSignalInitValue=0, ComTransferProperty=PENDING, ComSignalAccess=ACCESS_NEEDED_BY_SWC_OR_COM:
          OBJ_YAW_ANGLE_050_oRDR_TRACKER_OBJ_050_oPCAN_RADAR_8ea0b0ba_Tx: ComBitPosition=155, ComBitSize=12, ComSignalType=UINT16, ComHandleId=10975, ComSystemTemplateSystemSignalRef=OBJ_YAW_ANGLE_050
          OBJ_ALIVE_TIME_050_oRDR_TRACKER_OBJ_050_oPCAN_RADAR_83b89502_Tx: ComBitPosition=255, ComBitSize=16, ComSignalType=UINT16, ComHandleId=10935, ComSystemTemplateSystemSignalRef=OBJ_ALIVE_TIME_050
          OBJ_YAW_RATE_050_oRDR_TRACKER_OBJ_050_oPCAN_RADAR_ab2f95fd_Tx: ComBitPosition=399, ComBitSize=10, ComSignalType=UINT16, ComHandleId=10977, ComSystemTemplateSystemSignalRef=OBJ_YAW_RATE_050
          OBJ_ACCELERATION_LONG_050_oRDR_TRACKER_OBJ_050_oPCAN_RADAR_e3d9debe_Tx: ComBitPosition=193, ComBitSize=10, ComSignalType=UINT16, ComHandleId=10932, ComSystemTemplateSystemSignalRef=OBJ_ACCELERATION_LONG_050
          OBJ_REF_PT_LAT_OFFSET_050_oRDR_TRACKER_OBJ_050_oPCAN_RADAR_f18d8caf_Tx: ComBitPosition=370, ComBitSize=14, ComSignalType=UINT16, ComHandleId=10965, ComSystemTemplateSystemSignalRef=OBJ_REF_PT_LAT_OFFSET_050
          OBJ_ACCELERATION_LAT_ERR_050_oRDR_TRACKER_OBJ_050_oPCAN_RADAR_44ddbde0_Tx: ComBitPosition=223, ComBitSize=8, ComSignalType=UINT8, ComHandleId=10931, ComSystemTemplateSystemSignalRef=OBJ_ACCELERATION_LAT_ERR_050
          OBJ_CLS_TYPE6_PROB_050_oRDR_TRACKER_OBJ_050_oPCAN_RADAR_b2316577_Tx: ComBitPosition=343, ComBitSize=8, ComSignalType=UINT8, ComHandleId=10947, ComSystemTemplateSystemSignalRef=OBJ_CLS_TYPE6_PROB_050
          OBJ_CLS_TYPE1_PROB_050_oRDR_TRACKER_OBJ_050_oPCAN_RADAR_bc3ba3d7_Tx: ComBitPosition=303, ComBitSize=8, ComSignalType=UINT8, ComHandleId=10937, ComSystemTemplateSystemSignalRef=OBJ_CLS_TYPE1_PROB_050
          OBJ_CLS_TYPE5_050_oRDR_TRACKER_OBJ_050_oPCAN_RADAR_4fd3896f_Tx: ComBitPosition=287, ComBitSize=4, ComSignalType=UINT8, ComHandleId=10944, ComSystemTemplateSystemSignalRef=OBJ_CLS_TYPE5_050
          OBJ_EXISTENCE_PROB_050_oRDR_TRACKER_OBJ_050_oPCAN_RADAR_7e8f54f0_Tx: ComBitPosition=229, ComBitSize=14, ComSignalType=UINT16, ComHandleId=10952, ComSystemTemplateSystemSignalRef=OBJ_EXISTENCE_PROB_050
          OBJ_CLS_TYPE4_050_oRDR_TRACKER_OBJ_050_oPCAN_RADAR_c25b748d_Tx: ComBitPosition=275, ComBitSize=4, ComSignalType=UINT8, ComHandleId=10942, ComSystemTemplateSystemSignalRef=OBJ_CLS_TYPE4_050
          OBJ_CLS_TYPE1_050_oRDR_TRACKER_OBJ_050_oPCAN_RADAR_14637424_Tx: ComBitPosition=271, ComBitSize=4, ComSignalType=UINT8, ComHandleId=10936, ComSystemTemplateSystemSignalRef=OBJ_CLS_TYPE1_050
          OBJ_POS_LAT_050_oRDR_TRACKER_OBJ_050_oPCAN_RADAR_267fb1dd_Tx: ComBitPosition=79, ComBitSize=16, ComSignalType=UINT16, ComHandleId=10960, ComSystemTemplateSystemSignalRef=OBJ_POS_LAT_050
          OBJ_VELOCITY_ERR_CRR_COEF_050_oRDR_TRACKER_OBJ_050_oPCAN_RADAR_6daa7170_Tx: ComBitPosition=423, ComBitSize=8, ComSignalType=UINT8, ComHandleId=10970, ComSystemTemplateSystemSignalRef=OBJ_VELOCITY_ERR_CRR_COEF_050
          OBJ_ACCELERATION_LAT_050_oRDR_TRACKER_OBJ_050_oPCAN_RADAR_9129875e_Tx: ComBitPosition=177, ComBitSize=10, ComSignalType=UINT16, ComHandleId=10930, ComSystemTemplateSystemSignalRef=OBJ_ACCELERATION_LAT_050
          OBJ_ACCELERATION_LONG_ERR_050_oRDR_TRACKER_OBJ_050_oPCAN_RADAR_5b78184a_Tx: ComBitPosition=215, ComBitSize=8, ComSignalType=UINT8, ComHandleId=10933, ComSystemTemplateSystemSignalRef=OBJ_ACCELERATION_LONG_ERR_050
          OBJ_CLS_TYPE2_050_oRDR_TRACKER_OBJ_050_oPCAN_RADAR_598b7443_Tx: ComBitPosition=267, ComBitSize=4, ComSignalType=UINT8, ComHandleId=10938, ComSystemTemplateSystemSignalRef=OBJ_CLS_TYPE2_050
          OBJ_CLS_TYPE2_PROB_050_oRDR_TRACKER_OBJ_050_oPCAN_RADAR_750fb8da_Tx: ComBitPosition=311, ComBitSize=8, ComSignalType=UINT8, ComHandleId=10939, ComSystemTemplateSystemSignalRef=OBJ_CLS_TYPE2_PROB_050
          OBJ_MOVEMENT_STATUS_050_oRDR_TRACKER_OBJ_050_oPCAN_RADAR_54af8cab_Tx: ComBitPosition=196, ComBitSize=3, ComSignalType=UINT8, ComHandleId=10958, ComSystemTemplateSystemSignalRef=OBJ_MOVEMENT_STATUS_050
          OBJ_VELOCITY_LAT_ERR_050_oRDR_TRACKER_OBJ_050_oPCAN_RADAR_56e684ab_Tx: ComBitPosition=151, ComBitSize=8, ComSignalType=UINT8, ComHandleId=10972, ComSystemTemplateSystemSignalRef=OBJ_VELOCITY_LAT_ERR_050
          OBJ_ACCEL_ERR_CRR_COEF_050_oRDR_TRACKER_OBJ_050_oPCAN_RADAR_fbdb392c_Tx: ComBitPosition=431, ComBitSize=8, ComSignalType=UINT8, ComHandleId=10934, ComSystemTemplateSystemSignalRef=OBJ_ACCEL_ERR_CRR_COEF_050
          OBJ_YAW_ANGLE_ERR_050_oRDR_TRACKER_OBJ_050_oPCAN_RADAR_5badb66d_Tx: ComBitPosition=175, ComBitSize=7, ComSignalType=UINT8, ComHandleId=10976, ComSystemTemplateSystemSignalRef=OBJ_YAW_ANGLE_ERR_050
          OBJ_TIMESTAMP_OFFSET_050_oRDR_TRACKER_OBJ_050_oPCAN_RADAR_041ce78c_Tx: ComBitPosition=247, ComBitSize=8, ComSignalType=UINT8, ComHandleId=10967, ComSystemTemplateSystemSignalRef=OBJ_TIMESTAMP_OFFSET_050
          OBJ_CLS_TYPE3_PROB_050_oRDR_TRACKER_OBJ_050_oPCAN_RADAR_321c4e21_Tx: ComBitPosition=319, ComBitSize=8, ComSignalType=UINT8, ComHandleId=10941, ComSystemTemplateSystemSignalRef=OBJ_CLS_TYPE3_PROB_050
          OBJ_ID_050_oRDR_TRACKER_OBJ_050_oPCAN_RADAR_04d36b5a_Tx: ComBitPosition=7, ComBitSize=8, ComSignalType=UINT8, ComHandleId=10954, ComSystemTemplateSystemSignalRef=OBJ_ID_050
          OBJ_POS_LONG_050_oRDR_TRACKER_OBJ_050_oPCAN_RADAR_97df5a12_Tx: ComBitPosition=63, ComBitSize=16, ComSignalType=UINT16, ComHandleId=10962, ComSystemTemplateSystemSignalRef=OBJ_POS_LONG_050
          OBJ_REF_PT_LONG_OFFSET_050_oRDR_TRACKER_OBJ_050_oPCAN_RADAR_bedf7cac_Tx: ComBitPosition=357, ComBitSize=14, ComSignalType=UINT16, ComHandleId=10966, ComSystemTemplateSystemSignalRef=OBJ_REF_PT_LONG_OFFSET_050
          OBJ_TRACK_MOTION_MODEL_050_oRDR_TRACKER_OBJ_050_oPCAN_RADAR_c81fe651_Tx: ComBitPosition=9, ComBitSize=2, ComSignalType=UINT8, ComHandleId=10968, ComSystemTemplateSystemSignalRef=OBJ_TRACK_MOTION_MODEL_050
          OBJ_CLS_TYPE5_PROB_050_oRDR_TRACKER_OBJ_050_oPCAN_RADAR_7b057e7a_Tx: ComBitPosition=335, ComBitSize=8, ComSignalType=UINT8, ComHandleId=10945, ComSystemTemplateSystemSignalRef=OBJ_CLS_TYPE5_PROB_050
          OBJ_YAW_RATE_ERR_050_oRDR_TRACKER_OBJ_050_oPCAN_RADAR_94f70221_Tx: ComBitPosition=388, ComBitSize=5, ComSignalType=UINT8, ComHandleId=10978, ComSystemTemplateSystemSignalRef=OBJ_YAW_RATE_ERR_050
          OBJ_VELOCITY_LONG_050_oRDR_TRACKER_OBJ_050_oPCAN_RADAR_32918c3c_Tx: ComBitPosition=110, ComBitSize=15, ComSignalType=UINT16, ComHandleId=10973, ComSystemTemplateSystemSignalRef=OBJ_VELOCITY_LONG_050
          OBJ_VELOCITY_LAT_050_oRDR_TRACKER_OBJ_050_oPCAN_RADAR_621cf4fa_Tx: ComBitPosition=126, ComBitSize=15, ComSignalType=UINT16, ComHandleId=10971, ComSystemTemplateSystemSignalRef=OBJ_VELOCITY_LAT_050
          OBJ_CLS_TYPE3_050_oRDR_TRACKER_OBJ_050_oPCAN_RADAR_d40389a1_Tx: ComBitPosition=279, ComBitSize=4, ComSignalType=UINT8, ComHandleId=10940, ComSystemTemplateSystemSignalRef=OBJ_CLS_TYPE3_050
          OBJ_VELOCITY_LONG_ERR_050_oRDR_TRACKER_OBJ_050_oPCAN_RADAR_ba64bb6b_Tx: ComBitPosition=143, ComBitSize=8, ComSignalType=UINT8, ComHandleId=10974, ComSystemTemplateSystemSignalRef=OBJ_VELOCITY_LONG_ERR_050
          OBJ_CLS_TYPE6_050_oRDR_TRACKER_OBJ_050_oPCAN_RADAR_023b8908_Tx: ComBitPosition=282, ComBitSize=4, ComSignalType=UINT8, ComHandleId=10946, ComSystemTemplateSystemSignalRef=OBJ_CLS_TYPE6_050
          OBJ_POS_LAT_ERR_050_oRDR_TRACKER_OBJ_050_oPCAN_RADAR_2233e1ea_Tx: ComBitPosition=103, ComBitSize=8, ComSignalType=UINT8, ComHandleId=10961, ComSystemTemplateSystemSignalRef=OBJ_POS_LAT_ERR_050
          OBJ_DIMENSION_LENGTH_ERR_050_oRDR_TRACKER_OBJ_050_oPCAN_RADAR_6d05381a_Tx: ComBitPosition=41, ComBitSize=10, ComSignalType=UINT16, ComHandleId=10949, ComSystemTemplateSystemSignalRef=OBJ_DIMENSION_LENGTH_ERR_050
          OBJ_GROUP_ID_050_oRDR_TRACKER_OBJ_050_oPCAN_RADAR_f7fd405d_Tx: ComBitPosition=405, ComBitSize=6, ComSignalType=UINT8, ComHandleId=10953, ComSystemTemplateSystemSignalRef=OBJ_GROUP_ID_050
          OBJ_POS_LONG_ERR_050_oRDR_TRACKER_OBJ_050_oPCAN_RADAR_bbcb1f08_Tx: ComBitPosition=95, ComBitSize=8, ComSignalType=UINT8, ComHandleId=10963, ComSystemTemplateSystemSignalRef=OBJ_POS_LONG_ERR_050
          OBJ_VEH_TRACK_FLAG_050_oRDR_TRACKER_OBJ_050_oPCAN_RADAR_4a35100c_Tx: ComBitPosition=10, ComBitSize=1, ComSignalType=BOOLEAN, ComHandleId=10969, ComSystemTemplateSystemSignalRef=OBJ_VEH_TRACK_FLAG_050
          OBJ_DIMENSION_LENGTH_050_oRDR_TRACKER_OBJ_050_oPCAN_RADAR_56fd2760_Tx: ComBitPosition=37, ComBitSize=12, ComSignalType=UINT16, ComHandleId=10948, ComSystemTemplateSystemSignalRef=OBJ_DIMENSION_LENGTH_050
          OBJ_MEASUREMENT_STATUS_050_oRDR_TRACKER_OBJ_050_oPCAN_RADAR_7b0119e7_Tx: ComBitPosition=14, ComBitSize=3, ComSignalType=UINT8, ComHandleId=10955, ComSystemTemplateSystemSignalRef=OBJ_MEASUREMENT_STATUS_050
          OBJ_DIMENSION_WIDTH_ERR_050_oRDR_TRACKER_OBJ_050_oPCAN_RADAR_95911725_Tx: ComBitPosition=23, ComBitSize=6, ComSignalType=UINT8, ComHandleId=10951, ComSystemTemplateSystemSignalRef=OBJ_DIMENSION_WIDTH_ERR_050
          OBJ_DIMENSION_WIDTH_050_oRDR_TRACKER_OBJ_050_oPCAN_RADAR_7533d0cd_Tx: ComBitPosition=17, ComBitSize=10, ComSignalType=UINT16, ComHandleId=10950, ComSystemTemplateSystemSignalRef=OBJ_DIMENSION_WIDTH_050
          OBJ_CLS_TYPE4_PROB_050_oRDR_TRACKER_OBJ_050_oPCAN_RADAR_3c168881_Tx: ComBitPosition=327, ComBitSize=8, ComSignalType=UINT8, ComHandleId=10943, ComSystemTemplateSystemSignalRef=OBJ_CLS_TYPE4_PROB_050
          OBJ_POS_ERR_CRR_COEF_050_oRDR_TRACKER_OBJ_050_oPCAN_RADAR_c4d04c91_Tx: ComBitPosition=415, ComBitSize=8, ComSignalType=UINT8, ComHandleId=10959, ComSystemTemplateSystemSignalRef=OBJ_POS_ERR_CRR_COEF_050
          OBJ_RCS_050_oRDR_TRACKER_OBJ_050_oPCAN_RADAR_04b0e7da_Tx: ComBitPosition=351, ComBitSize=7, ComSignalType=UINT8, ComHandleId=10964, ComSystemTemplateSystemSignalRef=OBJ_RCS_050
          OBJ_MH_CRC16_050_oRDR_TRACKER_OBJ_050_oPCAN_RADAR_0761aedb_Tx: ComBitPosition=495, ComBitSize=16, ComSignalType=UINT16, ComHandleId=10956, ComSystemTemplateSystemSignalRef=OBJ_MH_CRC16_050
          OBJ_MH_CYCLE_COUNTER_050_oRDR_TRACKER_OBJ_050_oPCAN_RADAR_7685f43a_Tx: ComBitPosition=487, ComBitSize=8, ComSignalType=UINT8, ComHandleId=10957, ComSystemTemplateSystemSignalRef=OBJ_MH_CYCLE_COUNTER_050
      RDR_TRACKER_OBJ_012_oPCAN_RADAR_0e4276ee_Tx (ComIPdu):
        ComIPduDirection = SEND
        ComIPduType = NORMAL
        ComIPduCancellationSupport = false
        ComIPduHandleId = 122
        ComIPduSignalProcessing = DEFERRED
        ComIPduChannelRef = CN_PCAN_RADAR_458ff0f1
        ComIPduGroupRef = RDR01_oPCAN_RADAR_Tx_b6bdb067 if post-build-variant-condition{matching-criterion=RDR_POS, value=0}
        ComIPduSignalGroupRef = SG_TrackerObject012_oRDR_TRACKER_OBJ_012_oPCAN_RADAR_276317b7_Tx
        ComPduIdRef = RDR_TRACKER_OBJ_012_oPCAN_RADAR_0e4276ee_Tx
        ComIPduMainFunctionRef = ComMainFunctionTx_Event
        ComIPduGroupRef = RDR02_oPCAN_RADAR_Tx_9f750495 if post-build-variant-condition{matching-criterion=RDR_POS, value=1}
        ComIPduGroupRef = RDR03_oPCAN_RADAR_Tx_311d9504 if post-build-variant-condition{matching-criterion=RDR_POS, value=2}
        ComIPduGroupRef = RDR04_oPCAN_RADAR_Tx_cce46d71 if post-build-variant-condition{matching-criterion=RDR_POS, value=3}
        ComIPduGroupRef = RDR05_oPCAN_RADAR_Tx_628cfce0 if post-build-variant-condition{matching-criterion=RDR_POS, value=4}
        ComIPduGroupRef = RDR06_oPCAN_RADAR_Tx_4b444812 if post-build-variant-condition{matching-criterion=RDR_POS, value=5}
        ComIPduGroupRef = RDR07_oPCAN_RADAR_Tx_e52cd983 if post-build-variant-condition{matching-criterion=RDR_POS, value=6}
        ComIPduGroupRef = RDR08_oPCAN_RADAR_Tx_6bc6beb9 if post-build-variant-condition{matching-criterion=RDR_POS, value=7}
        ComTxIPdu: ComMinimumDelayTime=0, ComTxIPduUnusedAreasDefault=0
          ComTxModeTrue
            ComTxMode: ComTxModeMode=DIRECT, ComTxModeNumberOfRepetitions=0
          ComTxModeFalse
            ComTxMode: ComTxModeMode=NONE
      RDR_DETECTION_297_300_oPCAN_RADAR_4a05a9bb_Tx (ComIPdu):
        ComIPduDirection = SEND
        ComIPduType = NORMAL
        ComIPduCancellationSupport = false
        ComIPduHandleId = 80
        ComIPduSignalProcessing = DEFERRED
        ComIPduChannelRef = CN_PCAN_RADAR_458ff0f1
        ComIPduGroupRef = RDR01_oPCAN_RADAR_Tx_b6bdb067 if post-build-variant-condition{matching-criterion=RDR_POS, value=0}
        ComIPduSignalGroupRef = SG_Detections_297_300_oRDR_DETECTION_297_300_oPCAN_RADAR_59a3068e_Tx
        ComPduIdRef = RDR_DETECTION_297_300_oPCAN_RADAR_4a05a9bb_Tx
        ComIPduMainFunctionRef = ComMainFunctionTx_Event
        ComIPduGroupRef = RDR02_oPCAN_RADAR_Tx_9f750495 if post-build-variant-condition{matching-criterion=RDR_POS, value=1}
        ComIPduGroupRef = RDR03_oPCAN_RADAR_Tx_311d9504 if post-build-variant-condition{matching-criterion=RDR_POS, value=2}
        ComIPduGroupRef = RDR04_oPCAN_RADAR_Tx_cce46d71 if post-build-variant-condition{matching-criterion=RDR_POS, value=3}
        ComIPduGroupRef = RDR05_oPCAN_RADAR_Tx_628cfce0 if post-build-variant-condition{matching-criterion=RDR_POS, value=4}
        ComIPduGroupRef = RDR06_oPCAN_RADAR_Tx_4b444812 if post-build-variant-condition{matching-criterion=RDR_POS, value=5}
        ComIPduGroupRef = RDR07_oPCAN_RADAR_Tx_e52cd983 if post-build-variant-condition{matching-criterion=RDR_POS, value=6}
        ComIPduGroupRef = RDR08_oPCAN_RADAR_Tx_6bc6beb9 if post-build-variant-condition{matching-criterion=RDR_POS, value=7}
        ComTxIPdu: ComMinimumDelayTime=0, ComTxIPduUnusedAreasDefault=0
          ComTxModeTrue
            ComTxMode: ComTxModeMode=DIRECT, ComTxModeNumberOfRepetitions=0
          ComTxModeFalse
            ComTxMode: ComTxModeMode=NONE
      SG_TrackerObject046_oRDR_TRACKER_OBJ_046_oPCAN_RADAR_b67413fe_Tx (ComSignalGroup):
        ComTransferProperty = TRIGGERED
        ComSignalGroupAccess = ACCESS_NEEDED_BY_SWC_OR_COM
        ComHandleId = 155
        ComSignalGroupArrayAccess = true
        ComSystemTemplateSignalGroupRef = SG_TrackerObject046
        49 x ComGroupSignal, all with ComSignalEndianness=BIG_ENDIAN, ComSignalInitValue=0, ComTransferProperty=PENDING, ComSignalAccess=ACCESS_NEEDED_BY_SWC_OR_COM:
          OBJ_POS_LONG_046_oRDR_TRACKER_OBJ_046_oPCAN_RADAR_bea695c5_Tx: ComBitPosition=63, ComBitSize=16, ComSignalType=UINT16, ComHandleId=10766, ComSystemTemplateSystemSignalRef=OBJ_POS_LONG_046
          OBJ_REF_PT_LAT_OFFSET_046_oRDR_TRACKER_OBJ_046_oPCAN_RADAR_d8f44378_Tx: ComBitPosition=370, ComBitSize=14, ComSignalType=UINT16, ComHandleId=10769, ComSystemTemplateSystemSignalRef=OBJ_REF_PT_LAT_OFFSET_046
          OBJ_ALIVE_TIME_046_oRDR_TRACKER_OBJ_046_oPCAN_RADAR_aac15ad5_Tx: ComBitPosition=255, ComBitSize=16, ComSignalType=UINT16, ComHandleId=10739, ComSystemTemplateSystemSignalRef=OBJ_ALIVE_TIME_046
          OBJ_YAW_RATE_ERR_046_oRDR_TRACKER_OBJ_046_oPCAN_RADAR_bd8ecdf6_Tx: ComBitPosition=388, ComBitSize=5, ComSignalType=UINT8, ComHandleId=10782, ComSystemTemplateSystemSignalRef=OBJ_YAW_RATE_ERR_046
          OBJ_RCS_046_oRDR_TRACKER_OBJ_046_oPCAN_RADAR_2dc9280d_Tx: ComBitPosition=351, ComBitSize=7, ComSignalType=UINT8, ComHandleId=10768, ComSystemTemplateSystemSignalRef=OBJ_RCS_046
          OBJ_POS_LAT_ERR_046_oRDR_TRACKER_OBJ_046_oPCAN_RADAR_0b4a2e3d_Tx: ComBitPosition=103, ComBitSize=8, ComSignalType=UINT8, ComHandleId=10765, ComSystemTemplateSystemSignalRef=OBJ_POS_LAT_ERR_046
          OBJ_POS_LONG_ERR_046_oRDR_TRACKER_OBJ_046_oPCAN_RADAR_92b2d0df_Tx: ComBitPosition=95, ComBitSize=8, ComSignalType=UINT8, ComHandleId=10767, ComSystemTemplateSystemSignalRef=OBJ_POS_LONG_ERR_046
          OBJ_REF_PT_LONG_OFFSET_046_oRDR_TRACKER_OBJ_046_oPCAN_RADAR_97a6b37b_Tx: ComBitPosition=357, ComBitSize=14, ComSignalType=UINT16, ComHandleId=10770, ComSystemTemplateSystemSignalRef=OBJ_REF_PT_LONG_OFFSET_046
          OBJ_CLS_TYPE6_PROB_046_oRDR_TRACKER_OBJ_046_oPCAN_RADAR_9b48aaa0_Tx: ComBitPosition=343, ComBitSize=8, ComSignalType=UINT8, ComHandleId=10751, ComSystemTemplateSystemSignalRef=OBJ_CLS_TYPE6_PROB_046
          OBJ_CLS_TYPE1_046_oRDR_TRACKER_OBJ_046_oPCAN_RADAR_3d1abbf3_Tx: ComBitPosition=271, ComBitSize=4, ComSignalType=UINT8, ComHandleId=10740, ComSystemTemplateSystemSignalRef=OBJ_CLS_TYPE1_046
          OBJ_DIMENSION_WIDTH_046_oRDR_TRACKER_OBJ_046_oPCAN_RADAR_5c4a1f1a_Tx: ComBitPosition=17, ComBitSize=10, ComSignalType=UINT16, ComHandleId=10754, ComSystemTemplateSystemSignalRef=OBJ_DIMENSION_WIDTH_046
          OBJ_POS_LAT_046_oRDR_TRACKER_OBJ_046_oPCAN_RADAR_0f067e0a_Tx: ComBitPosition=79, ComBitSize=16, ComSignalType=UINT16, ComHandleId=10764, ComSystemTemplateSystemSignalRef=OBJ_POS_LAT_046
          OBJ_CLS_TYPE3_046_oRDR_TRACKER_OBJ_046_oPCAN_RADAR_fd7a4676_Tx: ComBitPosition=279, ComBitSize=4, ComSignalType=UINT8, ComHandleId=10744, ComSystemTemplateSystemSignalRef=OBJ_CLS_TYPE3_046
          OBJ_CLS_TYPE5_PROB_046_oRDR_TRACKER_OBJ_046_oPCAN_RADAR_527cb1ad_Tx: ComBitPosition=335, ComBitSize=8, ComSignalType=UINT8, ComHandleId=10749, ComSystemTemplateSystemSignalRef=OBJ_CLS_TYPE5_PROB_046
          OBJ_ACCEL_ERR_CRR_COEF_046_oRDR_TRACKER_OBJ_046_oPCAN_RADAR_d2a2f6fb_Tx: ComBitPosition=431, ComBitSize=8, ComSignalType=UINT8, ComHandleId=10738, ComSystemTemplateSystemSignalRef=OBJ_ACCEL_ERR_CRR_COEF_046
          OBJ_CLS_TYPE1_PROB_046_oRDR_TRACKER_OBJ_046_oPCAN_RADAR_95426c00_Tx: ComBitPosition=303, ComBitSize=8, ComSignalType=UINT8, ComHandleId=10741, ComSystemTemplateSystemSignalRef=OBJ_CLS_TYPE1_PROB_046
          OBJ_VELOCITY_LAT_046_oRDR_TRACKER_OBJ_046_oPCAN_RADAR_4b653b2d_Tx: ComBitPosition=126, ComBitSize=15, ComSignalType=UINT16, ComHandleId=10775, ComSystemTemplateSystemSignalRef=OBJ_VELOCITY_LAT_046
          OBJ_TIMESTAMP_OFFSET_046_oRDR_TRACKER_OBJ_046_oPCAN_RADAR_2d65285b_Tx: ComBitPosition=247, ComBitSize=8, ComSignalType=UINT8, ComHandleId=10771, ComSystemTemplateSystemSignalRef=OBJ_TIMESTAMP_OFFSET_046
          OBJ_VELOCITY_LONG_ERR_046_oRDR_TRACKER_OBJ_046_oPCAN_RADAR_931d74bc_Tx: ComBitPosition=143, ComBitSize=8, ComSignalType=UINT8, ComHandleId=10778, ComSystemTemplateSystemSignalRef=OBJ_VELOCITY_LONG_ERR_046
          OBJ_EXISTENCE_PROB_046_oRDR_TRACKER_OBJ_046_oPCAN_RADAR_57f69b27_Tx: ComBitPosition=229, ComBitSize=14, ComSignalType=UINT16, ComHandleId=10756, ComSystemTemplateSystemSignalRef=OBJ_EXISTENCE_PROB_046
          OBJ_VELOCITY_LONG_046_oRDR_TRACKER_OBJ_046_oPCAN_RADAR_1be843eb_Tx: ComBitPosition=110, ComBitSize=15, ComSignalType=UINT16, ComHandleId=10777, ComSystemTemplateSystemSignalRef=OBJ_VELOCITY_LONG_046
          OBJ_CLS_TYPE4_046_oRDR_TRACKER_OBJ_046_oPCAN_RADAR_eb22bb5a_Tx: ComBitPosition=275, ComBitSize=4, ComSignalType=UINT8, ComHandleId=10746, ComSystemTemplateSystemSignalRef=OBJ_CLS_TYPE4_046
          OBJ_VEH_TRACK_FLAG_046_oRDR_TRACKER_OBJ_046_oPCAN_RADAR_634cdfdb_Tx: ComBitPosition=10, ComBitSize=1, ComSignalType=BOOLEAN, ComHandleId=10773, ComSystemTemplateSystemSignalRef=OBJ_VEH_TRACK_FLAG_046
          OBJ_DIMENSION_LENGTH_ERR_046_oRDR_TRACKER_OBJ_046_oPCAN_RADAR_447cf7cd_Tx: ComBitPosition=41, ComBitSize=10, ComSignalType=UINT16, ComHandleId=10753, ComSystemTemplateSystemSignalRef=OBJ_DIMENSION_LENGTH_ERR_046
          OBJ_CLS_TYPE2_046_oRDR_TRACKER_OBJ_046_oPCAN_RADAR_70f2bb94_Tx: ComBitPosition=267, ComBitSize=4, ComSignalType=UINT8, ComHandleId=10742, ComSystemTemplateSystemSignalRef=OBJ_CLS_TYPE2_046
          OBJ_CLS_TYPE3_PROB_046_oRDR_TRACKER_OBJ_046_oPCAN_RADAR_1b6581f6_Tx: ComBitPosition=319, ComBitSize=8, ComSignalType=UINT8, ComHandleId=10745, ComSystemTemplateSystemSignalRef=OBJ_CLS_TYPE3_PROB_046
          OBJ_ACCELERATION_LONG_046_oRDR_TRACKER_OBJ_046_oPCAN_RADAR_caa01169_Tx: ComBitPosition=193, ComBitSize=10, ComSignalType=UINT16, ComHandleId=10736, ComSystemTemplateSystemSignalRef=OBJ_ACCELERATION_LONG_046
          OBJ_CLS_TYPE5_046_oRDR_TRACKER_OBJ_046_oPCAN_RADAR_66aa46b8_Tx: ComBitPosition=287, ComBitSize=4, ComSignalType=UINT8, ComHandleId=10748, ComSystemTemplateSystemSignalRef=OBJ_CLS_TYPE5_046
          OBJ_GROUP_ID_046_oRDR_TRACKER_OBJ_046_oPCAN_RADAR_de848f8a_Tx: ComBitPosition=405, ComBitSize=6, ComSignalType=UINT8, ComHandleId=10757, ComSystemTemplateSystemSignalRef=OBJ_GROUP_ID_046
          OBJ_ACCELERATION_LAT_ERR_046_oRDR_TRACKER_OBJ_046_oPCAN_RADAR_6da47237_Tx: ComBitPosition=223, ComBitSize=8, ComSignalType=UINT8, ComHandleId=10735, ComSystemTemplateSystemSignalRef=OBJ_ACCELERATION_LAT_ERR_046
          OBJ_VELOCITY_ERR_CRR_COEF_046_oRDR_TRACKER_OBJ_046_oPCAN_RADAR_44d3bea7_Tx: ComBitPosition=423, ComBitSize=8, ComSignalType=UINT8, ComHandleId=10774, ComSystemTemplateSystemSignalRef=OBJ_VELOCITY_ERR_CRR_COEF_046
          OBJ_VELOCITY_LAT_ERR_046_oRDR_TRACKER_OBJ_046_oPCAN_RADAR_7f9f4b7c_Tx: ComBitPosition=151, ComBitSize=8, ComSignalType=UINT8, ComHandleId=10776, ComSystemTemplateSystemSignalRef=OBJ_VELOCITY_LAT_ERR_046
          OBJ_CLS_TYPE4_PROB_046_oRDR_TRACKER_OBJ_046_oPCAN_RADAR_156f4756_Tx: ComBitPosition=327, ComBitSize=8, ComSignalType=UINT8, ComHandleId=10747, ComSystemTemplateSystemSignalRef=OBJ_CLS_TYPE4_PROB_046
          OBJ_DIMENSION_LENGTH_046_oRDR_TRACKER_OBJ_046_oPCAN_RADAR_7f84e8b7_Tx: ComBitPosition=37, ComBitSize=12, ComSignalType=UINT16, ComHandleId=10752, ComSystemTemplateSystemSignalRef=OBJ_DIMENSION_LENGTH_046
          OBJ_DIMENSION_WIDTH_ERR_046_oRDR_TRACKER_OBJ_046_oPCAN_RADAR_bce8d8f2_Tx: ComBitPosition=23, ComBitSize=6, ComSignalType=UINT8, ComHandleId=10755, ComSystemTemplateSystemSignalRef=OBJ_DIMENSION_WIDTH_ERR_046
          OBJ_TRACK_MOTION_MODEL_046_oRDR_TRACKER_OBJ_046_oPCAN_RADAR_e1662986_Tx: ComBitPosition=9, ComBitSize=2, ComSignalType=UINT8, ComHandleId=10772, ComSystemTemplateSystemSignalRef=OBJ_TRACK_MOTION_MODEL_046
          OBJ_YAW_ANGLE_046_oRDR_TRACKER_OBJ_046_oPCAN_RADAR_a7d97f6d_Tx: ComBitPosition=155, ComBitSize=12, ComSignalType=UINT16, ComHandleId=10779, ComSystemTemplateSystemSignalRef=OBJ_YAW_ANGLE_046
          OBJ_CLS_TYPE2_PROB_046_oRDR_TRACKER_OBJ_046_oPCAN_RADAR_5c76770d_Tx: ComBitPosition=311, ComBitSize=8, ComSignalType=UINT8, ComHandleId=10743, ComSystemTemplateSystemSignalRef=OBJ_CLS_TYPE2_PROB_046
          OBJ_MEASUREMENT_STATUS_046_oRDR_TRACKER_OBJ_046_oPCAN_RADAR_5278d630_Tx: ComBitPosition=14, ComBitSize=3, ComSignalType=UINT8, ComHandleId=10759, ComSystemTemplateSystemSignalRef=OBJ_MEASUREMENT_STATUS_046
          OBJ_MOVEMENT_STATUS_046_oRDR_TRACKER_OBJ_046_oPCAN_RADAR_7dd6437c_Tx: ComBitPosition=196, ComBitSize=3, ComSignalType=UINT8, ComHandleId=10762, ComSystemTemplateSystemSignalRef=OBJ_MOVEMENT_STATUS_046
          OBJ_YAW_RATE_046_oRDR_TRACKER_OBJ_046_oPCAN_RADAR_82565a2a_Tx: ComBitPosition=399, ComBitSize=10, ComSignalType=UINT16, ComHandleId=10781, ComSystemTemplateSystemSignalRef=OBJ_YAW_RATE_046
          OBJ_ACCELERATION_LONG_ERR_046_oRDR_TRACKER_OBJ_046_oPCAN_RADAR_7201d79d_Tx: ComBitPosition=215, ComBitSize=8, ComSignalType=UINT8, ComHandleId=10737, ComSystemTemplateSystemSignalRef=OBJ_ACCELERATION_LONG_ERR_046
          OBJ_YAW_ANGLE_ERR_046_oRDR_TRACKER_OBJ_046_oPCAN_RADAR_72d479ba_Tx: ComBitPosition=175, ComBitSize=7, ComSignalType=UINT8, ComHandleId=10780, ComSystemTemplateSystemSignalRef=OBJ_YAW_ANGLE_ERR_046
          OBJ_CLS_TYPE6_046_oRDR_TRACKER_OBJ_046_oPCAN_RADAR_2b4246df_Tx: ComBitPosition=282, ComBitSize=4, ComSignalType=UINT8, ComHandleId=10750, ComSystemTemplateSystemSignalRef=OBJ_CLS_TYPE6_046
          OBJ_POS_ERR_CRR_COEF_046_oRDR_TRACKER_OBJ_046_oPCAN_RADAR_eda98346_Tx: ComBitPosition=415, ComBitSize=8, ComSignalType=UINT8, ComHandleId=10763, ComSystemTemplateSystemSignalRef=OBJ_POS_ERR_CRR_COEF_046
          OBJ_ID_046_oRDR_TRACKER_OBJ_046_oPCAN_RADAR_2daaa48d_Tx: ComBitPosition=7, ComBitSize=8, ComSignalType=UINT8, ComHandleId=10758, ComSystemTemplateSystemSignalRef=OBJ_ID_046
          OBJ_ACCELERATION_LAT_046_oRDR_TRACKER_OBJ_046_oPCAN_RADAR_b8504889_Tx: ComBitPosition=177, ComBitSize=10, ComSignalType=UINT16, ComHandleId=10734, ComSystemTemplateSystemSignalRef=OBJ_ACCELERATION_LAT_046
          OBJ_MH_CYCLE_COUNTER_046_oRDR_TRACKER_OBJ_046_oPCAN_RADAR_5ffc3bed_Tx: ComBitPosition=487, ComBitSize=8, ComSignalType=UINT8, ComHandleId=10761, ComSystemTemplateSystemSignalRef=OBJ_MH_CYCLE_COUNTER_046
          OBJ_MH_CRC16_046_oRDR_TRACKER_OBJ_046_oPCAN_RADAR_2e18610c_Tx: ComBitPosition=495, ComBitSize=16, ComSignalType=UINT16, ComHandleId=10760, ComSystemTemplateSystemSignalRef=OBJ_MH_CRC16_046
      RDR_DETECTION_197_200_oPCAN_RADAR_50a8f4fa_Tx (ComIPdu):
        ComIPduDirection = SEND
        ComIPduType = NORMAL
        ComIPduCancellationSupport = false
        ComIPduHandleId = 55
        ComIPduSignalProcessing = DEFERRED
        ComIPduChannelRef = CN_PCAN_RADAR_458ff0f1
        ComIPduGroupRef = RDR01_oPCAN_RADAR_Tx_b6bdb067 if post-build-variant-condition{matching-criterion=RDR_POS, value=0}
        ComIPduSignalGroupRef = SG_Detections_197_200_oRDR_DETECTION_197_200_oPCAN_RADAR_f6bd2d5e_Tx
        ComPduIdRef = RDR_DETECTION_197_200_oPCAN_RADAR_50a8f4fa_Tx
        ComIPduMainFunctionRef = ComMainFunctionTx_Event
        ComIPduGroupRef = RDR02_oPCAN_RADAR_Tx_9f750495 if post-build-variant-condition{matching-criterion=RDR_POS, value=1}
        ComIPduGroupRef = RDR03_oPCAN_RADAR_Tx_311d9504 if post-build-variant-condition{matching-criterion=RDR_POS, value=2}
        ComIPduGroupRef = RDR04_oPCAN_RADAR_Tx_cce46d71 if post-build-variant-condition{matching-criterion=RDR_POS, value=3}
        ComIPduGroupRef = RDR05_oPCAN_RADAR_Tx_628cfce0 if post-build-variant-condition{matching-criterion=RDR_POS, value=4}
        ComIPduGroupRef = RDR06_oPCAN_RADAR_Tx_4b444812 if post-build-variant-condition{matching-criterion=RDR_POS, value=5}
        ComIPduGroupRef = RDR07_oPCAN_RADAR_Tx_e52cd983 if post-build-variant-condition{matching-criterion=RDR_POS, value=6}
        ComIPduGroupRef = RDR08_oPCAN_RADAR_Tx_6bc6beb9 if post-build-variant-condition{matching-criterion=RDR_POS, value=7}
        ComTxIPdu: ComMinimumDelayTime=0, ComTxIPduUnusedAreasDefault=0
          ComTxModeTrue
            ComTxMode: ComTxModeMode=DIRECT, ComTxModeNumberOfRepetitions=0
          ComTxModeFalse
            ComTxMode: ComTxModeMode=NONE
      SG_TrackerObject043_oRDR_TRACKER_OBJ_043_oPCAN_RADAR_1dd0b503_Tx (ComSignalGroup):
        ComTransferProperty = TRIGGERED
        ComSignalGroupAccess = ACCESS_NEEDED_BY_SWC_OR_COM
        ComHandleId = 152
        ComSignalGroupArrayAccess = true
        ComSystemTemplateSignalGroupRef = SG_TrackerObject043
        49 x ComGroupSignal, all with ComSignalEndianness=BIG_ENDIAN, ComSignalInitValue=0, ComTransferProperty=PENDING, ComSignalAccess=ACCESS_NEEDED_BY_SWC_OR_COM:
          OBJ_REF_PT_LONG_OFFSET_043_oRDR_TRACKER_OBJ_043_oPCAN_RADAR_3c021586_Tx: ComBitPosition=357, ComBitSize=14, ComSignalType=UINT16, ComHandleId=10623, ComSystemTemplateSystemSignalRef=OBJ_REF_PT_LONG_OFFSET_043
          OBJ_CLS_TYPE4_PROB_043_oRDR_TRACKER_OBJ_043_oPCAN_RADAR_becbe1ab_Tx: ComBitPosition=327, ComBitSize=8, ComSignalType=UINT8, ComHandleId=10600, ComSystemTemplateSystemSignalRef=OBJ_CLS_TYPE4_PROB_043
          OBJ_VEH_TRACK_FLAG_043_oRDR_TRACKER_OBJ_043_oPCAN_RADAR_c8e87926_Tx: ComBitPosition=10, ComBitSize=1, ComSignalType=BOOLEAN, ComHandleId=10626, ComSystemTemplateSystemSignalRef=OBJ_VEH_TRACK_FLAG_043
          OBJ_VELOCITY_LAT_043_oRDR_TRACKER_OBJ_043_oPCAN_RADAR_e0c19dd0_Tx: ComBitPosition=126, ComBitSize=15, ComSignalType=UINT16, ComHandleId=10628, ComSystemTemplateSystemSignalRef=OBJ_VELOCITY_LAT_043
          OBJ_DIMENSION_WIDTH_ERR_043_oRDR_TRACKER_OBJ_043_oPCAN_RADAR_174c7e0f_Tx: ComBitPosition=23, ComBitSize=6, ComSignalType=UINT8, ComHandleId=10608, ComSystemTemplateSystemSignalRef=OBJ_DIMENSION_WIDTH_ERR_043
          OBJ_VELOCITY_LAT_ERR_043_oRDR_TRACKER_OBJ_043_oPCAN_RADAR_d43bed81_Tx: ComBitPosition=151, ComBitSize=8, ComSignalType=UINT8, ComHandleId=10629, ComSystemTemplateSystemSignalRef=OBJ_VELOCITY_LAT_ERR_043
          OBJ_DIMENSION_LENGTH_ERR_043_oRDR_TRACKER_OBJ_043_oPCAN_RADAR_efd85130_Tx: ComBitPosition=41, ComBitSize=10, ComSignalType=UINT16, ComHandleId=10606, ComSystemTemplateSystemSignalRef=OBJ_DIMENSION_LENGTH_ERR_043
          OBJ_VELOCITY_LONG_ERR_043_oRDR_TRACKER_OBJ_043_oPCAN_RADAR_38b9d241_Tx: ComBitPosition=143, ComBitSize=8, ComSignalType=UINT8, ComHandleId=10631, ComSystemTemplateSystemSignalRef=OBJ_VELOCITY_LONG_ERR_043
          OBJ_ACCEL_ERR_CRR_COEF_043_oRDR_TRACKER_OBJ_043_oPCAN_RADAR_79065006_Tx: ComBitPosition=431, ComBitSize=8, ComSignalType=UINT8, ComHandleId=10591, ComSystemTemplateSystemSignalRef=OBJ_ACCEL_ERR_CRR_COEF_043
          OBJ_VELOCITY_ERR_CRR_COEF_043_oRDR_TRACKER_OBJ_043_oPCAN_RADAR_ef77185a_Tx: ComBitPosition=423, ComBitSize=8, ComSignalType=UINT8, ComHandleId=10627, ComSystemTemplateSystemSignalRef=OBJ_VELOCITY_ERR_CRR_COEF_043
          OBJ_ALIVE_TIME_043_oRDR_TRACKER_OBJ_043_oPCAN_RADAR_0165fc28_Tx: ComBitPosition=255, ComBitSize=16, ComSignalType=UINT16, ComHandleId=10592, ComSystemTemplateSystemSignalRef=OBJ_ALIVE_TIME_043
          OBJ_POS_LAT_ERR_043_oRDR_TRACKER_OBJ_043_oPCAN_RADAR_a0ee88c0_Tx: ComBitPosition=103, ComBitSize=8, ComSignalType=UINT8, ComHandleId=10618, ComSystemTemplateSystemSignalRef=OBJ_POS_LAT_ERR_043
          OBJ_YAW_ANGLE_ERR_043_oRDR_TRACKER_OBJ_043_oPCAN_RADAR_d970df47_Tx: ComBitPosition=175, ComBitSize=7, ComSignalType=UINT8, ComHandleId=10633, ComSystemTemplateSystemSignalRef=OBJ_YAW_ANGLE_ERR_043
          OBJ_POS_LONG_043_oRDR_TRACKER_OBJ_043_oPCAN_RADAR_15023338_Tx: ComBitPosition=63, ComBitSize=16, ComSignalType=UINT16, ComHandleId=10619, ComSystemTemplateSystemSignalRef=OBJ_POS_LONG_043
          OBJ_ID_043_oRDR_TRACKER_OBJ_043_oPCAN_RADAR_860e0270_Tx: ComBitPosition=7, ComBitSize=8, ComSignalType=UINT8, ComHandleId=10611, ComSystemTemplateSystemSignalRef=OBJ_ID_043
          OBJ_CLS_TYPE2_PROB_043_oRDR_TRACKER_OBJ_043_oPCAN_RADAR_f7d2d1f0_Tx: ComBitPosition=311, ComBitSize=8, ComSignalType=UINT8, ComHandleId=10596, ComSystemTemplateSystemSignalRef=OBJ_CLS_TYPE2_PROB_043
          OBJ_ACCELERATION_LONG_043_oRDR_TRACKER_OBJ_043_oPCAN_RADAR_6104b794_Tx: ComBitPosition=193, ComBitSize=10, ComSignalType=UINT16, ComHandleId=10589, ComSystemTemplateSystemSignalRef=OBJ_ACCELERATION_LONG_043
          OBJ_YAW_RATE_043_oRDR_TRACKER_OBJ_043_oPCAN_RADAR_29f2fcd7_Tx: ComBitPosition=399, ComBitSize=10, ComSignalType=UINT16, ComHandleId=10634, ComSystemTemplateSystemSignalRef=OBJ_YAW_RATE_043
          OBJ_DIMENSION_LENGTH_043_oRDR_TRACKER_OBJ_043_oPCAN_RADAR_d4204e4a_Tx: ComBitPosition=37, ComBitSize=12, ComSignalType=UINT16, ComHandleId=10605, ComSystemTemplateSystemSignalRef=OBJ_DIMENSION_LENGTH_043
          OBJ_CLS_TYPE6_043_oRDR_TRACKER_OBJ_043_oPCAN_RADAR_80e6e022_Tx: ComBitPosition=282, ComBitSize=4, ComSignalType=UINT8, ComHandleId=10603, ComSystemTemplateSystemSignalRef=OBJ_CLS_TYPE6_043
          OBJ_MEASUREMENT_STATUS_043_oRDR_TRACKER_OBJ_043_oPCAN_RADAR_f9dc70cd_Tx: ComBitPosition=14, ComBitSize=3, ComSignalType=UINT8, ComHandleId=10612, ComSystemTemplateSystemSignalRef=OBJ_MEASUREMENT_STATUS_043
          OBJ_ACCELERATION_LAT_043_oRDR_TRACKER_OBJ_043_oPCAN_RADAR_13f4ee74_Tx: ComBitPosition=177, ComBitSize=10, ComSignalType=UINT16, ComHandleId=10587, ComSystemTemplateSystemSignalRef=OBJ_ACCELERATION_LAT_043
          OBJ_CLS_TYPE1_043_oRDR_TRACKER_OBJ_043_oPCAN_RADAR_96be1d0e_Tx: ComBitPosition=271, ComBitSize=4, ComSignalType=UINT8, ComHandleId=10593, ComSystemTemplateSystemSignalRef=OBJ_CLS_TYPE1_043
          OBJ_POS_LAT_043_oRDR_TRACKER_OBJ_043_oPCAN_RADAR_a4a2d8f7_Tx: ComBitPosition=79, ComBitSize=16, ComSignalType=UINT16, ComHandleId=10617, ComSystemTemplateSystemSignalRef=OBJ_POS_LAT_043
          OBJ_YAW_ANGLE_043_oRDR_TRACKER_OBJ_043_oPCAN_RADAR_0c7dd990_Tx: ComBitPosition=155, ComBitSize=12, ComSignalType=UINT16, ComHandleId=10632, ComSystemTemplateSystemSignalRef=OBJ_YAW_ANGLE_043
          OBJ_CLS_TYPE5_043_oRDR_TRACKER_OBJ_043_oPCAN_RADAR_cd0ee045_Tx: ComBitPosition=287, ComBitSize=4, ComSignalType=UINT8, ComHandleId=10601, ComSystemTemplateSystemSignalRef=OBJ_CLS_TYPE5_043
          OBJ_POS_ERR_CRR_COEF_043_oRDR_TRACKER_OBJ_043_oPCAN_RADAR_460d25bb_Tx: ComBitPosition=415, ComBitSize=8, ComSignalType=UINT8, ComHandleId=10616, ComSystemTemplateSystemSignalRef=OBJ_POS_ERR_CRR_COEF_043
          OBJ_ACCELERATION_LONG_ERR_043_oRDR_TRACKER_OBJ_043_oPCAN_RADAR_d9a57160_Tx: ComBitPosition=215, ComBitSize=8, ComSignalType=UINT8, ComHandleId=10590, ComSystemTemplateSystemSignalRef=OBJ_ACCELERATION_LONG_ERR_043
          OBJ_CLS_TYPE6_PROB_043_oRDR_TRACKER_OBJ_043_oPCAN_RADAR_30ec0c5d_Tx: ComBitPosition=343, ComBitSize=8, ComSignalType=UINT8, ComHandleId=10604, ComSystemTemplateSystemSignalRef=OBJ_CLS_TYPE6_PROB_043
          OBJ_YAW_RATE_ERR_043_oRDR_TRACKER_OBJ_043_oPCAN_RADAR_162a6b0b_Tx: ComBitPosition=388, ComBitSize=5, ComSignalType=UINT8, ComHandleId=10635, ComSystemTemplateSystemSignalRef=OBJ_YAW_RATE_ERR_043
          OBJ_ACCELERATION_LAT_ERR_043_oRDR_TRACKER_OBJ_043_oPCAN_RADAR_c600d4ca_Tx: ComBitPosition=223, ComBitSize=8, ComSignalType=UINT8, ComHandleId=10588, ComSystemTemplateSystemSignalRef=OBJ_ACCELERATION_LAT_ERR_043
          OBJ_MOVEMENT_STATUS_043_oRDR_TRACKER_OBJ_043_oPCAN_RADAR_d672e581_Tx: ComBitPosition=196, ComBitSize=3, ComSignalType=UINT8, ComHandleId=10615, ComSystemTemplateSystemSignalRef=OBJ_MOVEMENT_STATUS_043
          OBJ_POS_LONG_ERR_043_oRDR_TRACKER_OBJ_043_oPCAN_RADAR_39167622_Tx: ComBitPosition=95, ComBitSize=8, ComSignalType=UINT8, ComHandleId=10620, ComSystemTemplateSystemSignalRef=OBJ_POS_LONG_ERR_043
          OBJ_TIMESTAMP_OFFSET_043_oRDR_TRACKER_OBJ_043_oPCAN_RADAR_86c18ea6_Tx: ComBitPosition=247, ComBitSize=8, ComSignalType=UINT8, ComHandleId=10624, ComSystemTemplateSystemSignalRef=OBJ_TIMESTAMP_OFFSET_043
          OBJ_CLS_TYPE1_PROB_043_oRDR_TRACKER_OBJ_043_oPCAN_RADAR_3ee6cafd_Tx: ComBitPosition=303, ComBitSize=8, ComSignalType=UINT8, ComHandleId=10594, ComSystemTemplateSystemSignalRef=OBJ_CLS_TYPE1_PROB_043
          OBJ_CLS_TYPE4_043_oRDR_TRACKER_OBJ_043_oPCAN_RADAR_40861da7_Tx: ComBitPosition=275, ComBitSize=4, ComSignalType=UINT8, ComHandleId=10599, ComSystemTemplateSystemSignalRef=OBJ_CLS_TYPE4_043
          OBJ_DIMENSION_WIDTH_043_oRDR_TRACKER_OBJ_043_oPCAN_RADAR_f7eeb9e7_Tx: ComBitPosition=17, ComBitSize=10, ComSignalType=UINT16, ComHandleId=10607, ComSystemTemplateSystemSignalRef=OBJ_DIMENSION_WIDTH_043
          OBJ_CLS_TYPE3_043_oRDR_TRACKER_OBJ_043_oPCAN_RADAR_56dee08b_Tx: ComBitPosition=279, ComBitSize=4, ComSignalType=UINT8, ComHandleId=10597, ComSystemTemplateSystemSignalRef=OBJ_CLS_TYPE3_043
          OBJ_CLS_TYPE3_PROB_043_oRDR_TRACKER_OBJ_043_oPCAN_RADAR_b0c1270b_Tx: ComBitPosition=319, ComBitSize=8, ComSignalType=UINT8, ComHandleId=10598, ComSystemTemplateSystemSignalRef=OBJ_CLS_TYPE3_PROB_043
          OBJ_REF_PT_LAT_OFFSET_043_oRDR_TRACKER_OBJ_043_oPCAN_RADAR_7350e585_Tx: ComBitPosition=370, ComBitSize=14, ComSignalType=UINT16, ComHandleId=10622, ComSystemTemplateSystemSignalRef=OBJ_REF_PT_LAT_OFFSET_043
          OBJ_VELOCITY_LONG_043_oRDR_TRACKER_OBJ_043_oPCAN_RADAR_b04ce516_Tx: ComBitPosition=110, ComBitSize=15, ComSignalType=UINT16, ComHandleId=10630, ComSystemTemplateSystemSignalRef=OBJ_VELOCITY_LONG_043
          OBJ_CLS_TYPE5_PROB_043_oRDR_TRACKER_OBJ_043_oPCAN_RADAR_f9d81750_Tx: ComBitPosition=335, ComBitSize=8, ComSignalType=UINT8, ComHandleId=10602, ComSystemTemplateSystemSignalRef=OBJ_CLS_TYPE5_PROB_043
          OBJ_GROUP_ID_043_oRDR_TRACKER_OBJ_043_oPCAN_RADAR_75202977_Tx: ComBitPosition=405, ComBitSize=6, ComSignalType=UINT8, ComHandleId=10610, ComSystemTemplateSystemSignalRef=OBJ_GROUP_ID_043
          OBJ_CLS_TYPE2_043_oRDR_TRACKER_OBJ_043_oPCAN_RADAR_db561d69_Tx: ComBitPosition=267, ComBitSize=4, ComSignalType=UINT8, ComHandleId=10595, ComSystemTemplateSystemSignalRef=OBJ_CLS_TYPE2_043
          OBJ_EXISTENCE_PROB_043_oRDR_TRACKER_OBJ_043_oPCAN_RADAR_fc523dda_Tx: ComBitPosition=229, ComBitSize=14, ComSignalType=UINT16, ComHandleId=10609, ComSystemTemplateSystemSignalRef=OBJ_EXISTENCE_PROB_043
          OBJ_RCS_043_oRDR_TRACKER_OBJ_043_oPCAN_RADAR_866d8ef0_Tx: ComBitPosition=351, ComBitSize=7, ComSignalType=UINT8, ComHandleId=10621, ComSystemTemplateSystemSignalRef=OBJ_RCS_043
          OBJ_TRACK_MOTION_MODEL_043_oRDR_TRACKER_OBJ_043_oPCAN_RADAR_4ac28f7b_Tx: ComBitPosition=9, ComBitSize=2, ComSignalType=UINT8, ComHandleId=10625, ComSystemTemplateSystemSignalRef=OBJ_TRACK_MOTION_MODEL_043
          OBJ_MH_CRC16_043_oRDR_TRACKER_OBJ_043_oPCAN_RADAR_85bcc7f1_Tx: ComBitPosition=495, ComBitSize=16, ComSignalType=UINT16, ComHandleId=10613, ComSystemTemplateSystemSignalRef=OBJ_MH_CRC16_043
          OBJ_MH_CYCLE_COUNTER_043_oRDR_TRACKER_OBJ_043_oPCAN_RADAR_f4589d10_Tx: ComBitPosition=487, ComBitSize=8, ComSignalType=UINT8, ComHandleId=10614, ComSystemTemplateSystemSignalRef=OBJ_MH_CYCLE_COUNTER_043
      RDR_DETECTION_341_344_oPCAN_RADAR_106db48d_Tx (ComIPdu):
        ComIPduDirection = SEND
        ComIPduType = NORMAL
        ComIPduCancellationSupport = false
        ComIPduHandleId = 91
        ComIPduSignalProcessing = DEFERRED
        ComIPduChannelRef = CN_PCAN_RADAR_458ff0f1
        ComIPduGroupRef = RDR01_oPCAN_RADAR_Tx_b6bdb067 if post-build-variant-condition{matching-criterion=RDR_POS, value=0}
        ComIPduSignalGroupRef = SG_Detections_341_344_oRDR_DETECTION_341_344_oPCAN_RADAR_725bb2c5_Tx
        ComPduIdRef = RDR_DETECTION_341_344_oPCAN_RADAR_106db48d_Tx
        ComIPduMainFunctionRef = ComMainFunctionTx_Event
        ComIPduGroupRef = RDR02_oPCAN_RADAR_Tx_9f750495 if post-build-variant-condition{matching-criterion=RDR_POS, value=1}
        ComIPduGroupRef = RDR03_oPCAN_RADAR_Tx_311d9504 if post-build-variant-condition{matching-criterion=RDR_POS, value=2}
        ComIPduGroupRef = RDR04_oPCAN_RADAR_Tx_cce46d71 if post-build-variant-condition{matching-criterion=RDR_POS, value=3}
        ComIPduGroupRef = RDR05_oPCAN_RADAR_Tx_628cfce0 if post-build-variant-condition{matching-criterion=RDR_POS, value=4}
        ComIPduGroupRef = RDR06_oPCAN_RADAR_Tx_4b444812 if post-build-variant-condition{matching-criterion=RDR_POS, value=5}
        ComIPduGroupRef = RDR07_oPCAN_RADAR_Tx_e52cd983 if post-build-variant-condition{matching-criterion=RDR_POS, value=6}
        ComIPduGroupRef = RDR08_oPCAN_RADAR_Tx_6bc6beb9 if post-build-variant-condition{matching-criterion=RDR_POS, value=7}
        ComTxIPdu: ComMinimumDelayTime=0, ComTxIPduUnusedAreasDefault=0
          ComTxModeTrue
            ComTxMode: ComTxModeMode=DIRECT, ComTxModeNumberOfRepetitions=0
          ComTxModeFalse
            ComTxMode: ComTxModeMode=NONE
      SG_TrackerObject057_oRDR_TRACKER_OBJ_057_oPCAN_RADAR_1df16df3_Tx (ComSignalGroup):
        ComTransferProperty = TRIGGERED
        ComSignalGroupAccess = ACCESS_NEEDED_BY_SWC_OR_COM
        ComHandleId = 166
        ComSignalGroupArrayAccess = true
        ComSystemTemplateSignalGroupRef = SG_TrackerObject057
        49 x ComGroupSignal, all with ComSignalEndianness=BIG_ENDIAN, ComSignalInitValue=0, ComTransferProperty=PENDING, ComSignalAccess=ACCESS_NEEDED_BY_SWC_OR_COM:
          OBJ_CLS_TYPE4_PROB_057_oRDR_TRACKER_OBJ_057_oPCAN_RADAR_beea395b_Tx: ComBitPosition=327, ComBitSize=8, ComSignalType=UINT8, ComHandleId=11286, ComSystemTemplateSystemSignalRef=OBJ_CLS_TYPE4_PROB_057
          OBJ_YAW_ANGLE_ERR_057_oRDR_TRACKER_OBJ_057_oPCAN_RADAR_d95107b7_Tx: ComBitPosition=175, ComBitSize=7, ComSignalType=UINT8, ComHandleId=11319, ComSystemTemplateSystemSignalRef=OBJ_YAW_ANGLE_ERR_057
          OBJ_YAW_ANGLE_057_oRDR_TRACKER_OBJ_057_oPCAN_RADAR_0c5c0160_Tx: ComBitPosition=155, ComBitSize=12, ComSignalType=UINT16, ComHandleId=11318, ComSystemTemplateSystemSignalRef=OBJ_YAW_ANGLE_057
          OBJ_CLS_TYPE6_PROB_057_oRDR_TRACKER_OBJ_057_oPCAN_RADAR_30cdd4ad_Tx: ComBitPosition=343, ComBitSize=8, ComSignalType=UINT8, ComHandleId=11290, ComSystemTemplateSystemSignalRef=OBJ_CLS_TYPE6_PROB_057
          OBJ_VELOCITY_LONG_ERR_057_oRDR_TRACKER_OBJ_057_oPCAN_RADAR_38980ab1_Tx: ComBitPosition=143, ComBitSize=8, ComSignalType=UINT8, ComHandleId=11317, ComSystemTemplateSystemSignalRef=OBJ_VELOCITY_LONG_ERR_057
          OBJ_VELOCITY_LONG_057_oRDR_TRACKER_OBJ_057_oPCAN_RADAR_b06d3de6_Tx: ComBitPosition=110, ComBitSize=15, ComSignalType=UINT16, ComHandleId=11316, ComSystemTemplateSystemSignalRef=OBJ_VELOCITY_LONG_057
          OBJ_GROUP_ID_057_oRDR_TRACKER_OBJ_057_oPCAN_RADAR_7501f187_Tx: ComBitPosition=405, ComBitSize=6, ComSignalType=UINT8, ComHandleId=11296, ComSystemTemplateSystemSignalRef=OBJ_GROUP_ID_057
          OBJ_POS_LAT_ERR_057_oRDR_TRACKER_OBJ_057_oPCAN_RADAR_a0cf5030_Tx: ComBitPosition=103, ComBitSize=8, ComSignalType=UINT8, ComHandleId=11304, ComSystemTemplateSystemSignalRef=OBJ_POS_LAT_ERR_057
          OBJ_TRACK_MOTION_MODEL_057_oRDR_TRACKER_OBJ_057_oPCAN_RADAR_4ae3578b_Tx: ComBitPosition=9, ComBitSize=2, ComSignalType=UINT8, ComHandleId=11311, ComSystemTemplateSystemSignalRef=OBJ_TRACK_MOTION_MODEL_057
          OBJ_CLS_TYPE4_057_oRDR_TRACKER_OBJ_057_oPCAN_RADAR_40a7c557_Tx: ComBitPosition=275, ComBitSize=4, ComSignalType=UINT8, ComHandleId=11285, ComSystemTemplateSystemSignalRef=OBJ_CLS_TYPE4_057
          OBJ_ACCEL_ERR_CRR_COEF_057_oRDR_TRACKER_OBJ_057_oPCAN_RADAR_792788f6_Tx: ComBitPosition=431, ComBitSize=8, ComSignalType=UINT8, ComHandleId=11277, ComSystemTemplateSystemSignalRef=OBJ_ACCEL_ERR_CRR_COEF_057
          OBJ_CLS_TYPE2_057_oRDR_TRACKER_OBJ_057_oPCAN_RADAR_db77c599_Tx: ComBitPosition=267, ComBitSize=4, ComSignalType=UINT8, ComHandleId=11281, ComSystemTemplateSystemSignalRef=OBJ_CLS_TYPE2_057
          OBJ_CLS_TYPE3_PROB_057_oRDR_TRACKER_OBJ_057_oPCAN_RADAR_b0e0fffb_Tx: ComBitPosition=319, ComBitSize=8, ComSignalType=UINT8, ComHandleId=11284, ComSystemTemplateSystemSignalRef=OBJ_CLS_TYPE3_PROB_057
          OBJ_CLS_TYPE5_057_oRDR_TRACKER_OBJ_057_oPCAN_RADAR_cd2f38b5_Tx: ComBitPosition=287, ComBitSize=4, ComSignalType=UINT8, ComHandleId=11287, ComSystemTemplateSystemSignalRef=OBJ_CLS_TYPE5_057
          OBJ_DIMENSION_WIDTH_ERR_057_oRDR_TRACKER_OBJ_057_oPCAN_RADAR_176da6ff_Tx: ComBitPosition=23, ComBitSize=6, ComSignalType=UINT8, ComHandleId=11294, ComSystemTemplateSystemSignalRef=OBJ_DIMENSION_WIDTH_ERR_057
          OBJ_ACCELERATION_LAT_057_oRDR_TRACKER_OBJ_057_oPCAN_RADAR_13d53684_Tx: ComBitPosition=177, ComBitSize=10, ComSignalType=UINT16, ComHandleId=11273, ComSystemTemplateSystemSignalRef=OBJ_ACCELERATION_LAT_057
          OBJ_CLS_TYPE3_057_oRDR_TRACKER_OBJ_057_oPCAN_RADAR_56ff387b_Tx: ComBitPosition=279, ComBitSize=4, ComSignalType=UINT8, ComHandleId=11283, ComSystemTemplateSystemSignalRef=OBJ_CLS_TYPE3_057
          OBJ_EXISTENCE_PROB_057_oRDR_TRACKER_OBJ_057_oPCAN_RADAR_fc73e52a_Tx: ComBitPosition=229, ComBitSize=14, ComSignalType=UINT16, ComHandleId=11295, ComSystemTemplateSystemSignalRef=OBJ_EXISTENCE_PROB_057
          OBJ_CLS_TYPE1_PROB_057_oRDR_TRACKER_OBJ_057_oPCAN_RADAR_3ec7120d_Tx: ComBitPosition=303, ComBitSize=8, ComSignalType=UINT8, ComHandleId=11280, ComSystemTemplateSystemSignalRef=OBJ_CLS_TYPE1_PROB_057
          OBJ_MOVEMENT_STATUS_057_oRDR_TRACKER_OBJ_057_oPCAN_RADAR_d6533d71_Tx: ComBitPosition=196, ComBitSize=3, ComSignalType=UINT8, ComHandleId=11301, ComSystemTemplateSystemSignalRef=OBJ_MOVEMENT_STATUS_057
          OBJ_ID_057_oRDR_TRACKER_OBJ_057_oPCAN_RADAR_862fda80_Tx: ComBitPosition=7, ComBitSize=8, ComSignalType=UINT8, ComHandleId=11297, ComSystemTemplateSystemSignalRef=OBJ_ID_057
          OBJ_TIMESTAMP_OFFSET_057_oRDR_TRACKER_OBJ_057_oPCAN_RADAR_86e05656_Tx: ComBitPosition=247, ComBitSize=8, ComSignalType=UINT8, ComHandleId=11310, ComSystemTemplateSystemSignalRef=OBJ_TIMESTAMP_OFFSET_057
          OBJ_VELOCITY_LAT_057_oRDR_TRACKER_OBJ_057_oPCAN_RADAR_e0e04520_Tx: ComBitPosition=126, ComBitSize=15, ComSignalType=UINT16, ComHandleId=11314, ComSystemTemplateSystemSignalRef=OBJ_VELOCITY_LAT_057
          OBJ_CLS_TYPE1_057_oRDR_TRACKER_OBJ_057_oPCAN_RADAR_969fc5fe_Tx: ComBitPosition=271, ComBitSize=4, ComSignalType=UINT8, ComHandleId=11279, ComSystemTemplateSystemSignalRef=OBJ_CLS_TYPE1_057
          OBJ_POS_LONG_ERR_057_oRDR_TRACKER_OBJ_057_oPCAN_RADAR_3937aed2_Tx: ComBitPosition=95, ComBitSize=8, ComSignalType=UINT8, ComHandleId=11306, ComSystemTemplateSystemSignalRef=OBJ_POS_LONG_ERR_057
          OBJ_REF_PT_LONG_OFFSET_057_oRDR_TRACKER_OBJ_057_oPCAN_RADAR_3c23cd76_Tx: ComBitPosition=357, ComBitSize=14, ComSignalType=UINT16, ComHandleId=11309, ComSystemTemplateSystemSignalRef=OBJ_REF_PT_LONG_OFFSET_057
          OBJ_VEH_TRACK_FLAG_057_oRDR_TRACKER_OBJ_057_oPCAN_RADAR_c8c9a1d6_Tx: ComBitPosition=10, ComBitSize=1, ComSignalType=BOOLEAN, ComHandleId=11312, ComSystemTemplateSystemSignalRef=OBJ_VEH_TRACK_FLAG_057
          OBJ_YAW_RATE_057_oRDR_TRACKER_OBJ_057_oPCAN_RADAR_29d32427_Tx: ComBitPosition=399, ComBitSize=10, ComSignalType=UINT16, ComHandleId=11320, ComSystemTemplateSystemSignalRef=OBJ_YAW_RATE_057
          OBJ_DIMENSION_LENGTH_ERR_057_oRDR_TRACKER_OBJ_057_oPCAN_RADAR_eff989c0_Tx: ComBitPosition=41, ComBitSize=10, ComSignalType=UINT16, ComHandleId=11292, ComSystemTemplateSystemSignalRef=OBJ_DIMENSION_LENGTH_ERR_057
          OBJ_YAW_RATE_ERR_057_oRDR_TRACKER_OBJ_057_oPCAN_RADAR_160bb3fb_Tx: ComBitPosition=388, ComBitSize=5, ComSignalType=UINT8, ComHandleId=11321, ComSystemTemplateSystemSignalRef=OBJ_YAW_RATE_ERR_057
          OBJ_DIMENSION_WIDTH_057_oRDR_TRACKER_OBJ_057_oPCAN_RADAR_f7cf6117_Tx: ComBitPosition=17, ComBitSize=10, ComSignalType=UINT16, ComHandleId=11293, ComSystemTemplateSystemSignalRef=OBJ_DIMENSION_WIDTH_057
          OBJ_POS_LAT_057_oRDR_TRACKER_OBJ_057_oPCAN_RADAR_a4830007_Tx: ComBitPosition=79, ComBitSize=16, ComSignalType=UINT16, ComHandleId=11303, ComSystemTemplateSystemSignalRef=OBJ_POS_LAT_057
          OBJ_CLS_TYPE6_057_oRDR_TRACKER_OBJ_057_oPCAN_RADAR_80c738d2_Tx: ComBitPosition=282, ComBitSize=4, ComSignalType=UINT8, ComHandleId=11289, ComSystemTemplateSystemSignalRef=OBJ_CLS_TYPE6_057
          OBJ_POS_ERR_CRR_COEF_057_oRDR_TRACKER_OBJ_057_oPCAN_RADAR_462cfd4b_Tx: ComBitPosition=415, ComBitSize=8, ComSignalType=UINT8, ComHandleId=11302, ComSystemTemplateSystemSignalRef=OBJ_POS_ERR_CRR_COEF_057
          OBJ_POS_LONG_057_oRDR_TRACKER_OBJ_057_oPCAN_RADAR_1523ebc8_Tx: ComBitPosition=63, ComBitSize=16, ComSignalType=UINT16, ComHandleId=11305, ComSystemTemplateSystemSignalRef=OBJ_POS_LONG_057
          OBJ_VELOCITY_ERR_CRR_COEF_057_oRDR_TRACKER_OBJ_057_oPCAN_RADAR_ef56c0aa_Tx: ComBitPosition=423, ComBitSize=8, ComSignalType=UINT8, ComHandleId=11313, ComSystemTemplateSystemSignalRef=OBJ_VELOCITY_ERR_CRR_COEF_057
          OBJ_VELOCITY_LAT_ERR_057_oRDR_TRACKER_OBJ_057_oPCAN_RADAR_d41a3571_Tx: ComBitPosition=151, ComBitSize=8, ComSignalType=UINT8, ComHandleId=11315, ComSystemTemplateSystemSignalRef=OBJ_VELOCITY_LAT_ERR_057
          OBJ_CLS_TYPE2_PROB_057_oRDR_TRACKER_OBJ_057_oPCAN_RADAR_f7f30900_Tx: ComBitPosition=311, ComBitSize=8, ComSignalType=UINT8, ComHandleId=11282, ComSystemTemplateSystemSignalRef=OBJ_CLS_TYPE2_PROB_057
          OBJ_ALIVE_TIME_057_oRDR_TRACKER_OBJ_057_oPCAN_RADAR_014424d8_Tx: ComBitPosition=255, ComBitSize=16, ComSignalType=UINT16, ComHandleId=11278, ComSystemTemplateSystemSignalRef=OBJ_ALIVE_TIME_057
          OBJ_DIMENSION_LENGTH_057_oRDR_TRACKER_OBJ_057_oPCAN_RADAR_d40196ba_Tx: ComBitPosition=37, ComBitSize=12, ComSignalType=UINT16, ComHandleId=11291, ComSystemTemplateSystemSignalRef=OBJ_DIMENSION_LENGTH_057
          OBJ_MEASUREMENT_STATUS_057_oRDR_TRACKER_OBJ_057_oPCAN_RADAR_f9fda83d_Tx: ComBitPosition=14, ComBitSize=3, ComSignalType=UINT8, ComHandleId=11298, ComSystemTemplateSystemSignalRef=OBJ_MEASUREMENT_STATUS_057
          OBJ_ACCELERATION_LAT_ERR_057_oRDR_TRACKER_OBJ_057_oPCAN_RADAR_c6210c3a_Tx: ComBitPosition=223, ComBitSize=8, ComSignalType=UINT8, ComHandleId=11274, ComSystemTemplateSystemSignalRef=OBJ_ACCELERATION_LAT_ERR_057
          OBJ_ACCELERATION_LONG_ERR_057_oRDR_TRACKER_OBJ_057_oPCAN_RADAR_d984a990_Tx: ComBitPosition=215, ComBitSize=8, ComSignalType=UINT8, ComHandleId=11276, ComSystemTemplateSystemSignalRef=OBJ_ACCELERATION_LONG_ERR_057
          OBJ_CLS_TYPE5_PROB_057_oRDR_TRACKER_OBJ_057_oPCAN_RADAR_f9f9cfa0_Tx: ComBitPosition=335, ComBitSize=8, ComSignalType=UINT8, ComHandleId=11288, ComSystemTemplateSystemSignalRef=OBJ_CLS_TYPE5_PROB_057
          OBJ_RCS_057_oRDR_TRACKER_OBJ_057_oPCAN_RADAR_864c5600_Tx: ComBitPosition=351, ComBitSize=7, ComSignalType=UINT8, ComHandleId=11307, ComSystemTemplateSystemSignalRef=OBJ_RCS_057
          OBJ_REF_PT_LAT_OFFSET_057_oRDR_TRACKER_OBJ_057_oPCAN_RADAR_73713d75_Tx: ComBitPosition=370, ComBitSize=14, ComSignalType=UINT16, ComHandleId=11308, ComSystemTemplateSystemSignalRef=OBJ_REF_PT_LAT_OFFSET_057
          OBJ_ACCELERATION_LONG_057_oRDR_TRACKER_OBJ_057_oPCAN_RADAR_61256f64_Tx: ComBitPosition=193, ComBitSize=10, ComSignalType=UINT16, ComHandleId=11275, ComSystemTemplateSystemSignalRef=OBJ_ACCELERATION_LONG_057
          OBJ_MH_CRC16_057_oRDR_TRACKER_OBJ_057_oPCAN_RADAR_859d1f01_Tx: ComBitPosition=495, ComBitSize=16, ComSignalType=UINT16, ComHandleId=11299, ComSystemTemplateSystemSignalRef=OBJ_MH_CRC16_057
          OBJ_MH_CYCLE_COUNTER_057_oRDR_TRACKER_OBJ_057_oPCAN_RADAR_f47945e0_Tx: ComBitPosition=487, ComBitSize=8, ComSignalType=UINT8, ComHandleId=11300, ComSystemTemplateSystemSignalRef=OBJ_MH_CYCLE_COUNTER_057
      5 x ComIPdu, all with ComIPduDirection=SEND, ComIPduType=NORMAL, ComIPduCancellationSupport=false, ComIPduSignalProcessing=DEFERRED, ComIPduChannelRef=CN_PCAN_RADAR_458ff0f1, ComIPduGroupRef=RDR01_oPCAN_RADAR_Tx_b6bdb067 if post-build-variant-condition{matching-criterion=RDR_POS, value=0}, ComIPduMainFunctionRef=ComMainFunctionTx_Event, ComIPduGroupRef=RDR02_oPCAN_RADAR_Tx_9f750495 if post-build-variant-condition{matching-criterion=RDR_POS, value=1}, ComIPduGroupRef=RDR03_oPCAN_RADAR_Tx_311d9504 if post-build-variant-condition{matching-criterion=RDR_POS, value=2}, ComIPduGroupRef=RDR04_oPCAN_RADAR_Tx_cce46d71 if post-build-variant-condition{matching-criterion=RDR_POS, value=3}, ComIPduGroupRef=RDR05_oPCAN_RADAR_Tx_628cfce0 if post-build-variant-condition{matching-criterion=RDR_POS, value=4}, ComIPduGroupRef=RDR06_oPCAN_RADAR_Tx_4b444812 if post-build-variant-condition{matching-criterion=RDR_POS, value=5}, ComIPduGroupRef=RDR07_oPCAN_RADAR_Tx_e52cd983 if post-build-variant-condition{matching-criterion=RDR_POS, value=6}, ComIPduGroupRef=RDR08_oPCAN_RADAR_Tx_6bc6beb9 if post-build-variant-condition{matching-criterion=RDR_POS, value=7}:
        RDR_DETECTION_209_212_oPCAN_RADAR_b78ac615_Tx: ComIPduHandleId=58, ComIPduSignalGroupRef=SG_Detections_209_212_oRDR_DETECTION_209_212_oPCAN_RADAR_b2a1c0f4_Tx, ComPduIdRef=RDR_DETECTION_209_212_oPCAN_RADAR_b78ac615_Tx
          ComTxIPdu: ComMinimumDelayTime=0, ComTxIPduUnusedAreasDefault=0
            ComTxModeTrue
              ComTxMode: ComTxModeMode=DIRECT, ComTxModeNumberOfRepetitions=0
            ComTxModeFalse
              ComTxMode: ComTxModeMode=NONE
        RDR_DETECTION_141_144_oPCAN_RADAR_cc5f03ed_Tx: ComIPduHandleId=41, ComIPduSignalGroupRef=SG_Detections_141_144_oRDR_DETECTION_141_144_oPCAN_RADAR_f70bf7bd_Tx, ComPduIdRef=RDR_DETECTION_141_144_oPCAN_RADAR_cc5f03ed_Tx
          ComTxIPdu: ComMinimumDelayTime=0, ComTxIPduUnusedAreasDefault=0
            ComTxModeTrue
              ComTxMode: ComTxModeMode=DIRECT, ComTxModeNumberOfRepetitions=0
            ComTxModeFalse
              ComTxMode: ComTxModeMode=NONE
        RDR_DETECTION_045_048_oPCAN_RADAR_4bf4c669_Tx: ComIPduHandleId=17, ComIPduSignalGroupRef=SG_Detections_045_048_oRDR_DETECTION_045_048_oPCAN_RADAR_c460e153_Tx, ComPduIdRef=RDR_DETECTION_045_048_oPCAN_RADAR_4bf4c669_Tx
          ComTxIPdu: ComMinimumDelayTime=0, ComTxIPduUnusedAreasDefault=0
            ComTxModeTrue
              ComTxMode: ComTxModeMode=DIRECT, ComTxModeNumberOfRepetitions=0
            ComTxModeFalse
              ComTxMode: ComTxModeMode=NONE
        RDR_DETECTION_137_140_oPCAN_RADAR_4afcd417_Tx: ComIPduHandleId=40, ComIPduSignalGroupRef=SG_Detections_137_140_oRDR_DETECTION_137_140_oPCAN_RADAR_e974e064_Tx, ComPduIdRef=RDR_DETECTION_137_140_oPCAN_RADAR_4afcd417_Tx
          ComTxIPdu: ComMinimumDelayTime=0, ComTxIPduUnusedAreasDefault=0
            ComTxModeTrue
              ComTxMode: ComTxModeMode=DIRECT, ComTxModeNumberOfRepetitions=0
            ComTxModeFalse
              ComTxMode: ComTxModeMode=NONE
        RDR_TRACKER_OBJ_060_oPCAN_RADAR_0bd36965_Tx: ComIPduHandleId=170, ComIPduSignalGroupRef=SG_TrackerObject060_oRDR_TRACKER_OBJ_060_oPCAN_RADAR_68bfc7eb_Tx, ComPduIdRef=RDR_TRACKER_OBJ_060_oPCAN_RADAR_0bd36965_Tx
          ComTxIPdu: ComMinimumDelayTime=0, ComTxIPduUnusedAreasDefault=0
            ComTxModeTrue
              ComTxMode: ComTxModeMode=DIRECT, ComTxModeNumberOfRepetitions=0
            ComTxModeFalse
              ComTxMode: ComTxModeMode=NONE
      SG_TrackerObject032_oRDR_TRACKER_OBJ_032_oPCAN_RADAR_8240facb_Tx (ComSignalGroup):
        ComTransferProperty = TRIGGERED
        ComSignalGroupAccess = ACCESS_NEEDED_BY_SWC_OR_COM
        ComHandleId = 141
        ComSignalGroupArrayAccess = true
        ComSystemTemplateSignalGroupRef = SG_TrackerObject032
        49 x ComGroupSignal, all with ComSignalEndianness=BIG_ENDIAN, ComSignalInitValue=0, ComTransferProperty=PENDING, ComSignalAccess=ACCESS_NEEDED_BY_SWC_OR_COM:
          OBJ_EXISTENCE_PROB_032_oRDR_TRACKER_OBJ_032_oPCAN_RADAR_63c27212_Tx: ComBitPosition=229, ComBitSize=14, ComSignalType=UINT16, ComHandleId=10070, ComSystemTemplateSystemSignalRef=OBJ_EXISTENCE_PROB_032
          OBJ_TIMESTAMP_OFFSET_032_oRDR_TRACKER_OBJ_032_oPCAN_RADAR_1951c16e_Tx: ComBitPosition=247, ComBitSize=8, ComSignalType=UINT8, ComHandleId=10085, ComSystemTemplateSystemSignalRef=OBJ_TIMESTAMP_OFFSET_032
          OBJ_ACCELERATION_LAT_032_oRDR_TRACKER_OBJ_032_oPCAN_RADAR_8c64a1bc_Tx: ComBitPosition=177, ComBitSize=10, ComSignalType=UINT16, ComHandleId=10048, ComSystemTemplateSystemSignalRef=OBJ_ACCELERATION_LAT_032
          OBJ_ACCELERATION_LAT_ERR_032_oRDR_TRACKER_OBJ_032_oPCAN_RADAR_59909b02_Tx: ComBitPosition=223, ComBitSize=8, ComSignalType=UINT8, ComHandleId=10049, ComSystemTemplateSystemSignalRef=OBJ_ACCELERATION_LAT_ERR_032
          OBJ_CLS_TYPE3_032_oRDR_TRACKER_OBJ_032_oPCAN_RADAR_c94eaf43_Tx: ComBitPosition=279, ComBitSize=4, ComSignalType=UINT8, ComHandleId=10058, ComSystemTemplateSystemSignalRef=OBJ_CLS_TYPE3_032
          OBJ_DIMENSION_WIDTH_ERR_032_oRDR_TRACKER_OBJ_032_oPCAN_RADAR_88dc31c7_Tx: ComBitPosition=23, ComBitSize=6, ComSignalType=UINT8, ComHandleId=10069, ComSystemTemplateSystemSignalRef=OBJ_DIMENSION_WIDTH_ERR_032
          OBJ_CLS_TYPE5_PROB_032_oRDR_TRACKER_OBJ_032_oPCAN_RADAR_66485898_Tx: ComBitPosition=335, ComBitSize=8, ComSignalType=UINT8, ComHandleId=10063, ComSystemTemplateSystemSignalRef=OBJ_CLS_TYPE5_PROB_032
          OBJ_CLS_TYPE6_PROB_032_oRDR_TRACKER_OBJ_032_oPCAN_RADAR_af7c4395_Tx: ComBitPosition=343, ComBitSize=8, ComSignalType=UINT8, ComHandleId=10065, ComSystemTemplateSystemSignalRef=OBJ_CLS_TYPE6_PROB_032
          OBJ_YAW_RATE_ERR_032_oRDR_TRACKER_OBJ_032_oPCAN_RADAR_89ba24c3_Tx: ComBitPosition=388, ComBitSize=5, ComSignalType=UINT8, ComHandleId=10096, ComSystemTemplateSystemSignalRef=OBJ_YAW_RATE_ERR_032
          OBJ_CLS_TYPE1_032_oRDR_TRACKER_OBJ_032_oPCAN_RADAR_092e52c6_Tx: ComBitPosition=271, ComBitSize=4, ComSignalType=UINT8, ComHandleId=10054, ComSystemTemplateSystemSignalRef=OBJ_CLS_TYPE1_032
          OBJ_CLS_TYPE2_032_oRDR_TRACKER_OBJ_032_oPCAN_RADAR_44c652a1_Tx: ComBitPosition=267, ComBitSize=4, ComSignalType=UINT8, ComHandleId=10056, ComSystemTemplateSystemSignalRef=OBJ_CLS_TYPE2_032
          OBJ_ACCEL_ERR_CRR_COEF_032_oRDR_TRACKER_OBJ_032_oPCAN_RADAR_e6961fce_Tx: ComBitPosition=431, ComBitSize=8, ComSignalType=UINT8, ComHandleId=10052, ComSystemTemplateSystemSignalRef=OBJ_ACCEL_ERR_CRR_COEF_032
          OBJ_DIMENSION_LENGTH_ERR_032_oRDR_TRACKER_OBJ_032_oPCAN_RADAR_70481ef8_Tx: ComBitPosition=41, ComBitSize=10, ComSignalType=UINT16, ComHandleId=10067, ComSystemTemplateSystemSignalRef=OBJ_DIMENSION_LENGTH_ERR_032
          OBJ_GROUP_ID_032_oRDR_TRACKER_OBJ_032_oPCAN_RADAR_eab066bf_Tx: ComBitPosition=405, ComBitSize=6, ComSignalType=UINT8, ComHandleId=10071, ComSystemTemplateSystemSignalRef=OBJ_GROUP_ID_032
          OBJ_VELOCITY_LONG_032_oRDR_TRACKER_OBJ_032_oPCAN_RADAR_2fdcaade_Tx: ComBitPosition=110, ComBitSize=15, ComSignalType=UINT16, ComHandleId=10091, ComSystemTemplateSystemSignalRef=OBJ_VELOCITY_LONG_032
          OBJ_CLS_TYPE5_032_oRDR_TRACKER_OBJ_032_oPCAN_RADAR_529eaf8d_Tx: ComBitPosition=287, ComBitSize=4, ComSignalType=UINT8, ComHandleId=10062, ComSystemTemplateSystemSignalRef=OBJ_CLS_TYPE5_032
          OBJ_YAW_RATE_032_oRDR_TRACKER_OBJ_032_oPCAN_RADAR_b662b31f_Tx: ComBitPosition=399, ComBitSize=10, ComSignalType=UINT16, ComHandleId=10095, ComSystemTemplateSystemSignalRef=OBJ_YAW_RATE_032
          OBJ_CLS_TYPE2_PROB_032_oRDR_TRACKER_OBJ_032_oPCAN_RADAR_68429e38_Tx: ComBitPosition=311, ComBitSize=8, ComSignalType=UINT8, ComHandleId=10057, ComSystemTemplateSystemSignalRef=OBJ_CLS_TYPE2_PROB_032
          OBJ_REF_PT_LAT_OFFSET_032_oRDR_TRACKER_OBJ_032_oPCAN_RADAR_ecc0aa4d_Tx: ComBitPosition=370, ComBitSize=14, ComSignalType=UINT16, ComHandleId=10083, ComSystemTemplateSystemSignalRef=OBJ_REF_PT_LAT_OFFSET_032
          OBJ_MEASUREMENT_STATUS_032_oRDR_TRACKER_OBJ_032_oPCAN_RADAR_664c3f05_Tx: ComBitPosition=14, ComBitSize=3, ComSignalType=UINT8, ComHandleId=10073, ComSystemTemplateSystemSignalRef=OBJ_MEASUREMENT_STATUS_032
          OBJ_ACCELERATION_LONG_032_oRDR_TRACKER_OBJ_032_oPCAN_RADAR_fe94f85c_Tx: ComBitPosition=193, ComBitSize=10, ComSignalType=UINT16, ComHandleId=10050, ComSystemTemplateSystemSignalRef=OBJ_ACCELERATION_LONG_032
          OBJ_POS_LONG_ERR_032_oRDR_TRACKER_OBJ_032_oPCAN_RADAR_a68639ea_Tx: ComBitPosition=95, ComBitSize=8, ComSignalType=UINT8, ComHandleId=10081, ComSystemTemplateSystemSignalRef=OBJ_POS_LONG_ERR_032
          OBJ_VEH_TRACK_FLAG_032_oRDR_TRACKER_OBJ_032_oPCAN_RADAR_577836ee_Tx: ComBitPosition=10, ComBitSize=1, ComSignalType=BOOLEAN, ComHandleId=10087, ComSystemTemplateSystemSignalRef=OBJ_VEH_TRACK_FLAG_032
          OBJ_POS_LAT_ERR_032_oRDR_TRACKER_OBJ_032_oPCAN_RADAR_3f7ec708_Tx: ComBitPosition=103, ComBitSize=8, ComSignalType=UINT8, ComHandleId=10079, ComSystemTemplateSystemSignalRef=OBJ_POS_LAT_ERR_032
          OBJ_CLS_TYPE4_PROB_032_oRDR_TRACKER_OBJ_032_oPCAN_RADAR_215bae63_Tx: ComBitPosition=327, ComBitSize=8, ComSignalType=UINT8, ComHandleId=10061, ComSystemTemplateSystemSignalRef=OBJ_CLS_TYPE4_PROB_032
          OBJ_YAW_ANGLE_032_oRDR_TRACKER_OBJ_032_oPCAN_RADAR_93ed9658_Tx: ComBitPosition=155, ComBitSize=12, ComSignalType=UINT16, ComHandleId=10093, ComSystemTemplateSystemSignalRef=OBJ_YAW_ANGLE_032
          OBJ_CLS_TYPE1_PROB_032_oRDR_TRACKER_OBJ_032_oPCAN_RADAR_a1768535_Tx: ComBitPosition=303, ComBitSize=8, ComSignalType=UINT8, ComHandleId=10055, ComSystemTemplateSystemSignalRef=OBJ_CLS_TYPE1_PROB_032
          OBJ_MOVEMENT_STATUS_032_oRDR_TRACKER_OBJ_032_oPCAN_RADAR_49e2aa49_Tx: ComBitPosition=196, ComBitSize=3, ComSignalType=UINT8, ComHandleId=10076, ComSystemTemplateSystemSignalRef=OBJ_MOVEMENT_STATUS_032
          OBJ_VELOCITY_LAT_032_oRDR_TRACKER_OBJ_032_oPCAN_RADAR_7f51d218_Tx: ComBitPosition=126, ComBitSize=15, ComSignalType=UINT16, ComHandleId=10089, ComSystemTemplateSystemSignalRef=OBJ_VELOCITY_LAT_032
          OBJ_ACCELERATION_LONG_ERR_032_oRDR_TRACKER_OBJ_032_oPCAN_RADAR_46353ea8_Tx: ComBitPosition=215, ComBitSize=8, ComSignalType=UINT8, ComHandleId=10051, ComSystemTemplateSystemSignalRef=OBJ_ACCELERATION_LONG_ERR_032
          OBJ_YAW_ANGLE_ERR_032_oRDR_TRACKER_OBJ_032_oPCAN_RADAR_46e0908f_Tx: ComBitPosition=175, ComBitSize=7, ComSignalType=UINT8, ComHandleId=10094, ComSystemTemplateSystemSignalRef=OBJ_YAW_ANGLE_ERR_032
          OBJ_CLS_TYPE4_032_oRDR_TRACKER_OBJ_032_oPCAN_RADAR_df16526f_Tx: ComBitPosition=275, ComBitSize=4, ComSignalType=UINT8, ComHandleId=10060, ComSystemTemplateSystemSignalRef=OBJ_CLS_TYPE4_032
          OBJ_DIMENSION_LENGTH_032_oRDR_TRACKER_OBJ_032_oPCAN_RADAR_4bb00182_Tx: ComBitPosition=37, ComBitSize=12, ComSignalType=UINT16, ComHandleId=10066, ComSystemTemplateSystemSignalRef=OBJ_DIMENSION_LENGTH_032
          OBJ_CLS_TYPE3_PROB_032_oRDR_TRACKER_OBJ_032_oPCAN_RADAR_2f5168c3_Tx: ComBitPosition=319, ComBitSize=8, ComSignalType=UINT8, ComHandleId=10059, ComSystemTemplateSystemSignalRef=OBJ_CLS_TYPE3_PROB_032
          OBJ_TRACK_MOTION_MODEL_032_oRDR_TRACKER_OBJ_032_oPCAN_RADAR_d552c0b3_Tx: ComBitPosition=9, ComBitSize=2, ComSignalType=UINT8, ComHandleId=10086, ComSystemTemplateSystemSignalRef=OBJ_TRACK_MOTION_MODEL_032
          OBJ_ALIVE_TIME_032_oRDR_TRACKER_OBJ_032_oPCAN_RADAR_9ef5b3e0_Tx: ComBitPosition=255, ComBitSize=16, ComSignalType=UINT16, ComHandleId=10053, ComSystemTemplateSystemSignalRef=OBJ_ALIVE_TIME_032
          OBJ_VELOCITY_LONG_ERR_032_oRDR_TRACKER_OBJ_032_oPCAN_RADAR_a7299d89_Tx: ComBitPosition=143, ComBitSize=8, ComSignalType=UINT8, ComHandleId=10092, ComSystemTemplateSystemSignalRef=OBJ_VELOCITY_LONG_ERR_032
          OBJ_ID_032_oRDR_TRACKER_OBJ_032_oPCAN_RADAR_199e4db8_Tx: ComBitPosition=7, ComBitSize=8, ComSignalType=UINT8, ComHandleId=10072, ComSystemTemplateSystemSignalRef=OBJ_ID_032
          OBJ_POS_LAT_032_oRDR_TRACKER_OBJ_032_oPCAN_RADAR_3b32973f_Tx: ComBitPosition=79, ComBitSize=16, ComSignalType=UINT16, ComHandleId=10078, ComSystemTemplateSystemSignalRef=OBJ_POS_LAT_032
          OBJ_VELOCITY_LAT_ERR_032_oRDR_TRACKER_OBJ_032_oPCAN_RADAR_4baba249_Tx: ComBitPosition=151, ComBitSize=8, ComSignalType=UINT8, ComHandleId=10090, ComSystemTemplateSystemSignalRef=OBJ_VELOCITY_LAT_ERR_032
          OBJ_POS_LONG_032_oRDR_TRACKER_OBJ_032_oPCAN_RADAR_8a927cf0_Tx: ComBitPosition=63, ComBitSize=16, ComSignalType=UINT16, ComHandleId=10080, ComSystemTemplateSystemSignalRef=OBJ_POS_LONG_032
          OBJ_DIMENSION_WIDTH_032_oRDR_TRACKER_OBJ_032_oPCAN_RADAR_687ef62f_Tx: ComBitPosition=17, ComBitSize=10, ComSignalType=UINT16, ComHandleId=10068, ComSystemTemplateSystemSignalRef=OBJ_DIMENSION_WIDTH_032
          OBJ_CLS_TYPE6_032_oRDR_TRACKER_OBJ_032_oPCAN_RADAR_1f76afea_Tx: ComBitPosition=282, ComBitSize=4, ComSignalType=UINT8, ComHandleId=10064, ComSystemTemplateSystemSignalRef=OBJ_CLS_TYPE6_032
          OBJ_RCS_032_oRDR_TRACKER_OBJ_032_oPCAN_RADAR_19fdc138_Tx: ComBitPosition=351, ComBitSize=7, ComSignalType=UINT8, ComHandleId=10082, ComSystemTemplateSystemSignalRef=OBJ_RCS_032
          OBJ_POS_ERR_CRR_COEF_032_oRDR_TRACKER_OBJ_032_oPCAN_RADAR_d99d6a73_Tx: ComBitPosition=415, ComBitSize=8, ComSignalType=UINT8, ComHandleId=10077, ComSystemTemplateSystemSignalRef=OBJ_POS_ERR_CRR_COEF_032
          OBJ_REF_PT_LONG_OFFSET_032_oRDR_TRACKER_OBJ_032_oPCAN_RADAR_a3925a4e_Tx: ComBitPosition=357, ComBitSize=14, ComSignalType=UINT16, ComHandleId=10084, ComSystemTemplateSystemSignalRef=OBJ_REF_PT_LONG_OFFSET_032
          OBJ_VELOCITY_ERR_CRR_COEF_032_oRDR_TRACKER_OBJ_032_oPCAN_RADAR_70e75792_Tx: ComBitPosition=423, ComBitSize=8, ComSignalType=UINT8, ComHandleId=10088, ComSystemTemplateSystemSignalRef=OBJ_VELOCITY_ERR_CRR_COEF_032
          OBJ_MH_CRC16_032_oRDR_TRACKER_OBJ_032_oPCAN_RADAR_1a2c8839_Tx: ComBitPosition=495, ComBitSize=16, ComSignalType=UINT16, ComHandleId=10074, ComSystemTemplateSystemSignalRef=OBJ_MH_CRC16_032
          OBJ_MH_CYCLE_COUNTER_032_oRDR_TRACKER_OBJ_032_oPCAN_RADAR_6bc8d2d8_Tx: ComBitPosition=487, ComBitSize=8, ComSignalType=UINT8, ComHandleId=10075, ComSystemTemplateSystemSignalRef=OBJ_MH_CYCLE_COUNTER_032
      3 x ComIPdu, all with ComIPduDirection=SEND, ComIPduType=NORMAL, ComIPduCancellationSupport=false, ComIPduSignalProcessing=DEFERRED, ComIPduChannelRef=CN_PCAN_RADAR_458ff0f1, ComIPduGroupRef=RDR01_oPCAN_RADAR_Tx_b6bdb067 if post-build-variant-condition{matching-criterion=RDR_POS, value=0}, ComIPduGroupRef=RDR02_oPCAN_RADAR_Tx_9f750495 if post-build-variant-condition{matching-criterion=RDR_POS, value=1}, ComIPduGroupRef=RDR03_oPCAN_RADAR_Tx_311d9504 if post-build-variant-condition{matching-criterion=RDR_POS, value=2}, ComIPduGroupRef=RDR04_oPCAN_RADAR_Tx_cce46d71 if post-build-variant-condition{matching-criterion=RDR_POS, value=3}, ComIPduGroupRef=RDR05_oPCAN_RADAR_Tx_628cfce0 if post-build-variant-condition{matching-criterion=RDR_POS, value=4}, ComIPduGroupRef=RDR06_oPCAN_RADAR_Tx_4b444812 if post-build-variant-condition{matching-criterion=RDR_POS, value=5}, ComIPduGroupRef=RDR07_oPCAN_RADAR_Tx_e52cd983 if post-build-variant-condition{matching-criterion=RDR_POS, value=6}, ComIPduGroupRef=RDR08_oPCAN_RADAR_Tx_6bc6beb9 if post-build-variant-condition{matching-criterion=RDR_POS, value=7}:
        RDR_DETECTION_365_368_oPCAN_RADAR_1d658597_Tx: ComIPduHandleId=97, ComIPduSignalGroupRef=SG_Detections_365_368_oRDR_DETECTION_365_368_oPCAN_RADAR_36ed26c5_Tx, ComPduIdRef=RDR_DETECTION_365_368_oPCAN_RADAR_1d658597_Tx, ComIPduMainFunctionRef=ComMainFunctionTx_Event
          ComTxIPdu: ComMinimumDelayTime=0, ComTxIPduUnusedAreasDefault=0
            ComTxModeTrue
              ComTxMode: ComTxModeMode=DIRECT, ComTxModeNumberOfRepetitions=0
            ComTxModeFalse
              ComTxMode: ComTxModeMode=NONE
        RDR_TRACKER_OBJ_015_oPCAN_RADAR_733170b6_Tx: ComIPduHandleId=125, ComIPduSignalGroupRef=SG_TrackerObject015_oRDR_TRACKER_OBJ_015_oPCAN_RADAR_a59fa66d_Tx, ComPduIdRef=RDR_TRACKER_OBJ_015_oPCAN_RADAR_733170b6_Tx, ComIPduMainFunctionRef=ComMainFunctionTx_Event
          ComTxIPdu: ComMinimumDelayTime=0, ComTxIPduUnusedAreasDefault=0
            ComTxModeTrue
              ComTxMode: ComTxModeMode=DIRECT, ComTxModeNumberOfRepetitions=0
            ComTxModeFalse
              ComTxMode: ComTxModeMode=NONE
        RDR_STATUS_001_oPCAN_RADAR_4b6de2c5_Tx: ComIPduHandleId=109, ComIPduSignalGroupRef=SG_RadarStatus1_oRDR_STATUS_001_oPCAN_RADAR_4935b1b8_Tx, ComPduIdRef=RDR_STATUS_001_oPCAN_RADAR_4b6de2c5_Tx, ComIPduMainFunctionRef=ComMainFunctionTx_Periodic
          ComTxIPdu: ComMinimumDelayTime=0, ComTxIPduUnusedAreasDefault=0
            ComTxModeTrue
              ComTxMode: ComTxModeMode=PERIODIC, ComTxModeTimeOffset=0, ComTxModeTimePeriod=1
            ComTxModeFalse
              ComTxMode: ComTxModeMode=PERIODIC, ComTxModeTimeOffset=0, ComTxModeTimePeriod=1
      SG_TrackerObject030_oRDR_TRACKER_OBJ_030_oPCAN_RADAR_ab18edec_Tx (ComSignalGroup):
        ComTransferProperty = TRIGGERED
        ComSignalGroupAccess = ACCESS_NEEDED_BY_SWC_OR_COM
        ComHandleId = 139
        ComSignalGroupArrayAccess = true
        ComSystemTemplateSignalGroupRef = SG_TrackerObject030
        49 x ComGroupSignal, all with ComSignalEndianness=BIG_ENDIAN, ComSignalInitValue=0, ComTransferProperty=PENDING, ComSignalAccess=ACCESS_NEEDED_BY_SWC_OR_COM:
          OBJ_POS_LAT_ERR_030_oRDR_TRACKER_OBJ_030_oPCAN_RADAR_1626d02f_Tx: ComBitPosition=103, ComBitSize=8, ComSignalType=UINT8, ComHandleId=9981, ComSystemTemplateSystemSignalRef=OBJ_POS_LAT_ERR_030
          OBJ_CLS_TYPE3_030_oRDR_TRACKER_OBJ_030_oPCAN_RADAR_e016b864_Tx: ComBitPosition=279, ComBitSize=4, ComSignalType=UINT8, ComHandleId=9960, ComSystemTemplateSystemSignalRef=OBJ_CLS_TYPE3_030
          OBJ_VEH_TRACK_FLAG_030_oRDR_TRACKER_OBJ_030_oPCAN_RADAR_7e2021c9_Tx: ComBitPosition=10, ComBitSize=1, ComSignalType=BOOLEAN, ComHandleId=9989, ComSystemTemplateSystemSignalRef=OBJ_VEH_TRACK_FLAG_030
          OBJ_EXISTENCE_PROB_030_oRDR_TRACKER_OBJ_030_oPCAN_RADAR_4a9a6535_Tx: ComBitPosition=229, ComBitSize=14, ComSignalType=UINT16, ComHandleId=9972, ComSystemTemplateSystemSignalRef=OBJ_EXISTENCE_PROB_030
          OBJ_GROUP_ID_030_oRDR_TRACKER_OBJ_030_oPCAN_RADAR_c3e87198_Tx: ComBitPosition=405, ComBitSize=6, ComSignalType=UINT8, ComHandleId=9973, ComSystemTemplateSystemSignalRef=OBJ_GROUP_ID_030
          OBJ_ACCELERATION_LAT_030_oRDR_TRACKER_OBJ_030_oPCAN_RADAR_a53cb69b_Tx: ComBitPosition=177, ComBitSize=10, ComSignalType=UINT16, ComHandleId=9950, ComSystemTemplateSystemSignalRef=OBJ_ACCELERATION_LAT_030
          OBJ_DIMENSION_LENGTH_030_oRDR_TRACKER_OBJ_030_oPCAN_RADAR_62e816a5_Tx: ComBitPosition=37, ComBitSize=12, ComSignalType=UINT16, ComHandleId=9968, ComSystemTemplateSystemSignalRef=OBJ_DIMENSION_LENGTH_030
          OBJ_MOVEMENT_STATUS_030_oRDR_TRACKER_OBJ_030_oPCAN_RADAR_60babd6e_Tx: ComBitPosition=196, ComBitSize=3, ComSignalType=UINT8, ComHandleId=9978, ComSystemTemplateSystemSignalRef=OBJ_MOVEMENT_STATUS_030
          OBJ_CLS_TYPE5_030_oRDR_TRACKER_OBJ_030_oPCAN_RADAR_7bc6b8aa_Tx: ComBitPosition=287, ComBitSize=4, ComSignalType=UINT8, ComHandleId=9964, ComSystemTemplateSystemSignalRef=OBJ_CLS_TYPE5_030
          OBJ_DIMENSION_WIDTH_ERR_030_oRDR_TRACKER_OBJ_030_oPCAN_RADAR_a18426e0_Tx: ComBitPosition=23, ComBitSize=6, ComSignalType=UINT8, ComHandleId=9971, ComSystemTemplateSystemSignalRef=OBJ_DIMENSION_WIDTH_ERR_030
          OBJ_POS_LONG_ERR_030_oRDR_TRACKER_OBJ_030_oPCAN_RADAR_8fde2ecd_Tx: ComBitPosition=95, ComBitSize=8, ComSignalType=UINT8, ComHandleId=9983, ComSystemTemplateSystemSignalRef=OBJ_POS_LONG_ERR_030
          OBJ_VELOCITY_LAT_030_oRDR_TRACKER_OBJ_030_oPCAN_RADAR_5609c53f_Tx: ComBitPosition=126, ComBitSize=15, ComSignalType=UINT16, ComHandleId=9991, ComSystemTemplateSystemSignalRef=OBJ_VELOCITY_LAT_030
          OBJ_VELOCITY_LONG_030_oRDR_TRACKER_OBJ_030_oPCAN_RADAR_0684bdf9_Tx: ComBitPosition=110, ComBitSize=15, ComSignalType=UINT16, ComHandleId=9993, ComSystemTemplateSystemSignalRef=OBJ_VELOCITY_LONG_030
          OBJ_ACCELERATION_LONG_ERR_030_oRDR_TRACKER_OBJ_030_oPCAN_RADAR_6f6d298f_Tx: ComBitPosition=215, ComBitSize=8, ComSignalType=UINT8, ComHandleId=9953, ComSystemTemplateSystemSignalRef=OBJ_ACCELERATION_LONG_ERR_030
          OBJ_CLS_TYPE1_030_oRDR_TRACKER_OBJ_030_oPCAN_RADAR_207645e1_Tx: ComBitPosition=271, ComBitSize=4, ComSignalType=UINT8, ComHandleId=9956, ComSystemTemplateSystemSignalRef=OBJ_CLS_TYPE1_030
          OBJ_CLS_TYPE2_030_oRDR_TRACKER_OBJ_030_oPCAN_RADAR_6d9e4586_Tx: ComBitPosition=267, ComBitSize=4, ComSignalType=UINT8, ComHandleId=9958, ComSystemTemplateSystemSignalRef=OBJ_CLS_TYPE2_030
          OBJ_POS_ERR_CRR_COEF_030_oRDR_TRACKER_OBJ_030_oPCAN_RADAR_f0c57d54_Tx: ComBitPosition=415, ComBitSize=8, ComSignalType=UINT8, ComHandleId=9979, ComSystemTemplateSystemSignalRef=OBJ_POS_ERR_CRR_COEF_030
          OBJ_POS_LAT_030_oRDR_TRACKER_OBJ_030_oPCAN_RADAR_126a8018_Tx: ComBitPosition=79, ComBitSize=16, ComSignalType=UINT16, ComHandleId=9980, ComSystemTemplateSystemSignalRef=OBJ_POS_LAT_030
          OBJ_DIMENSION_LENGTH_ERR_030_oRDR_TRACKER_OBJ_030_oPCAN_RADAR_591009df_Tx: ComBitPosition=41, ComBitSize=10, ComSignalType=UINT16, ComHandleId=9969, ComSystemTemplateSystemSignalRef=OBJ_DIMENSION_LENGTH_ERR_030
          OBJ_TRACK_MOTION_MODEL_030_oRDR_TRACKER_OBJ_030_oPCAN_RADAR_fc0ad794_Tx: ComBitPosition=9, ComBitSize=2, ComSignalType=UINT8, ComHandleId=9988, ComSystemTemplateSystemSignalRef=OBJ_TRACK_MOTION_MODEL_030
          OBJ_VELOCITY_LAT_ERR_030_oRDR_TRACKER_OBJ_030_oPCAN_RADAR_62f3b56e_Tx: ComBitPosition=151, ComBitSize=8, ComSignalType=UINT8, ComHandleId=9992, ComSystemTemplateSystemSignalRef=OBJ_VELOCITY_LAT_ERR_030
          OBJ_REF_PT_LONG_OFFSET_030_oRDR_TRACKER_OBJ_030_oPCAN_RADAR_8aca4d69_Tx: ComBitPosition=357, ComBitSize=14, ComSignalType=UINT16, ComHandleId=9986, ComSystemTemplateSystemSignalRef=OBJ_REF_PT_LONG_OFFSET_030
          OBJ_CLS_TYPE2_PROB_030_oRDR_TRACKER_OBJ_030_oPCAN_RADAR_411a891f_Tx: ComBitPosition=311, ComBitSize=8, ComSignalType=UINT8, ComHandleId=9959, ComSystemTemplateSystemSignalRef=OBJ_CLS_TYPE2_PROB_030
          OBJ_POS_LONG_030_oRDR_TRACKER_OBJ_030_oPCAN_RADAR_a3ca6bd7_Tx: ComBitPosition=63, ComBitSize=16, ComSignalType=UINT16, ComHandleId=9982, ComSystemTemplateSystemSignalRef=OBJ_POS_LONG_030
          OBJ_CLS_TYPE3_PROB_030_oRDR_TRACKER_OBJ_030_oPCAN_RADAR_06097fe4_Tx: ComBitPosition=319, ComBitSize=8, ComSignalType=UINT8, ComHandleId=9961, ComSystemTemplateSystemSignalRef=OBJ_CLS_TYPE3_PROB_030
          OBJ_VELOCITY_ERR_CRR_COEF_030_oRDR_TRACKER_OBJ_030_oPCAN_RADAR_59bf40b5_Tx: ComBitPosition=423, ComBitSize=8, ComSignalType=UINT8, ComHandleId=9990, ComSystemTemplateSystemSignalRef=OBJ_VELOCITY_ERR_CRR_COEF_030
          OBJ_CLS_TYPE4_PROB_030_oRDR_TRACKER_OBJ_030_oPCAN_RADAR_0803b944_Tx: ComBitPosition=327, ComBitSize=8, ComSignalType=UINT8, ComHandleId=9963, ComSystemTemplateSystemSignalRef=OBJ_CLS_TYPE4_PROB_030
          OBJ_VELOCITY_LONG_ERR_030_oRDR_TRACKER_OBJ_030_oPCAN_RADAR_8e718aae_Tx: ComBitPosition=143, ComBitSize=8, ComSignalType=UINT8, ComHandleId=9994, ComSystemTemplateSystemSignalRef=OBJ_VELOCITY_LONG_ERR_030
          OBJ_ID_030_oRDR_TRACKER_OBJ_030_oPCAN_RADAR_30c65a9f_Tx: ComBitPosition=7, ComBitSize=8, ComSignalType=UINT8, ComHandleId=9974, ComSystemTemplateSystemSignalRef=OBJ_ID_030
          OBJ_ACCELERATION_LONG_030_oRDR_TRACKER_OBJ_030_oPCAN_RADAR_d7ccef7b_Tx: ComBitPosition=193, ComBitSize=10, ComSignalType=UINT16, ComHandleId=9952, ComSystemTemplateSystemSignalRef=OBJ_ACCELERATION_LONG_030
          OBJ_ACCEL_ERR_CRR_COEF_030_oRDR_TRACKER_OBJ_030_oPCAN_RADAR_cfce08e9_Tx: ComBitPosition=431, ComBitSize=8, ComSignalType=UINT8, ComHandleId=9954, ComSystemTemplateSystemSignalRef=OBJ_ACCEL_ERR_CRR_COEF_030
          OBJ_CLS_TYPE4_030_oRDR_TRACKER_OBJ_030_oPCAN_RADAR_f64e4548_Tx: ComBitPosition=275, ComBitSize=4, ComSignalType=UINT8, ComHandleId=9962, ComSystemTemplateSystemSignalRef=OBJ_CLS_TYPE4_030
          OBJ_CLS_TYPE6_030_oRDR_TRACKER_OBJ_030_oPCAN_RADAR_362eb8cd_Tx: ComBitPosition=282, ComBitSize=4, ComSignalType=UINT8, ComHandleId=9966, ComSystemTemplateSystemSignalRef=OBJ_CLS_TYPE6_030
          OBJ_DIMENSION_WIDTH_030_oRDR_TRACKER_OBJ_030_oPCAN_RADAR_4126e108_Tx: ComBitPosition=17, ComBitSize=10, ComSignalType=UINT16, ComHandleId=9970, ComSystemTemplateSystemSignalRef=OBJ_DIMENSION_WIDTH_030
          OBJ_YAW_RATE_ERR_030_oRDR_TRACKER_OBJ_030_oPCAN_RADAR_a0e233e4_Tx: ComBitPosition=388, ComBitSize=5, ComSignalType=UINT8, ComHandleId=9998, ComSystemTemplateSystemSignalRef=OBJ_YAW_RATE_ERR_030
          OBJ_TIMESTAMP_OFFSET_030_oRDR_TRACKER_OBJ_030_oPCAN_RADAR_3009d649_Tx: ComBitPosition=247, ComBitSize=8, ComSignalType=UINT8, ComHandleId=9987, ComSystemTemplateSystemSignalRef=OBJ_TIMESTAMP_OFFSET_030
          OBJ_ACCELERATION_LAT_ERR_030_oRDR_TRACKER_OBJ_030_oPCAN_RADAR_70c88c25_Tx: ComBitPosition=223, ComBitSize=8, ComSignalType=UINT8, ComHandleId=9951, ComSystemTemplateSystemSignalRef=OBJ_ACCELERATION_LAT_ERR_030
          OBJ_MEASUREMENT_STATUS_030_oRDR_TRACKER_OBJ_030_oPCAN_RADAR_4f142822_Tx: ComBitPosition=14, ComBitSize=3, ComSignalType=UINT8, ComHandleId=9975, ComSystemTemplateSystemSignalRef=OBJ_MEASUREMENT_STATUS_030
          OBJ_REF_PT_LAT_OFFSET_030_oRDR_TRACKER_OBJ_030_oPCAN_RADAR_c598bd6a_Tx: ComBitPosition=370, ComBitSize=14, ComSignalType=UINT16, ComHandleId=9985, ComSystemTemplateSystemSignalRef=OBJ_REF_PT_LAT_OFFSET_030
          OBJ_ALIVE_TIME_030_oRDR_TRACKER_OBJ_030_oPCAN_RADAR_b7ada4c7_Tx: ComBitPosition=255, ComBitSize=16, ComSignalType=UINT16, ComHandleId=9955, ComSystemTemplateSystemSignalRef=OBJ_ALIVE_TIME_030
          OBJ_CLS_TYPE5_PROB_030_oRDR_TRACKER_OBJ_030_oPCAN_RADAR_4f104fbf_Tx: ComBitPosition=335, ComBitSize=8, ComSignalType=UINT8, ComHandleId=9965, ComSystemTemplateSystemSignalRef=OBJ_CLS_TYPE5_PROB_030
          OBJ_YAW_RATE_030_oRDR_TRACKER_OBJ_030_oPCAN_RADAR_9f3aa438_Tx: ComBitPosition=399, ComBitSize=10, ComSignalType=UINT16, ComHandleId=9997, ComSystemTemplateSystemSignalRef=OBJ_YAW_RATE_030
          OBJ_CLS_TYPE6_PROB_030_oRDR_TRACKER_OBJ_030_oPCAN_RADAR_862454b2_Tx: ComBitPosition=343, ComBitSize=8, ComSignalType=UINT8, ComHandleId=9967, ComSystemTemplateSystemSignalRef=OBJ_CLS_TYPE6_PROB_030
          OBJ_YAW_ANGLE_ERR_030_oRDR_TRACKER_OBJ_030_oPCAN_RADAR_6fb887a8_Tx: ComBitPosition=175, ComBitSize=7, ComSignalType=UINT8, ComHandleId=9996, ComSystemTemplateSystemSignalRef=OBJ_YAW_ANGLE_ERR_030
          OBJ_RCS_030_oRDR_TRACKER_OBJ_030_oPCAN_RADAR_30a5d61f_Tx: ComBitPosition=351, ComBitSize=7, ComSignalType=UINT8, ComHandleId=9984, ComSystemTemplateSystemSignalRef=OBJ_RCS_030
          OBJ_CLS_TYPE1_PROB_030_oRDR_TRACKER_OBJ_030_oPCAN_RADAR_882e9212_Tx: ComBitPosition=303, ComBitSize=8, ComSignalType=UINT8, ComHandleId=9957, ComSystemTemplateSystemSignalRef=OBJ_CLS_TYPE1_PROB_030
          OBJ_YAW_ANGLE_030_oRDR_TRACKER_OBJ_030_oPCAN_RADAR_bab5817f_Tx: ComBitPosition=155, ComBitSize=12, ComSignalType=UINT16, ComHandleId=9995, ComSystemTemplateSystemSignalRef=OBJ_YAW_ANGLE_030
          OBJ_MH_CYCLE_COUNTER_030_oRDR_TRACKER_OBJ_030_oPCAN_RADAR_4290c5ff_Tx: ComBitPosition=487, ComBitSize=8, ComSignalType=UINT8, ComHandleId=9977, ComSystemTemplateSystemSignalRef=OBJ_MH_CYCLE_COUNTER_030
          OBJ_MH_CRC16_030_oRDR_TRACKER_OBJ_030_oPCAN_RADAR_33749f1e_Tx: ComBitPosition=495, ComBitSize=16, ComSignalType=UINT16, ComHandleId=9976, ComSystemTemplateSystemSignalRef=OBJ_MH_CRC16_030
      SG_TrackerObject062_oRDR_TRACKER_OBJ_062_oPCAN_RADAR_41e7d0cc_Tx (ComSignalGroup):
        ComTransferProperty = TRIGGERED
        ComSignalGroupAccess = ACCESS_NEEDED_BY_SWC_OR_COM
        ComHandleId = 171
        ComSignalGroupArrayAccess = true
        ComSystemTemplateSignalGroupRef = SG_TrackerObject062
        49 x ComGroupSignal, all with ComSignalEndianness=BIG_ENDIAN, ComSignalInitValue=0, ComTransferProperty=PENDING, ComSignalAccess=ACCESS_NEEDED_BY_SWC_OR_COM:
          OBJ_CLS_TYPE2_062_oRDR_TRACKER_OBJ_062_oPCAN_RADAR_876178a6_Tx: ComBitPosition=267, ComBitSize=4, ComSignalType=UINT8, ComHandleId=11526, ComSystemTemplateSystemSignalRef=OBJ_CLS_TYPE2_062
          OBJ_ALIVE_TIME_062_oRDR_TRACKER_OBJ_062_oPCAN_RADAR_5d5299e7_Tx: ComBitPosition=255, ComBitSize=16, ComSignalType=UINT16, ComHandleId=11523, ComSystemTemplateSystemSignalRef=OBJ_ALIVE_TIME_062
          OBJ_VELOCITY_LONG_ERR_062_oRDR_TRACKER_OBJ_062_oPCAN_RADAR_648eb78e_Tx: ComBitPosition=143, ComBitSize=8, ComSignalType=UINT8, ComHandleId=11562, ComSystemTemplateSystemSignalRef=OBJ_VELOCITY_LONG_ERR_062
          OBJ_TRACK_MOTION_MODEL_062_oRDR_TRACKER_OBJ_062_oPCAN_RADAR_16f5eab4_Tx: ComBitPosition=9, ComBitSize=2, ComSignalType=UINT8, ComHandleId=11556, ComSystemTemplateSystemSignalRef=OBJ_TRACK_MOTION_MODEL_062
          OBJ_CLS_TYPE5_062_oRDR_TRACKER_OBJ_062_oPCAN_RADAR_9139858a_Tx: ComBitPosition=287, ComBitSize=4, ComSignalType=UINT8, ComHandleId=11532, ComSystemTemplateSystemSignalRef=OBJ_CLS_TYPE5_062
          OBJ_DIMENSION_LENGTH_ERR_062_oRDR_TRACKER_OBJ_062_oPCAN_RADAR_b3ef34ff_Tx: ComBitPosition=41, ComBitSize=10, ComSignalType=UINT16, ComHandleId=11537, ComSystemTemplateSystemSignalRef=OBJ_DIMENSION_LENGTH_ERR_062
          OBJ_POS_LONG_ERR_062_oRDR_TRACKER_OBJ_062_oPCAN_RADAR_652113ed_Tx: ComBitPosition=95, ComBitSize=8, ComSignalType=UINT8, ComHandleId=11551, ComSystemTemplateSystemSignalRef=OBJ_POS_LONG_ERR_062
          OBJ_VELOCITY_LAT_062_oRDR_TRACKER_OBJ_062_oPCAN_RADAR_bcf6f81f_Tx: ComBitPosition=126, ComBitSize=15, ComSignalType=UINT16, ComHandleId=11559, ComSystemTemplateSystemSignalRef=OBJ_VELOCITY_LAT_062
          OBJ_VELOCITY_LONG_062_oRDR_TRACKER_OBJ_062_oPCAN_RADAR_ec7b80d9_Tx: ComBitPosition=110, ComBitSize=15, ComSignalType=UINT16, ComHandleId=11561, ComSystemTemplateSystemSignalRef=OBJ_VELOCITY_LONG_062
          OBJ_CLS_TYPE4_062_oRDR_TRACKER_OBJ_062_oPCAN_RADAR_1cb17868_Tx: ComBitPosition=275, ComBitSize=4, ComSignalType=UINT8, ComHandleId=11530, ComSystemTemplateSystemSignalRef=OBJ_CLS_TYPE4_062
          OBJ_YAW_RATE_ERR_062_oRDR_TRACKER_OBJ_062_oPCAN_RADAR_4a1d0ec4_Tx: ComBitPosition=388, ComBitSize=5, ComSignalType=UINT8, ComHandleId=11566, ComSystemTemplateSystemSignalRef=OBJ_YAW_RATE_ERR_062
          OBJ_ACCELERATION_LONG_ERR_062_oRDR_TRACKER_OBJ_062_oPCAN_RADAR_859214af_Tx: ComBitPosition=215, ComBitSize=8, ComSignalType=UINT8, ComHandleId=11521, ComSystemTemplateSystemSignalRef=OBJ_ACCELERATION_LONG_ERR_062
          OBJ_CLS_TYPE5_PROB_062_oRDR_TRACKER_OBJ_062_oPCAN_RADAR_a5ef729f_Tx: ComBitPosition=335, ComBitSize=8, ComSignalType=UINT8, ComHandleId=11533, ComSystemTemplateSystemSignalRef=OBJ_CLS_TYPE5_PROB_062
          OBJ_TIMESTAMP_OFFSET_062_oRDR_TRACKER_OBJ_062_oPCAN_RADAR_daf6eb69_Tx: ComBitPosition=247, ComBitSize=8, ComSignalType=UINT8, ComHandleId=11555, ComSystemTemplateSystemSignalRef=OBJ_TIMESTAMP_OFFSET_062
          OBJ_VEH_TRACK_FLAG_062_oRDR_TRACKER_OBJ_062_oPCAN_RADAR_94df1ce9_Tx: ComBitPosition=10, ComBitSize=1, ComSignalType=BOOLEAN, ComHandleId=11557, ComSystemTemplateSystemSignalRef=OBJ_VEH_TRACK_FLAG_062
          OBJ_CLS_TYPE6_062_oRDR_TRACKER_OBJ_062_oPCAN_RADAR_dcd185ed_Tx: ComBitPosition=282, ComBitSize=4, ComSignalType=UINT8, ComHandleId=11534, ComSystemTemplateSystemSignalRef=OBJ_CLS_TYPE6_062
          OBJ_DIMENSION_LENGTH_062_oRDR_TRACKER_OBJ_062_oPCAN_RADAR_88172b85_Tx: ComBitPosition=37, ComBitSize=12, ComSignalType=UINT16, ComHandleId=11536, ComSystemTemplateSystemSignalRef=OBJ_DIMENSION_LENGTH_062
          OBJ_POS_LAT_ERR_062_oRDR_TRACKER_OBJ_062_oPCAN_RADAR_fcd9ed0f_Tx: ComBitPosition=103, ComBitSize=8, ComSignalType=UINT8, ComHandleId=11549, ComSystemTemplateSystemSignalRef=OBJ_POS_LAT_ERR_062
          OBJ_RCS_062_oRDR_TRACKER_OBJ_062_oPCAN_RADAR_da5aeb3f_Tx: ComBitPosition=351, ComBitSize=7, ComSignalType=UINT8, ComHandleId=11552, ComSystemTemplateSystemSignalRef=OBJ_RCS_062
          OBJ_ACCELERATION_LAT_ERR_062_oRDR_TRACKER_OBJ_062_oPCAN_RADAR_9a37b105_Tx: ComBitPosition=223, ComBitSize=8, ComSignalType=UINT8, ComHandleId=11519, ComSystemTemplateSystemSignalRef=OBJ_ACCELERATION_LAT_ERR_062
          OBJ_CLS_TYPE2_PROB_062_oRDR_TRACKER_OBJ_062_oPCAN_RADAR_abe5b43f_Tx: ComBitPosition=311, ComBitSize=8, ComSignalType=UINT8, ComHandleId=11527, ComSystemTemplateSystemSignalRef=OBJ_CLS_TYPE2_PROB_062
          OBJ_ACCELERATION_LAT_062_oRDR_TRACKER_OBJ_062_oPCAN_RADAR_4fc38bbb_Tx: ComBitPosition=177, ComBitSize=10, ComSignalType=UINT16, ComHandleId=11518, ComSystemTemplateSystemSignalRef=OBJ_ACCELERATION_LAT_062
          OBJ_CLS_TYPE4_PROB_062_oRDR_TRACKER_OBJ_062_oPCAN_RADAR_e2fc8464_Tx: ComBitPosition=327, ComBitSize=8, ComSignalType=UINT8, ComHandleId=11531, ComSystemTemplateSystemSignalRef=OBJ_CLS_TYPE4_PROB_062
          OBJ_POS_LONG_062_oRDR_TRACKER_OBJ_062_oPCAN_RADAR_493556f7_Tx: ComBitPosition=63, ComBitSize=16, ComSignalType=UINT16, ComHandleId=11550, ComSystemTemplateSystemSignalRef=OBJ_POS_LONG_062
          OBJ_ACCEL_ERR_CRR_COEF_062_oRDR_TRACKER_OBJ_062_oPCAN_RADAR_253135c9_Tx: ComBitPosition=431, ComBitSize=8, ComSignalType=UINT8, ComHandleId=11522, ComSystemTemplateSystemSignalRef=OBJ_ACCEL_ERR_CRR_COEF_062
          OBJ_DIMENSION_WIDTH_ERR_062_oRDR_TRACKER_OBJ_062_oPCAN_RADAR_4b7b1bc0_Tx: ComBitPosition=23, ComBitSize=6, ComSignalType=UINT8, ComHandleId=11539, ComSystemTemplateSystemSignalRef=OBJ_DIMENSION_WIDTH_ERR_062
          OBJ_VELOCITY_LAT_ERR_062_oRDR_TRACKER_OBJ_062_oPCAN_RADAR_880c884e_Tx: ComBitPosition=151, ComBitSize=8, ComSignalType=UINT8, ComHandleId=11560, ComSystemTemplateSystemSignalRef=OBJ_VELOCITY_LAT_ERR_062
          OBJ_YAW_ANGLE_ERR_062_oRDR_TRACKER_OBJ_062_oPCAN_RADAR_8547ba88_Tx: ComBitPosition=175, ComBitSize=7, ComSignalType=UINT8, ComHandleId=11564, ComSystemTemplateSystemSignalRef=OBJ_YAW_ANGLE_ERR_062
          OBJ_EXISTENCE_PROB_062_oRDR_TRACKER_OBJ_062_oPCAN_RADAR_a0655815_Tx: ComBitPosition=229, ComBitSize=14, ComSignalType=UINT16, ComHandleId=11540, ComSystemTemplateSystemSignalRef=OBJ_EXISTENCE_PROB_062
          OBJ_CLS_TYPE6_PROB_062_oRDR_TRACKER_OBJ_062_oPCAN_RADAR_6cdb6992_Tx: ComBitPosition=343, ComBitSize=8, ComSignalType=UINT8, ComHandleId=11535, ComSystemTemplateSystemSignalRef=OBJ_CLS_TYPE6_PROB_062
          OBJ_POS_ERR_CRR_COEF_062_oRDR_TRACKER_OBJ_062_oPCAN_RADAR_1a3a4074_Tx: ComBitPosition=415, ComBitSize=8, ComSignalType=UINT8, ComHandleId=11547, ComSystemTemplateSystemSignalRef=OBJ_POS_ERR_CRR_COEF_062
          OBJ_REF_PT_LAT_OFFSET_062_oRDR_TRACKER_OBJ_062_oPCAN_RADAR_2f67804a_Tx: ComBitPosition=370, ComBitSize=14, ComSignalType=UINT16, ComHandleId=11553, ComSystemTemplateSystemSignalRef=OBJ_REF_PT_LAT_OFFSET_062
          OBJ_ACCELERATION_LONG_062_oRDR_TRACKER_OBJ_062_oPCAN_RADAR_3d33d25b_Tx: ComBitPosition=193, ComBitSize=10, ComSignalType=UINT16, ComHandleId=11520, ComSystemTemplateSystemSignalRef=OBJ_ACCELERATION_LONG_062
          OBJ_MOVEMENT_STATUS_062_oRDR_TRACKER_OBJ_062_oPCAN_RADAR_8a45804e_Tx: ComBitPosition=196, ComBitSize=3, ComSignalType=UINT8, ComHandleId=11546, ComSystemTemplateSystemSignalRef=OBJ_MOVEMENT_STATUS_062
          OBJ_CLS_TYPE3_062_oRDR_TRACKER_OBJ_062_oPCAN_RADAR_0ae98544_Tx: ComBitPosition=279, ComBitSize=4, ComSignalType=UINT8, ComHandleId=11528, ComSystemTemplateSystemSignalRef=OBJ_CLS_TYPE3_062
          OBJ_GROUP_ID_062_oRDR_TRACKER_OBJ_062_oPCAN_RADAR_29174cb8_Tx: ComBitPosition=405, ComBitSize=6, ComSignalType=UINT8, ComHandleId=11541, ComSystemTemplateSystemSignalRef=OBJ_GROUP_ID_062
          OBJ_MEASUREMENT_STATUS_062_oRDR_TRACKER_OBJ_062_oPCAN_RADAR_a5eb1502_Tx: ComBitPosition=14, ComBitSize=3, ComSignalType=UINT8, ComHandleId=11543, ComSystemTemplateSystemSignalRef=OBJ_MEASUREMENT_STATUS_062
          OBJ_POS_LAT_062_oRDR_TRACKER_OBJ_062_oPCAN_RADAR_f895bd38_Tx: ComBitPosition=79, ComBitSize=16, ComSignalType=UINT16, ComHandleId=11548, ComSystemTemplateSystemSignalRef=OBJ_POS_LAT_062
          OBJ_YAW_RATE_062_oRDR_TRACKER_OBJ_062_oPCAN_RADAR_75c59918_Tx: ComBitPosition=399, ComBitSize=10, ComSignalType=UINT16, ComHandleId=11565, ComSystemTemplateSystemSignalRef=OBJ_YAW_RATE_062
          OBJ_YAW_ANGLE_062_oRDR_TRACKER_OBJ_062_oPCAN_RADAR_504abc5f_Tx: ComBitPosition=155, ComBitSize=12, ComSignalType=UINT16, ComHandleId=11563, ComSystemTemplateSystemSignalRef=OBJ_YAW_ANGLE_062
          OBJ_VELOCITY_ERR_CRR_COEF_062_oRDR_TRACKER_OBJ_062_oPCAN_RADAR_b3407d95_Tx: ComBitPosition=423, ComBitSize=8, ComSignalType=UINT8, ComHandleId=11558, ComSystemTemplateSystemSignalRef=OBJ_VELOCITY_ERR_CRR_COEF_062
          OBJ_CLS_TYPE1_062_oRDR_TRACKER_OBJ_062_oPCAN_RADAR_ca8978c1_Tx: ComBitPosition=271, ComBitSize=4, ComSignalType=UINT8, ComHandleId=11524, ComSystemTemplateSystemSignalRef=OBJ_CLS_TYPE1_062
          OBJ_CLS_TYPE1_PROB_062_oRDR_TRACKER_OBJ_062_oPCAN_RADAR_62d1af32_Tx: ComBitPosition=303, ComBitSize=8, ComSignalType=UINT8, ComHandleId=11525, ComSystemTemplateSystemSignalRef=OBJ_CLS_TYPE1_PROB_062
          OBJ_CLS_TYPE3_PROB_062_oRDR_TRACKER_OBJ_062_oPCAN_RADAR_ecf642c4_Tx: ComBitPosition=319, ComBitSize=8, ComSignalType=UINT8, ComHandleId=11529, ComSystemTemplateSystemSignalRef=OBJ_CLS_TYPE3_PROB_062
          OBJ_REF_PT_LONG_OFFSET_062_oRDR_TRACKER_OBJ_062_oPCAN_RADAR_60357049_Tx: ComBitPosition=357, ComBitSize=14, ComSignalType=UINT16, ComHandleId=11554, ComSystemTemplateSystemSignalRef=OBJ_REF_PT_LONG_OFFSET_062
          OBJ_ID_062_oRDR_TRACKER_OBJ_062_oPCAN_RADAR_da3967bf_Tx: ComBitPosition=7, ComBitSize=8, ComSignalType=UINT8, ComHandleId=11542, ComSystemTemplateSystemSignalRef=OBJ_ID_062
          OBJ_DIMENSION_WIDTH_062_oRDR_TRACKER_OBJ_062_oPCAN_RADAR_abd9dc28_Tx: ComBitPosition=17, ComBitSize=10, ComSignalType=UINT16, ComHandleId=11538, ComSystemTemplateSystemSignalRef=OBJ_DIMENSION_WIDTH_062
          OBJ_MH_CRC16_062_oRDR_TRACKER_OBJ_062_oPCAN_RADAR_d98ba23e_Tx: ComBitPosition=495, ComBitSize=16, ComSignalType=UINT16, ComHandleId=11544, ComSystemTemplateSystemSignalRef=OBJ_MH_CRC16_062
          OBJ_MH_CYCLE_COUNTER_062_oRDR_TRACKER_OBJ_062_oPCAN_RADAR_a86ff8df_Tx: ComBitPosition=487, ComBitSize=8, ComSignalType=UINT8, ComHandleId=11545, ComSystemTemplateSystemSignalRef=OBJ_MH_CYCLE_COUNTER_062
      3 x ComIPdu, all with ComIPduDirection=SEND, ComIPduType=NORMAL, ComIPduCancellationSupport=false, ComIPduSignalProcessing=DEFERRED, ComIPduChannelRef=CN_PCAN_RADAR_458ff0f1, ComIPduGroupRef=RDR01_oPCAN_RADAR_Tx_b6bdb067 if post-build-variant-condition{matching-criterion=RDR_POS, value=0}, ComIPduMainFunctionRef=ComMainFunctionTx_Event, ComIPduGroupRef=RDR02_oPCAN_RADAR_Tx_9f750495 if post-build-variant-condition{matching-criterion=RDR_POS, value=1}, ComIPduGroupRef=RDR03_oPCAN_RADAR_Tx_311d9504 if post-build-variant-condition{matching-criterion=RDR_POS, value=2}, ComIPduGroupRef=RDR04_oPCAN_RADAR_Tx_cce46d71 if post-build-variant-condition{matching-criterion=RDR_POS, value=3}, ComIPduGroupRef=RDR05_oPCAN_RADAR_Tx_628cfce0 if post-build-variant-condition{matching-criterion=RDR_POS, value=4}, ComIPduGroupRef=RDR06_oPCAN_RADAR_Tx_4b444812 if post-build-variant-condition{matching-criterion=RDR_POS, value=5}, ComIPduGroupRef=RDR07_oPCAN_RADAR_Tx_e52cd983 if post-build-variant-condition{matching-criterion=RDR_POS, value=6}, ComIPduGroupRef=RDR08_oPCAN_RADAR_Tx_6bc6beb9 if post-build-variant-condition{matching-criterion=RDR_POS, value=7}:
        RDR_TRACKER_OBJ_063_oPCAN_RADAR_b61905ab_Tx: ComIPduHandleId=173, ComIPduSignalGroupRef=SG_TrackerObject063_oRDR_TRACKER_OBJ_063_oPCAN_RADAR_b8f3587f_Tx, ComPduIdRef=RDR_TRACKER_OBJ_063_oPCAN_RADAR_b61905ab_Tx
          ComTxIPdu: ComMinimumDelayTime=0, ComTxIPduUnusedAreasDefault=0
            ComTxModeTrue
              ComTxMode: ComTxModeMode=DIRECT, ComTxModeNumberOfRepetitions=0
            ComTxModeFalse
              ComTxMode: ComTxModeMode=NONE
        RDR_TRACKER_OBJ_045_oPCAN_RADAR_f7921edb_Tx: ComIPduHandleId=155, ComIPduSignalGroupRef=SG_TrackerObject045_oRDR_TRACKER_OBJ_045_oPCAN_RADAR_66388c6a_Tx, ComPduIdRef=RDR_TRACKER_OBJ_045_oPCAN_RADAR_f7921edb_Tx
          ComTxIPdu: ComMinimumDelayTime=0, ComTxIPduUnusedAreasDefault=0
            ComTxModeTrue
              ComTxMode: ComTxModeMode=DIRECT, ComTxModeNumberOfRepetitions=0
            ComTxModeFalse
              ComTxMode: ComTxModeMode=NONE
        RDR_DETECTION_037_040_oPCAN_RADAR_24e58fa7_Tx: ComIPduHandleId=15, ComIPduSignalGroupRef=SG_Detections_037_040_oRDR_DETECTION_037_040_oPCAN_RADAR_abdcc2d8_Tx, ComPduIdRef=RDR_DETECTION_037_040_oPCAN_RADAR_24e58fa7_Tx
          ComTxIPdu: ComMinimumDelayTime=0, ComTxIPduUnusedAreasDefault=0
            ComTxModeTrue
              ComTxMode: ComTxModeMode=DIRECT, ComTxModeNumberOfRepetitions=0
            ComTxModeFalse
              ComTxMode: ComTxModeMode=NONE
