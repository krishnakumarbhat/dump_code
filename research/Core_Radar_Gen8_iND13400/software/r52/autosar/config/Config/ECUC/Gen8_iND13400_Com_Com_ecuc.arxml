[part 20 of 20: package /ActiveEcuC]
AUTOSAR XML (schema 00053)
package /ActiveEcuC  (continued)
  module config Com: implementation-config-variant=VARIANT-PRE-COMPILE, module-description=Com_Impl  (continued)
    ComConfig: ComConfigurationId=0, ComRxImmediateNotificationCacheSize=0, ComRxDeferredNotificationCacheSize=1  (continued)
      SG_Fusion_Detections_077_080_oRDR_FUSION_DET_077_080_oPCAN_RADAR_ea1c1377_Rx (ComSignalGroup):
        ComTimeout = 0
        ComTransferProperty = PENDING
        ComSignalGroupAccess = ACCESS_NEEDED_BY_SWC_OR_COM
        ComHandleId = 27
        ComSignalGroupArrayAccess = true
        ComSystemTemplateSignalGroupRef = SG_Fusion_Detections_077_080
        83 x ComGroupSignal, all with ComSignalEndianness=LITTLE_ENDIAN, ComSignalInitValue=0, ComSignalAccess=ACCESS_NEEDED_BY_SWC_OR_COM:
          DET_BI_STATIC_FLAG_080_Rx_oRDR_FUSION_DET_077_080_oPCAN_RADAR_7f712830_Rx: ComBitPosition=440, ComBitSize=1, ComSignalType=BOOLEAN, ComHandleId=1666, ComSystemTemplateSystemSignalRef=DET_BI_STATIC_FLAG_080_Rx
          DET_RANGE_VELOCITY_ERR_078_Rx_oRDR_FUSION_DET_077_080_oPCAN_RADAR_9bfc37da_Rx: ComBitPosition=176, ComBitSize=8, ComSignalType=UINT8, ComHandleId=1719, ComSystemTemplateSystemSignalRef=DET_RANGE_VELOCITY_ERR_078_Rx
          DET_SUPER_RES_TARGET_077_Rx_oRDR_FUSION_DET_077_080_oPCAN_RADAR_8dbcf742_Rx: ComBitPosition=87, ComBitSize=1, ComSignalType=BOOLEAN, ComHandleId=1730, ComSystemTemplateSystemSignalRef=DET_SUPER_RES_TARGET_077_Rx
          DET_IDM_077_Rx_oRDR_FUSION_DET_077_080_oPCAN_RADAR_736476a8_Rx: ComBitPosition=63, ComBitSize=1, ComSignalType=BOOLEAN, ComHandleId=1691, ComSystemTemplateSystemSignalRef=DET_IDM_077_Rx
          DET_RANGE_ERR_077_Rx_oRDR_FUSION_DET_077_080_oPCAN_RADAR_0fd13aae_Rx: ComBitPosition=40, ComBitSize=7, ComSignalType=UINT8, ComHandleId=1710, ComSystemTemplateSystemSignalRef=DET_RANGE_ERR_077_Rx
          DET_CONFD_AZIMUTH_077_Rx_oRDR_FUSION_DET_077_080_oPCAN_RADAR_bea8549b_Rx: ComBitPosition=118, ComBitSize=2, ComSignalType=UINT8, ComHandleId=1667, ComSystemTemplateSystemSignalRef=DET_CONFD_AZIMUTH_077_Rx
          DET_ELEVATION_ERR_079_Rx_oRDR_FUSION_DET_077_080_oPCAN_RADAR_4369fad5_Rx: ComBitPosition=304, ComBitSize=6, ComSignalType=UINT8, ComHandleId=1681, ComSystemTemplateSystemSignalRef=DET_ELEVATION_ERR_079_Rx
          DET_RANGE_VELOCITY_ERR_077_Rx_oRDR_FUSION_DET_077_080_oPCAN_RADAR_1bb24572_Rx: ComBitPosition=64, ComBitSize=8, ComSignalType=UINT8, ComHandleId=1718, ComSystemTemplateSystemSignalRef=DET_RANGE_VELOCITY_ERR_077_Rx
          DET_BELOW_RAIN_THOLD_080_Rx_oRDR_FUSION_DET_077_080_oPCAN_RADAR_08ef8323_Rx: ComBitPosition=375, ComBitSize=1, ComSignalType=BOOLEAN, ComHandleId=1662, ComSystemTemplateSystemSignalRef=DET_BELOW_RAIN_THOLD_080_Rx
          DET_RANGE_077_Rx_oRDR_FUSION_DET_077_080_oPCAN_RADAR_5f23b64e_Rx: ComBitPosition=24, ComBitSize=15, ComSignalType=UINT16, ComHandleId=1706, ComSystemTemplateSystemSignalRef=DET_RANGE_077_Rx
          DET_AZIMUTH_ERR_078_Rx_oRDR_FUSION_DET_077_080_oPCAN_RADAR_cec23943_Rx: ComBitPosition=217, ComBitSize=7, ComSignalType=UINT8, ComHandleId=1656, ComSystemTemplateSystemSignalRef=DET_AZIMUTH_ERR_078_Rx
          DET_CONFD_AZIMUTH_079_Rx_oRDR_FUSION_DET_077_080_oPCAN_RADAR_91a2b474_Rx: ComBitPosition=342, ComBitSize=2, ComSignalType=UINT8, ComHandleId=1669, ComSystemTemplateSystemSignalRef=DET_CONFD_AZIMUTH_079_Rx
          DET_BELOW_RAIN_THOLD_077_Rx_oRDR_FUSION_DET_077_080_oPCAN_RADAR_2a5f15dc_Rx: ComBitPosition=39, ComBitSize=1, ComSignalType=BOOLEAN, ComHandleId=1659, ComSystemTemplateSystemSignalRef=DET_BELOW_RAIN_THOLD_077_Rx
          DET_CONFD_AZIMUTH_080_Rx_oRDR_FUSION_DET_077_080_oPCAN_RADAR_9c18c264_Rx: ComBitPosition=454, ComBitSize=2, ComSignalType=UINT8, ComHandleId=1670, ComSystemTemplateSystemSignalRef=DET_CONFD_AZIMUTH_080_Rx
          DET_EXISTENCE_PROB_077_Rx_oRDR_FUSION_DET_077_080_oPCAN_RADAR_9b7b62af_Rx: ComBitPosition=112, ComBitSize=6, ComSignalType=UINT8, ComHandleId=1683, ComSystemTemplateSystemSignalRef=DET_EXISTENCE_PROB_077_Rx
          DET_BELOW_RAIN_THOLD_078_Rx_oRDR_FUSION_DET_077_080_oPCAN_RADAR_aa116774_Rx: ComBitPosition=151, ComBitSize=1, ComSignalType=BOOLEAN, ComHandleId=1660, ComSystemTemplateSystemSignalRef=DET_BELOW_RAIN_THOLD_078_Rx
          DET_ELEVATION_079_Rx_oRDR_FUSION_DET_077_080_oPCAN_RADAR_91d0d80a_Rx: ComBitPosition=296, ComBitSize=8, ComSignalType=UINT8, ComHandleId=1677, ComSystemTemplateSystemSignalRef=DET_ELEVATION_079_Rx
          DET_RANGE_ERR_080_Rx_oRDR_FUSION_DET_077_080_oPCAN_RADAR_2d61ac51_Rx: ComBitPosition=376, ComBitSize=7, ComSignalType=UINT8, ComHandleId=1713, ComSystemTemplateSystemSignalRef=DET_RANGE_ERR_080_Rx
          DET_SNR_077_Rx_oRDR_FUSION_DET_077_080_oPCAN_RADAR_4647d642_Rx: ComBitPosition=120, ComBitSize=8, ComSignalType=UINT8, ComHandleId=1726, ComSystemTemplateSystemSignalRef=DET_SNR_077_Rx
          DET_RCS_080_Rx_oRDR_FUSION_DET_077_080_oPCAN_RADAR_6dad3154_Rx: ComBitPosition=464, ComBitSize=8, ComSignalType=UINT8, ComHandleId=1725, ComSystemTemplateSystemSignalRef=DET_RCS_080_Rx
          DET_RANGE_VELOCITY_079_Rx_oRDR_FUSION_DET_077_080_oPCAN_RADAR_addcd55f_Rx: ComBitPosition=272, ComBitSize=15, ComSignalType=UINT16, ComHandleId=1716, ComSystemTemplateSystemSignalRef=DET_RANGE_VELOCITY_079_Rx
          DET_SNR_080_Rx_oRDR_FUSION_DET_077_080_oPCAN_RADAR_64f740bd_Rx: ComBitPosition=456, ComBitSize=8, ComSignalType=UINT8, ComHandleId=1729, ComSystemTemplateSystemSignalRef=DET_SNR_080_Rx
          DET_AZIMUTH_080_Rx_oRDR_FUSION_DET_077_080_oPCAN_RADAR_6e557c96_Rx: ComBitPosition=424, ComBitSize=13, ComSignalType=UINT16, ComHandleId=1654, ComSystemTemplateSystemSignalRef=DET_AZIMUTH_080_Rx
          DET_ELEVATION_ERR_078_Rx_oRDR_FUSION_DET_077_080_oPCAN_RADAR_ec2d6892_Rx: ComBitPosition=192, ComBitSize=6, ComSignalType=UINT8, ComHandleId=1680, ComSystemTemplateSystemSignalRef=DET_ELEVATION_ERR_078_Rx
          DET_MTD_078_Rx_oRDR_FUSION_DET_077_080_oPCAN_RADAR_4ea93270_Rx: ComBitPosition=159, ComBitSize=1, ComSignalType=BOOLEAN, ComHandleId=1699, ComSystemTemplateSystemSignalRef=DET_MTD_078_Rx
          DET_SUPER_RES_TARGET_079_Rx_oRDR_FUSION_DET_077_080_oPCAN_RADAR_a2b617ad_Rx: ComBitPosition=311, ComBitSize=1, ComSignalType=BOOLEAN, ComHandleId=1732, ComSystemTemplateSystemSignalRef=DET_SUPER_RES_TARGET_079_Rx
          DET_BI_STATIC_FLAG_078_Rx_oRDR_FUSION_DET_077_080_oPCAN_RADAR_dd8fcc67_Rx: ComBitPosition=216, ComBitSize=1, ComSignalType=BOOLEAN, ComHandleId=1664, ComSystemTemplateSystemSignalRef=DET_BI_STATIC_FLAG_078_Rx
          DET_MTD_080_Rx_oRDR_FUSION_DET_077_080_oPCAN_RADAR_ec57d627_Rx: ComBitPosition=383, ComBitSize=1, ComSignalType=BOOLEAN, ComHandleId=1701, ComSystemTemplateSystemSignalRef=DET_MTD_080_Rx
          DET_RCS_079_Rx_oRDR_FUSION_DET_077_080_oPCAN_RADAR_60174744_Rx: ComBitPosition=352, ComBitSize=8, ComSignalType=UINT8, ComHandleId=1724, ComSystemTemplateSystemSignalRef=DET_RCS_079_Rx
          DET_SUPER_RES_TARGET_080_Rx_oRDR_FUSION_DET_077_080_oPCAN_RADAR_af0c61bd_Rx: ComBitPosition=423, ComBitSize=1, ComSignalType=BOOLEAN, ComHandleId=1733, ComSystemTemplateSystemSignalRef=DET_SUPER_RES_TARGET_080_Rx
          DET_AZIMUTH_ERR_077_Rx_oRDR_FUSION_DET_077_080_oPCAN_RADAR_4e8c4beb_Rx: ComBitPosition=105, ComBitSize=7, ComSignalType=UINT8, ComHandleId=1655, ComSystemTemplateSystemSignalRef=DET_AZIMUTH_ERR_077_Rx
          DET_ELEVATION_080_Rx_oRDR_FUSION_DET_077_080_oPCAN_RADAR_9c6aae1a_Rx: ComBitPosition=408, ComBitSize=8, ComSignalType=UINT8, ComHandleId=1678, ComSystemTemplateSystemSignalRef=DET_ELEVATION_080_Rx
          DET_ELEVATION_077_Rx_oRDR_FUSION_DET_077_080_oPCAN_RADAR_beda38e5_Rx: ComBitPosition=72, ComBitSize=8, ComSignalType=UINT8, ComHandleId=1675, ComSystemTemplateSystemSignalRef=DET_ELEVATION_077_Rx
          DET_RCS_078_Rx_oRDR_FUSION_DET_077_080_oPCAN_RADAR_cf53d503_Rx: ComBitPosition=240, ComBitSize=8, ComSignalType=UINT8, ComHandleId=1723, ComSystemTemplateSystemSignalRef=DET_RCS_078_Rx
          DET_ELEVATION_078_Rx_oRDR_FUSION_DET_077_080_oPCAN_RADAR_3e944a4d_Rx: ComBitPosition=184, ComBitSize=8, ComSignalType=UINT8, ComHandleId=1676, ComSystemTemplateSystemSignalRef=DET_ELEVATION_078_Rx
          DET_SNR_078_Rx_oRDR_FUSION_DET_077_080_oPCAN_RADAR_c609a4ea_Rx: ComBitPosition=232, ComBitSize=8, ComSignalType=UINT8, ComHandleId=1727, ComSystemTemplateSystemSignalRef=DET_SNR_078_Rx
          DET_AZIMUTH_079_Rx_oRDR_FUSION_DET_077_080_oPCAN_RADAR_63ef0a86_Rx: ComBitPosition=312, ComBitSize=13, ComSignalType=UINT16, ComHandleId=1653, ComSystemTemplateSystemSignalRef=DET_AZIMUTH_079_Rx
          DET_BI_STATIC_FLAG_077_Rx_oRDR_FUSION_DET_077_080_oPCAN_RADAR_5dc1becf_Rx: ComBitPosition=104, ComBitSize=1, ComSignalType=BOOLEAN, ComHandleId=1663, ComSystemTemplateSystemSignalRef=DET_BI_STATIC_FLAG_077_Rx
          DET_AZIMUTH_078_Rx_oRDR_FUSION_DET_077_080_oPCAN_RADAR_ccab98c1_Rx: ComBitPosition=200, ComBitSize=13, ComSignalType=UINT16, ComHandleId=1652, ComSystemTemplateSystemSignalRef=DET_AZIMUTH_078_Rx
          DET_CONFD_ELEVATION_078_Rx_oRDR_FUSION_DET_077_080_oPCAN_RADAR_34c7a5b4_Rx: ComBitPosition=213, ComBitSize=2, ComSignalType=UINT8, ComHandleId=1672, ComSystemTemplateSystemSignalRef=DET_CONFD_ELEVATION_078_Rx
          DET_PROB_1STAZHYPO_079_Rx_oRDR_FUSION_DET_077_080_oPCAN_RADAR_2b94beb6_Rx: ComBitPosition=327, ComBitSize=1, ComSignalType=BOOLEAN, ComHandleId=1704, ComSystemTemplateSystemSignalRef=DET_PROB_1STAZHYPO_079_Rx
          DET_MH_CRC16_077_080_Rx_oRDR_FUSION_DET_077_080_oPCAN_RADAR_170385b4_Rx: ComBitPosition=0, ComBitSize=16, ComSignalType=UINT16, ComHandleId=1695, ComSystemTemplateSystemSignalRef=DET_MH_CRC16_077_080_Rx
          DET_RANGE_VELOCITY_078_Rx_oRDR_FUSION_DET_077_080_oPCAN_RADAR_02984718_Rx: ComBitPosition=160, ComBitSize=15, ComSignalType=UINT16, ComHandleId=1715, ComSystemTemplateSystemSignalRef=DET_RANGE_VELOCITY_078_Rx
          DET_PROB_1STAZHYPO_080_Rx_oRDR_FUSION_DET_077_080_oPCAN_RADAR_262ec8a6_Rx: ComBitPosition=439, ComBitSize=1, ComSignalType=BOOLEAN, ComHandleId=1705, ComSystemTemplateSystemSignalRef=DET_PROB_1STAZHYPO_080_Rx
          DET_RANGE_VELOCITY_080_Rx_oRDR_FUSION_DET_077_080_oPCAN_RADAR_a066a34f_Rx: ComBitPosition=384, ComBitSize=15, ComSignalType=UINT16, ComHandleId=1717, ComSystemTemplateSystemSignalRef=DET_RANGE_VELOCITY_080_Rx
          DET_MH_CYCLE_COUNTER_077_080_Rx_oRDR_FUSION_DET_077_080_oPCAN_RADAR_1ad8b871_Rx: ComBitPosition=16, ComBitSize=8, ComSignalType=UINT8, ComHandleId=1696, ComSystemTemplateSystemSignalRef=DET_MH_CYCLE_COUNTER_077_080_Rx
          DET_RANGE_079_Rx_oRDR_FUSION_DET_077_080_oPCAN_RADAR_702956a1_Rx: ComBitPosition=248, ComBitSize=15, ComSignalType=UINT16, ComHandleId=1708, ComSystemTemplateSystemSignalRef=DET_RANGE_079_Rx
          DET_CONFD_AZIMUTH_078_Rx_oRDR_FUSION_DET_077_080_oPCAN_RADAR_3ee62633_Rx: ComBitPosition=230, ComBitSize=2, ComSignalType=UINT8, ComHandleId=1668, ComSystemTemplateSystemSignalRef=DET_CONFD_AZIMUTH_078_Rx
          DET_ELEVATION_ERR_080_Rx_oRDR_FUSION_DET_077_080_oPCAN_RADAR_4ed38cc5_Rx: ComBitPosition=416, ComBitSize=6, ComSignalType=UINT8, ComHandleId=1682, ComSystemTemplateSystemSignalRef=DET_ELEVATION_ERR_080_Rx
          DET_RANGE_ERR_079_Rx_oRDR_FUSION_DET_077_080_oPCAN_RADAR_20dbda41_Rx: ComBitPosition=264, ComBitSize=7, ComSignalType=UINT8, ComHandleId=1712, ComSystemTemplateSystemSignalRef=DET_RANGE_ERR_079_Rx
          DET_EXISTENCE_PROB_080_Rx_oRDR_FUSION_DET_077_080_oPCAN_RADAR_b9cbf450_Rx: ComBitPosition=448, ComBitSize=6, ComSignalType=UINT8, ComHandleId=1686, ComSystemTemplateSystemSignalRef=DET_EXISTENCE_PROB_080_Rx
          DET_RANGE_080_Rx_oRDR_FUSION_DET_077_080_oPCAN_RADAR_7d9320b1_Rx: ComBitPosition=360, ComBitSize=15, ComSignalType=UINT16, ComHandleId=1709, ComSystemTemplateSystemSignalRef=DET_RANGE_080_Rx
          DET_RANGE_ERR_078_Rx_oRDR_FUSION_DET_077_080_oPCAN_RADAR_8f9f4806_Rx: ComBitPosition=152, ComBitSize=7, ComSignalType=UINT8, ComHandleId=1711, ComSystemTemplateSystemSignalRef=DET_RANGE_ERR_078_Rx
          DET_SUPER_RES_TARGET_078_Rx_oRDR_FUSION_DET_077_080_oPCAN_RADAR_0df285ea_Rx: ComBitPosition=199, ComBitSize=1, ComSignalType=BOOLEAN, ComHandleId=1731, ComSystemTemplateSystemSignalRef=DET_SUPER_RES_TARGET_078_Rx
          DET_RANGE_078_Rx_oRDR_FUSION_DET_077_080_oPCAN_RADAR_df6dc4e6_Rx: ComBitPosition=136, ComBitSize=15, ComSignalType=UINT16, ComHandleId=1707, ComSystemTemplateSystemSignalRef=DET_RANGE_078_Rx
          DET_PROB_1STAZHYPO_078_Rx_oRDR_FUSION_DET_077_080_oPCAN_RADAR_84d02cf1_Rx: ComBitPosition=215, ComBitSize=1, ComSignalType=BOOLEAN, ComHandleId=1703, ComSystemTemplateSystemSignalRef=DET_PROB_1STAZHYPO_078_Rx
          DET_CONFD_ELEVATION_079_Rx_oRDR_FUSION_DET_077_080_oPCAN_RADAR_9b8337f3_Rx: ComBitPosition=325, ComBitSize=2, ComSignalType=UINT8, ComHandleId=1673, ComSystemTemplateSystemSignalRef=DET_CONFD_ELEVATION_079_Rx
          DET_AZIMUTH_ERR_080_Rx_oRDR_FUSION_DET_077_080_oPCAN_RADAR_6c3cdd14_Rx: ComBitPosition=441, ComBitSize=7, ComSignalType=UINT8, ComHandleId=1658, ComSystemTemplateSystemSignalRef=DET_AZIMUTH_ERR_080_Rx
          DET_IDM_080_Rx_oRDR_FUSION_DET_077_080_oPCAN_RADAR_51d4e057_Rx: ComBitPosition=399, ComBitSize=1, ComSignalType=BOOLEAN, ComHandleId=1694, ComSystemTemplateSystemSignalRef=DET_IDM_080_Rx
          DET_ELEVATION_ERR_077_Rx_oRDR_FUSION_DET_077_080_oPCAN_RADAR_6c631a3a_Rx: ComBitPosition=80, ComBitSize=6, ComSignalType=UINT8, ComHandleId=1679, ComSystemTemplateSystemSignalRef=DET_ELEVATION_ERR_077_Rx
          DET_SNR_079_Rx_oRDR_FUSION_DET_077_080_oPCAN_RADAR_694d36ad_Rx: ComBitPosition=344, ComBitSize=8, ComSignalType=UINT8, ComHandleId=1728, ComSystemTemplateSystemSignalRef=DET_SNR_079_Rx
          DET_AZIMUTH_ERR_079_Rx_oRDR_FUSION_DET_077_080_oPCAN_RADAR_6186ab04_Rx: ComBitPosition=329, ComBitSize=7, ComSignalType=UINT8, ComHandleId=1657, ComSystemTemplateSystemSignalRef=DET_AZIMUTH_ERR_079_Rx
          DET_BELOW_RAIN_THOLD_079_Rx_oRDR_FUSION_DET_077_080_oPCAN_RADAR_0555f533_Rx: ComBitPosition=263, ComBitSize=1, ComSignalType=BOOLEAN, ComHandleId=1661, ComSystemTemplateSystemSignalRef=DET_BELOW_RAIN_THOLD_079_Rx
          DET_HVC_FLAG_079_Rx_oRDR_FUSION_DET_077_080_oPCAN_RADAR_69af6f0f_Rx: ComBitPosition=310, ComBitSize=1, ComSignalType=BOOLEAN, ComHandleId=1689, ComSystemTemplateSystemSignalRef=DET_HVC_FLAG_079_Rx
          DET_IDM_078_Rx_oRDR_FUSION_DET_077_080_oPCAN_RADAR_f32a0400_Rx: ComBitPosition=175, ComBitSize=1, ComSignalType=BOOLEAN, ComHandleId=1692, ComSystemTemplateSystemSignalRef=DET_IDM_078_Rx
          DET_MTD_077_Rx_oRDR_FUSION_DET_077_080_oPCAN_RADAR_cee740d8_Rx: ComBitPosition=47, ComBitSize=1, ComSignalType=BOOLEAN, ComHandleId=1698, ComSystemTemplateSystemSignalRef=DET_MTD_077_Rx
          DET_PROB_1STAZHYPO_077_Rx_oRDR_FUSION_DET_077_080_oPCAN_RADAR_049e5e59_Rx: ComBitPosition=103, ComBitSize=1, ComSignalType=BOOLEAN, ComHandleId=1702, ComSystemTemplateSystemSignalRef=DET_PROB_1STAZHYPO_077_Rx
          DET_EXISTENCE_PROB_078_Rx_oRDR_FUSION_DET_077_080_oPCAN_RADAR_1b351007_Rx: ComBitPosition=224, ComBitSize=6, ComSignalType=UINT8, ComHandleId=1684, ComSystemTemplateSystemSignalRef=DET_EXISTENCE_PROB_078_Rx
          DET_AZIMUTH_077_Rx_oRDR_FUSION_DET_077_080_oPCAN_RADAR_4ce5ea69_Rx: ComBitPosition=88, ComBitSize=13, ComSignalType=UINT16, ComHandleId=1651, ComSystemTemplateSystemSignalRef=DET_AZIMUTH_077_Rx
          DET_MH_SCAN_INDEX_4LSB_077_080_Rx_oRDR_FUSION_DET_077_080_oPCAN_RADAR_7e68774a_Rx: ComBitPosition=476, ComBitSize=4, ComSignalType=UINT8, ComHandleId=1697, ComSystemTemplateSystemSignalRef=DET_MH_SCAN_INDEX_4LSB_077_080_Rx
          DET_BI_STATIC_FLAG_079_Rx_oRDR_FUSION_DET_077_080_oPCAN_RADAR_72cb5e20_Rx: ComBitPosition=328, ComBitSize=1, ComSignalType=BOOLEAN, ComHandleId=1665, ComSystemTemplateSystemSignalRef=DET_BI_STATIC_FLAG_079_Rx
          DET_IDM_079_Rx_oRDR_FUSION_DET_077_080_oPCAN_RADAR_5c6e9647_Rx: ComBitPosition=287, ComBitSize=1, ComSignalType=BOOLEAN, ComHandleId=1693, ComSystemTemplateSystemSignalRef=DET_IDM_079_Rx
          DET_CONFD_ELEVATION_077_Rx_oRDR_FUSION_DET_077_080_oPCAN_RADAR_b489d71c_Rx: ComBitPosition=101, ComBitSize=2, ComSignalType=UINT8, ComHandleId=1671, ComSystemTemplateSystemSignalRef=DET_CONFD_ELEVATION_077_Rx
          DET_HVC_FLAG_078_Rx_oRDR_FUSION_DET_077_080_oPCAN_RADAR_c6ebfd48_Rx: ComBitPosition=198, ComBitSize=1, ComSignalType=BOOLEAN, ComHandleId=1688, ComSystemTemplateSystemSignalRef=DET_HVC_FLAG_078_Rx
          DET_HVC_FLAG_080_Rx_oRDR_FUSION_DET_077_080_oPCAN_RADAR_6415191f_Rx: ComBitPosition=422, ComBitSize=1, ComSignalType=BOOLEAN, ComHandleId=1690, ComSystemTemplateSystemSignalRef=DET_HVC_FLAG_080_Rx
          DET_RANGE_VELOCITY_ERR_080_Rx_oRDR_FUSION_DET_077_080_oPCAN_RADAR_3902d38d_Rx: ComBitPosition=400, ComBitSize=8, ComSignalType=UINT8, ComHandleId=1721, ComSystemTemplateSystemSignalRef=DET_RANGE_VELOCITY_ERR_080_Rx
          DET_RCS_077_Rx_oRDR_FUSION_DET_077_080_oPCAN_RADAR_4f1da7ab_Rx: ComBitPosition=128, ComBitSize=8, ComSignalType=UINT8, ComHandleId=1722, ComSystemTemplateSystemSignalRef=DET_RCS_077_Rx
          DET_HVC_FLAG_077_Rx_oRDR_FUSION_DET_077_080_oPCAN_RADAR_46a58fe0_Rx: ComBitPosition=86, ComBitSize=1, ComSignalType=BOOLEAN, ComHandleId=1687, ComSystemTemplateSystemSignalRef=DET_HVC_FLAG_077_Rx
          DET_MTD_079_Rx_oRDR_FUSION_DET_077_080_oPCAN_RADAR_e1eda037_Rx: ComBitPosition=271, ComBitSize=1, ComSignalType=BOOLEAN, ComHandleId=1700, ComSystemTemplateSystemSignalRef=DET_MTD_079_Rx
          DET_RANGE_VELOCITY_ERR_079_Rx_oRDR_FUSION_DET_077_080_oPCAN_RADAR_34b8a59d_Rx: ComBitPosition=288, ComBitSize=8, ComSignalType=UINT8, ComHandleId=1720, ComSystemTemplateSystemSignalRef=DET_RANGE_VELOCITY_ERR_079_Rx
          DET_CONFD_ELEVATION_080_Rx_oRDR_FUSION_DET_077_080_oPCAN_RADAR_963941e3_Rx: ComBitPosition=437, ComBitSize=2, ComSignalType=UINT8, ComHandleId=1674, ComSystemTemplateSystemSignalRef=DET_CONFD_ELEVATION_080_Rx
          DET_RANGE_VELOCITY_077_Rx_oRDR_FUSION_DET_077_080_oPCAN_RADAR_82d635b0_Rx: ComBitPosition=48, ComBitSize=15, ComSignalType=UINT16, ComHandleId=1714, ComSystemTemplateSystemSignalRef=DET_RANGE_VELOCITY_077_Rx
          DET_EXISTENCE_PROB_079_Rx_oRDR_FUSION_DET_077_080_oPCAN_RADAR_b4718240_Rx: ComBitPosition=336, ComBitSize=6, ComSignalType=UINT8, ComHandleId=1685, ComSystemTemplateSystemSignalRef=DET_EXISTENCE_PROB_079_Rx
      4 x ComIPdu, all with ComIPduDirection=RECEIVE, ComIPduType=NORMAL, ComIPduCancellationSupport=false, ComIPduSignalProcessing=DEFERRED, ComIPduChannelRef=CN_PCAN_RADAR_458ff0f1, ComIPduGroupRef=RDR01_oPCAN_RADAR_Rx_e0e717e1 if post-build-variant-condition{matching-criterion=RDR_POS, value=0}, ComIPduMainFunctionRef=ComMainFunctionRx, ComIPduGroupRef=RDR02_oPCAN_RADAR_Rx_c92fa313 if post-build-variant-condition{matching-criterion=RDR_POS, value=1}, ComIPduGroupRef=RDR03_oPCAN_RADAR_Rx_67473282 if post-build-variant-condition{matching-criterion=RDR_POS, value=2}, ComIPduGroupRef=RDR04_oPCAN_RADAR_Rx_9abecaf7 if post-build-variant-condition{matching-criterion=RDR_POS, value=3}, ComIPduGroupRef=RDR05_oPCAN_RADAR_Rx_34d65b66 if post-build-variant-condition{matching-criterion=RDR_POS, value=4}, ComIPduGroupRef=RDR06_oPCAN_RADAR_Rx_1d1eef94 if post-build-variant-condition{matching-criterion=RDR_POS, value=5}, ComIPduGroupRef=RDR07_oPCAN_RADAR_Rx_b3767e05 if post-build-variant-condition{matching-criterion=RDR_POS, value=6}, ComIPduGroupRef=RDR08_oPCAN_RADAR_Rx_3d9c193f if post-build-variant-condition{matching-criterion=RDR_POS, value=7}:
        RDR_FUSION_DET_081_084_oPCAN_RADAR_f7961d8f_Rx: ComIPduHandleId=42, ComIPduSignalGroupRef=SG_Fusion_Detections_081_084_oRDR_FUSION_DET_081_084_oPCAN_RADAR_d08af384_Rx, ComPduIdRef=RDR_FUSION_DET_081_084_oPCAN_RADAR_f7961d8f_Rx
        RDR_FUSION_DET_049_052_oPCAN_RADAR_1a60849d_Rx: ComIPduHandleId=34, ComIPduSignalGroupRef=SG_Fusion_Detections_049_052_oRDR_FUSION_DET_049_052_oPCAN_RADAR_25715fa9_Rx, ComPduIdRef=RDR_FUSION_DET_049_052_oPCAN_RADAR_1a60849d_Rx
        RDR_FUSION_DET_121_124_oPCAN_RADAR_593d592b_Rx: ComIPduHandleId=52, ComIPduSignalGroupRef=SG_Fusion_Detections_121_124_oRDR_FUSION_DET_121_124_oPCAN_RADAR_9023764b_Rx, ComPduIdRef=RDR_FUSION_DET_121_124_oPCAN_RADAR_593d592b_Rx
        RDR_FUSION_DET_073_076_oPCAN_RADAR_e31d289d_Rx: ComIPduHandleId=40, ComIPduSignalGroupRef=SG_Fusion_Detections_073_076_oRDR_FUSION_DET_073_076_oPCAN_RADAR_6c2268ef_Rx, ComPduIdRef=RDR_FUSION_DET_073_076_oPCAN_RADAR_e31d289d_Rx
      SG_Fusion_Detections_117_120_oRDR_FUSION_DET_117_120_oPCAN_RADAR_56a2c27e_Rx (ComSignalGroup):
        ComTimeout = 0
        ComTransferProperty = PENDING
        ComSignalGroupAccess = ACCESS_NEEDED_BY_SWC_OR_COM
        ComHandleId = 37
        ComSignalGroupArrayAccess = true
        ComSystemTemplateSignalGroupRef = SG_Fusion_Detections_117_120
        83 x ComGroupSignal, all with ComSignalEndianness=LITTLE_ENDIAN, ComSignalInitValue=0, ComSignalAccess=ACCESS_NEEDED_BY_SWC_OR_COM:
          DET_ELEVATION_119_Rx_oRDR_FUSION_DET_117_120_oPCAN_RADAR_9f59084f_Rx: ComBitPosition=296, ComBitSize=8, ComSignalType=UINT8, ComHandleId=2507, ComSystemTemplateSystemSignalRef=DET_ELEVATION_119_Rx
          DET_BI_STATIC_FLAG_118_Rx_oRDR_FUSION_DET_117_120_oPCAN_RADAR_d3061c22_Rx: ComBitPosition=216, ComBitSize=1, ComSignalType=BOOLEAN, ComHandleId=2494, ComSystemTemplateSystemSignalRef=DET_BI_STATIC_FLAG_118_Rx
          DET_PROB_1STAZHYPO_120_Rx_oRDR_FUSION_DET_117_120_oPCAN_RADAR_1363cae9_Rx: ComBitPosition=439, ComBitSize=1, ComSignalType=BOOLEAN, ComHandleId=2535, ComSystemTemplateSystemSignalRef=DET_PROB_1STAZHYPO_120_Rx
          DET_RANGE_ERR_119_Rx_oRDR_FUSION_DET_117_120_oPCAN_RADAR_2e520a04_Rx: ComBitPosition=264, ComBitSize=7, ComSignalType=UINT8, ComHandleId=2542, ComSystemTemplateSystemSignalRef=DET_RANGE_ERR_119_Rx
          DET_RANGE_VELOCITY_120_Rx_oRDR_FUSION_DET_117_120_oPCAN_RADAR_952ba100_Rx: ComBitPosition=384, ComBitSize=15, ComSignalType=UINT16, ComHandleId=2547, ComSystemTemplateSystemSignalRef=DET_RANGE_VELOCITY_120_Rx
          DET_BI_STATIC_FLAG_119_Rx_oRDR_FUSION_DET_117_120_oPCAN_RADAR_7c428e65_Rx: ComBitPosition=328, ComBitSize=1, ComSignalType=BOOLEAN, ComHandleId=2495, ComSystemTemplateSystemSignalRef=DET_BI_STATIC_FLAG_119_Rx
          DET_RANGE_119_Rx_oRDR_FUSION_DET_117_120_oPCAN_RADAR_7ea086e4_Rx: ComBitPosition=248, ComBitSize=15, ComSignalType=UINT16, ComHandleId=2538, ComSystemTemplateSystemSignalRef=DET_RANGE_119_Rx
          DET_BI_STATIC_FLAG_120_Rx_oRDR_FUSION_DET_117_120_oPCAN_RADAR_4a3c2a7f_Rx: ComBitPosition=440, ComBitSize=1, ComSignalType=BOOLEAN, ComHandleId=2496, ComSystemTemplateSystemSignalRef=DET_BI_STATIC_FLAG_120_Rx
          DET_RCS_118_Rx_oRDR_FUSION_DET_117_120_oPCAN_RADAR_c1da0546_Rx: ComBitPosition=240, ComBitSize=8, ComSignalType=UINT8, ComHandleId=2553, ComSystemTemplateSystemSignalRef=DET_RCS_118_Rx
          DET_HVC_FLAG_120_Rx_oRDR_FUSION_DET_117_120_oPCAN_RADAR_51581b50_Rx: ComBitPosition=422, ComBitSize=1, ComSignalType=BOOLEAN, ComHandleId=2520, ComSystemTemplateSystemSignalRef=DET_HVC_FLAG_120_Rx
          DET_SNR_118_Rx_oRDR_FUSION_DET_117_120_oPCAN_RADAR_c88074af_Rx: ComBitPosition=232, ComBitSize=8, ComSignalType=UINT8, ComHandleId=2557, ComSystemTemplateSystemSignalRef=DET_SNR_118_Rx
          DET_SUPER_RES_TARGET_120_Rx_oRDR_FUSION_DET_117_120_oPCAN_RADAR_9a4163f2_Rx: ComBitPosition=423, ComBitSize=1, ComSignalType=BOOLEAN, ComHandleId=2563, ComSystemTemplateSystemSignalRef=DET_SUPER_RES_TARGET_120_Rx
          DET_CONFD_AZIMUTH_119_Rx_oRDR_FUSION_DET_117_120_oPCAN_RADAR_9f2b6431_Rx: ComBitPosition=342, ComBitSize=2, ComSignalType=UINT8, ComHandleId=2499, ComSystemTemplateSystemSignalRef=DET_CONFD_AZIMUTH_119_Rx
          DET_RANGE_120_Rx_oRDR_FUSION_DET_117_120_oPCAN_RADAR_48de22fe_Rx: ComBitPosition=360, ComBitSize=15, ComSignalType=UINT16, ComHandleId=2539, ComSystemTemplateSystemSignalRef=DET_RANGE_120_Rx
          DET_RCS_117_Rx_oRDR_FUSION_DET_117_120_oPCAN_RADAR_419477ee_Rx: ComBitPosition=128, ComBitSize=8, ComSignalType=UINT8, ComHandleId=2552, ComSystemTemplateSystemSignalRef=DET_RCS_117_Rx
          DET_RANGE_117_Rx_oRDR_FUSION_DET_117_120_oPCAN_RADAR_51aa660b_Rx: ComBitPosition=24, ComBitSize=15, ComSignalType=UINT16, ComHandleId=2536, ComSystemTemplateSystemSignalRef=DET_RANGE_117_Rx
          DET_RANGE_ERR_118_Rx_oRDR_FUSION_DET_117_120_oPCAN_RADAR_81169843_Rx: ComBitPosition=152, ComBitSize=7, ComSignalType=UINT8, ComHandleId=2541, ComSystemTemplateSystemSignalRef=DET_RANGE_ERR_118_Rx
          DET_RANGE_VELOCITY_ERR_117_Rx_oRDR_FUSION_DET_117_120_oPCAN_RADAR_153b9537_Rx: ComBitPosition=64, ComBitSize=8, ComSignalType=UINT8, ComHandleId=2548, ComSystemTemplateSystemSignalRef=DET_RANGE_VELOCITY_ERR_117_Rx
          DET_IDM_119_Rx_oRDR_FUSION_DET_117_120_oPCAN_RADAR_52e74602_Rx: ComBitPosition=287, ComBitSize=1, ComSignalType=BOOLEAN, ComHandleId=2523, ComSystemTemplateSystemSignalRef=DET_IDM_119_Rx
          DET_HVC_FLAG_118_Rx_oRDR_FUSION_DET_117_120_oPCAN_RADAR_c8622d0d_Rx: ComBitPosition=198, ComBitSize=1, ComSignalType=BOOLEAN, ComHandleId=2518, ComSystemTemplateSystemSignalRef=DET_HVC_FLAG_118_Rx
          DET_MTD_119_Rx_oRDR_FUSION_DET_117_120_oPCAN_RADAR_ef647072_Rx: ComBitPosition=271, ComBitSize=1, ComSignalType=BOOLEAN, ComHandleId=2530, ComSystemTemplateSystemSignalRef=DET_MTD_119_Rx
          DET_RANGE_VELOCITY_119_Rx_oRDR_FUSION_DET_117_120_oPCAN_RADAR_a355051a_Rx: ComBitPosition=272, ComBitSize=15, ComSignalType=UINT16, ComHandleId=2546, ComSystemTemplateSystemSignalRef=DET_RANGE_VELOCITY_119_Rx
          DET_AZIMUTH_119_Rx_oRDR_FUSION_DET_117_120_oPCAN_RADAR_6d66dac3_Rx: ComBitPosition=312, ComBitSize=13, ComSignalType=UINT16, ComHandleId=2483, ComSystemTemplateSystemSignalRef=DET_AZIMUTH_119_Rx
          DET_AZIMUTH_ERR_120_Rx_oRDR_FUSION_DET_117_120_oPCAN_RADAR_5971df5b_Rx: ComBitPosition=441, ComBitSize=7, ComSignalType=UINT8, ComHandleId=2488, ComSystemTemplateSystemSignalRef=DET_AZIMUTH_ERR_120_Rx
          DET_BELOW_RAIN_THOLD_120_Rx_oRDR_FUSION_DET_117_120_oPCAN_RADAR_3da2816c_Rx: ComBitPosition=375, ComBitSize=1, ComSignalType=BOOLEAN, ComHandleId=2492, ComSystemTemplateSystemSignalRef=DET_BELOW_RAIN_THOLD_120_Rx
          DET_EXISTENCE_PROB_118_Rx_oRDR_FUSION_DET_117_120_oPCAN_RADAR_15bcc042_Rx: ComBitPosition=224, ComBitSize=6, ComSignalType=UINT8, ComHandleId=2514, ComSystemTemplateSystemSignalRef=DET_EXISTENCE_PROB_118_Rx
          DET_CONFD_ELEVATION_120_Rx_oRDR_FUSION_DET_117_120_oPCAN_RADAR_a37443ac_Rx: ComBitPosition=437, ComBitSize=2, ComSignalType=UINT8, ComHandleId=2504, ComSystemTemplateSystemSignalRef=DET_CONFD_ELEVATION_120_Rx
          DET_AZIMUTH_ERR_119_Rx_oRDR_FUSION_DET_117_120_oPCAN_RADAR_6f0f7b41_Rx: ComBitPosition=329, ComBitSize=7, ComSignalType=UINT8, ComHandleId=2487, ComSystemTemplateSystemSignalRef=DET_AZIMUTH_ERR_119_Rx
          DET_MTD_117_Rx_oRDR_FUSION_DET_117_120_oPCAN_RADAR_c06e909d_Rx: ComBitPosition=47, ComBitSize=1, ComSignalType=BOOLEAN, ComHandleId=2528, ComSystemTemplateSystemSignalRef=DET_MTD_117_Rx
          DET_MTD_120_Rx_oRDR_FUSION_DET_117_120_oPCAN_RADAR_d91ad468_Rx: ComBitPosition=383, ComBitSize=1, ComSignalType=BOOLEAN, ComHandleId=2531, ComSystemTemplateSystemSignalRef=DET_MTD_120_Rx
          DET_HVC_FLAG_117_Rx_oRDR_FUSION_DET_117_120_oPCAN_RADAR_482c5fa5_Rx: ComBitPosition=86, ComBitSize=1, ComSignalType=BOOLEAN, ComHandleId=2517, ComSystemTemplateSystemSignalRef=DET_HVC_FLAG_117_Rx
          DET_CONFD_AZIMUTH_117_Rx_oRDR_FUSION_DET_117_120_oPCAN_RADAR_b02184de_Rx: ComBitPosition=118, ComBitSize=2, ComSignalType=UINT8, ComHandleId=2497, ComSystemTemplateSystemSignalRef=DET_CONFD_AZIMUTH_117_Rx
          DET_MTD_118_Rx_oRDR_FUSION_DET_117_120_oPCAN_RADAR_4020e235_Rx: ComBitPosition=159, ComBitSize=1, ComSignalType=BOOLEAN, ComHandleId=2529, ComSystemTemplateSystemSignalRef=DET_MTD_118_Rx
          DET_SNR_119_Rx_oRDR_FUSION_DET_117_120_oPCAN_RADAR_67c4e6e8_Rx: ComBitPosition=344, ComBitSize=8, ComSignalType=UINT8, ComHandleId=2558, ComSystemTemplateSystemSignalRef=DET_SNR_119_Rx
          DET_AZIMUTH_118_Rx_oRDR_FUSION_DET_117_120_oPCAN_RADAR_c2224884_Rx: ComBitPosition=200, ComBitSize=13, ComSignalType=UINT16, ComHandleId=2482, ComSystemTemplateSystemSignalRef=DET_AZIMUTH_118_Rx
          DET_RANGE_VELOCITY_118_Rx_oRDR_FUSION_DET_117_120_oPCAN_RADAR_0c11975d_Rx: ComBitPosition=160, ComBitSize=15, ComSignalType=UINT16, ComHandleId=2545, ComSystemTemplateSystemSignalRef=DET_RANGE_VELOCITY_118_Rx
          DET_SUPER_RES_TARGET_118_Rx_oRDR_FUSION_DET_117_120_oPCAN_RADAR_037b55af_Rx: ComBitPosition=199, ComBitSize=1, ComSignalType=BOOLEAN, ComHandleId=2561, ComSystemTemplateSystemSignalRef=DET_SUPER_RES_TARGET_118_Rx
          DET_PROB_1STAZHYPO_118_Rx_oRDR_FUSION_DET_117_120_oPCAN_RADAR_8a59fcb4_Rx: ComBitPosition=215, ComBitSize=1, ComSignalType=BOOLEAN, ComHandleId=2533, ComSystemTemplateSystemSignalRef=DET_PROB_1STAZHYPO_118_Rx
          DET_BELOW_RAIN_THOLD_117_Rx_oRDR_FUSION_DET_117_120_oPCAN_RADAR_24d6c599_Rx: ComBitPosition=39, ComBitSize=1, ComSignalType=BOOLEAN, ComHandleId=2489, ComSystemTemplateSystemSignalRef=DET_BELOW_RAIN_THOLD_117_Rx
          DET_ELEVATION_117_Rx_oRDR_FUSION_DET_117_120_oPCAN_RADAR_b053e8a0_Rx: ComBitPosition=72, ComBitSize=8, ComSignalType=UINT8, ComHandleId=2505, ComSystemTemplateSystemSignalRef=DET_ELEVATION_117_Rx
          DET_AZIMUTH_120_Rx_oRDR_FUSION_DET_117_120_oPCAN_RADAR_5b187ed9_Rx: ComBitPosition=424, ComBitSize=13, ComSignalType=UINT16, ComHandleId=2484, ComSystemTemplateSystemSignalRef=DET_AZIMUTH_120_Rx
          DET_CONFD_AZIMUTH_118_Rx_oRDR_FUSION_DET_117_120_oPCAN_RADAR_306ff676_Rx: ComBitPosition=230, ComBitSize=2, ComSignalType=UINT8, ComHandleId=2498, ComSystemTemplateSystemSignalRef=DET_CONFD_AZIMUTH_118_Rx
          DET_MH_SCAN_INDEX_4LSB_117_120_Rx_oRDR_FUSION_DET_117_120_oPCAN_RADAR_4b7a13bc_Rx: ComBitPosition=476, ComBitSize=4, ComSignalType=UINT8, ComHandleId=2527, ComSystemTemplateSystemSignalRef=DET_MH_SCAN_INDEX_4LSB_117_120_Rx
          DET_ELEVATION_ERR_119_Rx_oRDR_FUSION_DET_117_120_oPCAN_RADAR_4de02a90_Rx: ComBitPosition=304, ComBitSize=6, ComSignalType=UINT8, ComHandleId=2511, ComSystemTemplateSystemSignalRef=DET_ELEVATION_ERR_119_Rx
          DET_SNR_117_Rx_oRDR_FUSION_DET_117_120_oPCAN_RADAR_48ce0607_Rx: ComBitPosition=120, ComBitSize=8, ComSignalType=UINT8, ComHandleId=2556, ComSystemTemplateSystemSignalRef=DET_SNR_117_Rx
          DET_BELOW_RAIN_THOLD_119_Rx_oRDR_FUSION_DET_117_120_oPCAN_RADAR_0bdc2576_Rx: ComBitPosition=263, ComBitSize=1, ComSignalType=BOOLEAN, ComHandleId=2491, ComSystemTemplateSystemSignalRef=DET_BELOW_RAIN_THOLD_119_Rx
          DET_EXISTENCE_PROB_120_Rx_oRDR_FUSION_DET_117_120_oPCAN_RADAR_8c86f61f_Rx: ComBitPosition=448, ComBitSize=6, ComSignalType=UINT8, ComHandleId=2516, ComSystemTemplateSystemSignalRef=DET_EXISTENCE_PROB_120_Rx
          DET_PROB_1STAZHYPO_117_Rx_oRDR_FUSION_DET_117_120_oPCAN_RADAR_0a178e1c_Rx: ComBitPosition=103, ComBitSize=1, ComSignalType=BOOLEAN, ComHandleId=2532, ComSystemTemplateSystemSignalRef=DET_PROB_1STAZHYPO_117_Rx
          DET_RANGE_ERR_117_Rx_oRDR_FUSION_DET_117_120_oPCAN_RADAR_0158eaeb_Rx: ComBitPosition=40, ComBitSize=7, ComSignalType=UINT8, ComHandleId=2540, ComSystemTemplateSystemSignalRef=DET_RANGE_ERR_117_Rx
          DET_RCS_119_Rx_oRDR_FUSION_DET_117_120_oPCAN_RADAR_6e9e9701_Rx: ComBitPosition=352, ComBitSize=8, ComSignalType=UINT8, ComHandleId=2554, ComSystemTemplateSystemSignalRef=DET_RCS_119_Rx
          DET_RANGE_VELOCITY_ERR_118_Rx_oRDR_FUSION_DET_117_120_oPCAN_RADAR_9575e79f_Rx: ComBitPosition=176, ComBitSize=8, ComSignalType=UINT8, ComHandleId=2549, ComSystemTemplateSystemSignalRef=DET_RANGE_VELOCITY_ERR_118_Rx
          DET_ELEVATION_ERR_117_Rx_oRDR_FUSION_DET_117_120_oPCAN_RADAR_62eaca7f_Rx: ComBitPosition=80, ComBitSize=6, ComSignalType=UINT8, ComHandleId=2509, ComSystemTemplateSystemSignalRef=DET_ELEVATION_ERR_117_Rx
          DET_ELEVATION_118_Rx_oRDR_FUSION_DET_117_120_oPCAN_RADAR_301d9a08_Rx: ComBitPosition=184, ComBitSize=8, ComSignalType=UINT8, ComHandleId=2506, ComSystemTemplateSystemSignalRef=DET_ELEVATION_118_Rx
          DET_IDM_118_Rx_oRDR_FUSION_DET_117_120_oPCAN_RADAR_fda3d445_Rx: ComBitPosition=175, ComBitSize=1, ComSignalType=BOOLEAN, ComHandleId=2522, ComSystemTemplateSystemSignalRef=DET_IDM_118_Rx
          DET_RANGE_118_Rx_oRDR_FUSION_DET_117_120_oPCAN_RADAR_d1e414a3_Rx: ComBitPosition=136, ComBitSize=15, ComSignalType=UINT16, ComHandleId=2537, ComSystemTemplateSystemSignalRef=DET_RANGE_118_Rx
          DET_SUPER_RES_TARGET_117_Rx_oRDR_FUSION_DET_117_120_oPCAN_RADAR_83352707_Rx: ComBitPosition=87, ComBitSize=1, ComSignalType=BOOLEAN, ComHandleId=2560, ComSystemTemplateSystemSignalRef=DET_SUPER_RES_TARGET_117_Rx
          DET_EXISTENCE_PROB_119_Rx_oRDR_FUSION_DET_117_120_oPCAN_RADAR_baf85205_Rx: ComBitPosition=336, ComBitSize=6, ComSignalType=UINT8, ComHandleId=2515, ComSystemTemplateSystemSignalRef=DET_EXISTENCE_PROB_119_Rx
          DET_BI_STATIC_FLAG_117_Rx_oRDR_FUSION_DET_117_120_oPCAN_RADAR_53486e8a_Rx: ComBitPosition=104, ComBitSize=1, ComSignalType=BOOLEAN, ComHandleId=2493, ComSystemTemplateSystemSignalRef=DET_BI_STATIC_FLAG_117_Rx
          DET_BELOW_RAIN_THOLD_118_Rx_oRDR_FUSION_DET_117_120_oPCAN_RADAR_a498b731_Rx: ComBitPosition=151, ComBitSize=1, ComSignalType=BOOLEAN, ComHandleId=2490, ComSystemTemplateSystemSignalRef=DET_BELOW_RAIN_THOLD_118_Rx
          DET_HVC_FLAG_119_Rx_oRDR_FUSION_DET_117_120_oPCAN_RADAR_6726bf4a_Rx: ComBitPosition=310, ComBitSize=1, ComSignalType=BOOLEAN, ComHandleId=2519, ComSystemTemplateSystemSignalRef=DET_HVC_FLAG_119_Rx
          DET_CONFD_ELEVATION_118_Rx_oRDR_FUSION_DET_117_120_oPCAN_RADAR_3a4e75f1_Rx: ComBitPosition=213, ComBitSize=2, ComSignalType=UINT8, ComHandleId=2502, ComSystemTemplateSystemSignalRef=DET_CONFD_ELEVATION_118_Rx
          DET_RCS_120_Rx_oRDR_FUSION_DET_117_120_oPCAN_RADAR_58e0331b_Rx: ComBitPosition=464, ComBitSize=8, ComSignalType=UINT8, ComHandleId=2555, ComSystemTemplateSystemSignalRef=DET_RCS_120_Rx
          DET_AZIMUTH_117_Rx_oRDR_FUSION_DET_117_120_oPCAN_RADAR_426c3a2c_Rx: ComBitPosition=88, ComBitSize=13, ComSignalType=UINT16, ComHandleId=2481, ComSystemTemplateSystemSignalRef=DET_AZIMUTH_117_Rx
          DET_ELEVATION_ERR_118_Rx_oRDR_FUSION_DET_117_120_oPCAN_RADAR_e2a4b8d7_Rx: ComBitPosition=192, ComBitSize=6, ComSignalType=UINT8, ComHandleId=2510, ComSystemTemplateSystemSignalRef=DET_ELEVATION_ERR_118_Rx
          DET_CONFD_ELEVATION_117_Rx_oRDR_FUSION_DET_117_120_oPCAN_RADAR_ba000759_Rx: ComBitPosition=101, ComBitSize=2, ComSignalType=UINT8, ComHandleId=2501, ComSystemTemplateSystemSignalRef=DET_CONFD_ELEVATION_117_Rx
          DET_ELEVATION_ERR_120_Rx_oRDR_FUSION_DET_117_120_oPCAN_RADAR_7b9e8e8a_Rx: ComBitPosition=416, ComBitSize=6, ComSignalType=UINT8, ComHandleId=2512, ComSystemTemplateSystemSignalRef=DET_ELEVATION_ERR_120_Rx
          DET_AZIMUTH_ERR_117_Rx_oRDR_FUSION_DET_117_120_oPCAN_RADAR_40059bae_Rx: ComBitPosition=105, ComBitSize=7, ComSignalType=UINT8, ComHandleId=2485, ComSystemTemplateSystemSignalRef=DET_AZIMUTH_ERR_117_Rx
          DET_IDM_120_Rx_oRDR_FUSION_DET_117_120_oPCAN_RADAR_6499e218_Rx: ComBitPosition=399, ComBitSize=1, ComSignalType=BOOLEAN, ComHandleId=2524, ComSystemTemplateSystemSignalRef=DET_IDM_120_Rx
          DET_PROB_1STAZHYPO_119_Rx_oRDR_FUSION_DET_117_120_oPCAN_RADAR_251d6ef3_Rx: ComBitPosition=327, ComBitSize=1, ComSignalType=BOOLEAN, ComHandleId=2534, ComSystemTemplateSystemSignalRef=DET_PROB_1STAZHYPO_119_Rx
          DET_MH_CYCLE_COUNTER_117_120_Rx_oRDR_FUSION_DET_117_120_oPCAN_RADAR_2fcadc87_Rx: ComBitPosition=16, ComBitSize=8, ComSignalType=UINT8, ComHandleId=2526, ComSystemTemplateSystemSignalRef=DET_MH_CYCLE_COUNTER_117_120_Rx
          DET_CONFD_ELEVATION_119_Rx_oRDR_FUSION_DET_117_120_oPCAN_RADAR_950ae7b6_Rx: ComBitPosition=325, ComBitSize=2, ComSignalType=UINT8, ComHandleId=2503, ComSystemTemplateSystemSignalRef=DET_CONFD_ELEVATION_119_Rx
          DET_SNR_120_Rx_oRDR_FUSION_DET_117_120_oPCAN_RADAR_51ba42f2_Rx: ComBitPosition=456, ComBitSize=8, ComSignalType=UINT8, ComHandleId=2559, ComSystemTemplateSystemSignalRef=DET_SNR_120_Rx
          DET_RANGE_ERR_120_Rx_oRDR_FUSION_DET_117_120_oPCAN_RADAR_182cae1e_Rx: ComBitPosition=376, ComBitSize=7, ComSignalType=UINT8, ComHandleId=2543, ComSystemTemplateSystemSignalRef=DET_RANGE_ERR_120_Rx
          DET_SUPER_RES_TARGET_119_Rx_oRDR_FUSION_DET_117_120_oPCAN_RADAR_ac3fc7e8_Rx: ComBitPosition=311, ComBitSize=1, ComSignalType=BOOLEAN, ComHandleId=2562, ComSystemTemplateSystemSignalRef=DET_SUPER_RES_TARGET_119_Rx
          DET_AZIMUTH_ERR_118_Rx_oRDR_FUSION_DET_117_120_oPCAN_RADAR_c04be906_Rx: ComBitPosition=217, ComBitSize=7, ComSignalType=UINT8, ComHandleId=2486, ComSystemTemplateSystemSignalRef=DET_AZIMUTH_ERR_118_Rx
          DET_IDM_117_Rx_oRDR_FUSION_DET_117_120_oPCAN_RADAR_7deda6ed_Rx: ComBitPosition=63, ComBitSize=1, ComSignalType=BOOLEAN, ComHandleId=2521, ComSystemTemplateSystemSignalRef=DET_IDM_117_Rx
          DET_RANGE_VELOCITY_117_Rx_oRDR_FUSION_DET_117_120_oPCAN_RADAR_8c5fe5f5_Rx: ComBitPosition=48, ComBitSize=15, ComSignalType=UINT16, ComHandleId=2544, ComSystemTemplateSystemSignalRef=DET_RANGE_VELOCITY_117_Rx
          DET_ELEVATION_120_Rx_oRDR_FUSION_DET_117_120_oPCAN_RADAR_a927ac55_Rx: ComBitPosition=408, ComBitSize=8, ComSignalType=UINT8, ComHandleId=2508, ComSystemTemplateSystemSignalRef=DET_ELEVATION_120_Rx
          DET_RANGE_VELOCITY_ERR_119_Rx_oRDR_FUSION_DET_117_120_oPCAN_RADAR_3a3175d8_Rx: ComBitPosition=288, ComBitSize=8, ComSignalType=UINT8, ComHandleId=2550, ComSystemTemplateSystemSignalRef=DET_RANGE_VELOCITY_ERR_119_Rx
          DET_RANGE_VELOCITY_ERR_120_Rx_oRDR_FUSION_DET_117_120_oPCAN_RADAR_0c4fd1c2_Rx: ComBitPosition=400, ComBitSize=8, ComSignalType=UINT8, ComHandleId=2551, ComSystemTemplateSystemSignalRef=DET_RANGE_VELOCITY_ERR_120_Rx
          DET_EXISTENCE_PROB_117_Rx_oRDR_FUSION_DET_117_120_oPCAN_RADAR_95f2b2ea_Rx: ComBitPosition=112, ComBitSize=6, ComSignalType=UINT8, ComHandleId=2513, ComSystemTemplateSystemSignalRef=DET_EXISTENCE_PROB_117_Rx
          DET_MH_CRC16_117_120_Rx_oRDR_FUSION_DET_117_120_oPCAN_RADAR_2211e142_Rx: ComBitPosition=0, ComBitSize=16, ComSignalType=UINT16, ComHandleId=2525, ComSystemTemplateSystemSignalRef=DET_MH_CRC16_117_120_Rx
          DET_CONFD_AZIMUTH_120_Rx_oRDR_FUSION_DET_117_120_oPCAN_RADAR_a955c02b_Rx: ComBitPosition=454, ComBitSize=2, ComSignalType=UINT8, ComHandleId=2500, ComSystemTemplateSystemSignalRef=DET_CONFD_AZIMUTH_120_Rx
      SG_Fusion_Detections_037_040_oRDR_FUSION_DET_037_040_oPCAN_RADAR_cee54bfa_Rx (ComSignalGroup):
        ComTimeout = 0
        ComTransferProperty = PENDING
        ComSignalGroupAccess = ACCESS_NEEDED_BY_SWC_OR_COM
        ComHandleId = 17
        ComSignalGroupArrayAccess = true
        ComSystemTemplateSignalGroupRef = SG_Fusion_Detections_037_040
        83 x ComGroupSignal, all with ComSignalEndianness=LITTLE_ENDIAN, ComSignalInitValue=0, ComSignalAccess=ACCESS_NEEDED_BY_SWC_OR_COM:
          DET_IDM_039_Rx_oRDR_FUSION_DET_037_040_oPCAN_RADAR_6b8f9e6a_Rx: ComBitPosition=287, ComBitSize=1, ComSignalType=BOOLEAN, ComHandleId=863, ComSystemTemplateSystemSignalRef=DET_IDM_039_Rx
          DET_MTD_040_Rx_oRDR_FUSION_DET_037_040_oPCAN_RADAR_f6ce4206_Rx: ComBitPosition=383, ComBitSize=1, ComSignalType=BOOLEAN, ComHandleId=871, ComSystemTemplateSystemSignalRef=DET_MTD_040_Rx
          DET_RANGE_VELOCITY_ERR_040_Rx_oRDR_FUSION_DET_037_040_oPCAN_RADAR_239b47ac_Rx: ComBitPosition=400, ComBitSize=8, ComSignalType=UINT8, ComHandleId=891, ComSystemTemplateSystemSignalRef=DET_RANGE_VELOCITY_ERR_040_Rx
          DET_MH_CYCLE_COUNTER_037_040_Rx_oRDR_FUSION_DET_037_040_oPCAN_RADAR_e38a87a3_Rx: ComBitPosition=16, ComBitSize=8, ComSignalType=UINT8, ComHandleId=866, ComSystemTemplateSystemSignalRef=DET_MH_CYCLE_COUNTER_037_040_Rx
          DET_RANGE_ERR_040_Rx_oRDR_FUSION_DET_037_040_oPCAN_RADAR_37f83870_Rx: ComBitPosition=376, ComBitSize=7, ComSignalType=UINT8, ComHandleId=883, ComSystemTemplateSystemSignalRef=DET_RANGE_ERR_040_Rx
          DET_AZIMUTH_ERR_037_Rx_oRDR_FUSION_DET_037_040_oPCAN_RADAR_796d43c6_Rx: ComBitPosition=105, ComBitSize=7, ComSignalType=UINT8, ComHandleId=825, ComSystemTemplateSystemSignalRef=DET_AZIMUTH_ERR_037_Rx
          DET_EXISTENCE_PROB_040_Rx_oRDR_FUSION_DET_037_040_oPCAN_RADAR_a3526071_Rx: ComBitPosition=448, ComBitSize=6, ComSignalType=UINT8, ComHandleId=856, ComSystemTemplateSystemSignalRef=DET_EXISTENCE_PROB_040_Rx
          DET_RANGE_038_Rx_oRDR_FUSION_DET_037_040_oPCAN_RADAR_e88ccccb_Rx: ComBitPosition=136, ComBitSize=15, ComSignalType=UINT16, ComHandleId=877, ComSystemTemplateSystemSignalRef=DET_RANGE_038_Rx
          DET_MH_CRC16_037_040_Rx_oRDR_FUSION_DET_037_040_oPCAN_RADAR_ee51ba66_Rx: ComBitPosition=0, ComBitSize=16, ComSignalType=UINT16, ComHandleId=865, ComSystemTemplateSystemSignalRef=DET_MH_CRC16_037_040_Rx
          DET_RCS_040_Rx_oRDR_FUSION_DET_037_040_oPCAN_RADAR_7734a575_Rx: ComBitPosition=464, ComBitSize=8, ComSignalType=UINT8, ComHandleId=895, ComSystemTemplateSystemSignalRef=DET_RCS_040_Rx
          DET_BI_STATIC_FLAG_039_Rx_oRDR_FUSION_DET_037_040_oPCAN_RADAR_452a560d_Rx: ComBitPosition=328, ComBitSize=1, ComSignalType=BOOLEAN, ComHandleId=835, ComSystemTemplateSystemSignalRef=DET_BI_STATIC_FLAG_039_Rx
          DET_SNR_040_Rx_oRDR_FUSION_DET_037_040_oPCAN_RADAR_7e6ed49c_Rx: ComBitPosition=456, ComBitSize=8, ComSignalType=UINT8, ComHandleId=899, ComSystemTemplateSystemSignalRef=DET_SNR_040_Rx
          DET_PROB_1STAZHYPO_037_Rx_oRDR_FUSION_DET_037_040_oPCAN_RADAR_337f5674_Rx: ComBitPosition=103, ComBitSize=1, ComSignalType=BOOLEAN, ComHandleId=872, ComSystemTemplateSystemSignalRef=DET_PROB_1STAZHYPO_037_Rx
          DET_BI_STATIC_FLAG_038_Rx_oRDR_FUSION_DET_037_040_oPCAN_RADAR_ea6ec44a_Rx: ComBitPosition=216, ComBitSize=1, ComSignalType=BOOLEAN, ComHandleId=834, ComSystemTemplateSystemSignalRef=DET_BI_STATIC_FLAG_038_Rx
          DET_BI_STATIC_FLAG_040_Rx_oRDR_FUSION_DET_037_040_oPCAN_RADAR_65e8bc11_Rx: ComBitPosition=440, ComBitSize=1, ComSignalType=BOOLEAN, ComHandleId=836, ComSystemTemplateSystemSignalRef=DET_BI_STATIC_FLAG_040_Rx
          DET_MTD_039_Rx_oRDR_FUSION_DET_037_040_oPCAN_RADAR_d60ca81a_Rx: ComBitPosition=271, ComBitSize=1, ComSignalType=BOOLEAN, ComHandleId=870, ComSystemTemplateSystemSignalRef=DET_MTD_039_Rx
          DET_RCS_037_Rx_oRDR_FUSION_DET_037_040_oPCAN_RADAR_78fcaf86_Rx: ComBitPosition=128, ComBitSize=8, ComSignalType=UINT8, ComHandleId=892, ComSystemTemplateSystemSignalRef=DET_RCS_037_Rx
          DET_RANGE_ERR_038_Rx_oRDR_FUSION_DET_037_040_oPCAN_RADAR_b87e402b_Rx: ComBitPosition=152, ComBitSize=7, ComSignalType=UINT8, ComHandleId=881, ComSystemTemplateSystemSignalRef=DET_RANGE_ERR_038_Rx
          DET_ELEVATION_039_Rx_oRDR_FUSION_DET_037_040_oPCAN_RADAR_a631d027_Rx: ComBitPosition=296, ComBitSize=8, ComSignalType=UINT8, ComHandleId=847, ComSystemTemplateSystemSignalRef=DET_ELEVATION_039_Rx
          DET_SNR_038_Rx_oRDR_FUSION_DET_037_040_oPCAN_RADAR_f1e8acc7_Rx: ComBitPosition=232, ComBitSize=8, ComSignalType=UINT8, ComHandleId=897, ComSystemTemplateSystemSignalRef=DET_SNR_038_Rx
          DET_CONFD_ELEVATION_040_Rx_oRDR_FUSION_DET_037_040_oPCAN_RADAR_8ca0d5c2_Rx: ComBitPosition=437, ComBitSize=2, ComSignalType=UINT8, ComHandleId=844, ComSystemTemplateSystemSignalRef=DET_CONFD_ELEVATION_040_Rx
          DET_EXISTENCE_PROB_039_Rx_oRDR_FUSION_DET_037_040_oPCAN_RADAR_83908a6d_Rx: ComBitPosition=336, ComBitSize=6, ComSignalType=UINT8, ComHandleId=855, ComSystemTemplateSystemSignalRef=DET_EXISTENCE_PROB_039_Rx
          DET_RANGE_VELOCITY_ERR_037_Rx_oRDR_FUSION_DET_037_040_oPCAN_RADAR_2c534d5f_Rx: ComBitPosition=64, ComBitSize=8, ComSignalType=UINT8, ComHandleId=888, ComSystemTemplateSystemSignalRef=DET_RANGE_VELOCITY_ERR_037_Rx
          DET_CONFD_AZIMUTH_038_Rx_oRDR_FUSION_DET_037_040_oPCAN_RADAR_09072e1e_Rx: ComBitPosition=230, ComBitSize=2, ComSignalType=UINT8, ComHandleId=838, ComSystemTemplateSystemSignalRef=DET_CONFD_AZIMUTH_038_Rx
          DET_ELEVATION_ERR_037_Rx_oRDR_FUSION_DET_037_040_oPCAN_RADAR_5b821217_Rx: ComBitPosition=80, ComBitSize=6, ComSignalType=UINT8, ComHandleId=849, ComSystemTemplateSystemSignalRef=DET_ELEVATION_ERR_037_Rx
          DET_PROB_1STAZHYPO_039_Rx_oRDR_FUSION_DET_037_040_oPCAN_RADAR_1c75b69b_Rx: ComBitPosition=327, ComBitSize=1, ComSignalType=BOOLEAN, ComHandleId=874, ComSystemTemplateSystemSignalRef=DET_PROB_1STAZHYPO_039_Rx
          DET_RANGE_VELOCITY_039_Rx_oRDR_FUSION_DET_037_040_oPCAN_RADAR_9a3ddd72_Rx: ComBitPosition=272, ComBitSize=15, ComSignalType=UINT16, ComHandleId=886, ComSystemTemplateSystemSignalRef=DET_RANGE_VELOCITY_039_Rx
          DET_BELOW_RAIN_THOLD_038_Rx_oRDR_FUSION_DET_037_040_oPCAN_RADAR_9df06f59_Rx: ComBitPosition=151, ComBitSize=1, ComSignalType=BOOLEAN, ComHandleId=830, ComSystemTemplateSystemSignalRef=DET_BELOW_RAIN_THOLD_038_Rx
          DET_CONFD_AZIMUTH_040_Rx_oRDR_FUSION_DET_037_040_oPCAN_RADAR_86815645_Rx: ComBitPosition=454, ComBitSize=2, ComSignalType=UINT8, ComHandleId=840, ComSystemTemplateSystemSignalRef=DET_CONFD_AZIMUTH_040_Rx
          DET_ELEVATION_ERR_038_Rx_oRDR_FUSION_DET_037_040_oPCAN_RADAR_dbcc60bf_Rx: ComBitPosition=192, ComBitSize=6, ComSignalType=UINT8, ComHandleId=850, ComSystemTemplateSystemSignalRef=DET_ELEVATION_ERR_038_Rx
          DET_ELEVATION_040_Rx_oRDR_FUSION_DET_037_040_oPCAN_RADAR_86f33a3b_Rx: ComBitPosition=408, ComBitSize=8, ComSignalType=UINT8, ComHandleId=848, ComSystemTemplateSystemSignalRef=DET_ELEVATION_040_Rx
          DET_CONFD_ELEVATION_038_Rx_oRDR_FUSION_DET_037_040_oPCAN_RADAR_0326ad99_Rx: ComBitPosition=213, ComBitSize=2, ComSignalType=UINT8, ComHandleId=842, ComSystemTemplateSystemSignalRef=DET_CONFD_ELEVATION_038_Rx
          DET_SUPER_RES_TARGET_037_Rx_oRDR_FUSION_DET_037_040_oPCAN_RADAR_ba5dff6f_Rx: ComBitPosition=87, ComBitSize=1, ComSignalType=BOOLEAN, ComHandleId=900, ComSystemTemplateSystemSignalRef=DET_SUPER_RES_TARGET_037_Rx
          DET_AZIMUTH_039_Rx_oRDR_FUSION_DET_037_040_oPCAN_RADAR_540e02ab_Rx: ComBitPosition=312, ComBitSize=13, ComSignalType=UINT16, ComHandleId=823, ComSystemTemplateSystemSignalRef=DET_AZIMUTH_039_Rx
          DET_RANGE_VELOCITY_ERR_038_Rx_oRDR_FUSION_DET_037_040_oPCAN_RADAR_ac1d3ff7_Rx: ComBitPosition=176, ComBitSize=8, ComSignalType=UINT8, ComHandleId=889, ComSystemTemplateSystemSignalRef=DET_RANGE_VELOCITY_ERR_038_Rx
          DET_CONFD_AZIMUTH_039_Rx_oRDR_FUSION_DET_037_040_oPCAN_RADAR_a643bc59_Rx: ComBitPosition=342, ComBitSize=2, ComSignalType=UINT8, ComHandleId=839, ComSystemTemplateSystemSignalRef=DET_CONFD_AZIMUTH_039_Rx
          DET_MTD_038_Rx_oRDR_FUSION_DET_037_040_oPCAN_RADAR_79483a5d_Rx: ComBitPosition=159, ComBitSize=1, ComSignalType=BOOLEAN, ComHandleId=869, ComSystemTemplateSystemSignalRef=DET_MTD_038_Rx
          DET_IDM_040_Rx_oRDR_FUSION_DET_037_040_oPCAN_RADAR_4b4d7476_Rx: ComBitPosition=399, ComBitSize=1, ComSignalType=BOOLEAN, ComHandleId=864, ComSystemTemplateSystemSignalRef=DET_IDM_040_Rx
          DET_IDM_038_Rx_oRDR_FUSION_DET_037_040_oPCAN_RADAR_c4cb0c2d_Rx: ComBitPosition=175, ComBitSize=1, ComSignalType=BOOLEAN, ComHandleId=862, ComSystemTemplateSystemSignalRef=DET_IDM_038_Rx
          DET_SUPER_RES_TARGET_039_Rx_oRDR_FUSION_DET_037_040_oPCAN_RADAR_95571f80_Rx: ComBitPosition=311, ComBitSize=1, ComSignalType=BOOLEAN, ComHandleId=902, ComSystemTemplateSystemSignalRef=DET_SUPER_RES_TARGET_039_Rx
          DET_IDM_037_Rx_oRDR_FUSION_DET_037_040_oPCAN_RADAR_44857e85_Rx: ComBitPosition=63, ComBitSize=1, ComSignalType=BOOLEAN, ComHandleId=861, ComSystemTemplateSystemSignalRef=DET_IDM_037_Rx
          DET_PROB_1STAZHYPO_040_Rx_oRDR_FUSION_DET_037_040_oPCAN_RADAR_3cb75c87_Rx: ComBitPosition=439, ComBitSize=1, ComSignalType=BOOLEAN, ComHandleId=875, ComSystemTemplateSystemSignalRef=DET_PROB_1STAZHYPO_040_Rx
          DET_RANGE_040_Rx_oRDR_FUSION_DET_037_040_oPCAN_RADAR_670ab490_Rx: ComBitPosition=360, ComBitSize=15, ComSignalType=UINT16, ComHandleId=879, ComSystemTemplateSystemSignalRef=DET_RANGE_040_Rx
          DET_SNR_039_Rx_oRDR_FUSION_DET_037_040_oPCAN_RADAR_5eac3e80_Rx: ComBitPosition=344, ComBitSize=8, ComSignalType=UINT8, ComHandleId=898, ComSystemTemplateSystemSignalRef=DET_SNR_039_Rx
          DET_ELEVATION_ERR_040_Rx_oRDR_FUSION_DET_037_040_oPCAN_RADAR_544a18e4_Rx: ComBitPosition=416, ComBitSize=6, ComSignalType=UINT8, ComHandleId=852, ComSystemTemplateSystemSignalRef=DET_ELEVATION_ERR_040_Rx
          DET_ELEVATION_ERR_039_Rx_oRDR_FUSION_DET_037_040_oPCAN_RADAR_7488f2f8_Rx: ComBitPosition=304, ComBitSize=6, ComSignalType=UINT8, ComHandleId=851, ComSystemTemplateSystemSignalRef=DET_ELEVATION_ERR_039_Rx
          DET_SUPER_RES_TARGET_040_Rx_oRDR_FUSION_DET_037_040_oPCAN_RADAR_b595f59c_Rx: ComBitPosition=423, ComBitSize=1, ComSignalType=BOOLEAN, ComHandleId=903, ComSystemTemplateSystemSignalRef=DET_SUPER_RES_TARGET_040_Rx
          DET_EXISTENCE_PROB_037_Rx_oRDR_FUSION_DET_037_040_oPCAN_RADAR_ac9a6a82_Rx: ComBitPosition=112, ComBitSize=6, ComSignalType=UINT8, ComHandleId=853, ComSystemTemplateSystemSignalRef=DET_EXISTENCE_PROB_037_Rx
          DET_RANGE_VELOCITY_037_Rx_oRDR_FUSION_DET_037_040_oPCAN_RADAR_b5373d9d_Rx: ComBitPosition=48, ComBitSize=15, ComSignalType=UINT16, ComHandleId=884, ComSystemTemplateSystemSignalRef=DET_RANGE_VELOCITY_037_Rx
          DET_AZIMUTH_ERR_039_Rx_oRDR_FUSION_DET_037_040_oPCAN_RADAR_5667a329_Rx: ComBitPosition=329, ComBitSize=7, ComSignalType=UINT8, ComHandleId=827, ComSystemTemplateSystemSignalRef=DET_AZIMUTH_ERR_039_Rx
          DET_BELOW_RAIN_THOLD_037_Rx_oRDR_FUSION_DET_037_040_oPCAN_RADAR_1dbe1df1_Rx: ComBitPosition=39, ComBitSize=1, ComSignalType=BOOLEAN, ComHandleId=829, ComSystemTemplateSystemSignalRef=DET_BELOW_RAIN_THOLD_037_Rx
          DET_HVC_FLAG_038_Rx_oRDR_FUSION_DET_037_040_oPCAN_RADAR_f10af565_Rx: ComBitPosition=198, ComBitSize=1, ComSignalType=BOOLEAN, ComHandleId=858, ComSystemTemplateSystemSignalRef=DET_HVC_FLAG_038_Rx
          DET_RANGE_ERR_037_Rx_oRDR_FUSION_DET_037_040_oPCAN_RADAR_38303283_Rx: ComBitPosition=40, ComBitSize=7, ComSignalType=UINT8, ComHandleId=880, ComSystemTemplateSystemSignalRef=DET_RANGE_ERR_037_Rx
          DET_ELEVATION_037_Rx_oRDR_FUSION_DET_037_040_oPCAN_RADAR_893b30c8_Rx: ComBitPosition=72, ComBitSize=8, ComSignalType=UINT8, ComHandleId=845, ComSystemTemplateSystemSignalRef=DET_ELEVATION_037_Rx
          DET_HVC_FLAG_040_Rx_oRDR_FUSION_DET_037_040_oPCAN_RADAR_7e8c8d3e_Rx: ComBitPosition=422, ComBitSize=1, ComSignalType=BOOLEAN, ComHandleId=860, ComSystemTemplateSystemSignalRef=DET_HVC_FLAG_040_Rx
          DET_AZIMUTH_040_Rx_oRDR_FUSION_DET_037_040_oPCAN_RADAR_74cce8b7_Rx: ComBitPosition=424, ComBitSize=13, ComSignalType=UINT16, ComHandleId=824, ComSystemTemplateSystemSignalRef=DET_AZIMUTH_040_Rx
          DET_AZIMUTH_ERR_040_Rx_oRDR_FUSION_DET_037_040_oPCAN_RADAR_76a54935_Rx: ComBitPosition=441, ComBitSize=7, ComSignalType=UINT8, ComHandleId=828, ComSystemTemplateSystemSignalRef=DET_AZIMUTH_ERR_040_Rx
          DET_ELEVATION_038_Rx_oRDR_FUSION_DET_037_040_oPCAN_RADAR_09754260_Rx: ComBitPosition=184, ComBitSize=8, ComSignalType=UINT8, ComHandleId=846, ComSystemTemplateSystemSignalRef=DET_ELEVATION_038_Rx
          DET_HVC_FLAG_037_Rx_oRDR_FUSION_DET_037_040_oPCAN_RADAR_714487cd_Rx: ComBitPosition=86, ComBitSize=1, ComSignalType=BOOLEAN, ComHandleId=857, ComSystemTemplateSystemSignalRef=DET_HVC_FLAG_037_Rx
          DET_CONFD_ELEVATION_039_Rx_oRDR_FUSION_DET_037_040_oPCAN_RADAR_ac623fde_Rx: ComBitPosition=325, ComBitSize=2, ComSignalType=UINT8, ComHandleId=843, ComSystemTemplateSystemSignalRef=DET_CONFD_ELEVATION_039_Rx
          DET_RANGE_039_Rx_oRDR_FUSION_DET_037_040_oPCAN_RADAR_47c85e8c_Rx: ComBitPosition=248, ComBitSize=15, ComSignalType=UINT16, ComHandleId=878, ComSystemTemplateSystemSignalRef=DET_RANGE_039_Rx
          DET_CONFD_AZIMUTH_037_Rx_oRDR_FUSION_DET_037_040_oPCAN_RADAR_89495cb6_Rx: ComBitPosition=118, ComBitSize=2, ComSignalType=UINT8, ComHandleId=837, ComSystemTemplateSystemSignalRef=DET_CONFD_AZIMUTH_037_Rx
          DET_RANGE_VELOCITY_ERR_039_Rx_oRDR_FUSION_DET_037_040_oPCAN_RADAR_0359adb0_Rx: ComBitPosition=288, ComBitSize=8, ComSignalType=UINT8, ComHandleId=890, ComSystemTemplateSystemSignalRef=DET_RANGE_VELOCITY_ERR_039_Rx
          DET_EXISTENCE_PROB_038_Rx_oRDR_FUSION_DET_037_040_oPCAN_RADAR_2cd4182a_Rx: ComBitPosition=224, ComBitSize=6, ComSignalType=UINT8, ComHandleId=854, ComSystemTemplateSystemSignalRef=DET_EXISTENCE_PROB_038_Rx
          DET_HVC_FLAG_039_Rx_oRDR_FUSION_DET_037_040_oPCAN_RADAR_5e4e6722_Rx: ComBitPosition=310, ComBitSize=1, ComSignalType=BOOLEAN, ComHandleId=859, ComSystemTemplateSystemSignalRef=DET_HVC_FLAG_039_Rx
          DET_BELOW_RAIN_THOLD_040_Rx_oRDR_FUSION_DET_037_040_oPCAN_RADAR_12761702_Rx: ComBitPosition=375, ComBitSize=1, ComSignalType=BOOLEAN, ComHandleId=832, ComSystemTemplateSystemSignalRef=DET_BELOW_RAIN_THOLD_040_Rx
          DET_RCS_039_Rx_oRDR_FUSION_DET_037_040_oPCAN_RADAR_57f64f69_Rx: ComBitPosition=352, ComBitSize=8, ComSignalType=UINT8, ComHandleId=894, ComSystemTemplateSystemSignalRef=DET_RCS_039_Rx
          DET_SNR_037_Rx_oRDR_FUSION_DET_037_040_oPCAN_RADAR_71a6de6f_Rx: ComBitPosition=120, ComBitSize=8, ComSignalType=UINT8, ComHandleId=896, ComSystemTemplateSystemSignalRef=DET_SNR_037_Rx
          DET_AZIMUTH_038_Rx_oRDR_FUSION_DET_037_040_oPCAN_RADAR_fb4a90ec_Rx: ComBitPosition=200, ComBitSize=13, ComSignalType=UINT16, ComHandleId=822, ComSystemTemplateSystemSignalRef=DET_AZIMUTH_038_Rx
          DET_PROB_1STAZHYPO_038_Rx_oRDR_FUSION_DET_037_040_oPCAN_RADAR_b33124dc_Rx: ComBitPosition=215, ComBitSize=1, ComSignalType=BOOLEAN, ComHandleId=873, ComSystemTemplateSystemSignalRef=DET_PROB_1STAZHYPO_038_Rx
          DET_AZIMUTH_ERR_038_Rx_oRDR_FUSION_DET_037_040_oPCAN_RADAR_f923316e_Rx: ComBitPosition=217, ComBitSize=7, ComSignalType=UINT8, ComHandleId=826, ComSystemTemplateSystemSignalRef=DET_AZIMUTH_ERR_038_Rx
          DET_SUPER_RES_TARGET_038_Rx_oRDR_FUSION_DET_037_040_oPCAN_RADAR_3a138dc7_Rx: ComBitPosition=199, ComBitSize=1, ComSignalType=BOOLEAN, ComHandleId=901, ComSystemTemplateSystemSignalRef=DET_SUPER_RES_TARGET_038_Rx
          DET_BI_STATIC_FLAG_037_Rx_oRDR_FUSION_DET_037_040_oPCAN_RADAR_6a20b6e2_Rx: ComBitPosition=104, ComBitSize=1, ComSignalType=BOOLEAN, ComHandleId=833, ComSystemTemplateSystemSignalRef=DET_BI_STATIC_FLAG_037_Rx
          DET_RCS_038_Rx_oRDR_FUSION_DET_037_040_oPCAN_RADAR_f8b2dd2e_Rx: ComBitPosition=240, ComBitSize=8, ComSignalType=UINT8, ComHandleId=893, ComSystemTemplateSystemSignalRef=DET_RCS_038_Rx
          DET_AZIMUTH_037_Rx_oRDR_FUSION_DET_037_040_oPCAN_RADAR_7b04e244_Rx: ComBitPosition=88, ComBitSize=13, ComSignalType=UINT16, ComHandleId=821, ComSystemTemplateSystemSignalRef=DET_AZIMUTH_037_Rx
          DET_MH_SCAN_INDEX_4LSB_037_040_Rx_oRDR_FUSION_DET_037_040_oPCAN_RADAR_873a4898_Rx: ComBitPosition=476, ComBitSize=4, ComSignalType=UINT8, ComHandleId=867, ComSystemTemplateSystemSignalRef=DET_MH_SCAN_INDEX_4LSB_037_040_Rx
          DET_RANGE_VELOCITY_038_Rx_oRDR_FUSION_DET_037_040_oPCAN_RADAR_35794f35_Rx: ComBitPosition=160, ComBitSize=15, ComSignalType=UINT16, ComHandleId=885, ComSystemTemplateSystemSignalRef=DET_RANGE_VELOCITY_038_Rx
          DET_RANGE_037_Rx_oRDR_FUSION_DET_037_040_oPCAN_RADAR_68c2be63_Rx: ComBitPosition=24, ComBitSize=15, ComSignalType=UINT16, ComHandleId=876, ComSystemTemplateSystemSignalRef=DET_RANGE_037_Rx
          DET_BELOW_RAIN_THOLD_039_Rx_oRDR_FUSION_DET_037_040_oPCAN_RADAR_32b4fd1e_Rx: ComBitPosition=263, ComBitSize=1, ComSignalType=BOOLEAN, ComHandleId=831, ComSystemTemplateSystemSignalRef=DET_BELOW_RAIN_THOLD_039_Rx
          DET_CONFD_ELEVATION_037_Rx_oRDR_FUSION_DET_037_040_oPCAN_RADAR_8368df31_Rx: ComBitPosition=101, ComBitSize=2, ComSignalType=UINT8, ComHandleId=841, ComSystemTemplateSystemSignalRef=DET_CONFD_ELEVATION_037_Rx
          DET_RANGE_ERR_039_Rx_oRDR_FUSION_DET_037_040_oPCAN_RADAR_173ad26c_Rx: ComBitPosition=264, ComBitSize=7, ComSignalType=UINT8, ComHandleId=882, ComSystemTemplateSystemSignalRef=DET_RANGE_ERR_039_Rx
          DET_MTD_037_Rx_oRDR_FUSION_DET_037_040_oPCAN_RADAR_f90648f5_Rx: ComBitPosition=47, ComBitSize=1, ComSignalType=BOOLEAN, ComHandleId=868, ComSystemTemplateSystemSignalRef=DET_MTD_037_Rx
          DET_RANGE_VELOCITY_040_Rx_oRDR_FUSION_DET_037_040_oPCAN_RADAR_baff376e_Rx: ComBitPosition=384, ComBitSize=15, ComSignalType=UINT16, ComHandleId=887, ComSystemTemplateSystemSignalRef=DET_RANGE_VELOCITY_040_Rx
      9 x ComIPdu, all with ComIPduType=NORMAL, ComIPduCancellationSupport=false, ComIPduSignalProcessing=DEFERRED:
        RDR_FUSION_DET_113_116_oPCAN_RADAR_7bba841e_Rx: ComIPduDirection=RECEIVE, ComIPduHandleId=50, ComIPduChannelRef=CN_PCAN_RADAR_458ff0f1, ComIPduGroupRef=RDR01_oPCAN_RADAR_Rx_e0e717e1 if post-build-variant-condition{matching-criterion=RDR_POS, value=0}, ComIPduSignalGroupRef=SG_Fusion_Detections_113_116_oRDR_FUSION_DET_113_116_oPCAN_RADAR_16b82f16_Rx, ComPduIdRef=RDR_FUSION_DET_113_116_oPCAN_RADAR_7bba841e_Rx, ComIPduMainFunctionRef=ComMainFunctionRx, ComIPduGroupRef=RDR02_oPCAN_RADAR_Rx_c92fa313 if post-build-variant-condition{matching-criterion=RDR_POS, value=1}, ComIPduGroupRef=RDR03_oPCAN_RADAR_Rx_67473282 if post-build-variant-condition{matching-criterion=RDR_POS, value=2}, ComIPduGroupRef=RDR04_oPCAN_RADAR_Rx_9abecaf7 if post-build-variant-condition{matching-criterion=RDR_POS, value=3}, ComIPduGroupRef=RDR05_oPCAN_RADAR_Rx_34d65b66 if post-build-variant-condition{matching-criterion=RDR_POS, value=4}, ComIPduGroupRef=RDR06_oPCAN_RADAR_Rx_1d1eef94 if post-build-variant-condition{matching-criterion=RDR_POS, value=5}, ComIPduGroupRef=RDR07_oPCAN_RADAR_Rx_b3767e05 if post-build-variant-condition{matching-criterion=RDR_POS, value=6}, ComIPduGroupRef=RDR08_oPCAN_RADAR_Rx_3d9c193f if post-build-variant-condition{matching-criterion=RDR_POS, value=7}
        RDR_FUSION_DET_109_112_oPCAN_RADAR_667d8730_Rx: ComIPduDirection=RECEIVE, ComIPduHandleId=49, ComIPduChannelRef=CN_PCAN_RADAR_458ff0f1, ComIPduGroupRef=RDR01_oPCAN_RADAR_Rx_e0e717e1 if post-build-variant-condition{matching-criterion=RDR_POS, value=0}, ComIPduSignalGroupRef=SG_Fusion_Detections_109_112_oRDR_FUSION_DET_109_112_oPCAN_RADAR_e2334566_Rx, ComPduIdRef=RDR_FUSION_DET_109_112_oPCAN_RADAR_667d8730_Rx, ComIPduMainFunctionRef=ComMainFunctionRx, ComIPduGroupRef=RDR02_oPCAN_RADAR_Rx_c92fa313 if post-build-variant-condition{matching-criterion=RDR_POS, value=1}, ComIPduGroupRef=RDR03_oPCAN_RADAR_Rx_67473282 if post-build-variant-condition{matching-criterion=RDR_POS, value=2}, ComIPduGroupRef=RDR04_oPCAN_RADAR_Rx_9abecaf7 if post-build-variant-condition{matching-criterion=RDR_POS, value=3}, ComIPduGroupRef=RDR05_oPCAN_RADAR_Rx_34d65b66 if post-build-variant-condition{matching-criterion=RDR_POS, value=4}, ComIPduGroupRef=RDR06_oPCAN_RADAR_Rx_1d1eef94 if post-build-variant-condition{matching-criterion=RDR_POS, value=5}, ComIPduGroupRef=RDR07_oPCAN_RADAR_Rx_b3767e05 if post-build-variant-condition{matching-criterion=RDR_POS, value=6}, ComIPduGroupRef=RDR08_oPCAN_RADAR_Rx_3d9c193f if post-build-variant-condition{matching-criterion=RDR_POS, value=7}
        RDR_FUSION_DET_029_032_oPCAN_RADAR_ecde73ae_Rx: ComIPduDirection=RECEIVE, ComIPduHandleId=29, ComIPduChannelRef=CN_PCAN_RADAR_458ff0f1, ComIPduGroupRef=RDR01_oPCAN_RADAR_Rx_e0e717e1 if post-build-variant-condition{matching-criterion=RDR_POS, value=0}, ComIPduSignalGroupRef=SG_Fusion_Detections_029_032_oRDR_FUSION_DET_029_032_oPCAN_RADAR_3868beb2_Rx, ComPduIdRef=RDR_FUSION_DET_029_032_oPCAN_RADAR_ecde73ae_Rx, ComIPduMainFunctionRef=ComMainFunctionRx, ComIPduGroupRef=RDR02_oPCAN_RADAR_Rx_c92fa313 if post-build-variant-condition{matching-criterion=RDR_POS, value=1}, ComIPduGroupRef=RDR03_oPCAN_RADAR_Rx_67473282 if post-build-variant-condition{matching-criterion=RDR_POS, value=2}, ComIPduGroupRef=RDR04_oPCAN_RADAR_Rx_9abecaf7 if post-build-variant-condition{matching-criterion=RDR_POS, value=3}, ComIPduGroupRef=RDR05_oPCAN_RADAR_Rx_34d65b66 if post-build-variant-condition{matching-criterion=RDR_POS, value=4}, ComIPduGroupRef=RDR06_oPCAN_RADAR_Rx_1d1eef94 if post-build-variant-condition{matching-criterion=RDR_POS, value=5}, ComIPduGroupRef=RDR07_oPCAN_RADAR_Rx_b3767e05 if post-build-variant-condition{matching-criterion=RDR_POS, value=6}, ComIPduGroupRef=RDR08_oPCAN_RADAR_Rx_3d9c193f if post-build-variant-condition{matching-criterion=RDR_POS, value=7}
        VI_oVCAN_RADAR_260d64a7_Rx: ComIPduDirection=RECEIVE, ComIPduHandleId=62, ComIPduChannelRef=CN_VCAN_RADAR_489180b6, ComIPduGroupRef=RDR01_oVCAN_RADAR_Rx_BC_7567adec if post-build-variant-condition{matching-criterion=RDR_POS, value=0}, ComIPduSignalGroupRef=SG_VI_oVI_oVCAN_RADAR_7241e1af_Rx, ComPduIdRef=VI_oVCAN_RADAR_260d64a7_Rx, ComIPduMainFunctionRef=ComMainFunctionRx, ComIPduGroupRef=RDR02_oVCAN_RADAR_Rx_BC_d6312b45 if post-build-variant-condition{matching-criterion=RDR_POS, value=1}, ComIPduGroupRef=RDR03_oVCAN_RADAR_Rx_BC_01d3ab1d if post-build-variant-condition{matching-criterion=RDR_POS, value=2}, ComIPduGroupRef=RDR04_oVCAN_RADAR_Rx_BC_4bed2056 if post-build-variant-condition{matching-criterion=RDR_POS, value=3}, ComIPduGroupRef=RDR05_oVCAN_RADAR_Rx_BC_9c0fa00e if post-build-variant-condition{matching-criterion=RDR_POS, value=4}, ComIPduGroupRef=RDR06_oVCAN_RADAR_Rx_BC_3f5926a7 if post-build-variant-condition{matching-criterion=RDR_POS, value=5}, ComIPduGroupRef=RDR07_oVCAN_RADAR_Rx_BC_e8bba6ff if post-build-variant-condition{matching-criterion=RDR_POS, value=6}, ComIPduGroupRef=RDR08_oVCAN_RADAR_Rx_BC_ab243031 if post-build-variant-condition{matching-criterion=RDR_POS, value=7}
        MOIS_oVCAN_RADAR_39784631_Tx: ComIPduDirection=SEND, ComIPduHandleId=1, ComIPduChannelRef=CN_VCAN_RADAR_489180b6, ComIPduGroupRef=RDR01_oVCAN_RADAR_Tx_0xD0_2361e9dc if post-build-variant-condition{matching-criterion=RDR_POS, value=0}, ComIPduSignalGroupRef=SG_MOIS_oMOIS_oVCAN_RADAR_f9ec408e_Tx, ComPduIdRef=MOIS_oVCAN_RADAR_39784631_Tx, ComIPduMainFunctionRef=ComMainFunctionTx_Periodic, ComIPduGroupRef=RDR02_oVCAN_RADAR_Tx_0xD0_587f6b3f if post-build-variant-condition{matching-criterion=RDR_POS, value=1}, ComIPduGroupRef=RDR03_oVCAN_RADAR_Tx_0xD0_c7a5e8a1 if post-build-variant-condition{matching-criterion=RDR_POS, value=2}, ComIPduGroupRef=RDR04_oVCAN_RADAR_Tx_0xD0_ae426ef9 if post-build-variant-condition{matching-criterion=RDR_POS, value=3}, ComIPduGroupRef=RDR05_oVCAN_RADAR_Tx_0xD0_3198ed67 if post-build-variant-condition{matching-criterion=RDR_POS, value=4}, ComIPduGroupRef=RDR06_oVCAN_RADAR_Tx_0xD0_4a866f84 if post-build-variant-condition{matching-criterion=RDR_POS, value=5}, ComIPduGroupRef=RDR07_oVCAN_RADAR_Tx_0xD0_d55cec1a if post-build-variant-condition{matching-criterion=RDR_POS, value=6}, ComIPduGroupRef=RDR08_oVCAN_RADAR_Tx_0xD0_99496334 if post-build-variant-condition{matching-criterion=RDR_POS, value=7}
          ComTxIPdu: ComMinimumDelayTime=0, ComTxIPduUnusedAreasDefault=255
            ComTxModeTrue
              ComTxMode: ComTxModeMode=PERIODIC, ComTxModeTimeOffset=0, ComTxModeTimePeriod=0.05
            ComTxModeFalse
              ComTxMode: ComTxModeMode=NONE, ComTxModeTimeOffset=0, ComTxModeTimePeriod=0.05
        CLS_Tx_4_oVCAN_RADAR_1adbb350_Rx: ComIPduDirection=RECEIVE, ComIPduHandleId=2, ComIPduChannelRef=CN_VCAN_RADAR_489180b6, ComIPduGroupRef=RDR01_oVCAN_RADAR_Rx_BC_7567adec if post-build-variant-condition{matching-criterion=RDR_POS, value=0}, ComIPduSignalGroupRef=SG_CLS_Tx_4_oCLS_Tx_4_oVCAN_RADAR_72dadf8e_Rx, ComPduIdRef=CLS_Tx_4_oVCAN_RADAR_1adbb350_Rx, ComIPduMainFunctionRef=ComMainFunctionRx, ComIPduGroupRef=RDR02_oVCAN_RADAR_Rx_BC_d6312b45 if post-build-variant-condition{matching-criterion=RDR_POS, value=1}, ComIPduGroupRef=RDR03_oVCAN_RADAR_Rx_BC_01d3ab1d if post-build-variant-condition{matching-criterion=RDR_POS, value=2}, ComIPduGroupRef=RDR04_oVCAN_RADAR_Rx_BC_4bed2056 if post-build-variant-condition{matching-criterion=RDR_POS, value=3}, ComIPduGroupRef=RDR05_oVCAN_RADAR_Rx_BC_9c0fa00e if post-build-variant-condition{matching-criterion=RDR_POS, value=4}, ComIPduGroupRef=RDR06_oVCAN_RADAR_Rx_BC_3f5926a7 if post-build-variant-condition{matching-criterion=RDR_POS, value=5}, ComIPduGroupRef=RDR07_oVCAN_RADAR_Rx_BC_e8bba6ff if post-build-variant-condition{matching-criterion=RDR_POS, value=6}, ComIPduGroupRef=RDR08_oVCAN_RADAR_Rx_BC_ab243031 if post-build-variant-condition{matching-criterion=RDR_POS, value=7}
        ETC2_00_oVCAN_RADAR_322c725a_Rx: ComIPduDirection=RECEIVE, ComIPduHandleId=4, ComIPduChannelRef=CN_VCAN_RADAR_489180b6, ComIPduGroupRef=RDR01_oVCAN_RADAR_Rx_BC_7567adec if post-build-variant-condition{matching-criterion=RDR_POS, value=0}, ComIPduSignalGroupRef=SG_ETC2_00_oETC2_00_oVCAN_RADAR_efbda90a_Rx, ComPduIdRef=ETC2_00_oVCAN_RADAR_322c725a_Rx, ComIPduMainFunctionRef=ComMainFunctionRx, ComIPduGroupRef=RDR02_oVCAN_RADAR_Rx_BC_d6312b45 if post-build-variant-condition{matching-criterion=RDR_POS, value=1}, ComIPduGroupRef=RDR03_oVCAN_RADAR_Rx_BC_01d3ab1d if post-build-variant-condition{matching-criterion=RDR_POS, value=2}, ComIPduGroupRef=RDR04_oVCAN_RADAR_Rx_BC_4bed2056 if post-build-variant-condition{matching-criterion=RDR_POS, value=3}, ComIPduGroupRef=RDR05_oVCAN_RADAR_Rx_BC_9c0fa00e if post-build-variant-condition{matching-criterion=RDR_POS, value=4}, ComIPduGroupRef=RDR06_oVCAN_RADAR_Rx_BC_3f5926a7 if post-build-variant-condition{matching-criterion=RDR_POS, value=5}, ComIPduGroupRef=RDR07_oVCAN_RADAR_Rx_BC_e8bba6ff if post-build-variant-condition{matching-criterion=RDR_POS, value=6}, ComIPduGroupRef=RDR08_oVCAN_RADAR_Rx_BC_ab243031 if post-build-variant-condition{matching-criterion=RDR_POS, value=7}
        SAS_oVCAN_RADAR_fe45d49a_Rx: ComIPduDirection=RECEIVE, ComIPduHandleId=57, ComIPduChannelRef=CN_VCAN_RADAR_489180b6, ComIPduGroupRef=RDR01_oVCAN_RADAR_Rx_BC_7567adec if post-build-variant-condition{matching-criterion=RDR_POS, value=0}, ComIPduSignalGroupRef=SG_SAS_oSAS_oVCAN_RADAR_c902864e_Rx, ComPduIdRef=SAS_oVCAN_RADAR_fe45d49a_Rx, ComIPduMainFunctionRef=ComMainFunctionRx, ComIPduGroupRef=RDR02_oVCAN_RADAR_Rx_BC_d6312b45 if post-build-variant-condition{matching-criterion=RDR_POS, value=1}, ComIPduGroupRef=RDR03_oVCAN_RADAR_Rx_BC_01d3ab1d if post-build-variant-condition{matching-criterion=RDR_POS, value=2}, ComIPduGroupRef=RDR04_oVCAN_RADAR_Rx_BC_4bed2056 if post-build-variant-condition{matching-criterion=RDR_POS, value=3}, ComIPduGroupRef=RDR05_oVCAN_RADAR_Rx_BC_9c0fa00e if post-build-variant-condition{matching-criterion=RDR_POS, value=4}, ComIPduGroupRef=RDR06_oVCAN_RADAR_Rx_BC_3f5926a7 if post-build-variant-condition{matching-criterion=RDR_POS, value=5}, ComIPduGroupRef=RDR07_oVCAN_RADAR_Rx_BC_e8bba6ff if post-build-variant-condition{matching-criterion=RDR_POS, value=6}, ComIPduGroupRef=RDR08_oVCAN_RADAR_Rx_BC_ab243031 if post-build-variant-condition{matching-criterion=RDR_POS, value=7}
        ETC2_03_oVCAN_RADAR_8fe61e94_Rx: ComIPduDirection=RECEIVE, ComIPduHandleId=5, ComIPduChannelRef=CN_VCAN_RADAR_489180b6, ComIPduGroupRef=RDR01_oVCAN_RADAR_Rx_BC_7567adec if post-build-variant-condition{matching-criterion=RDR_POS, value=0}, ComIPduSignalGroupRef=SG_ETC2_03_oETC2_03_oVCAN_RADAR_6b0f6884_Rx, ComPduIdRef=ETC2_03_oVCAN_RADAR_8fe61e94_Rx, ComIPduMainFunctionRef=ComMainFunctionRx, ComIPduGroupRef=RDR02_oVCAN_RADAR_Rx_BC_d6312b45 if post-build-variant-condition{matching-criterion=RDR_POS, value=1}, ComIPduGroupRef=RDR03_oVCAN_RADAR_Rx_BC_01d3ab1d if post-build-variant-condition{matching-criterion=RDR_POS, value=2}, ComIPduGroupRef=RDR04_oVCAN_RADAR_Rx_BC_4bed2056 if post-build-variant-condition{matching-criterion=RDR_POS, value=3}, ComIPduGroupRef=RDR05_oVCAN_RADAR_Rx_BC_9c0fa00e if post-build-variant-condition{matching-criterion=RDR_POS, value=4}, ComIPduGroupRef=RDR06_oVCAN_RADAR_Rx_BC_3f5926a7 if post-build-variant-condition{matching-criterion=RDR_POS, value=5}, ComIPduGroupRef=RDR07_oVCAN_RADAR_Rx_BC_e8bba6ff if post-build-variant-condition{matching-criterion=RDR_POS, value=6}, ComIPduGroupRef=RDR08_oVCAN_RADAR_Rx_BC_ab243031 if post-build-variant-condition{matching-criterion=RDR_POS, value=7}
      RDR01_oVCAN_RADAR_Rx_BC_7567adec (ComIPduGroup): ComIPduGroupHandleId=2, variation-point=post-build-variant-condition{matching-criterion=RDR_POS, value=0}
      CLS_Tx_16_oVCAN_RADAR_4a01c26f_Rx (ComIPdu):
        ComIPduDirection = RECEIVE
        ComIPduType = NORMAL
        ComIPduCancellationSupport = false
        ComIPduHandleId = 3
        ComIPduSignalProcessing = DEFERRED
        ComIPduChannelRef = CN_VCAN_RADAR_489180b6
        ComIPduGroupRef = RDR01_oVCAN_RADAR_Rx_BC_7567adec if post-build-variant-condition{matching-criterion=RDR_POS, value=0}
        ComIPduSignalGroupRef = SG_CLS_Tx_16_oCLS_Tx_16_oVCAN_RADAR_ce7ac5cf_Rx
        ComPduIdRef = CLS_Tx_16_oVCAN_RADAR_4a01c26f_Rx
        ComIPduMainFunctionRef = ComMainFunctionRx
        ComIPduGroupRef = RDR02_oVCAN_RADAR_Rx_BC_d6312b45 if post-build-variant-condition{matching-criterion=RDR_POS, value=1}
        ComIPduGroupRef = RDR03_oVCAN_RADAR_Rx_BC_01d3ab1d if post-build-variant-condition{matching-criterion=RDR_POS, value=2}
        ComIPduGroupRef = RDR04_oVCAN_RADAR_Rx_BC_4bed2056 if post-build-variant-condition{matching-criterion=RDR_POS, value=3}
        ComIPduGroupRef = RDR05_oVCAN_RADAR_Rx_BC_9c0fa00e if post-build-variant-condition{matching-criterion=RDR_POS, value=4}
        ComIPduGroupRef = RDR06_oVCAN_RADAR_Rx_BC_3f5926a7 if post-build-variant-condition{matching-criterion=RDR_POS, value=5}
        ComIPduGroupRef = RDR07_oVCAN_RADAR_Rx_BC_e8bba6ff if post-build-variant-condition{matching-criterion=RDR_POS, value=6}
        ComIPduGroupRef = RDR08_oVCAN_RADAR_Rx_BC_ab243031 if post-build-variant-condition{matching-criterion=RDR_POS, value=7}
      RDR01_oVCAN_RADAR_Tx_0xD0_2361e9dc (ComIPduGroup): ComIPduGroupHandleId=3, variation-point=post-build-variant-condition{matching-criterion=RDR_POS, value=0}
      18 x ComIPdu, all with ComIPduType=NORMAL, ComIPduCancellationSupport=false, ComIPduSignalProcessing=DEFERRED:
        VD_oVCAN_RADAR_612104d9_Rx: ComIPduDirection=RECEIVE, ComIPduHandleId=61, ComIPduChannelRef=CN_VCAN_RADAR_489180b6, ComIPduGroupRef=RDR01_oVCAN_RADAR_Rx_BC_7567adec if post-build-variant-condition{matching-criterion=RDR_POS, value=0}, ComIPduSignalGroupRef=SG_VD_oVD_oVCAN_RADAR_27d322c3_Rx, ComPduIdRef=VD_oVCAN_RADAR_612104d9_Rx, ComIPduMainFunctionRef=ComMainFunctionRx, ComIPduGroupRef=RDR02_oVCAN_RADAR_Rx_BC_d6312b45 if post-build-variant-condition{matching-criterion=RDR_POS, value=1}, ComIPduGroupRef=RDR03_oVCAN_RADAR_Rx_BC_01d3ab1d if post-build-variant-condition{matching-criterion=RDR_POS, value=2}, ComIPduGroupRef=RDR04_oVCAN_RADAR_Rx_BC_4bed2056 if post-build-variant-condition{matching-criterion=RDR_POS, value=3}, ComIPduGroupRef=RDR05_oVCAN_RADAR_Rx_BC_9c0fa00e if post-build-variant-condition{matching-criterion=RDR_POS, value=4}, ComIPduGroupRef=RDR06_oVCAN_RADAR_Rx_BC_3f5926a7 if post-build-variant-condition{matching-criterion=RDR_POS, value=5}, ComIPduGroupRef=RDR07_oVCAN_RADAR_Rx_BC_e8bba6ff if post-build-variant-condition{matching-criterion=RDR_POS, value=6}, ComIPduGroupRef=RDR08_oVCAN_RADAR_Rx_BC_ab243031 if post-build-variant-condition{matching-criterion=RDR_POS, value=7}
        TD_oVCAN_RADAR_804fc074_Rx: ComIPduDirection=RECEIVE, ComIPduHandleId=59, ComIPduChannelRef=CN_VCAN_RADAR_489180b6, ComIPduGroupRef=RDR01_oVCAN_RADAR_Rx_BC_7567adec if post-build-variant-condition{matching-criterion=RDR_POS, value=0}, ComIPduSignalGroupRef=SG_TD_oTD_oVCAN_RADAR_c3698ded_Rx, ComPduIdRef=TD_oVCAN_RADAR_804fc074_Rx, ComIPduMainFunctionRef=ComMainFunctionRx, ComIPduGroupRef=RDR02_oVCAN_RADAR_Rx_BC_d6312b45 if post-build-variant-condition{matching-criterion=RDR_POS, value=1}, ComIPduGroupRef=RDR03_oVCAN_RADAR_Rx_BC_01d3ab1d if post-build-variant-condition{matching-criterion=RDR_POS, value=2}, ComIPduGroupRef=RDR04_oVCAN_RADAR_Rx_BC_4bed2056 if post-build-variant-condition{matching-criterion=RDR_POS, value=3}, ComIPduGroupRef=RDR05_oVCAN_RADAR_Rx_BC_9c0fa00e if post-build-variant-condition{matching-criterion=RDR_POS, value=4}, ComIPduGroupRef=RDR06_oVCAN_RADAR_Rx_BC_3f5926a7 if post-build-variant-condition{matching-criterion=RDR_POS, value=5}, ComIPduGroupRef=RDR07_oVCAN_RADAR_Rx_BC_e8bba6ff if post-build-variant-condition{matching-criterion=RDR_POS, value=6}, ComIPduGroupRef=RDR08_oVCAN_RADAR_Rx_BC_ab243031 if post-build-variant-condition{matching-criterion=RDR_POS, value=7}
        VDC2_oVCAN_RADAR_5a222cac_Rx: ComIPduDirection=RECEIVE, ComIPduHandleId=60, ComIPduChannelRef=CN_VCAN_RADAR_489180b6, ComIPduGroupRef=RDR01_oVCAN_RADAR_Rx_BC_7567adec if post-build-variant-condition{matching-criterion=RDR_POS, value=0}, ComIPduSignalGroupRef=SG_VDC2_oVDC2_oVCAN_RADAR_06eddadd_Rx, ComPduIdRef=VDC2_oVCAN_RADAR_5a222cac_Rx, ComIPduMainFunctionRef=ComMainFunctionRx, ComIPduGroupRef=RDR02_oVCAN_RADAR_Rx_BC_d6312b45 if post-build-variant-condition{matching-criterion=RDR_POS, value=1}, ComIPduGroupRef=RDR03_oVCAN_RADAR_Rx_BC_01d3ab1d if post-build-variant-condition{matching-criterion=RDR_POS, value=2}, ComIPduGroupRef=RDR04_oVCAN_RADAR_Rx_BC_4bed2056 if post-build-variant-condition{matching-criterion=RDR_POS, value=3}, ComIPduGroupRef=RDR05_oVCAN_RADAR_Rx_BC_9c0fa00e if post-build-variant-condition{matching-criterion=RDR_POS, value=4}, ComIPduGroupRef=RDR06_oVCAN_RADAR_Rx_BC_3f5926a7 if post-build-variant-condition{matching-criterion=RDR_POS, value=5}, ComIPduGroupRef=RDR07_oVCAN_RADAR_Rx_BC_e8bba6ff if post-build-variant-condition{matching-criterion=RDR_POS, value=6}, ComIPduGroupRef=RDR08_oVCAN_RADAR_Rx_BC_ab243031 if post-build-variant-condition{matching-criterion=RDR_POS, value=7}
        OEL_oVCAN_RADAR_75091ec5_Rx: ComIPduDirection=RECEIVE, ComIPduHandleId=18, ComIPduChannelRef=CN_VCAN_RADAR_489180b6, ComIPduGroupRef=RDR01_oVCAN_RADAR_Rx_BC_7567adec if post-build-variant-condition{matching-criterion=RDR_POS, value=0}, ComIPduSignalGroupRef=SG_OEL_oOEL_oVCAN_RADAR_400a2f4d_Rx, ComPduIdRef=OEL_oVCAN_RADAR_75091ec5_Rx, ComIPduMainFunctionRef=ComMainFunctionRx, ComIPduGroupRef=RDR02_oVCAN_RADAR_Rx_BC_d6312b45 if post-build-variant-condition{matching-criterion=RDR_POS, value=1}, ComIPduGroupRef=RDR03_oVCAN_RADAR_Rx_BC_01d3ab1d if post-build-variant-condition{matching-criterion=RDR_POS, value=2}, ComIPduGroupRef=RDR04_oVCAN_RADAR_Rx_BC_4bed2056 if post-build-variant-condition{matching-criterion=RDR_POS, value=3}, ComIPduGroupRef=RDR05_oVCAN_RADAR_Rx_BC_9c0fa00e if post-build-variant-condition{matching-criterion=RDR_POS, value=4}, ComIPduGroupRef=RDR06_oVCAN_RADAR_Rx_BC_3f5926a7 if post-build-variant-condition{matching-criterion=RDR_POS, value=5}, ComIPduGroupRef=RDR07_oVCAN_RADAR_Rx_BC_e8bba6ff if post-build-variant-condition{matching-criterion=RDR_POS, value=6}, ComIPduGroupRef=RDR08_oVCAN_RADAR_Rx_BC_ab243031 if post-build-variant-condition{matching-criterion=RDR_POS, value=7}
        CCVS1_oVCAN_RADAR_7fab2fed_Rx: ComIPduDirection=RECEIVE, ComIPduHandleId=1, ComIPduChannelRef=CN_VCAN_RADAR_489180b6, ComIPduGroupRef=RDR01_oVCAN_RADAR_Rx_BC_7567adec if post-build-variant-condition{matching-criterion=RDR_POS, value=0}, ComIPduSignalGroupRef=SG_CCVS1_oCCVS1_oVCAN_RADAR_1b2d3da2_Rx, ComPduIdRef=CCVS1_oVCAN_RADAR_7fab2fed_Rx, ComIPduMainFunctionRef=ComMainFunctionRx, ComIPduGroupRef=RDR02_oVCAN_RADAR_Rx_BC_d6312b45 if post-build-variant-condition{matching-criterion=RDR_POS, value=1}, ComIPduGroupRef=RDR03_oVCAN_RADAR_Rx_BC_01d3ab1d if post-build-variant-condition{matching-criterion=RDR_POS, value=2}, ComIPduGroupRef=RDR04_oVCAN_RADAR_Rx_BC_4bed2056 if post-build-variant-condition{matching-criterion=RDR_POS, value=3}, ComIPduGroupRef=RDR05_oVCAN_RADAR_Rx_BC_9c0fa00e if post-build-variant-condition{matching-criterion=RDR_POS, value=4}, ComIPduGroupRef=RDR06_oVCAN_RADAR_Rx_BC_3f5926a7 if post-build-variant-condition{matching-criterion=RDR_POS, value=5}, ComIPduGroupRef=RDR07_oVCAN_RADAR_Rx_BC_e8bba6ff if post-build-variant-condition{matching-criterion=RDR_POS, value=6}, ComIPduGroupRef=RDR08_oVCAN_RADAR_Rx_BC_ab243031 if post-build-variant-condition{matching-criterion=RDR_POS, value=7}
        ADAS_FN_Enable_disable_sts_oVCAN_RADAR_dbe1c88d_Rx: ComIPduDirection=RECEIVE, ComIPduHandleId=0, ComIPduChannelRef=CN_VCAN_RADAR_489180b6, ComIPduGroupRef=RDR01_oVCAN_RADAR_Rx_BC_7567adec if post-build-variant-condition{matching-criterion=RDR_POS, value=0}, ComIPduSignalGroupRef=SG_ADAS_FN_Enable_disable_sts_oADAS_FN_Enable_disable_sts_oVCAN_RADAR_46faeb96_Rx, ComPduIdRef=ADAS_FN_Enable_disable_sts_oVCAN_RADAR_dbe1c88d_Rx, ComIPduMainFunctionRef=ComMainFunctionRx, ComIPduGroupRef=RDR02_oVCAN_RADAR_Rx_BC_d6312b45 if post-build-variant-condition{matching-criterion=RDR_POS, value=1}, ComIPduGroupRef=RDR03_oVCAN_RADAR_Rx_BC_01d3ab1d if post-build-variant-condition{matching-criterion=RDR_POS, value=2}, ComIPduGroupRef=RDR04_oVCAN_RADAR_Rx_BC_4bed2056 if post-build-variant-condition{matching-criterion=RDR_POS, value=3}, ComIPduGroupRef=RDR05_oVCAN_RADAR_Rx_BC_9c0fa00e if post-build-variant-condition{matching-criterion=RDR_POS, value=4}, ComIPduGroupRef=RDR06_oVCAN_RADAR_Rx_BC_3f5926a7 if post-build-variant-condition{matching-criterion=RDR_POS, value=5}, ComIPduGroupRef=RDR07_oVCAN_RADAR_Rx_BC_e8bba6ff if post-build-variant-condition{matching-criterion=RDR_POS, value=6}, ComIPduGroupRef=RDR08_oVCAN_RADAR_Rx_BC_ab243031 if post-build-variant-condition{matching-criterion=RDR_POS, value=7}
        GW_CLS_Tx_4_oPCAN_RADAR_888f4e35_Rx: ComIPduDirection=RECEIVE, ComIPduHandleId=8, ComIPduChannelRef=CN_PCAN_RADAR_458ff0f1, ComIPduGroupRef=RDR01_oPCAN_RADAR_Rx_e0e717e1 if post-build-variant-condition{matching-criterion=RDR_POS, value=0}, ComIPduSignalGroupRef=SG_GW_CLS_Tx_4_oGW_CLS_Tx_4_oPCAN_RADAR_474ec459_Rx, ComPduIdRef=GW_CLS_Tx_4_oPCAN_RADAR_888f4e35_Rx, ComIPduMainFunctionRef=ComMainFunctionRx, ComIPduGroupRef=RDR02_oPCAN_RADAR_Rx_c92fa313 if post-build-variant-condition{matching-criterion=RDR_POS, value=1}, ComIPduGroupRef=RDR03_oPCAN_RADAR_Rx_67473282 if post-build-variant-condition{matching-criterion=RDR_POS, value=2}, ComIPduGroupRef=RDR04_oPCAN_RADAR_Rx_9abecaf7 if post-build-variant-condition{matching-criterion=RDR_POS, value=3}, ComIPduGroupRef=RDR05_oPCAN_RADAR_Rx_34d65b66 if post-build-variant-condition{matching-criterion=RDR_POS, value=4}, ComIPduGroupRef=RDR06_oPCAN_RADAR_Rx_1d1eef94 if post-build-variant-condition{matching-criterion=RDR_POS, value=5}, ComIPduGroupRef=RDR07_oPCAN_RADAR_Rx_b3767e05 if post-build-variant-condition{matching-criterion=RDR_POS, value=6}, ComIPduGroupRef=RDR08_oPCAN_RADAR_Rx_3d9c193f if post-build-variant-condition{matching-criterion=RDR_POS, value=7}
        GW_ADAS_FN_Enable_disable_sts_oPCAN_RADAR_a2ffe33c_Rx: ComIPduDirection=RECEIVE, ComIPduHandleId=6, ComIPduChannelRef=CN_PCAN_RADAR_458ff0f1, ComIPduGroupRef=RDR01_oPCAN_RADAR_Rx_e0e717e1 if post-build-variant-condition{matching-criterion=RDR_POS, value=0}, ComIPduSignalGroupRef=SG_GW_ADAS_FN_Enable_disable_sts_oGW_ADAS_FN_Enable_disable_sts_oPCAN_RADAR_9a8054b4_Rx, ComPduIdRef=GW_ADAS_FN_Enable_disable_sts_oPCAN_RADAR_a2ffe33c_Rx, ComIPduMainFunctionRef=ComMainFunctionRx, ComIPduGroupRef=RDR02_oPCAN_RADAR_Rx_c92fa313 if post-build-variant-condition{matching-criterion=RDR_POS, value=1}, ComIPduGroupRef=RDR03_oPCAN_RADAR_Rx_67473282 if post-build-variant-condition{matching-criterion=RDR_POS, value=2}, ComIPduGroupRef=RDR04_oPCAN_RADAR_Rx_9abecaf7 if post-build-variant-condition{matching-criterion=RDR_POS, value=3}, ComIPduGroupRef=RDR05_oPCAN_RADAR_Rx_34d65b66 if post-build-variant-condition{matching-criterion=RDR_POS, value=4}, ComIPduGroupRef=RDR06_oPCAN_RADAR_Rx_1d1eef94 if post-build-variant-condition{matching-criterion=RDR_POS, value=5}, ComIPduGroupRef=RDR07_oPCAN_RADAR_Rx_b3767e05 if post-build-variant-condition{matching-criterion=RDR_POS, value=6}, ComIPduGroupRef=RDR08_oPCAN_RADAR_Rx_3d9c193f if post-build-variant-condition{matching-criterion=RDR_POS, value=7}
        GW_VDC2_oPCAN_RADAR_a2fdf3c6_Rx: ComIPduDirection=RECEIVE, ComIPduHandleId=15, ComIPduChannelRef=CN_PCAN_RADAR_458ff0f1, ComIPduGroupRef=RDR01_oPCAN_RADAR_Rx_e0e717e1 if post-build-variant-condition{matching-criterion=RDR_POS, value=0}, ComIPduSignalGroupRef=SG_GW_VDC2_oGW_VDC2_oPCAN_RADAR_41520959_Rx, ComPduIdRef=GW_VDC2_oPCAN_RADAR_a2fdf3c6_Rx, ComIPduMainFunctionRef=ComMainFunctionRx, ComIPduGroupRef=RDR02_oPCAN_RADAR_Rx_c92fa313 if post-build-variant-condition{matching-criterion=RDR_POS, value=1}, ComIPduGroupRef=RDR03_oPCAN_RADAR_Rx_67473282 if post-build-variant-condition{matching-criterion=RDR_POS, value=2}, ComIPduGroupRef=RDR04_oPCAN_RADAR_Rx_9abecaf7 if post-build-variant-condition{matching-criterion=RDR_POS, value=3}, ComIPduGroupRef=RDR05_oPCAN_RADAR_Rx_34d65b66 if post-build-variant-condition{matching-criterion=RDR_POS, value=4}, ComIPduGroupRef=RDR06_oPCAN_RADAR_Rx_1d1eef94 if post-build-variant-condition{matching-criterion=RDR_POS, value=5}, ComIPduGroupRef=RDR07_oPCAN_RADAR_Rx_b3767e05 if post-build-variant-condition{matching-criterion=RDR_POS, value=6}, ComIPduGroupRef=RDR08_oPCAN_RADAR_Rx_3d9c193f if post-build-variant-condition{matching-criterion=RDR_POS, value=7}
        GW_TD_oPCAN_RADAR_87cf7844_Rx: ComIPduDirection=RECEIVE, ComIPduHandleId=14, ComIPduChannelRef=CN_PCAN_RADAR_458ff0f1, ComIPduGroupRef=RDR01_oPCAN_RADAR_Rx_e0e717e1 if post-build-variant-condition{matching-criterion=RDR_POS, value=0}, ComIPduSignalGroupRef=SG_GW_TD_oGW_TD_oPCAN_RADAR_a8a59c34_Rx, ComPduIdRef=GW_TD_oPCAN_RADAR_87cf7844_Rx, ComIPduMainFunctionRef=ComMainFunctionRx, ComIPduGroupRef=RDR02_oPCAN_RADAR_Rx_c92fa313 if post-build-variant-condition{matching-criterion=RDR_POS, value=1}, ComIPduGroupRef=RDR03_oPCAN_RADAR_Rx_67473282 if post-build-variant-condition{matching-criterion=RDR_POS, value=2}, ComIPduGroupRef=RDR04_oPCAN_RADAR_Rx_9abecaf7 if post-build-variant-condition{matching-criterion=RDR_POS, value=3}, ComIPduGroupRef=RDR05_oPCAN_RADAR_Rx_34d65b66 if post-build-variant-condition{matching-criterion=RDR_POS, value=4}, ComIPduGroupRef=RDR06_oPCAN_RADAR_Rx_1d1eef94 if post-build-variant-condition{matching-criterion=RDR_POS, value=5}, ComIPduGroupRef=RDR07_oPCAN_RADAR_Rx_b3767e05 if post-build-variant-condition{matching-criterion=RDR_POS, value=6}, ComIPduGroupRef=RDR08_oPCAN_RADAR_Rx_3d9c193f if post-build-variant-condition{matching-criterion=RDR_POS, value=7}
        GW_SAS_oPCAN_RADAR_3d30de8a_Rx: ComIPduDirection=RECEIVE, ComIPduHandleId=13, ComIPduChannelRef=CN_PCAN_RADAR_458ff0f1, ComIPduGroupRef=RDR01_oPCAN_RADAR_Rx_e0e717e1 if post-build-variant-condition{matching-criterion=RDR_POS, value=0}, ComIPduSignalGroupRef=SG_GW_SAS_oGW_SAS_oPCAN_RADAR_0d213b5c_Rx, ComPduIdRef=GW_SAS_oPCAN_RADAR_3d30de8a_Rx, ComIPduMainFunctionRef=ComMainFunctionRx, ComIPduGroupRef=RDR02_oPCAN_RADAR_Rx_c92fa313 if post-build-variant-condition{matching-criterion=RDR_POS, value=1}, ComIPduGroupRef=RDR03_oPCAN_RADAR_Rx_67473282 if post-build-variant-condition{matching-criterion=RDR_POS, value=2}, ComIPduGroupRef=RDR04_oPCAN_RADAR_Rx_9abecaf7 if post-build-variant-condition{matching-criterion=RDR_POS, value=3}, ComIPduGroupRef=RDR05_oPCAN_RADAR_Rx_34d65b66 if post-build-variant-condition{matching-criterion=RDR_POS, value=4}, ComIPduGroupRef=RDR06_oPCAN_RADAR_Rx_1d1eef94 if post-build-variant-condition{matching-criterion=RDR_POS, value=5}, ComIPduGroupRef=RDR07_oPCAN_RADAR_Rx_b3767e05 if post-build-variant-condition{matching-criterion=RDR_POS, value=6}, ComIPduGroupRef=RDR08_oPCAN_RADAR_Rx_3d9c193f if post-build-variant-condition{matching-criterion=RDR_POS, value=7}
        GW_ETC2_oPCAN_RADAR_2970e6e5_Rx: ComIPduDirection=RECEIVE, ComIPduHandleId=11, ComIPduChannelRef=CN_PCAN_RADAR_458ff0f1, ComIPduGroupRef=RDR01_oPCAN_RADAR_Rx_e0e717e1 if post-build-variant-condition{matching-criterion=RDR_POS, value=0}, ComIPduSignalGroupRef=SG_GW_ETC2_oGW_ETC2_oPCAN_RADAR_d84ef27a_Rx, ComPduIdRef=GW_ETC2_oPCAN_RADAR_2970e6e5_Rx, ComIPduMainFunctionRef=ComMainFunctionRx, ComIPduGroupRef=RDR02_oPCAN_RADAR_Rx_c92fa313 if post-build-variant-condition{matching-criterion=RDR_POS, value=1}, ComIPduGroupRef=RDR03_oPCAN_RADAR_Rx_67473282 if post-build-variant-condition{matching-criterion=RDR_POS, value=2}, ComIPduGroupRef=RDR04_oPCAN_RADAR_Rx_9abecaf7 if post-build-variant-condition{matching-criterion=RDR_POS, value=3}, ComIPduGroupRef=RDR05_oPCAN_RADAR_Rx_34d65b66 if post-build-variant-condition{matching-criterion=RDR_POS, value=4}, ComIPduGroupRef=RDR06_oPCAN_RADAR_Rx_1d1eef94 if post-build-variant-condition{matching-criterion=RDR_POS, value=5}, ComIPduGroupRef=RDR07_oPCAN_RADAR_Rx_b3767e05 if post-build-variant-condition{matching-criterion=RDR_POS, value=6}, ComIPduGroupRef=RDR08_oPCAN_RADAR_Rx_3d9c193f if post-build-variant-condition{matching-criterion=RDR_POS, value=7}
        GW_VD_oPCAN_RADAR_66a1bce9_Rx: ComIPduDirection=RECEIVE, ComIPduHandleId=16, ComIPduChannelRef=CN_PCAN_RADAR_458ff0f1, ComIPduGroupRef=RDR01_oPCAN_RADAR_Rx_e0e717e1 if post-build-variant-condition{matching-criterion=RDR_POS, value=0}, ComIPduSignalGroupRef=SG_GW_VD_oGW_VD_oPCAN_RADAR_ad0f59e4_Rx, ComPduIdRef=GW_VD_oPCAN_RADAR_66a1bce9_Rx, ComIPduMainFunctionRef=ComMainFunctionRx, ComIPduGroupRef=RDR02_oPCAN_RADAR_Rx_c92fa313 if post-build-variant-condition{matching-criterion=RDR_POS, value=1}, ComIPduGroupRef=RDR03_oPCAN_RADAR_Rx_67473282 if post-build-variant-condition{matching-criterion=RDR_POS, value=2}, ComIPduGroupRef=RDR04_oPCAN_RADAR_Rx_9abecaf7 if post-build-variant-condition{matching-criterion=RDR_POS, value=3}, ComIPduGroupRef=RDR05_oPCAN_RADAR_Rx_34d65b66 if post-build-variant-condition{matching-criterion=RDR_POS, value=4}, ComIPduGroupRef=RDR06_oPCAN_RADAR_Rx_1d1eef94 if post-build-variant-condition{matching-criterion=RDR_POS, value=5}, ComIPduGroupRef=RDR07_oPCAN_RADAR_Rx_b3767e05 if post-build-variant-condition{matching-criterion=RDR_POS, value=6}, ComIPduGroupRef=RDR08_oPCAN_RADAR_Rx_3d9c193f if post-build-variant-condition{matching-criterion=RDR_POS, value=7}
        GW_OEL_oPCAN_RADAR_b67c14d5_Rx: ComIPduDirection=RECEIVE, ComIPduHandleId=12, ComIPduChannelRef=CN_PCAN_RADAR_458ff0f1, ComIPduGroupRef=RDR01_oPCAN_RADAR_Rx_e0e717e1 if post-build-variant-condition{matching-criterion=RDR_POS, value=0}, ComIPduSignalGroupRef=SG_GW_OEL_oGW_OEL_oPCAN_RADAR_dcaa9b38_Rx, ComPduIdRef=GW_OEL_oPCAN_RADAR_b67c14d5_Rx, ComIPduMainFunctionRef=ComMainFunctionRx, ComIPduGroupRef=RDR02_oPCAN_RADAR_Rx_c92fa313 if post-build-variant-condition{matching-criterion=RDR_POS, value=1}, ComIPduGroupRef=RDR03_oPCAN_RADAR_Rx_67473282 if post-build-variant-condition{matching-criterion=RDR_POS, value=2}, ComIPduGroupRef=RDR04_oPCAN_RADAR_Rx_9abecaf7 if post-build-variant-condition{matching-criterion=RDR_POS, value=3}, ComIPduGroupRef=RDR05_oPCAN_RADAR_Rx_34d65b66 if post-build-variant-condition{matching-criterion=RDR_POS, value=4}, ComIPduGroupRef=RDR06_oPCAN_RADAR_Rx_1d1eef94 if post-build-variant-condition{matching-criterion=RDR_POS, value=5}, ComIPduGroupRef=RDR07_oPCAN_RADAR_Rx_b3767e05 if post-build-variant-condition{matching-criterion=RDR_POS, value=6}, ComIPduGroupRef=RDR08_oPCAN_RADAR_Rx_3d9c193f if post-build-variant-condition{matching-criterion=RDR_POS, value=7}
        GW_VI_oPCAN_RADAR_218ddc97_Rx: ComIPduDirection=RECEIVE, ComIPduHandleId=17, ComIPduChannelRef=CN_PCAN_RADAR_458ff0f1, ComIPduGroupRef=RDR01_oPCAN_RADAR_Rx_e0e717e1 if post-build-variant-condition{matching-criterion=RDR_POS, value=0}, ComIPduSignalGroupRef=SG_GW_VI_oGW_VI_oPCAN_RADAR_5c723f37_Rx, ComPduIdRef=GW_VI_oPCAN_RADAR_218ddc97_Rx, ComIPduMainFunctionRef=ComMainFunctionRx, ComIPduGroupRef=RDR02_oPCAN_RADAR_Rx_c92fa313 if post-build-variant-condition{matching-criterion=RDR_POS, value=1}, ComIPduGroupRef=RDR03_oPCAN_RADAR_Rx_67473282 if post-build-variant-condition{matching-criterion=RDR_POS, value=2}, ComIPduGroupRef=RDR04_oPCAN_RADAR_Rx_9abecaf7 if post-build-variant-condition{matching-criterion=RDR_POS, value=3}, ComIPduGroupRef=RDR05_oPCAN_RADAR_Rx_34d65b66 if post-build-variant-condition{matching-criterion=RDR_POS, value=4}, ComIPduGroupRef=RDR06_oPCAN_RADAR_Rx_1d1eef94 if post-build-variant-condition{matching-criterion=RDR_POS, value=5}, ComIPduGroupRef=RDR07_oPCAN_RADAR_Rx_b3767e05 if post-build-variant-condition{matching-criterion=RDR_POS, value=6}, ComIPduGroupRef=RDR08_oPCAN_RADAR_Rx_3d9c193f if post-build-variant-condition{matching-criterion=RDR_POS, value=7}
        RDR_BSD1_Tx_oPCAN_RADAR_170995fb_Tx: ComIPduDirection=SEND, ComIPduHandleId=4, ComIPduChannelRef=CN_PCAN_RADAR_458ff0f1, ComIPduGroupRef=RDR01_oPCAN_RADAR_Tx_b6bdb067 if post-build-variant-condition{matching-criterion=RDR_POS, value=0}, ComIPduSignalGroupRef=SG_RDR_BSD1_Tx_oRDR_BSD1_Tx_oPCAN_RADAR_bd131ac1_Tx, ComPduIdRef=RDR_BSD1_Tx_oPCAN_RADAR_170995fb_Tx, ComIPduMainFunctionRef=ComMainFunctionTx_Periodic, ComIPduGroupRef=RDR02_oPCAN_RADAR_Tx_9f750495 if post-build-variant-condition{matching-criterion=RDR_POS, value=1}, ComIPduGroupRef=RDR03_oPCAN_RADAR_Tx_311d9504 if post-build-variant-condition{matching-criterion=RDR_POS, value=2}, ComIPduGroupRef=RDR04_oPCAN_RADAR_Tx_cce46d71 if post-build-variant-condition{matching-criterion=RDR_POS, value=3}, ComIPduGroupRef=RDR05_oPCAN_RADAR_Tx_628cfce0 if post-build-variant-condition{matching-criterion=RDR_POS, value=4}, ComIPduGroupRef=RDR06_oPCAN_RADAR_Tx_4b444812 if post-build-variant-condition{matching-criterion=RDR_POS, value=5}, ComIPduGroupRef=RDR07_oPCAN_RADAR_Tx_e52cd983 if post-build-variant-condition{matching-criterion=RDR_POS, value=6}, ComIPduGroupRef=RDR08_oPCAN_RADAR_Tx_6bc6beb9 if post-build-variant-condition{matching-criterion=RDR_POS, value=7}
          ComTxIPdu: ComMinimumDelayTime=0, ComTxIPduUnusedAreasDefault=0
            ComTxModeTrue
              ComTxMode: ComTxModeMode=PERIODIC, ComTxModeTimeOffset=0, ComTxModeTimePeriod=0.05
            ComTxModeFalse
              ComTxMode: ComTxModeMode=NONE, ComTxModeTimeOffset=0, ComTxModeTimePeriod=0.05
        GW_CLS_Tx_16_oPCAN_RADAR_92e0b941_Rx: ComIPduDirection=RECEIVE, ComIPduHandleId=9, ComIPduChannelRef=CN_PCAN_RADAR_458ff0f1, ComIPduGroupRef=RDR01_oPCAN_RADAR_Rx_e0e717e1 if post-build-variant-condition{matching-criterion=RDR_POS, value=0}, ComIPduSignalGroupRef=SG_GW_CLS_Tx_16_oGW_CLS_Tx_16_oPCAN_RADAR_ecf85999_Rx, ComPduIdRef=GW_CLS_Tx_16_oPCAN_RADAR_92e0b941_Rx, ComIPduMainFunctionRef=ComMainFunctionRx, ComIPduGroupRef=RDR02_oPCAN_RADAR_Rx_c92fa313 if post-build-variant-condition{matching-criterion=RDR_POS, value=1}, ComIPduGroupRef=RDR03_oPCAN_RADAR_Rx_67473282 if post-build-variant-condition{matching-criterion=RDR_POS, value=2}, ComIPduGroupRef=RDR04_oPCAN_RADAR_Rx_9abecaf7 if post-build-variant-condition{matching-criterion=RDR_POS, value=3}, ComIPduGroupRef=RDR05_oPCAN_RADAR_Rx_34d65b66 if post-build-variant-condition{matching-criterion=RDR_POS, value=4}, ComIPduGroupRef=RDR06_oPCAN_RADAR_Rx_1d1eef94 if post-build-variant-condition{matching-criterion=RDR_POS, value=5}, ComIPduGroupRef=RDR07_oPCAN_RADAR_Rx_b3767e05 if post-build-variant-condition{matching-criterion=RDR_POS, value=6}, ComIPduGroupRef=RDR08_oPCAN_RADAR_Rx_3d9c193f if post-build-variant-condition{matching-criterion=RDR_POS, value=7}
        GW_CCVS1_oPCAN_RADAR_379fc270_Rx: ComIPduDirection=RECEIVE, ComIPduHandleId=7, ComIPduChannelRef=CN_PCAN_RADAR_458ff0f1, ComIPduGroupRef=RDR01_oPCAN_RADAR_Rx_e0e717e1 if post-build-variant-condition{matching-criterion=RDR_POS, value=0}, ComIPduSignalGroupRef=SG_GW_CCVS1_oGW_CCVS1_oPCAN_RADAR_70857376_Rx, ComPduIdRef=GW_CCVS1_oPCAN_RADAR_379fc270_Rx, ComIPduMainFunctionRef=ComMainFunctionRx, ComIPduGroupRef=RDR02_oPCAN_RADAR_Rx_c92fa313 if post-build-variant-condition{matching-criterion=RDR_POS, value=1}, ComIPduGroupRef=RDR03_oPCAN_RADAR_Rx_67473282 if post-build-variant-condition{matching-criterion=RDR_POS, value=2}, ComIPduGroupRef=RDR04_oPCAN_RADAR_Rx_9abecaf7 if post-build-variant-condition{matching-criterion=RDR_POS, value=3}, ComIPduGroupRef=RDR05_oPCAN_RADAR_Rx_34d65b66 if post-build-variant-condition{matching-criterion=RDR_POS, value=4}, ComIPduGroupRef=RDR06_oPCAN_RADAR_Rx_1d1eef94 if post-build-variant-condition{matching-criterion=RDR_POS, value=5}, ComIPduGroupRef=RDR07_oPCAN_RADAR_Rx_b3767e05 if post-build-variant-condition{matching-criterion=RDR_POS, value=6}, ComIPduGroupRef=RDR08_oPCAN_RADAR_Rx_3d9c193f if post-build-variant-condition{matching-criterion=RDR_POS, value=7}
      SG_TD_oTD_oVCAN_RADAR_c3698ded_Rx (ComSignalGroup):
        ComTransferProperty = PENDING
        ComSignalGroupAccess = ACCESS_NEEDED_BY_SWC_OR_COM
        ComHandleId = 58
        ComNotification = ComNotification_SG_TD_oTD_oVCAN_RADAR_c3698ded_Rx
        ComTimeoutNotification = ComTimeoutNotification_SG_TD_oTD_oVCAN_RADAR_c3698ded_Rx
        ComTimeout = 1
        ComFirstTimeout = 0.5
        ComSystemTemplateSignalGroupRef = SG_TD
        8 x ComGroupSignal, all with ComBitSize=8, ComSignalEndianness=LITTLE_ENDIAN, ComSignalType=UINT8:
          Seconds_oTD_oVCAN_RADAR_b2a2ca59_Rx: ComBitPosition=0, ComSignalInitValue=0, ComSignalAccess=ACCESS_UNCLEAR, ComHandleId=2940, ComSystemTemplateSystemSignalRef=Seconds
          Minutes_oTD_oVCAN_RADAR_2546db9e_Rx: ComBitPosition=8, ComSignalInitValue=0, ComSignalAccess=ACCESS_UNCLEAR, ComHandleId=2938, ComSystemTemplateSystemSignalRef=Minutes
          LocalMinuteOffset_oTD_oVCAN_RADAR_074fc4ab_Rx: ComBitPosition=56, ComSignalInitValue=125, ComSignalAccess=ACCESS_UNCLEAR, ComHandleId=2937, ComSystemTemplateSystemSignalRef=LocalMinuteOffset
          Year_oTD_oVCAN_RADAR_b229b348_Rx: ComBitPosition=40, ComSignalInitValue=0, ComSignalAccess=ACCESS_NEEDED_BY_SWC_OR_COM, ComHandleId=2941, ComSystemTemplateSystemSignalRef=Year
          Day_oTD_oVCAN_RADAR_d9e1ba53_Rx: ComBitPosition=32, ComSignalInitValue=0, ComSignalAccess=ACCESS_UNCLEAR, ComHandleId=2934, ComSystemTemplateSystemSignalRef=Day
          LocalHourOffset_oTD_oVCAN_RADAR_82942db5_Rx: ComBitPosition=48, ComSignalInitValue=125, ComSignalAccess=ACCESS_UNCLEAR, ComHandleId=2936, ComSystemTemplateSystemSignalRef=LocalHourOffset
          Month_oTD_oVCAN_RADAR_d8bc3ad5_Rx: ComBitPosition=24, ComSignalInitValue=0, ComSignalAccess=ACCESS_UNCLEAR, ComHandleId=2939, ComSystemTemplateSystemSignalRef=Month
          Hours_oTD_oVCAN_RADAR_408d2c34_Rx: ComBitPosition=16, ComSignalInitValue=0, ComSignalAccess=ACCESS_UNCLEAR, ComHandleId=2935, ComSystemTemplateSystemSignalRef=Hours
      SG_CLS_Tx_4_oCLS_Tx_4_oVCAN_RADAR_72dadf8e_Rx (ComSignalGroup):
        ComTransferProperty = PENDING
        ComSignalGroupAccess = ACCESS_NEEDED_BY_SWC_OR_COM
        ComHandleId = 2
        ComTimeout = 0.1
        ComTimeoutNotification = ComTimeoutNotification_SG_CLS_Tx_4_oCLS_Tx_4_oVCAN_RADAR_72dadf8e_Rx
        ComFirstTimeout = 0.5
        ComNotification = ComNotification_SG_CLS_Tx_4_oCLS_Tx_4_oVCAN_RADAR_72dadf8e_Rx
        ComSystemTemplateSignalGroupRef = SG_CLS_Tx_4
        Ignition_oCLS_Tx_4_oVCAN_RADAR_cb871f88_Rx (ComGroupSignal):
          ComBitPosition = 32
          ComBitSize = 2
          ComSignalEndianness = LITTLE_ENDIAN
          ComSignalInitValue = 0
          ComSignalType = UINT8
          ComSignalAccess = ACCESS_UNCLEAR
          ComHandleId = 7
          ComSystemTemplateSystemSignalRef = Ignition
        ReverseSwitchInfo_oCLS_Tx_4_oVCAN_RADAR_b4b1941a_Rx (ComGroupSignal):
          ComBitPosition = 28
          ComBitSize = 2
          ComSignalEndianness = LITTLE_ENDIAN
          ComSignalInitValue = 0
          ComSignalType = UINT8
          ComSignalAccess = ACCESS_UNCLEAR
          ComHandleId = 8
          ComSystemTemplateSystemSignalRef = ReverseSwitchInfo
      RDR_FUSION_ALIGNMENT_STATUS_002_oPCAN_RADAR_e1715b9f_Rx (ComIPdu):
        ComIPduDirection = RECEIVE
        ComIPduType = NORMAL
        ComIPduCancellationSupport = false
        ComIPduHandleId = 20
        ComIPduSignalProcessing = DEFERRED
        ComIPduChannelRef = CN_PCAN_RADAR_458ff0f1
        ComIPduGroupRef = RDR01_oPCAN_RADAR_Rx_e0e717e1 if post-build-variant-condition{matching-criterion=RDR_POS, value=0}
        ComIPduSignalGroupRef = SG_Fusion_AlignmentStatus2_oRDR_FUSION_ALIGNMENT_STATUS_002_oPCAN_RADAR_13cf0319_Rx
        ComPduIdRef = RDR_FUSION_ALIGNMENT_STATUS_002_oPCAN_RADAR_e1715b9f_Rx
        ComIPduGroupRef = RDR02_oPCAN_RADAR_Rx_c92fa313 if post-build-variant-condition{matching-criterion=RDR_POS, value=1}
        ComIPduGroupRef = RDR03_oPCAN_RADAR_Rx_67473282 if post-build-variant-condition{matching-criterion=RDR_POS, value=2}
        ComIPduGroupRef = RDR04_oPCAN_RADAR_Rx_9abecaf7 if post-build-variant-condition{matching-criterion=RDR_POS, value=3}
        ComIPduGroupRef = RDR05_oPCAN_RADAR_Rx_34d65b66 if post-build-variant-condition{matching-criterion=RDR_POS, value=4}
        ComIPduGroupRef = RDR06_oPCAN_RADAR_Rx_1d1eef94 if post-build-variant-condition{matching-criterion=RDR_POS, value=5}
        ComIPduGroupRef = RDR07_oPCAN_RADAR_Rx_b3767e05 if post-build-variant-condition{matching-criterion=RDR_POS, value=6}
        ComIPduGroupRef = RDR08_oPCAN_RADAR_Rx_3d9c193f if post-build-variant-condition{matching-criterion=RDR_POS, value=7}
        ComIPduMainFunctionRef = ComMainFunctionRx
      6 x ComSignalGroup, all with ComTransferProperty=PENDING, ComSignalGroupAccess=ACCESS_NEEDED_BY_SWC_OR_COM, ComFirstTimeout=0.5:
        SG_GW_SAS_oGW_SAS_oPCAN_RADAR_0d213b5c_Rx: ComTimeout=0.01, ComHandleId=51, ComNotification=ComNotification_SG_GW_SAS_oGW_SAS_oPCAN_RADAR_0d213b5c_Rx, ComTimeoutNotification=ComTimeoutNotification_SG_GW_SAS_oGW_SAS_oPCAN_RADAR_0d213b5c_Rx, ComSystemTemplateSignalGroupRef=SG_GW_SAS
          8 x ComGroupSignal, all with ComSignalEndianness=LITTLE_ENDIAN, ComSignalInitValue=0, ComSignalAccess=ACCESS_UNCLEAR:
            SteerWheelAngleRange_oGW_SAS_oPCAN_RADAR_fe08ddff_Rx: ComBitPosition=32, ComBitSize=16, ComSignalType=UINT16, ComHandleId=2907, ComSystemTemplateSystemSignalRef=SteerWheelAngleRange
            MessageChecksum_oGW_SAS_oPCAN_RADAR_87a8a844_Rx: ComBitPosition=60, ComBitSize=4, ComSignalType=UINT8, ComHandleId=2901, ComSystemTemplateSystemSignalRef=MessageChecksum
            SteerAngleSensorActiveMode_oGW_SAS_oPCAN_RADAR_8c83afe6_Rx: ComBitPosition=48, ComBitSize=2, ComSignalType=UINT8, ComHandleId=2903, ComSystemTemplateSystemSignalRef=SteerAngleSensorActiveMode
            SteerWheelAngleRangeCounter_oGW_SAS_oPCAN_RADAR_e6274286_Rx: ComBitPosition=16, ComBitSize=6, ComSignalType=UINT8, ComHandleId=2906, ComSystemTemplateSystemSignalRef=SteerWheelAngleRangeCounter
            SteerWheelAngle_oGW_SAS_oPCAN_RADAR_a582dc0a_Rx: ComBitPosition=0, ComBitSize=16, ComSignalType=UINT16, ComHandleId=2908, ComSystemTemplateSystemSignalRef=SteerWheelAngle
            MessageCounter_oGW_SAS_oPCAN_RADAR_f51168b6_Rx: ComBitPosition=56, ComBitSize=4, ComSignalType=UINT8, ComHandleId=2902, ComSystemTemplateSystemSignalRef=MessageCounter
            SteerWheelAngleRangeCounterType_oGW_SAS_oPCAN_RADAR_30be95a7_Rx: ComBitPosition=22, ComBitSize=2, ComSignalType=UINT8, ComHandleId=2905, ComSystemTemplateSystemSignalRef=SteerWheelAngleRangeCounterType
            SteerAngleSensorCalibrated_oGW_SAS_oPCAN_RADAR_883db374_Rx: ComBitPosition=50, ComBitSize=2, ComSignalType=UINT8, ComHandleId=2904, ComSystemTemplateSystemSignalRef=SteerAngleSensorCalibrated
        SG_GW_ETC2_oGW_ETC2_oPCAN_RADAR_d84ef27a_Rx: ComTimeout=0.1, ComHandleId=49, ComNotification=ComNotification_SG_GW_ETC2_oGW_ETC2_oPCAN_RADAR_d84ef27a_Rx, ComTimeoutNotification=ComTimeoutNotification_SG_GW_ETC2_oGW_ETC2_oPCAN_RADAR_d84ef27a_Rx, ComSystemTemplateSignalGroupRef=SG_GW_ETC2
          TransCurrentGear_00_oGW_ETC2_oPCAN_RADAR_2bdb78e8_Rx (ComGroupSignal):
            ComBitPosition = 24
            ComBitSize = 8
            ComSignalEndianness = LITTLE_ENDIAN
            ComSignalInitValue = 0
            ComSignalType = UINT8
            ComSignalAccess = ACCESS_UNCLEAR
            ComHandleId = 2897
            ComSystemTemplateSystemSignalRef = TransCurrentGear_00
        SG_CCVS1_oCCVS1_oVCAN_RADAR_1b2d3da2_Rx: ComHandleId=1, ComTimeout=0.02, ComNotification=ComNotification_SG_CCVS1_oCCVS1_oVCAN_RADAR_1b2d3da2_Rx, ComTimeoutNotification=ComTimeoutNotification_SG_CCVS1_oCCVS1_oVCAN_RADAR_1b2d3da2_Rx, ComSystemTemplateSignalGroupRef=SG_CCVS1
          3 x ComGroupSignal, all with ComSignalEndianness=LITTLE_ENDIAN, ComSignalInitValue=0, ComSignalAccess=ACCESS_UNCLEAR:
            BrakeSwitch_oCCVS1_oVCAN_RADAR_1059096c_Rx: ComBitPosition=28, ComBitSize=2, ComSignalType=UINT8, ComHandleId=4, ComSystemTemplateSystemSignalRef=BrakeSwitch
            WheelBasedVehicleSpeed_oCCVS1_oVCAN_RADAR_c435b4dd_Rx: ComBitPosition=8, ComBitSize=16, ComSignalType=UINT16, ComHandleId=6, ComSystemTemplateSystemSignalRef=WheelBasedVehicleSpeed
            ParkingBrakeSwitch_oCCVS1_oVCAN_RADAR_fe400b10_Rx: ComBitPosition=2, ComBitSize=2, ComSignalType=UINT8, ComHandleId=5, ComSystemTemplateSystemSignalRef=ParkingBrakeSwitch
        SG_GW_VDC2_oGW_VDC2_oPCAN_RADAR_41520959_Rx: ComTimeout=0.01, ComHandleId=53, ComTimeoutNotification=ComTimeoutNotification_SG_GW_VDC2_oGW_VDC2_oPCAN_RADAR_41520959_Rx, ComNotification=ComNotification_SG_GW_VDC2_oGW_VDC2_oPCAN_RADAR_41520959_Rx, ComSystemTemplateSignalGroupRef=SG_GW_VDC2
          4 x ComGroupSignal, all with ComSignalEndianness=LITTLE_ENDIAN, ComSignalInitValue=0, ComSignalAccess=ACCESS_UNCLEAR:
            YawRate_oGW_VDC2_oPCAN_RADAR_f47de610_Rx: ComBitPosition=24, ComBitSize=16, ComSignalType=UINT16, ComHandleId=2920, ComSystemTemplateSystemSignalRef=YawRate
            LateralAcceleration_oGW_VDC2_oPCAN_RADAR_d68a0cd8_Rx: ComBitPosition=40, ComBitSize=16, ComSignalType=UINT16, ComHandleId=2917, ComSystemTemplateSystemSignalRef=LateralAcceleration
            SteerWheelAngle_oGW_VDC2_oPCAN_RADAR_4fddc2e4_Rx: ComBitPosition=0, ComBitSize=16, ComSignalType=UINT16, ComHandleId=2919, ComSystemTemplateSystemSignalRef=SteerWheelAngle
            LongitudinalAcceleration_oGW_VDC2_oPCAN_RADAR_c0095fa4_Rx: ComBitPosition=56, ComBitSize=8, ComSignalType=UINT8, ComHandleId=2918, ComSystemTemplateSystemSignalRef=LongitudinalAcceleration
        SG_Fusion_RadarStatus2_oRDR_FUSION_STATUS_002_oPCAN_RADAR_458079fc_Rx: ComSignalGroupArrayAccess=true, ComTimeout=0.05, ComHandleId=42, ComTimeoutNotification=ComTimeoutNotification_SG_Fusion_RadarStatus2_oRDR_FUSION_STATUS_002_oPCAN_RADAR_458079fc_Rx, ComNotification=ComNotification_SG_Fusion_RadarStatus2_oRDR_FUSION_STATUS_002_oPCAN_RADAR_458079fc_Rx, ComSystemTemplateSignalGroupRef=SG_Fusion_RadarStatus2
          38 x ComGroupSignal, all with ComSignalEndianness=LITTLE_ENDIAN, ComSignalInitValue=0, ComSignalAccess=ACCESS_UNCLEAR:
            STS_AF_CORE_THROUGHPUT_Rx_oRDR_FUSION_STATUS_002_oPCAN_RADAR_fca7dcb6_Rx: ComBitPosition=128, ComBitSize=6, ComSignalType=UINT8, ComHandleId=2797, ComSystemTemplateSystemSignalRef=STS_AF_CORE_THROUGHPUT_Rx
            STS_XCVR_OPERATIONAL_Rx_oRDR_FUSION_STATUS_002_oPCAN_RADAR_2d179a83_Rx: ComBitPosition=43, ComBitSize=1, ComSignalType=BOOLEAN, ComHandleId=2832, ComSystemTemplateSystemSignalRef=STS_XCVR_OPERATIONAL_Rx
            STS_CORE_ACTV_FLT_BYTE_8_to_11_Rx_oRDR_FUSION_STATUS_002_oPCAN_RADAR_02a7f53e_Rx: ComBitPosition=224, ComBitSize=32, ComSignalType=UINT32, ComHandleId=2802, ComSystemTemplateSystemSignalRef=STS_CORE_ACTV_FLT_BYTE_8_to_11_Rx
            STS_Last_CAN_Det_Inst_Latency_Rx_oRDR_FUSION_STATUS_002_oPCAN_RADAR_383e71e8_Rx: ComBitPosition=336, ComBitSize=12, ComSignalType=UINT16, ComHandleId=2809, ComSystemTemplateSystemSignalRef=STS_Last_CAN_Det_Inst_Latency_Rx
            STS_YAW_RATE_BIAS_Rx_oRDR_FUSION_STATUS_002_oPCAN_RADAR_d7dadf21_Rx: ComBitPosition=28, ComBitSize=4, ComSignalType=UINT8, ComHandleId=2833, ComSystemTemplateSystemSignalRef=STS_YAW_RATE_BIAS_Rx
            STS_INTRFC_VERSION_ID_PATCH_Rx_oRDR_FUSION_STATUS_002_oPCAN_RADAR_2cd61204_Rx: ComBitPosition=392, ComBitSize=8, ComSignalType=UINT8, ComHandleId=2808, ComSystemTemplateSystemSignalRef=STS_INTRFC_VERSION_ID_PATCH_Rx
            STS_TKEY_ACTV_FLT_BYTE_0_to_3_Rx_oRDR_FUSION_STATUS_002_oPCAN_RADAR_73aea715_Rx: ComBitPosition=288, ComBitSize=32, ComSignalType=UINT32, ComHandleId=2826, ComSystemTemplateSystemSignalRef=STS_TKEY_ACTV_FLT_BYTE_0_to_3_Rx
            STS_Vehicle_Speed_Calc_QF_Rx_oRDR_FUSION_STATUS_002_oPCAN_RADAR_cf710cdf_Rx: ComBitPosition=134, ComBitSize=2, ComSignalType=UINT8, ComHandleId=2831, ComSystemTemplateSystemSignalRef=STS_Vehicle_Speed_Calc_QF_Rx
            STS_MMIC_TEMP_RX_Rx_oRDR_FUSION_STATUS_002_oPCAN_RADAR_8467dc68_Rx: ComBitPosition=144, ComBitSize=8, ComSignalType=UINT8, ComHandleId=2814, ComSystemTemplateSystemSignalRef=STS_MMIC_TEMP_RX_Rx
            STS_VEH_SPEED_DIRECTION_Rx_oRDR_FUSION_STATUS_002_oPCAN_RADAR_238cca73_Rx: ComBitPosition=177, ComBitSize=1, ComSignalType=BOOLEAN, ComHandleId=2830, ComSystemTemplateSystemSignalRef=STS_VEH_SPEED_DIRECTION_Rx
            STS_TIME_SYNC_OFFSET_Rx_oRDR_FUSION_STATUS_002_oPCAN_RADAR_d61087bd_Rx: ComBitPosition=152, ComBitSize=16, ComSignalType=SINT16, ComHandleId=2825, ComSystemTemplateSystemSignalRef=STS_TIME_SYNC_OFFSET_Rx
            STS_MMIC_TEMP_TX1_2_Rx_oRDR_FUSION_STATUS_002_oPCAN_RADAR_8c03a0ef_Rx: ComBitPosition=72, ComBitSize=8, ComSignalType=UINT8, ComHandleId=2816, ComSystemTemplateSystemSignalRef=STS_MMIC_TEMP_TX1_2_Rx
            STS_BRR_STATUS_Rx_oRDR_FUSION_STATUS_002_oPCAN_RADAR_ab4c702f_Rx: ComBitPosition=41, ComBitSize=2, ComSignalType=UINT8, ComHandleId=2798, ComSystemTemplateSystemSignalRef=STS_BRR_STATUS_Rx
            STS_INTRFC_VERSION_ID_MAJOR_Rx_oRDR_FUSION_STATUS_002_oPCAN_RADAR_24081e81_Rx: ComBitPosition=376, ComBitSize=8, ComSignalType=UINT8, ComHandleId=2806, ComSystemTemplateSystemSignalRef=STS_INTRFC_VERSION_ID_MAJOR_Rx
            STS_First_CAN_Det_Inst_Latency_Rx_oRDR_FUSION_STATUS_002_oPCAN_RADAR_97228231_Rx: ComBitPosition=348, ComBitSize=12, ComSignalType=UINT16, ComHandleId=2804, ComSystemTemplateSystemSignalRef=STS_First_CAN_Det_Inst_Latency_Rx
            STS_STEERING_ANGLE_SIGN_Rx_oRDR_FUSION_STATUS_002_oPCAN_RADAR_9792032c_Rx: ComBitPosition=176, ComBitSize=1, ComSignalType=BOOLEAN, ComHandleId=2824, ComSystemTemplateSystemSignalRef=STS_STEERING_ANGLE_SIGN_Rx
            STS_CORE_ACTV_FLT_BYTE_11_to_15_Rx_oRDR_FUSION_STATUS_002_oPCAN_RADAR_46956790_Rx: ComBitPosition=256, ComBitSize=32, ComSignalType=UINT32, ComHandleId=2803, ComSystemTemplateSystemSignalRef=STS_CORE_ACTV_FLT_BYTE_11_to_15_Rx
            STS_RDD_CORE_THROUGHPUT_Rx_oRDR_FUSION_STATUS_002_oPCAN_RADAR_e15fe345_Rx: ComBitPosition=136, ComBitSize=6, ComSignalType=UINT8, ComHandleId=2821, ComSystemTemplateSystemSignalRef=STS_RDD_CORE_THROUGHPUT_Rx
            STS_Gear_Position_Rx_oRDR_FUSION_STATUS_002_oPCAN_RADAR_6cfac34a_Rx: ComBitPosition=59, ComBitSize=4, ComSignalType=UINT8, ComHandleId=2805, ComSystemTemplateSystemSignalRef=STS_Gear_Position_Rx
            STS_STEERING_ANGLE_Rx_oRDR_FUSION_STATUS_002_oPCAN_RADAR_4b147df6_Rx: ComBitPosition=32, ComBitSize=8, ComSignalType=UINT8, ComHandleId=2823, ComSystemTemplateSystemSignalRef=STS_STEERING_ANGLE_Rx
            STS_TKEY_ACTV_FLT_BYTE_4_to_5_Rx_oRDR_FUSION_STATUS_002_oPCAN_RADAR_a749792a_Rx: ComBitPosition=320, ComBitSize=16, ComSignalType=UINT16, ComHandleId=2827, ComSystemTemplateSystemSignalRef=STS_TKEY_ACTV_FLT_BYTE_4_to_5_Rx
            STS_RAIN_COUNT_Rx_oRDR_FUSION_STATUS_002_oPCAN_RADAR_1e737e66_Rx: ComBitPosition=360, ComBitSize=9, ComSignalType=UINT16, ComHandleId=2820, ComSystemTemplateSystemSignalRef=STS_RAIN_COUNT_Rx
            STS_SCAN_TYPE_Rx_oRDR_FUSION_STATUS_002_oPCAN_RADAR_10a1b094_Rx: ComBitPosition=58, ComBitSize=1, ComSignalType=BOOLEAN, ComHandleId=2822, ComSystemTemplateSystemSignalRef=STS_SCAN_TYPE_Rx
            STS_CAN_NM_State_Rx_oRDR_FUSION_STATUS_002_oPCAN_RADAR_69c86af9_Rx: ComBitPosition=64, ComBitSize=8, ComSignalType=UINT8, ComHandleId=2799, ComSystemTemplateSystemSignalRef=STS_CAN_NM_State_Rx
            STS_INTRFC_VERSION_ID_MINOR_Rx_oRDR_FUSION_STATUS_002_oPCAN_RADAR_3b2f6430_Rx: ComBitPosition=384, ComBitSize=8, ComSignalType=UINT8, ComHandleId=2807, ComSystemTemplateSystemSignalRef=STS_INTRFC_VERSION_ID_MINOR_Rx
            STS_VEHICLE_SPEED_CALC_Rx_oRDR_FUSION_STATUS_002_oPCAN_RADAR_ac8a2f2e_Rx: ComBitPosition=178, ComBitSize=14, ComSignalType=UINT16, ComHandleId=2828, ComSystemTemplateSystemSignalRef=STS_VEHICLE_SPEED_CALC_Rx
            STS_MMIC_RE_INIT_COUNT_Rx_oRDR_FUSION_STATUS_002_oPCAN_RADAR_1306724b_Rx: ComBitPosition=44, ComBitSize=4, ComSignalType=UINT8, ComHandleId=2813, ComSystemTemplateSystemSignalRef=STS_MMIC_RE_INIT_COUNT_Rx
            STS_NO_TSYN_ERROR_Rx_oRDR_FUSION_STATUS_002_oPCAN_RADAR_d3eee9d9_Rx: ComBitPosition=40, ComBitSize=1, ComSignalType=BOOLEAN, ComHandleId=2818, ComSystemTemplateSystemSignalRef=STS_NO_TSYN_ERROR_Rx
            STS_CORE_ACTV_FLT_BYTE_0_to_3_Rx_oRDR_FUSION_STATUS_002_oPCAN_RADAR_d8ff22f4_Rx: ComBitPosition=192, ComBitSize=32, ComSignalType=UINT32, ComHandleId=2800, ComSystemTemplateSystemSignalRef=STS_CORE_ACTV_FLT_BYTE_0_to_3_Rx
            STS_MMIC_TEMP_TX0_Rx_oRDR_FUSION_STATUS_002_oPCAN_RADAR_3137a36b_Rx: ComBitPosition=168, ComBitSize=8, ComSignalType=UINT8, ComHandleId=2815, ComSystemTemplateSystemSignalRef=STS_MMIC_TEMP_TX0_Rx
            STS_MH_002_CYCLE_COUNTER_Rx_oRDR_FUSION_STATUS_002_oPCAN_RADAR_97a416ac_Rx: ComBitPosition=16, ComBitSize=8, ComSignalType=UINT8, ComHandleId=2812, ComSystemTemplateSystemSignalRef=STS_MH_002_CYCLE_COUNTER_Rx
            STS_VEHICLE_SUPPLY_VOLTAGE_Rx_oRDR_FUSION_STATUS_002_oPCAN_RADAR_b633ed3e_Rx: ComBitPosition=24, ComBitSize=4, ComSignalType=UINT8, ComHandleId=2829, ComSystemTemplateSystemSignalRef=STS_VEHICLE_SUPPLY_VOLTAGE_Rx
            STS_Yaw_Rate_Calc_QF_Rx_oRDR_FUSION_STATUS_002_oPCAN_RADAR_ba579c34_Rx: ComBitPosition=142, ComBitSize=2, ComSignalType=UINT8, ComHandleId=2834, ComSystemTemplateSystemSignalRef=STS_Yaw_Rate_Calc_QF_Rx
            STS_MCU_TEMP_Rx_oRDR_FUSION_STATUS_002_oPCAN_RADAR_b492ba9b_Rx: ComBitPosition=88, ComBitSize=8, ComSignalType=UINT8, ComHandleId=2810, ComSystemTemplateSystemSignalRef=STS_MCU_TEMP_Rx
            STS_MH_002_CRC16_Rx_oRDR_FUSION_STATUS_002_oPCAN_RADAR_75522b12_Rx: ComBitPosition=0, ComBitSize=16, ComSignalType=UINT16, ComHandleId=2811, ComSystemTemplateSystemSignalRef=STS_MH_002_CRC16_Rx
            STS_MMIC_TEMP_TX3_4_Rx_oRDR_FUSION_STATUS_002_oPCAN_RADAR_fb1ab85b_Rx: ComBitPosition=80, ComBitSize=8, ComSignalType=UINT8, ComHandleId=2817, ComSystemTemplateSystemSignalRef=STS_MMIC_TEMP_TX3_4_Rx
            STS_CORE_ACTV_FLT_BYTE_4_to_7_Rx_oRDR_FUSION_STATUS_002_oPCAN_RADAR_910aeb99_Rx: ComBitPosition=96, ComBitSize=32, ComSignalType=UINT32, ComHandleId=2801, ComSystemTemplateSystemSignalRef=STS_CORE_ACTV_FLT_BYTE_4_to_7_Rx
            STS_POINT_OF_TRIGGER_Rx_oRDR_FUSION_STATUS_002_oPCAN_RADAR_81e821a6_Rx: ComBitPosition=48, ComBitSize=10, ComSignalType=UINT16, ComHandleId=2819, ComSystemTemplateSystemSignalRef=STS_POINT_OF_TRIGGER_Rx
        SG_ETC2_03_oETC2_03_oVCAN_RADAR_6b0f6884_Rx: ComHandleId=5, ComNotification=ComNotification_SG_ETC2_03_oETC2_03_oVCAN_RADAR_6b0f6884_Rx, ComTimeoutNotification=ComTimeoutNotification_SG_ETC2_03_oETC2_03_oVCAN_RADAR_6b0f6884_Rx, ComTimeout=0.1, ComSystemTemplateSignalGroupRef=SG_ETC2_03
          TransCurrentGear_03_oETC2_03_oVCAN_RADAR_b4352dd9_Rx (ComGroupSignal):
            ComBitPosition = 24
            ComBitSize = 8
            ComSignalEndianness = LITTLE_ENDIAN
            ComSignalInitValue = 0
            ComSignalType = UINT8
            ComSignalAccess = ACCESS_UNCLEAR
            ComHandleId = 12
            ComSystemTemplateSystemSignalRef = TransCurrentGear_03
      GW_ETC2_03_oPCAN_RADAR_7791e995_Rx (ComIPdu):
        ComIPduDirection = RECEIVE
        ComIPduType = NORMAL
        ComIPduCancellationSupport = false
        ComIPduHandleId = 10
        ComIPduSignalProcessing = DEFERRED
        ComIPduChannelRef = CN_PCAN_RADAR_458ff0f1
        ComIPduGroupRef = RDR01_oPCAN_RADAR_Rx_e0e717e1 if post-build-variant-condition{matching-criterion=RDR_POS, value=0}
        ComIPduSignalGroupRef = SG_GW_ETC2_03_oGW_ETC2_03_oPCAN_RADAR_04d9a8d8_Rx
        ComPduIdRef = GW_ETC2_03_oPCAN_RADAR_7791e995_Rx
        ComIPduGroupRef = RDR02_oPCAN_RADAR_Rx_c92fa313 if post-build-variant-condition{matching-criterion=RDR_POS, value=1}
        ComIPduGroupRef = RDR03_oPCAN_RADAR_Rx_67473282 if post-build-variant-condition{matching-criterion=RDR_POS, value=2}
        ComIPduGroupRef = RDR04_oPCAN_RADAR_Rx_9abecaf7 if post-build-variant-condition{matching-criterion=RDR_POS, value=3}
        ComIPduGroupRef = RDR05_oPCAN_RADAR_Rx_34d65b66 if post-build-variant-condition{matching-criterion=RDR_POS, value=4}
        ComIPduGroupRef = RDR06_oPCAN_RADAR_Rx_1d1eef94 if post-build-variant-condition{matching-criterion=RDR_POS, value=5}
        ComIPduGroupRef = RDR07_oPCAN_RADAR_Rx_b3767e05 if post-build-variant-condition{matching-criterion=RDR_POS, value=6}
        ComIPduGroupRef = RDR08_oPCAN_RADAR_Rx_3d9c193f if post-build-variant-condition{matching-criterion=RDR_POS, value=7}
        ComIPduMainFunctionRef = ComMainFunctionRx
      4 x ComSignalGroup, all with ComTransferProperty=PENDING, ComSignalGroupAccess=ACCESS_NEEDED_BY_SWC_OR_COM:
        SG_VD_oVD_oVCAN_RADAR_27d322c3_Rx: ComHandleId=60, ComTimeout=0.1, ComTimeoutNotification=ComTimeoutNotification_SG_VD_oVD_oVCAN_RADAR_27d322c3_Rx, ComNotification=ComNotification_SG_VD_oVD_oVCAN_RADAR_27d322c3_Rx, ComFirstTimeout=0.5, ComSystemTemplateSignalGroupRef=SG_VD
          Total_vehicle_distance_oVD_oVCAN_RADAR_7583597c_Rx (ComGroupSignal):
            ComBitPosition = 32
            ComBitSize = 32
            ComSignalEndianness = LITTLE_ENDIAN
            ComSignalInitValue = 0
            ComSignalType = UINT32
            ComSignalAccess = ACCESS_UNCLEAR
            ComHandleId = 2946
            ComSystemTemplateSystemSignalRef = Total_vehicle_distance
        SG_GW_ADAS_FN_Enable_disable_sts_oGW_ADAS_FN_Enable_disable_sts_oPCAN_RADAR_9a8054b4_Rx: ComTimeout=0.05, ComHandleId=44, ComTimeoutNotification=ComTimeoutNotification_SG_GW_ADAS_FN_Enable_disable_sts_oGW_ADAS_FN_Enable_disable_sts_oPCAN_RADAR_9a8054b4_Rx, ComNotification=ComNotification_SG_GW_ADAS_FN_Enable_disable_sts_oGW_ADAS_FN_Enable_disable_sts_oPCAN_RADAR_9a8054b4_Rx, ComFirstTimeout=0.5, ComSystemTemplateSignalGroupRef=SG_GW_ADAS_FN_Enable_disable_sts
          8 x ComGroupSignal, all with ComSignalEndianness=LITTLE_ENDIAN, ComSignalInitValue=0, ComSignalType=UINT8, ComSignalAccess=ACCESS_UNCLEAR:
            AEBS_FN_Switch_sts_oGW_ADAS_FN_Enable_disable_sts_oPCAN_RADAR_319f3146_Rx: ComBitPosition=11, ComBitSize=3, ComHandleId=2881, ComSystemTemplateSystemSignalRef=AEBS_FN_Switch_sts
            DDAW_fn_switch_sts_oGW_ADAS_FN_Enable_disable_sts_oPCAN_RADAR_a583cbd8_Rx: ComBitPosition=8, ComBitSize=3, ComHandleId=2883, ComSystemTemplateSystemSignalRef=DDAW_fn_switch_sts
            MessageAliveCounter_oGW_ADAS_FN_Enable_disable_sts_oPCAN_RADAR_4999ad4b_Rx: ComBitPosition=52, ComBitSize=4, ComHandleId=2887, ComSystemTemplateSystemSignalRef=MessageAliveCounter
            MOIS_Fn_Switch_sts_oGW_ADAS_FN_Enable_disable_sts_oPCAN_RADAR_37aa4c7c_Rx: ComBitPosition=0, ComBitSize=3, ComHandleId=2886, ComSystemTemplateSystemSignalRef=MOIS_Fn_Switch_sts
            MessageCRC_oGW_ADAS_FN_Enable_disable_sts_oPCAN_RADAR_705ba35b_Rx: ComBitPosition=56, ComBitSize=8, ComHandleId=2888, ComSystemTemplateSystemSignalRef=MessageCRC
            BSIS_fn_Switch_Sts_oGW_ADAS_FN_Enable_disable_sts_oPCAN_RADAR_5e1d7109_Rx: ComBitPosition=3, ComBitSize=3, ComHandleId=2882, ComSystemTemplateSystemSignalRef=BSIS_fn_Switch_Sts
            DDAW_warning_suppression_oGW_ADAS_FN_Enable_disable_sts_oPCAN_RADAR_e90c956f_Rx: ComBitPosition=19, ComBitSize=2, ComHandleId=2884, ComSystemTemplateSystemSignalRef=DDAW_warning_suppression
            LDWS_FN_Switch_sts_oGW_ADAS_FN_Enable_disable_sts_oPCAN_RADAR_c735f110_Rx: ComBitPosition=16, ComBitSize=3, ComHandleId=2885, ComSystemTemplateSystemSignalRef=LDWS_FN_Switch_sts
        SG_RDR_BSD1_Tx_oRDR_BSD1_Tx_oPCAN_RADAR_bd131ac1_Tx: ComHandleId=104, ComSignalGroupArrayAccess=true, ComSystemTemplateSignalGroupRef=SG_RDR_BSD1_Tx
          BlindSpotCollisionWarningLevel_Tx_oRDR_BSD1_Tx_oPCAN_RADAR_5d3220a5_Tx (ComGroupSignal):
            ComBitPosition = 4
            ComBitSize = 4
            ComSignalEndianness = LITTLE_ENDIAN
            ComSignalInitValue = 0
            ComSignalType = UINT8
            ComTransferProperty = PENDING
            ComSignalAccess = ACCESS_NEEDED_BY_SWC_OR_COM
            ComHandleId = 8365
            ComSystemTemplateSystemSignalRef = BlindSpotCollisionWarningLevel_Tx
          BlindSpotDetectionState_Tx_oRDR_BSD1_Tx_oPCAN_RADAR_edbb925a_Tx (ComGroupSignal):
            ComBitPosition = 0
            ComBitSize = 4
            ComSignalEndianness = LITTLE_ENDIAN
            ComSignalInitValue = 0
            ComSignalType = UINT8
            ComTransferProperty = PENDING
            ComSignalAccess = ACCESS_NEEDED_BY_SWC_OR_COM
            ComHandleId = 8366
            ComSystemTemplateSystemSignalRef = BlindSpotDetectionState_Tx
        SG_SAS_oSAS_oVCAN_RADAR_c902864e_Rx: ComHandleId=57, ComTimeout=0.01, ComTimeoutNotification=ComTimeoutNotification_SG_SAS_oSAS_oVCAN_RADAR_c902864e_Rx, ComFirstTimeout=0.5, ComNotification=ComNotification_SG_SAS_oSAS_oVCAN_RADAR_c902864e_Rx, ComSystemTemplateSignalGroupRef=SG_SAS
          8 x ComGroupSignal, all with ComSignalEndianness=LITTLE_ENDIAN, ComSignalInitValue=0, ComSignalAccess=ACCESS_UNCLEAR:
            SteeringWheelAngleRangeCounter_oSAS_oVCAN_RADAR_5300a9ef_Rx: ComBitPosition=16, ComBitSize=6, ComSignalType=UINT8, ComHandleId=2931, ComSystemTemplateSystemSignalRef=SteeringWheelAngleRangeCounter
            MessageChecksum_oSAS_oVCAN_RADAR_61fa3dc9_Rx: ComBitPosition=60, ComBitSize=4, ComSignalType=UINT8, ComHandleId=2928, ComSystemTemplateSystemSignalRef=MessageChecksum
            SteeringWheelAngleRange_oSAS_oVCAN_RADAR_2ef6c42e_Rx: ComBitPosition=32, ComBitSize=16, ComSignalType=UINT16, ComHandleId=2932, ComSystemTemplateSystemSignalRef=SteeringWheelAngleRange
            SteeringWheelAngle_oSAS_oVCAN_RADAR_17cf9abd_Rx: ComBitPosition=0, ComBitSize=16, ComSignalType=UINT16, ComHandleId=2933, ComSystemTemplateSystemSignalRef=SteeringWheelAngle
            SteeringWheelAngleRangeCounterType_oSAS_oVCAN_RADAR_7889a4bc_Rx: ComBitPosition=22, ComBitSize=2, ComSignalType=UINT8, ComHandleId=2930, ComSystemTemplateSystemSignalRef=SteeringWheelAngleRangeCounterType
            MessageCounter_oSAS_oVCAN_RADAR_bad50fe2_Rx: ComBitPosition=56, ComBitSize=4, ComSignalType=UINT8, ComHandleId=2929, ComSystemTemplateSystemSignalRef=MessageCounter
            ActiveMode_oSAS_oVCAN_RADAR_d0796acb_Rx: ComBitPosition=48, ComBitSize=2, ComSignalDataInvalidValue=3, ComSignalType=UINT8, ComHandleId=2926, ComSystemTemplateSystemSignalRef=ActiveMode
            Calibrated_oSAS_oVCAN_RADAR_ebf0ded0_Rx: ComBitPosition=50, ComBitSize=2, ComSignalDataInvalidValue=3, ComSignalType=UINT8, ComHandleId=2927, ComSystemTemplateSystemSignalRef=Calibrated
      prop_ADAS_MOIS_info_oVCAN_RADAR_f03aed28_Tx (ComIPdu):
        ComIPduDirection = SEND
        ComIPduType = NORMAL
        ComIPduCancellationSupport = false
        ComIPduHandleId = 175
        ComIPduSignalProcessing = DEFERRED
        ComIPduChannelRef = CN_VCAN_RADAR_489180b6
        ComIPduGroupRef = RDR01_oVCAN_RADAR_Tx_0xD0_2361e9dc if post-build-variant-condition{matching-criterion=RDR_POS, value=0}
        ComIPduSignalGroupRef = SG_prop_ADAS_MOIS_info_oprop_ADAS_MOIS_info_oVCAN_RADAR_cb191e50_Tx
        ComPduIdRef = prop_ADAS_MOIS_info_oVCAN_RADAR_f03aed28_Tx
        ComIPduGroupRef = RDR02_oVCAN_RADAR_Tx_0xD0_587f6b3f if post-build-variant-condition{matching-criterion=RDR_POS, value=1}
        ComIPduGroupRef = RDR03_oVCAN_RADAR_Tx_0xD0_c7a5e8a1 if post-build-variant-condition{matching-criterion=RDR_POS, value=2}
        ComIPduGroupRef = RDR04_oVCAN_RADAR_Tx_0xD0_ae426ef9 if post-build-variant-condition{matching-criterion=RDR_POS, value=3}
        ComIPduGroupRef = RDR05_oVCAN_RADAR_Tx_0xD0_3198ed67 if post-build-variant-condition{matching-criterion=RDR_POS, value=4}
        ComIPduGroupRef = RDR06_oVCAN_RADAR_Tx_0xD0_4a866f84 if post-build-variant-condition{matching-criterion=RDR_POS, value=5}
        ComIPduGroupRef = RDR07_oVCAN_RADAR_Tx_0xD0_d55cec1a if post-build-variant-condition{matching-criterion=RDR_POS, value=6}
        ComIPduGroupRef = RDR08_oVCAN_RADAR_Tx_0xD0_99496334 if post-build-variant-condition{matching-criterion=RDR_POS, value=7}
        ComIPduMainFunctionRef = ComMainFunctionTx_Periodic
        ComTxIPdu: ComMinimumDelayTime=0, ComTxIPduUnusedAreasDefault=255
          ComTxModeTrue
            ComTxMode: ComTxModeMode=PERIODIC, ComTxModeTimeOffset=0, ComTxModeTimePeriod=1
          ComTxModeFalse
            ComTxMode: ComTxModeMode=NONE, ComTxModeTimeOffset=0, ComTxModeTimePeriod=1
      GW_prop_ADAS_BSIS_info_oPCAN_RADAR_f2d61fec_Tx (ComIPdu):
        ComIPduDirection = SEND
        ComIPduType = NORMAL
        ComIPduCancellationSupport = false
        ComIPduHandleId = 0
        ComIPduSignalProcessing = DEFERRED
        ComIPduChannelRef = CN_PCAN_RADAR_458ff0f1
        ComIPduGroupRef = RDR01_oPCAN_RADAR_Tx_b6bdb067 if post-build-variant-condition{matching-criterion=RDR_POS, value=0}
        ComIPduSignalGroupRef = SG_GW_prop_ADAS_BSIS_info_oGW_prop_ADAS_BSIS_info_oPCAN_RADAR_e9da8865_Tx
        ComPduIdRef = GW_prop_ADAS_BSIS_info_oPCAN_RADAR_f2d61fec_Tx
        ComIPduGroupRef = RDR02_oPCAN_RADAR_Tx_9f750495 if post-build-variant-condition{matching-criterion=RDR_POS, value=1}
        ComIPduGroupRef = RDR03_oPCAN_RADAR_Tx_311d9504 if post-build-variant-condition{matching-criterion=RDR_POS, value=2}
        ComIPduGroupRef = RDR04_oPCAN_RADAR_Tx_cce46d71 if post-build-variant-condition{matching-criterion=RDR_POS, value=3}
        ComIPduGroupRef = RDR05_oPCAN_RADAR_Tx_628cfce0 if post-build-variant-condition{matching-criterion=RDR_POS, value=4}
        ComIPduGroupRef = RDR06_oPCAN_RADAR_Tx_4b444812 if post-build-variant-condition{matching-criterion=RDR_POS, value=5}
        ComIPduGroupRef = RDR07_oPCAN_RADAR_Tx_e52cd983 if post-build-variant-condition{matching-criterion=RDR_POS, value=6}
        ComIPduGroupRef = RDR08_oPCAN_RADAR_Tx_6bc6beb9 if post-build-variant-condition{matching-criterion=RDR_POS, value=7}
        ComIPduMainFunctionRef = ComMainFunctionTx_Periodic
        ComTxIPdu: ComMinimumDelayTime=0, ComTxIPduUnusedAreasDefault=0
          ComTxModeTrue
            ComTxMode: ComTxModeMode=PERIODIC, ComTxModeTimeOffset=0, ComTxModeTimePeriod=1
          ComTxModeFalse
            ComTxMode: ComTxModeMode=NONE
      9 x ComSignalGroup, all with ComTransferProperty=PENDING:
        SG_GW_VD_oGW_VD_oPCAN_RADAR_ad0f59e4_Rx: ComTimeout=0.1, ComSignalGroupAccess=ACCESS_NEEDED_BY_SWC_OR_COM, ComHandleId=54, ComNotification=ComNotification_SG_GW_VD_oGW_VD_oPCAN_RADAR_ad0f59e4_Rx, ComTimeoutNotification=ComTimeoutNotification_SG_GW_VD_oGW_VD_oPCAN_RADAR_ad0f59e4_Rx, ComFirstTimeout=0.5, ComSystemTemplateSignalGroupRef=SG_GW_VD
          TotalVehicleDistance_oGW_VD_oPCAN_RADAR_55cc86c5_Rx (ComGroupSignal):
            ComBitPosition = 32
            ComBitSize = 32
            ComSignalEndianness = LITTLE_ENDIAN
            ComSignalInitValue = 0
            ComSignalType = UINT32
            ComSignalAccess = ACCESS_UNCLEAR
            ComHandleId = 2921
            ComSystemTemplateSystemSignalRef = TotalVehicleDistance
        SG_Fusion_RadarCapability_oRDR_FUSION_CAPABILITY_oPCAN_RADAR_c3552fd5_Rx: ComSignalGroupArrayAccess=true, ComTimeout=0.05, ComSignalGroupAccess=ACCESS_NEEDED_BY_SWC_OR_COM, ComHandleId=40, ComFirstTimeout=0.5, ComTimeoutNotification=ComTimeoutNotification_SG_Fusion_RadarCapability_oRDR_FUSION_CAPABILITY_oPCAN_RADAR_c3552fd5_Rx, ComNotification=ComNotification_SG_Fusion_RadarCapability_oRDR_FUSION_CAPABILITY_oPCAN_RADAR_c3552fd5_Rx, ComSystemTemplateSignalGroupRef=SG_Fusion_RadarCapability
          31 x ComGroupSignal, all with ComSignalEndianness=LITTLE_ENDIAN, ComSignalInitValue=0, ComSignalAccess=ACCESS_UNCLEAR:
            CAP_FreeSightCheckActive_Rx_oRDR_FUSION_CAPABILITY_oPCAN_RADAR_73e0c0e2_Rx: ComBitPosition=176, ComBitSize=8, ComSignalType=UINT8, ComHandleId=2742, ComSystemTemplateSystemSignalRef=CAP_FreeSightCheckActive_Rx
            CAP_MaxDetRangePedestrian_2_Rx_oRDR_FUSION_CAPABILITY_oPCAN_RADAR_68b6a8b1_Rx: ComBitPosition=153, ComBitSize=9, ComSignalType=UINT16, ComHandleId=2750, ComSystemTemplateSystemSignalRef=CAP_MaxDetRangePedestrian_2_Rx
            CAP_RangeEstimationActive_Rx_oRDR_FUSION_CAPABILITY_oPCAN_RADAR_92caa8b4_Rx: ComBitPosition=31, ComBitSize=1, ComSignalType=BOOLEAN, ComHandleId=2754, ComSystemTemplateSystemSignalRef=CAP_RangeEstimationActive_Rx
            CAP_MaxDetRangePedestrian_1_Rx_oRDR_FUSION_CAPABILITY_oPCAN_RADAR_bb2db44a_Rx: ComBitPosition=135, ComBitSize=9, ComSignalType=UINT16, ComHandleId=2749, ComSystemTemplateSystemSignalRef=CAP_MaxDetRangePedestrian_1_Rx
            CAP_MaxDetectionRangeCar_1_Rx_oRDR_FUSION_CAPABILITY_oPCAN_RADAR_fe65071c_Rx: ComBitPosition=108, ComBitSize=9, ComSignalType=UINT16, ComHandleId=2752, ComSystemTemplateSystemSignalRef=CAP_MaxDetectionRangeCar_1_Rx
            CAP_SLLMonitoringActive_Rx_oRDR_FUSION_CAPABILITY_oPCAN_RADAR_f5cab52b_Rx: ComBitPosition=59, ComBitSize=1, ComSignalType=BOOLEAN, ComHandleId=2758, ComSystemTemplateSystemSignalRef=CAP_SLLMonitoringActive_Rx
            CAP_MH_CRC16_Rx_oRDR_FUSION_CAPABILITY_oPCAN_RADAR_018c523e_Rx: ComBitPosition=0, ComBitSize=16, ComSignalType=UINT16, ComHandleId=2744, ComSystemTemplateSystemSignalRef=CAP_MH_CRC16_Rx
            CAP_SideLobeLevelBeamformer_Rx_oRDR_FUSION_CAPABILITY_oPCAN_RADAR_bb7efd72_Rx: ComBitPosition=168, ComBitSize=8, ComSignalType=UINT8, ComHandleId=2760, ComSystemTemplateSystemSignalRef=CAP_SideLobeLevelBeamformer_Rx
            CAP_SLBlockageFlag_Rx_oRDR_FUSION_CAPABILITY_oPCAN_RADAR_21586390_Rx: ComBitPosition=24, ComBitSize=1, ComSignalType=BOOLEAN, ComHandleId=2757, ComSystemTemplateSystemSignalRef=CAP_SLBlockageFlag_Rx
            CAP_SLBlockageFilterValue_Rx_oRDR_FUSION_CAPABILITY_oPCAN_RADAR_0444b24e_Rx: ComBitPosition=25, ComBitSize=6, ComSignalType=UINT8, ComHandleId=2756, ComSystemTemplateSystemSignalRef=CAP_SLBlockageFilterValue_Rx
            CAP_MaxDetRangePedestrian_0_Rx_oRDR_FUSION_CAPABILITY_oPCAN_RADAR_f5a4bfe3_Rx: ComBitPosition=81, ComBitSize=9, ComSignalType=UINT16, ComHandleId=2748, ComSystemTemplateSystemSignalRef=CAP_MaxDetRangePedestrian_0_Rx
            CAP_DampingStandardDeviation_Rx_oRDR_FUSION_CAPABILITY_oPCAN_RADAR_9a983e87_Rx: ComBitPosition=48, ComBitSize=8, ComSignalType=UINT8, ComHandleId=2740, ComSystemTemplateSystemSignalRef=CAP_DampingStandardDeviation_Rx
            CAP_MaxDetRangeMotorbike_1_Rx_oRDR_FUSION_CAPABILITY_oPCAN_RADAR_5169643b_Rx: ComBitPosition=72, ComBitSize=9, ComSignalType=UINT16, ComHandleId=2746, ComSystemTemplateSystemSignalRef=CAP_MaxDetRangeMotorbike_1_Rx
            CAP_BlockageStatus_Rx_oRDR_FUSION_CAPABILITY_oPCAN_RADAR_bfd94e34_Rx: ComBitPosition=163, ComBitSize=3, ComSignalType=UINT8, ComHandleId=2735, ComSystemTemplateSystemSignalRef=CAP_BlockageStatus_Rx
            CAP_MaxDetectionRangeCar_2_Rx_oRDR_FUSION_CAPABILITY_oPCAN_RADAR_2dfe1be7_Rx: ComBitPosition=117, ComBitSize=9, ComSignalType=UINT16, ComHandleId=2753, ComSystemTemplateSystemSignalRef=CAP_MaxDetectionRangeCar_2_Rx
            CAP_BlockageValue_Rx_oRDR_FUSION_CAPABILITY_oPCAN_RADAR_2053f8c3_Rx: ComBitPosition=184, ComBitSize=3, ComSignalType=UINT8, ComHandleId=2736, ComSystemTemplateSystemSignalRef=CAP_BlockageValue_Rx
            CAP_RangeEstimationStatus_Rx_oRDR_FUSION_CAPABILITY_oPCAN_RADAR_1a8c4664_Rx: ComBitPosition=56, ComBitSize=3, ComSignalType=UINT8, ComHandleId=2755, ComSystemTemplateSystemSignalRef=CAP_RangeEstimationStatus_Rx
            CAP_DampingActive_Rx_oRDR_FUSION_CAPABILITY_oPCAN_RADAR_e5da1c2d_Rx: ComBitPosition=215, ComBitSize=1, ComSignalType=BOOLEAN, ComHandleId=2738, ComSystemTemplateSystemSignalRef=CAP_DampingActive_Rx
            CAP_SLLMonitoringStatus_Rx_oRDR_FUSION_CAPABILITY_oPCAN_RADAR_7d8c5bfb_Rx: ComBitPosition=60, ComBitSize=3, ComSignalType=UINT8, ComHandleId=2759, ComSystemTemplateSystemSignalRef=CAP_SLLMonitoringStatus_Rx
            CAP_AngleAzimuthRangeEnd_Rx_oRDR_FUSION_CAPABILITY_oPCAN_RADAR_8071b245_Rx: ComBitPosition=99, ComBitSize=9, ComSignalType=SINT16, ComHandleId=2730, ComSystemTemplateSystemSignalRef=CAP_AngleAzimuthRangeEnd_Rx
            CAP_MaxDetRangeMotorbike_0_Rx_oRDR_FUSION_CAPABILITY_oPCAN_RADAR_1fe06f92_Rx: ComBitPosition=126, ComBitSize=9, ComSignalType=UINT16, ComHandleId=2745, ComSystemTemplateSystemSignalRef=CAP_MaxDetRangeMotorbike_0_Rx
            CAP_MaxDetRangeMotorbike_2_Rx_oRDR_FUSION_CAPABILITY_oPCAN_RADAR_82f278c0_Rx: ComBitPosition=144, ComBitSize=9, ComSignalType=UINT16, ComHandleId=2747, ComSystemTemplateSystemSignalRef=CAP_MaxDetRangeMotorbike_2_Rx
            CAP_MaxDetectionRangeCar_0_Rx_oRDR_FUSION_CAPABILITY_oPCAN_RADAR_b0ec0cb5_Rx: ComBitPosition=63, ComBitSize=9, ComSignalType=UINT16, ComHandleId=2751, ComSystemTemplateSystemSignalRef=CAP_MaxDetectionRangeCar_0_Rx
            CAP_DampingCurrent_Rx_oRDR_FUSION_CAPABILITY_oPCAN_RADAR_12be9d0c_Rx: ComBitPosition=32, ComBitSize=16, ComSignalType=UINT16, ComHandleId=2739, ComSystemTemplateSystemSignalRef=CAP_DampingCurrent_Rx
            CAP_DampingStatus_Rx_oRDR_FUSION_CAPABILITY_oPCAN_RADAR_6d9cf2fd_Rx: ComBitPosition=187, ComBitSize=3, ComSignalType=UINT8, ComHandleId=2741, ComSystemTemplateSystemSignalRef=CAP_DampingStatus_Rx
            CAP_BlockageProbability_Rx_oRDR_FUSION_CAPABILITY_oPCAN_RADAR_397cd1e8_Rx: ComBitPosition=208, ComBitSize=7, ComSignalType=UINT8, ComHandleId=2733, ComSystemTemplateSystemSignalRef=CAP_BlockageProbability_Rx
            CAP_AngleAzimuthRangeStart_Rx_oRDR_FUSION_CAPABILITY_oPCAN_RADAR_b276ba71_Rx: ComBitPosition=90, ComBitSize=9, ComSignalType=SINT16, ComHandleId=2731, ComSystemTemplateSystemSignalRef=CAP_AngleAzimuthRangeStart_Rx
            CAP_CYCLE_COUNTER_Rx_oRDR_FUSION_CAPABILITY_oPCAN_RADAR_9144c2b9_Rx: ComBitPosition=16, ComBitSize=8, ComSignalType=UINT8, ComHandleId=2737, ComSystemTemplateSystemSignalRef=CAP_CYCLE_COUNTER_Rx
            CAP_FreeSightCheckStatus_Rx_oRDR_FUSION_CAPABILITY_oPCAN_RADAR_fba62e32_Rx: ComBitPosition=192, ComBitSize=8, ComSignalType=UINT8, ComHandleId=2743, ComSystemTemplateSystemSignalRef=CAP_FreeSightCheckStatus_Rx
            CAP_BlockageActive_Rx_oRDR_FUSION_CAPABILITY_oPCAN_RADAR_379fa0e4_Rx: ComBitPosition=162, ComBitSize=1, ComSignalType=BOOLEAN, ComHandleId=2732, ComSystemTemplateSystemSignalRef=CAP_BlockageActive_Rx
            CAP_BlockageSensitivity_Rx_oRDR_FUSION_CAPABILITY_oPCAN_RADAR_8548cf44_Rx: ComBitPosition=200, ComBitSize=8, ComSignalType=UINT8, ComHandleId=2734, ComSystemTemplateSystemSignalRef=CAP_BlockageSensitivity_Rx
        SG_Fusion_AlignmentStatus2_oRDR_FUSION_ALIGNMENT_STATUS_002_oPCAN_RADAR_13cf0319_Rx: ComSignalGroupArrayAccess=true, ComTimeout=0, ComSignalGroupAccess=ACCESS_UNCLEAR, ComHandleId=7, ComSystemTemplateSignalGroupRef=SG_Fusion_AlignmentStatus2
          19 x ComGroupSignal, all with ComSignalEndianness=LITTLE_ENDIAN, ComSignalInitValue=0, ComSignalAccess=ACCESS_UNCLEAR:
            STS_AlignmentServiceStatus_Rx_oRDR_FUSION_ALIGNMENT_STATUS_002_oPCAN_RADAR_96feaa0c_Rx: ComBitPosition=308, ComBitSize=3, ComSignalType=UINT8, ComHandleId=57, ComSystemTemplateSystemSignalRef=STS_AlignmentServiceStatus_Rx
            STS_MeasuredRangeRate_Rx_oRDR_FUSION_ALIGNMENT_STATUS_002_oPCAN_RADAR_62640a65_Rx: ComBitPosition=69, ComBitSize=18, ComSignalType=SINT32, ComHandleId=69, ComSystemTemplateSystemSignalRef=STS_MeasuredRangeRate_Rx
            AL_STS_002_MH_CRC16_Rx_oRDR_FUSION_ALIGNMENT_STATUS_002_oPCAN_RADAR_a0be74d6_Rx: ComBitPosition=0, ComBitSize=16, ComSignalType=UINT16, ComHandleId=56, ComSystemTemplateSystemSignalRef=AL_STS_002_MH_CRC16_Rx
            STS_AlignmentShortTrackStatus_Rx_oRDR_FUSION_ALIGNMENT_STATUS_002_oPCAN_RADAR_4b78fe49_Rx: ComBitPosition=107, ComBitSize=3, ComSignalType=UINT8, ComHandleId=58, ComSystemTemplateSystemSignalRef=STS_AlignmentShortTrackStatus_Rx
            STS_DurationEffective_Rx_oRDR_FUSION_ALIGNMENT_STATUS_002_oPCAN_RADAR_4562e410_Rx: ComBitPosition=272, ComBitSize=32, ComSignalType=UINT32, ComHandleId=65, ComSystemTemplateSystemSignalRef=STS_DurationEffective_Rx
            STS_DistanceAbsolute_Rx_oRDR_FUSION_ALIGNMENT_STATUS_002_oPCAN_RADAR_2fe90afa_Rx: ComBitPosition=112, ComBitSize=32, ComSignalType=UINT32, ComHandleId=62, ComSystemTemplateSystemSignalRef=STS_DistanceAbsolute_Rx
            STS_VehicleCondition_Rx_oRDR_FUSION_ALIGNMENT_STATUS_002_oPCAN_RADAR_4c9d97f7_Rx: ComBitPosition=104, ComBitSize=3, ComSignalType=UINT8, ComHandleId=73, ComSystemTemplateSystemSignalRef=STS_VehicleCondition_Rx
            STS_ImpactByInterference_Rx_oRDR_FUSION_ALIGNMENT_STATUS_002_oPCAN_RADAR_dbc02f0e_Rx: ComBitPosition=307, ComBitSize=1, ComSignalType=BOOLEAN, ComHandleId=66, ComSystemTemplateSystemSignalRef=STS_ImpactByInterference_Rx
            STS_DurationAbsolute_Rx_oRDR_FUSION_ALIGNMENT_STATUS_002_oPCAN_RADAR_ad18ccaf_Rx: ComBitPosition=208, ComBitSize=32, ComSignalType=UINT32, ComHandleId=64, ComSystemTemplateSystemSignalRef=STS_DurationAbsolute_Rx
            STS_Measured_Range_Rx_oRDR_FUSION_ALIGNMENT_STATUS_002_oPCAN_RADAR_b763ef82_Rx: ComBitPosition=312, ComBitSize=14, ComSignalType=UINT16, ComHandleId=72, ComSystemTemplateSystemSignalRef=STS_Measured_Range_Rx
            STS_MeasuredRangeStd_Rx_oRDR_FUSION_ALIGNMENT_STATUS_002_oPCAN_RADAR_79b75936_Rx: ComBitPosition=24, ComBitSize=16, ComSignalType=UINT16, ComHandleId=70, ComSystemTemplateSystemSignalRef=STS_MeasuredRangeStd_Rx
            AL_STS_002_CYCLE_COUNTER_Rx_oRDR_FUSION_ALIGNMENT_STATUS_002_oPCAN_RADAR_88f856d4_Rx: ComBitPosition=16, ComBitSize=8, ComSignalType=UINT8, ComHandleId=55, ComSystemTemplateSystemSignalRef=AL_STS_002_CYCLE_COUNTER_Rx
            STS_AverageSpeed_Rx_oRDR_FUSION_ALIGNMENT_STATUS_002_oPCAN_RADAR_b3b0e615_Rx: ComBitPosition=240, ComBitSize=32, ComSignalType=UINT32, ComHandleId=61, ComSystemTemplateSystemSignalRef=STS_AverageSpeed_Rx
            STS_MeasuredAmpSTD_Rx_oRDR_FUSION_ALIGNMENT_STATUS_002_oPCAN_RADAR_93fa8c9f_Rx: ComBitPosition=88, ComBitSize=15, ComSignalType=UINT16, ComHandleId=67, ComSystemTemplateSystemSignalRef=STS_MeasuredAmpSTD_Rx
            STS_AlignmentStaticStatus_Rx_oRDR_FUSION_ALIGNMENT_STATUS_002_oPCAN_RADAR_bcc15f29_Rx: ComBitPosition=304, ComBitSize=3, ComSignalType=UINT8, ComHandleId=59, ComSystemTemplateSystemSignalRef=STS_AlignmentStaticStatus_Rx
            STS_MeasuredRangeRateStd_Rx_oRDR_FUSION_ALIGNMENT_STATUS_002_oPCAN_RADAR_7ea372f0_Rx: ComBitPosition=40, ComBitSize=16, ComSignalType=SINT16, ComHandleId=68, ComSystemTemplateSystemSignalRef=STS_MeasuredRangeRateStd_Rx
            STS_MeasuredRawAmplitude_Rx_oRDR_FUSION_ALIGNMENT_STATUS_002_oPCAN_RADAR_37a2fd07_Rx: ComBitPosition=56, ComBitSize=13, ComSignalType=SINT16, ComHandleId=71, ComSystemTemplateSystemSignalRef=STS_MeasuredRawAmplitude_Rx
            STS_DistanceEffective_Rx_oRDR_FUSION_ALIGNMENT_STATUS_002_oPCAN_RADAR_5ee1b0ad_Rx: ComBitPosition=176, ComBitSize=32, ComSignalType=UINT32, ComHandleId=63, ComSystemTemplateSystemSignalRef=STS_DistanceEffective_Rx
            STS_AverageNumberOfDetections_Rx_oRDR_FUSION_ALIGNMENT_STATUS_002_oPCAN_RADAR_87939da8_Rx: ComBitPosition=144, ComBitSize=32, ComSignalType=UINT32, ComHandleId=60, ComSystemTemplateSystemSignalRef=STS_AverageNumberOfDetections_Rx
        SG_CLS_Tx_16_oCLS_Tx_16_oVCAN_RADAR_ce7ac5cf_Rx: ComSignalGroupAccess=ACCESS_NEEDED_BY_SWC_OR_COM, ComHandleId=3, ComTimeoutNotification=ComTimeoutNotification_SG_CLS_Tx_16_oCLS_Tx_16_oVCAN_RADAR_ce7ac5cf_Rx, ComTimeout=0.1, ComFirstTimeout=0.5, ComNotification=ComNotification_SG_CLS_Tx_16_oCLS_Tx_16_oVCAN_RADAR_ce7ac5cf_Rx, ComSystemTemplateSignalGroupRef=SG_CLS_Tx_16
          Transmission_type_info_oCLS_Tx_16_oVCAN_RADAR_d6d97de8_Rx (ComGroupSignal):
            ComBitPosition = 41
            ComBitSize = 3
            ComSignalEndianness = LITTLE_ENDIAN
            ComSignalInitValue = 0
            ComSignalType = UINT8
            ComSignalAccess = ACCESS_UNCLEAR
            ComHandleId = 10
            ComSystemTemplateSystemSignalRef = Transmission_type_info
          Crawler_confi_status_info_oCLS_Tx_16_oVCAN_RADAR_9635d3b9_Rx (ComGroupSignal):
            ComBitPosition = 40
            ComBitSize = 1
            ComSignalEndianness = LITTLE_ENDIAN
            ComSignalInitValue = 0
            ComSignalType = BOOLEAN
            ComSignalAccess = ACCESS_UNCLEAR
            ComHandleId = 9
            ComSystemTemplateSystemSignalRef = Crawler_confi_status_info
        SG_GW_ETC2_03_oGW_ETC2_03_oPCAN_RADAR_04d9a8d8_Rx: ComTimeout=0.1, ComSignalGroupAccess=ACCESS_NEEDED_BY_SWC_OR_COM, ComHandleId=48, ComFirstTimeout=0.5, ComNotification=ComNotification_SG_GW_ETC2_03_oGW_ETC2_03_oPCAN_RADAR_04d9a8d8_Rx, ComTimeoutNotification=ComTimeoutNotification_SG_GW_ETC2_03_oGW_ETC2_03_oPCAN_RADAR_04d9a8d8_Rx, ComSystemTemplateSignalGroupRef=SG_GW_ETC2_03
          TransCurrentGear_03_oGW_ETC2_03_oPCAN_RADAR_e4621163_Rx (ComGroupSignal):
            ComBitPosition = 24
            ComBitSize = 8
            ComSignalEndianness = LITTLE_ENDIAN
            ComSignalInitValue = 0
            ComSignalType = UINT8
            ComSignalAccess = ACCESS_UNCLEAR
            ComHandleId = 2896
            ComSystemTemplateSystemSignalRef = TransCurrentGear_03
        SG_GW_CLS_Tx_16_oGW_CLS_Tx_16_oPCAN_RADAR_ecf85999_Rx: ComTimeout=0.1, ComSignalGroupAccess=ACCESS_NEEDED_BY_SWC_OR_COM, ComHandleId=47, ComTimeoutNotification=ComTimeoutNotification_SG_GW_CLS_Tx_16_oGW_CLS_Tx_16_oPCAN_RADAR_ecf85999_Rx, ComFirstTimeout=0.5, ComNotification=ComNotification_SG_GW_CLS_Tx_16_oGW_CLS_Tx_16_oPCAN_RADAR_ecf85999_Rx, ComSystemTemplateSignalGroupRef=SG_GW_CLS_Tx_16
          Crawler_confi_status_info_oGW_CLS_Tx_16_oPCAN_RADAR_698927ba_Rx (ComGroupSignal):
            ComBitPosition = 40
            ComBitSize = 1
            ComSignalEndianness = LITTLE_ENDIAN
            ComSignalInitValue = 0
            ComSignalType = BOOLEAN
            ComSignalAccess = ACCESS_UNCLEAR
            ComHandleId = 2894
            ComSystemTemplateSystemSignalRef = Crawler_confi_status_info
          Transmission_type_info_oGW_CLS_Tx_16_oPCAN_RADAR_9dcf5c49_Rx (ComGroupSignal):
            ComBitPosition = 41
            ComBitSize = 3
            ComSignalEndianness = LITTLE_ENDIAN
            ComSignalInitValue = 0
            ComSignalType = UINT8
            ComSignalAccess = ACCESS_UNCLEAR
            ComHandleId = 2895
            ComSystemTemplateSystemSignalRef = Transmission_type_info
        SG_ETC2_00_oETC2_00_oVCAN_RADAR_efbda90a_Rx: ComSignalGroupAccess=ACCESS_NEEDED_BY_SWC_OR_COM, ComHandleId=4, ComFirstTimeout=0.5, ComTimeout=0.1, ComNotification=ComNotification_SG_ETC2_00_oETC2_00_oVCAN_RADAR_efbda90a_Rx, ComTimeoutNotification=ComTimeoutNotification_SG_ETC2_00_oETC2_00_oVCAN_RADAR_efbda90a_Rx, ComSystemTemplateSignalGroupRef=SG_ETC2_00
          TransCurrentGear_00_oETC2_00_oVCAN_RADAR_3087ec57_Rx (ComGroupSignal):
            ComBitPosition = 24
            ComBitSize = 8
            ComSignalEndianness = LITTLE_ENDIAN
            ComSignalInitValue = 125
            ComSignalType = UINT8
            ComSignalAccess = ACCESS_UNCLEAR
            ComHandleId = 11
            ComSystemTemplateSystemSignalRef = TransCurrentGear_00
        SG_GW_OEL_oGW_OEL_oPCAN_RADAR_dcaa9b38_Rx: ComTimeout=0.1, ComSignalGroupAccess=ACCESS_NEEDED_BY_SWC_OR_COM, ComHandleId=50, ComNotification=ComNotification_SG_GW_OEL_oGW_OEL_oPCAN_RADAR_dcaa9b38_Rx, ComTimeoutNotification=ComTimeoutNotification_SG_GW_OEL_oGW_OEL_oPCAN_RADAR_dcaa9b38_Rx, ComFirstTimeout=0.5, ComSystemTemplateSignalGroupRef=SG_GW_OEL
          3 x ComGroupSignal, all with ComSignalEndianness=LITTLE_ENDIAN, ComSignalInitValue=0, ComSignalType=UINT8, ComSignalAccess=ACCESS_UNCLEAR:
            TurnSignalSwitch_oGW_OEL_oPCAN_RADAR_ae279c7f_Rx: ComBitPosition=8, ComBitSize=4, ComHandleId=2900, ComSystemTemplateSystemSignalRef=TurnSignalSwitch
            HazardLightSwitch_oGW_OEL_oPCAN_RADAR_5efed0a6_Rx: ComBitPosition=12, ComBitSize=2, ComHandleId=2898, ComSystemTemplateSystemSignalRef=HazardLightSwitch
            HighLowBeamSwitch_oGW_OEL_oPCAN_RADAR_5e6caf50_Rx: ComBitPosition=14, ComBitSize=2, ComHandleId=2899, ComSystemTemplateSystemSignalRef=HighLowBeamSwitch
        SG_GW_VI_oGW_VI_oPCAN_RADAR_5c723f37_Rx: ComTimeout=0, ComSignalGroupAccess=ACCESS_UNCLEAR, ComHandleId=55, ComSystemTemplateSignalGroupRef=SG_GW_VI
          VehicleIdentification_oGW_VI_oPCAN_RADAR_d901cf94_Rx (ComGroupSignal):
            ComBitPosition = 0
            ComBitSize = 8
            ComSignalEndianness = LITTLE_ENDIAN
            ComSignalInitValue = 0
            ComSignalType = UINT8
            ComSignalAccess = ACCESS_UNCLEAR
            ComHandleId = 2922
            ComSystemTemplateSystemSignalRef = VehicleIdentification
      RDR_FUSION_ALIGNMENT_STATUS_001_oPCAN_RADAR_5cbb3751_Rx (ComIPdu):
        ComIPduDirection = RECEIVE
        ComIPduType = NORMAL
        ComIPduCancellationSupport = false
        ComIPduHandleId = 19
        ComIPduSignalProcessing = DEFERRED
        ComIPduChannelRef = CN_PCAN_RADAR_458ff0f1
        ComIPduGroupRef = RDR01_oPCAN_RADAR_Rx_e0e717e1 if post-build-variant-condition{matching-criterion=RDR_POS, value=0}
        ComIPduSignalGroupRef = SG_Fusion_AlignmentStatus1_oRDR_FUSION_ALIGNMENT_STATUS_001_oPCAN_RADAR_2e5fc362_Rx
        ComPduIdRef = RDR_FUSION_ALIGNMENT_STATUS_001_oPCAN_RADAR_5cbb3751_Rx
        ComIPduGroupRef = RDR02_oPCAN_RADAR_Rx_c92fa313 if post-build-variant-condition{matching-criterion=RDR_POS, value=1}
        ComIPduGroupRef = RDR03_oPCAN_RADAR_Rx_67473282 if post-build-variant-condition{matching-criterion=RDR_POS, value=2}
        ComIPduGroupRef = RDR04_oPCAN_RADAR_Rx_9abecaf7 if post-build-variant-condition{matching-criterion=RDR_POS, value=3}
        ComIPduGroupRef = RDR05_oPCAN_RADAR_Rx_34d65b66 if post-build-variant-condition{matching-criterion=RDR_POS, value=4}
        ComIPduGroupRef = RDR06_oPCAN_RADAR_Rx_1d1eef94 if post-build-variant-condition{matching-criterion=RDR_POS, value=5}
        ComIPduGroupRef = RDR07_oPCAN_RADAR_Rx_b3767e05 if post-build-variant-condition{matching-criterion=RDR_POS, value=6}
        ComIPduGroupRef = RDR08_oPCAN_RADAR_Rx_3d9c193f if post-build-variant-condition{matching-criterion=RDR_POS, value=7}
        ComIPduMainFunctionRef = ComMainFunctionRx
      4 x ComSignalGroup, all with ComTransferProperty=PENDING, ComSignalGroupAccess=ACCESS_NEEDED_BY_SWC_OR_COM:
        SG_ADAS_FN_Enable_disable_sts_oADAS_FN_Enable_disable_sts_oVCAN_RADAR_46faeb96_Rx: ComHandleId=0, ComTimeoutNotification=ComTimeoutNotification_SG_ADAS_FN_Enable_disable_sts_oADAS_FN_Enable_disable_sts_oVCAN_RADAR_46faeb96_Rx, ComTimeout=0.05, ComNotification=ComNotification_SG_ADAS_FN_Enable_disable_sts_oADAS_FN_Enable_disable_sts_oVCAN_RADAR_46faeb96_Rx, ComFirstTimeout=0.5, ComSystemTemplateSignalGroupRef=SG_ADAS_FN_Enable_disable_sts
          4 x ComGroupSignal, all with ComSignalEndianness=LITTLE_ENDIAN, ComSignalInitValue=0, ComSignalType=UINT8, ComSignalAccess=ACCESS_UNCLEAR:
            BSIS_Fn_Switch_Sts_oADAS_FN_Enable_disable_sts_oVCAN_RADAR_8602f31d_Rx: ComBitPosition=3, ComBitSize=3, ComHandleId=0, ComSystemTemplateSystemSignalRef=BSIS_Fn_Switch_Sts
            MOIS_Fn_Switch_sts_oADAS_FN_Enable_disable_sts_oVCAN_RADAR_ebefa562_Rx: ComBitPosition=0, ComBitSize=3, ComHandleId=1, ComSystemTemplateSystemSignalRef=MOIS_Fn_Switch_sts
            MessageAliveCounter_oADAS_FN_Enable_disable_sts_oVCAN_RADAR_2a6971aa_Rx: ComBitPosition=52, ComBitSize=4, ComHandleId=2, ComSystemTemplateSystemSignalRef=MessageAliveCounter
            MessageCRC_oADAS_FN_Enable_disable_sts_oVCAN_RADAR_332c8084_Rx: ComBitPosition=56, ComBitSize=8, ComHandleId=3, ComSystemTemplateSystemSignalRef=MessageCRC
        SG_GW_CCVS1_oGW_CCVS1_oPCAN_RADAR_70857376_Rx: ComTimeout=0.02, ComHandleId=45, ComTimeoutNotification=ComTimeoutNotification_SG_GW_CCVS1_oGW_CCVS1_oPCAN_RADAR_70857376_Rx, ComNotification=ComNotification_SG_GW_CCVS1_oGW_CCVS1_oPCAN_RADAR_70857376_Rx, ComFirstTimeout=0.5, ComSystemTemplateSignalGroupRef=SG_GW_CCVS1
          3 x ComGroupSignal, all with ComSignalEndianness=LITTLE_ENDIAN, ComSignalInitValue=0, ComSignalAccess=ACCESS_UNCLEAR:
            BrakeSwitch_oGW_CCVS1_oPCAN_RADAR_4705a3bc_Rx: ComBitPosition=28, ComBitSize=2, ComSignalType=UINT8, ComHandleId=2889, ComSystemTemplateSystemSignalRef=BrakeSwitch
            ParkingBrakeSwitch_oGW_CCVS1_oPCAN_RADAR_4cb3f824_Rx: ComBitPosition=2, ComBitSize=2, ComSignalType=UINT8, ComHandleId=2890, ComSystemTemplateSystemSignalRef=ParkingBrakeSwitch
            WheelBasedVehicleSpeed_oGW_CCVS1_oPCAN_RADAR_96f6cac9_Rx: ComBitPosition=8, ComBitSize=16, ComSignalType=UINT16, ComHandleId=2891, ComSystemTemplateSystemSignalRef=WheelBasedVehicleSpeed
        SG_GW_TD_oGW_TD_oPCAN_RADAR_a8a59c34_Rx: ComTimeout=1, ComHandleId=52, ComTimeoutNotification=ComTimeoutNotification_SG_GW_TD_oGW_TD_oPCAN_RADAR_a8a59c34_Rx, ComNotification=ComNotification_SG_GW_TD_oGW_TD_oPCAN_RADAR_a8a59c34_Rx, ComFirstTimeout=0.5, ComSystemTemplateSignalGroupRef=SG_GW_TD
          8 x ComGroupSignal, all with ComBitSize=8, ComSignalEndianness=LITTLE_ENDIAN, ComSignalInitValue=0, ComSignalType=UINT8, ComSignalAccess=ACCESS_UNCLEAR:
            Minutes_oGW_TD_oPCAN_RADAR_f3505ea9_Rx: ComBitPosition=8, ComHandleId=2913, ComSystemTemplateSystemSignalRef=Minutes
            Seconds_oGW_TD_oPCAN_RADAR_930edb8a_Rx: ComBitPosition=0, ComHandleId=2915, ComSystemTemplateSystemSignalRef=Seconds
            Day_oGW_TD_oPCAN_RADAR_5e7337eb_Rx: ComBitPosition=32, ComHandleId=2909, ComSystemTemplateSystemSignalRef=Day
            Month_oGW_TD_oPCAN_RADAR_9592e5da_Rx: ComBitPosition=24, ComHandleId=2914, ComSystemTemplateSystemSignalRef=Month
            Year_oGW_TD_oPCAN_RADAR_0a7d8ada_Rx: ComBitPosition=40, ComHandleId=2916, ComSystemTemplateSystemSignalRef=Year
            LocalMinuteOffset_oGW_TD_oPCAN_RADAR_6576cfca_Rx: ComBitPosition=56, ComHandleId=2912, ComSystemTemplateSystemSignalRef=LocalMinuteOffset
            LocalHourOffset_oGW_TD_oPCAN_RADAR_ed7302cc_Rx: ComBitPosition=48, ComHandleId=2911, ComSystemTemplateSystemSignalRef=LocalHourOffset
            Hours_oGW_TD_oPCAN_RADAR_70f4ea38_Rx: ComBitPosition=16, ComHandleId=2910, ComSystemTemplateSystemSignalRef=Hours
        SG_GW_prop_ADAS_BSIS_info_oGW_prop_ADAS_BSIS_info_oPCAN_RADAR_e9da8865_Tx: ComHandleId=102, ComSignalGroupArrayAccess=true, ComSystemTemplateSignalGroupRef=SG_GW_prop_ADAS_BSIS_info
          BlindSpotCollisionWarningLevel_oGW_prop_ADAS_BSIS_info_oPCAN_RADAR_787ec14f_Tx (ComGroupSignal):
            ComBitPosition = 4
            ComBitSize = 4
            ComSignalEndianness = LITTLE_ENDIAN
            ComSignalInitValue = 0
            ComSignalType = SINT8
            ComTransferProperty = PENDING
            ComSignalAccess = ACCESS_NEEDED_BY_SWC_OR_COM
            ComHandleId = 8361
            ComSystemTemplateSystemSignalRef = BlindSpotCollisionWarningLevel
          BlindSpotDetectionState_oGW_prop_ADAS_BSIS_info_oPCAN_RADAR_c0a7d424_Tx (ComGroupSignal):
            ComBitPosition = 0
            ComBitSize = 4
            ComSignalEndianness = LITTLE_ENDIAN
            ComSignalInitValue = 0
            ComSignalType = SINT8
            ComTransferProperty = PENDING
            ComSignalAccess = ACCESS_NEEDED_BY_SWC_OR_COM
            ComHandleId = 8362
            ComSystemTemplateSystemSignalRef = BlindSpotDetectionState
      RDR_FUSION_STATUS_002_oPCAN_RADAR_36391f53_Rx (ComIPdu):
        ComIPduDirection = RECEIVE
        ComIPduType = NORMAL
        ComIPduCancellationSupport = false
        ComIPduHandleId = 56
        ComIPduSignalProcessing = DEFERRED
        ComIPduChannelRef = CN_PCAN_RADAR_458ff0f1
        ComIPduGroupRef = RDR01_oPCAN_RADAR_Rx_e0e717e1 if post-build-variant-condition{matching-criterion=RDR_POS, value=0}
        ComIPduSignalGroupRef = SG_Fusion_RadarStatus2_oRDR_FUSION_STATUS_002_oPCAN_RADAR_458079fc_Rx
        ComPduIdRef = RDR_FUSION_STATUS_002_oPCAN_RADAR_36391f53_Rx
        ComIPduGroupRef = RDR02_oPCAN_RADAR_Rx_c92fa313 if post-build-variant-condition{matching-criterion=RDR_POS, value=1}
        ComIPduGroupRef = RDR03_oPCAN_RADAR_Rx_67473282 if post-build-variant-condition{matching-criterion=RDR_POS, value=2}
        ComIPduGroupRef = RDR04_oPCAN_RADAR_Rx_9abecaf7 if post-build-variant-condition{matching-criterion=RDR_POS, value=3}
        ComIPduGroupRef = RDR05_oPCAN_RADAR_Rx_34d65b66 if post-build-variant-condition{matching-criterion=RDR_POS, value=4}
        ComIPduGroupRef = RDR06_oPCAN_RADAR_Rx_1d1eef94 if post-build-variant-condition{matching-criterion=RDR_POS, value=5}
        ComIPduGroupRef = RDR07_oPCAN_RADAR_Rx_b3767e05 if post-build-variant-condition{matching-criterion=RDR_POS, value=6}
        ComIPduGroupRef = RDR08_oPCAN_RADAR_Rx_3d9c193f if post-build-variant-condition{matching-criterion=RDR_POS, value=7}
        ComIPduMainFunctionRef = ComMainFunctionRx
      RDR_FUSION_CAPABILITY_oPCAN_RADAR_d81ad430_Rx (ComIPdu):
        ComIPduDirection = RECEIVE
        ComIPduType = NORMAL
        ComIPduCancellationSupport = false
        ComIPduHandleId = 21
        ComIPduSignalProcessing = DEFERRED
        ComIPduChannelRef = CN_PCAN_RADAR_458ff0f1
        ComIPduGroupRef = RDR01_oPCAN_RADAR_Rx_e0e717e1 if post-build-variant-condition{matching-criterion=RDR_POS, value=0}
        ComIPduSignalGroupRef = SG_Fusion_RadarCapability_oRDR_FUSION_CAPABILITY_oPCAN_RADAR_c3552fd5_Rx
        ComPduIdRef = RDR_FUSION_CAPABILITY_oPCAN_RADAR_d81ad430_Rx
        ComIPduGroupRef = RDR02_oPCAN_RADAR_Rx_c92fa313 if post-build-variant-condition{matching-criterion=RDR_POS, value=1}
        ComIPduGroupRef = RDR03_oPCAN_RADAR_Rx_67473282 if post-build-variant-condition{matching-criterion=RDR_POS, value=2}
        ComIPduGroupRef = RDR04_oPCAN_RADAR_Rx_9abecaf7 if post-build-variant-condition{matching-criterion=RDR_POS, value=3}
        ComIPduGroupRef = RDR05_oPCAN_RADAR_Rx_34d65b66 if post-build-variant-condition{matching-criterion=RDR_POS, value=4}
        ComIPduGroupRef = RDR06_oPCAN_RADAR_Rx_1d1eef94 if post-build-variant-condition{matching-criterion=RDR_POS, value=5}
        ComIPduGroupRef = RDR07_oPCAN_RADAR_Rx_b3767e05 if post-build-variant-condition{matching-criterion=RDR_POS, value=6}
        ComIPduGroupRef = RDR08_oPCAN_RADAR_Rx_3d9c193f if post-build-variant-condition{matching-criterion=RDR_POS, value=7}
        ComIPduMainFunctionRef = ComMainFunctionRx
      7 x ComSignalGroup, all with ComTransferProperty=PENDING:
        SG_MOIS_oMOIS_oVCAN_RADAR_f9ec408e_Tx: ComSignalGroupAccess=ACCESS_NEEDED_BY_SWC_OR_COM, ComHandleId=103, ComSignalGroupArrayAccess=true, ComSystemTemplateSignalGroupRef=SG_MOIS
          MOISCollisionWarningLevel_oMOIS_oVCAN_RADAR_c4480988_Tx (ComGroupSignal):
            ComBitPosition = 4
            ComBitSize = 4
            ComSignalEndianness = LITTLE_ENDIAN
            ComSignalInitValue = 0
            ComSignalType = UINT8
            ComTransferProperty = PENDING
            ComSignalAccess = ACCESS_NEEDED_BY_SWC_OR_COM
            ComHandleId = 8363
            ComSystemTemplateSystemSignalRef = MOISCollisionWarningLevel
          MovingObjectDetectionState_oMOIS_oVCAN_RADAR_133b7455_Tx (ComGroupSignal):
            ComBitPosition = 0
            ComBitSize = 4
            ComSignalEndianness = LITTLE_ENDIAN
            ComSignalInitValue = 0
            ComSignalType = UINT8
            ComTransferProperty = PENDING
            ComSignalAccess = ACCESS_NEEDED_BY_SWC_OR_COM
            ComHandleId = 8364
            ComSystemTemplateSystemSignalRef = MovingObjectDetectionState
        SG_Fusion_AlignmentStatus1_oRDR_FUSION_ALIGNMENT_STATUS_001_oPCAN_RADAR_2e5fc362_Rx: ComSignalGroupArrayAccess=true, ComTimeout=1, ComSignalGroupAccess=ACCESS_NEEDED_BY_SWC_OR_COM, ComHandleId=6, ComTimeoutNotification=ComTimeoutNotification_SG_Fusion_AlignmentStatus1_oRDR_FUSION_ALIGNMENT_STATUS_001_oPCAN_RADAR_2e5fc362_Rx, ComNotification=ComNotification_SG_Fusion_AlignmentStatus1_oRDR_FUSION_ALIGNMENT_STATUS_001_oPCAN_RADAR_2e5fc362_Rx, ComFirstTimeout=0.5, ComSystemTemplateSignalGroupRef=SG_Fusion_AlignmentStatus1
          42 x ComGroupSignal, all with ComSignalEndianness=LITTLE_ENDIAN, ComSignalInitValue=0, ComSignalAccess=ACCESS_UNCLEAR:
            STS_AzimuthErrorNegative_Rx_oRDR_FUSION_ALIGNMENT_STATUS_001_oPCAN_RADAR_03e79242_Rx: ComBitPosition=96, ComBitSize=15, ComSignalType=SINT16, ComHandleId=28, ComSystemTemplateSystemSignalRef=STS_AzimuthErrorNegative_Rx
            STS_StartAzimuth_Rx_oRDR_FUSION_ALIGNMENT_STATUS_001_oPCAN_RADAR_3b77c56a_Rx: ComBitPosition=149, ComBitSize=15, ComSignalType=SINT16, ComHandleId=52, ComSystemTemplateSystemSignalRef=STS_StartAzimuth_Rx
            STS_AAElevationStd_Rx_oRDR_FUSION_ALIGNMENT_STATUS_001_oPCAN_RADAR_2f821d5a_Rx: ComBitPosition=257, ComBitSize=14, ComSignalType=UINT16, ComHandleId=19, ComSystemTemplateSystemSignalRef=STS_AAElevationStd_Rx
            STS_AutoAlignmentFailRootCause_Rx_oRDR_FUSION_ALIGNMENT_STATUS_001_oPCAN_RADAR_9bc9d16b_Rx: ComBitPosition=144, ComBitSize=5, ComSignalType=UINT8, ComHandleId=27, ComSystemTemplateSystemSignalRef=STS_AutoAlignmentFailRootCause_Rx
            STS_AzimuthStd_Rx_oRDR_FUSION_ALIGNMENT_STATUS_001_oPCAN_RADAR_3a37c4c6_Rx: ComBitPosition=164, ComBitSize=13, ComSignalType=UINT16, ComHandleId=30, ComSystemTemplateSystemSignalRef=STS_AzimuthStd_Rx
            STS_RollErrorNegative_Rx_oRDR_FUSION_ALIGNMENT_STATUS_001_oPCAN_RADAR_fe114bd3_Rx: ComBitPosition=448, ComBitSize=15, ComSignalType=SINT16, ComHandleId=49, ComSystemTemplateSystemSignalRef=STS_RollErrorNegative_Rx
            STS_AlignmentElevation_Rx_oRDR_FUSION_ALIGNMENT_STATUS_001_oPCAN_RADAR_51af66c3_Rx: ComBitPosition=400, ComBitSize=15, ComSignalType=UINT16, ComHandleId=23, ComSystemTemplateSystemSignalRef=STS_AlignmentElevation_Rx
            STS_ElevationUpdates_Rx_oRDR_FUSION_ALIGNMENT_STATUS_001_oPCAN_RADAR_00e5a516_Rx: ComBitPosition=352, ComBitSize=32, ComSignalType=UINT32, ComHandleId=38, ComSystemTemplateSystemSignalRef=STS_ElevationUpdates_Rx
            STS_AAAzimuthStd_Rx_oRDR_FUSION_ALIGNMENT_STATUS_001_oPCAN_RADAR_e0014852_Rx: ComBitPosition=243, ComBitSize=14, ComSignalType=UINT16, ComHandleId=15, ComSystemTemplateSystemSignalRef=STS_AAAzimuthStd_Rx
            STS_AlignmentModeIn_Rx_oRDR_FUSION_ALIGNMENT_STATUS_001_oPCAN_RADAR_817bfc0d_Rx: ComBitPosition=92, ComBitSize=3, ComSignalType=UINT8, ComHandleId=25, ComSystemTemplateSystemSignalRef=STS_AlignmentModeIn_Rx
            STS_AlignmentModeOut_Rx_oRDR_FUSION_ALIGNMENT_STATUS_001_oPCAN_RADAR_515d8cc1_Rx: ComBitPosition=218, ComBitSize=3, ComSignalType=UINT8, ComHandleId=26, ComSystemTemplateSystemSignalRef=STS_AlignmentModeOut_Rx
            STS_ElevationStd_Rx_oRDR_FUSION_ALIGNMENT_STATUS_001_oPCAN_RADAR_dea14779_Rx: ComBitPosition=111, ComBitSize=13, ComSignalType=UINT16, ComHandleId=37, ComSystemTemplateSystemSignalRef=STS_ElevationStd_Rx
            STS_InitAlignRsltElevationUpdate_Rx_oRDR_FUSION_ALIGNMENT_STATUS_001_oPCAN_RADAR_a120152f_Rx: ComBitPosition=24, ComBitSize=16, ComSignalType=UINT16, ComHandleId=42, ComSystemTemplateSystemSignalRef=STS_InitAlignRsltElevationUpdate_Rx
            STS_InitAlignRsltHostSpdCompFac_Rx_oRDR_FUSION_ALIGNMENT_STATUS_001_oPCAN_RADAR_9cd6c2f3_Rx: ComBitPosition=40, ComBitSize=7, ComSignalType=UINT8, ComHandleId=43, ComSystemTemplateSystemSignalRef=STS_InitAlignRsltHostSpdCompFac_Rx
            AL_STS_001_MH_CRC16_Rx_oRDR_FUSION_ALIGNMENT_STATUS_001_oPCAN_RADAR_c23d08ad_Rx: ComBitPosition=0, ComBitSize=16, ComSignalType=UINT16, ComHandleId=14, ComSystemTemplateSystemSignalRef=AL_STS_001_MH_CRC16_Rx
            STS_CoordinateSystemInput_Rx_oRDR_FUSION_ALIGNMENT_STATUS_001_oPCAN_RADAR_148acc89_Rx: ComBitPosition=59, ComBitSize=2, ComSignalType=UINT8, ComHandleId=34, ComSystemTemplateSystemSignalRef=STS_CoordinateSystemInput_Rx
            STS_CalDisplay_Rx_oRDR_FUSION_ALIGNMENT_STATUS_001_oPCAN_RADAR_989af3fe_Rx: ComBitPosition=95, ComBitSize=1, ComSignalType=BOOLEAN, ComHandleId=32, ComSystemTemplateSystemSignalRef=STS_CalDisplay_Rx
            STS_ElevationErrorNegative_Rx_oRDR_FUSION_ALIGNMENT_STATUS_001_oPCAN_RADAR_3dc2410e_Rx: ComBitPosition=287, ComBitSize=11, ComSignalType=SINT16, ComHandleId=35, ComSystemTemplateSystemSignalRef=STS_ElevationErrorNegative_Rx
            STS_ElevationErrorPositive_Rx_oRDR_FUSION_ALIGNMENT_STATUS_001_oPCAN_RADAR_4db4c7a6_Rx: ComBitPosition=232, ComBitSize=11, ComSignalType=SINT16, ComHandleId=36, ComSystemTemplateSystemSignalRef=STS_ElevationErrorPositive_Rx
            STS_HostSpeedCompensationFactor_Rx_oRDR_FUSION_ALIGNMENT_STATUS_001_oPCAN_RADAR_6d203191_Rx: ComBitPosition=313, ComBitSize=7, ComSignalType=UINT8, ComHandleId=40, ComSystemTemplateSystemSignalRef=STS_HostSpeedCompensationFactor_Rx
            STS_StartElevation_Rx_oRDR_FUSION_ALIGNMENT_STATUS_001_oPCAN_RADAR_5259f244_Rx: ComBitPosition=48, ComBitSize=11, ComSignalType=SINT16, ComHandleId=53, ComSystemTemplateSystemSignalRef=STS_StartElevation_Rx
            STS_AlignmentAzimuth_Rx_oRDR_FUSION_ALIGNMENT_STATUS_001_oPCAN_RADAR_92f72180_Rx: ComBitPosition=384, ComBitSize=15, ComSignalType=UINT16, ComHandleId=22, ComSystemTemplateSystemSignalRef=STS_AlignmentAzimuth_Rx
            STS_ProgressPercent_Rx_oRDR_FUSION_ALIGNMENT_STATUS_001_oPCAN_RADAR_e195d140_Rx: ComBitPosition=136, ComBitSize=7, ComSignalType=UINT8, ComHandleId=47, ComSystemTemplateSystemSignalRef=STS_ProgressPercent_Rx
            STS_InitAlignmentResultElevation_Rx_oRDR_FUSION_ALIGNMENT_STATUS_001_oPCAN_RADAR_6a40b927_Rx: ComBitPosition=298, ComBitSize=14, ComSignalType=SINT16, ComHandleId=45, ComSystemTemplateSystemSignalRef=STS_InitAlignmentResultElevation_Rx
            AL_STS_001_CYCLE_COUNTER_Rx_oRDR_FUSION_ALIGNMENT_STATUS_001_oPCAN_RADAR_c4e7857e_Rx: ComBitPosition=16, ComBitSize=8, ComSignalType=UINT8, ComHandleId=13, ComSystemTemplateSystemSignalRef=AL_STS_001_CYCLE_COUNTER_Rx
            STS_AzimuthErrorPositive_Rx_oRDR_FUSION_ALIGNMENT_STATUS_001_oPCAN_RADAR_739114ea_Rx: ComBitPosition=192, ComBitSize=15, ComSignalType=SINT16, ComHandleId=29, ComSystemTemplateSystemSignalRef=STS_AzimuthErrorPositive_Rx
            STS_AARoll_Std_Rx_oRDR_FUSION_ALIGNMENT_STATUS_001_oPCAN_RADAR_c2a8bede_Rx: ComBitPosition=464, ComBitSize=14, ComSignalType=UINT16, ComHandleId=20, ComSystemTemplateSystemSignalRef=STS_AARoll_Std_Rx
            STS_InitLastSuccessfulAlignMode_Rx_oRDR_FUSION_ALIGNMENT_STATUS_001_oPCAN_RADAR_527c92a9_Rx: ComBitPosition=478, ComBitSize=3, ComSignalType=UINT8, ComHandleId=46, ComSystemTemplateSystemSignalRef=STS_InitLastSuccessfulAlignMode_Rx
            STS_Roll_Updates_Rx_oRDR_FUSION_ALIGNMENT_STATUS_001_oPCAN_RADAR_5eac71d0_Rx: ComBitPosition=416, ComBitSize=32, ComSignalType=UINT32, ComHandleId=51, ComSystemTemplateSystemSignalRef=STS_Roll_Updates_Rx
            STS_AlignmentAutoStatus_Rx_oRDR_FUSION_ALIGNMENT_STATUS_001_oPCAN_RADAR_83b4b0f6_Rx: ComBitPosition=133, ComBitSize=3, ComSignalType=UINT8, ComHandleId=21, ComSystemTemplateSystemSignalRef=STS_AlignmentAutoStatus_Rx
            STS_RollErrorPositive_Rx_oRDR_FUSION_ALIGNMENT_STATUS_001_oPCAN_RADAR_8e67cd7b_Rx: ComBitPosition=221, ComBitSize=10, ComSignalType=SINT16, ComHandleId=50, ComSystemTemplateSystemSignalRef=STS_RollErrorPositive_Rx
            STS_HostSpdCompensationFactorQF_Rx_oRDR_FUSION_ALIGNMENT_STATUS_001_oPCAN_RADAR_fe70a223_Rx: ComBitPosition=61, ComBitSize=2, ComSignalType=UINT8, ComHandleId=39, ComSystemTemplateSystemSignalRef=STS_HostSpdCompensationFactorQF_Rx
            STS_InitAlignmentResultAzimuth_Rx_oRDR_FUSION_ALIGNMENT_STATUS_001_oPCAN_RADAR_d3cdcc54_Rx: ComBitPosition=272, ComBitSize=15, ComSignalType=SINT16, ComHandleId=44, ComSystemTemplateSystemSignalRef=STS_InitAlignmentResultAzimuth_Rx
            STS_RadarTypeInput_Rx_oRDR_FUSION_ALIGNMENT_STATUS_001_oPCAN_RADAR_294e7a2f_Rx: ComBitPosition=124, ComBitSize=3, ComSignalType=UINT8, ComHandleId=48, ComSystemTemplateSystemSignalRef=STS_RadarTypeInput_Rx
            STS_StartRoll_Rx_oRDR_FUSION_ALIGNMENT_STATUS_001_oPCAN_RADAR_2c0c1bdd_Rx: ComBitPosition=496, ComBitSize=15, ComSignalType=SINT16, ComHandleId=54, ComSystemTemplateSystemSignalRef=STS_StartRoll_Rx
            STS_AACurrentElevation_Rx_oRDR_FUSION_ALIGNMENT_STATUS_001_oPCAN_RADAR_7298a7ea_Rx: ComBitPosition=207, ComBitSize=11, ComSignalType=UINT16, ComHandleId=17, ComSystemTemplateSystemSignalRef=STS_AACurrentElevation_Rx
            STS_AlignmentError_Rx_oRDR_FUSION_ALIGNMENT_STATUS_001_oPCAN_RADAR_c93c23de_Rx: ComBitPosition=128, ComBitSize=5, ComSignalType=UINT8, ComHandleId=24, ComSystemTemplateSystemSignalRef=STS_AlignmentError_Rx
            STS_CalTime_Rx_oRDR_FUSION_ALIGNMENT_STATUS_001_oPCAN_RADAR_7a04fce5_Rx: ComBitPosition=80, ComBitSize=12, ComSignalType=UINT16, ComHandleId=33, ComSystemTemplateSystemSignalRef=STS_CalTime_Rx
            STS_InitAlignResultAzimuthUpdate_Rx_oRDR_FUSION_ALIGNMENT_STATUS_001_oPCAN_RADAR_cb93d2df_Rx: ComBitPosition=64, ComBitSize=16, ComSignalType=UINT16, ComHandleId=41, ComSystemTemplateSystemSignalRef=STS_InitAlignResultAzimuthUpdate_Rx
            STS_AzimuthUpdates_Rx_oRDR_FUSION_ALIGNMENT_STATUS_001_oPCAN_RADAR_26fb55fe_Rx: ComBitPosition=320, ComBitSize=32, ComSignalType=UINT32, ComHandleId=31, ComSystemTemplateSystemSignalRef=STS_AzimuthUpdates_Rx
            STS_AACurrentAzimuth_Rx_oRDR_FUSION_ALIGNMENT_STATUS_001_oPCAN_RADAR_3a00fa82_Rx: ComBitPosition=177, ComBitSize=15, ComSignalType=UINT16, ComHandleId=16, ComSystemTemplateSystemSignalRef=STS_AACurrentAzimuth_Rx
            STS_AACurrentRoll_Rx_oRDR_FUSION_ALIGNMENT_STATUS_001_oPCAN_RADAR_590d7e8e_Rx: ComBitPosition=481, ComBitSize=15, ComSignalType=SINT16, ComHandleId=18, ComSystemTemplateSystemSignalRef=STS_AACurrentRoll_Rx
        SG_prop_ADAS_MOIS_info_oprop_ADAS_MOIS_info_oVCAN_RADAR_cb191e50_Tx: ComSignalGroupAccess=ACCESS_NEEDED_BY_SWC_OR_COM, ComHandleId=175, ComSignalGroupArrayAccess=true, ComSystemTemplateSignalGroupRef=SG_prop_ADAS_MOIS_info
          rdn_MOISCollisionWarningLevel_oprop_ADAS_MOIS_info_oVCAN_RADAR_9b3bdf39_Tx (ComGroupSignal):
            ComBitPosition = 4
            ComBitSize = 4
            ComSignalEndianness = LITTLE_ENDIAN
            ComSignalInitValue = 0
            ComSignalType = UINT8
            ComTransferProperty = PENDING
            ComSignalAccess = ACCESS_NEEDED_BY_SWC_OR_COM
            ComHandleId = 11673
            ComSystemTemplateSystemSignalRef = rdn_MOISCollisionWarningLevel
          rdn_MovingObjectDetectionState_oprop_ADAS_MOIS_info_oVCAN_RADAR_f2d3c1fd_Tx (ComGroupSignal):
            ComBitPosition = 0
            ComBitSize = 4
            ComSignalEndianness = LITTLE_ENDIAN
            ComSignalInitValue = 0
            ComSignalType = UINT8
            ComTransferProperty = PENDING
            ComSignalAccess = ACCESS_NEEDED_BY_SWC_OR_COM
            ComHandleId = 11674
            ComSystemTemplateSystemSignalRef = rdn_MovingObjectDetectionState
        SG_VDC2_oVDC2_oVCAN_RADAR_06eddadd_Rx: ComSignalGroupAccess=ACCESS_NEEDED_BY_SWC_OR_COM, ComHandleId=59, ComFirstTimeout=0.5, ComTimeout=0.01, ComTimeoutNotification=ComTimeoutNotification_SG_VDC2_oVDC2_oVCAN_RADAR_06eddadd_Rx, ComNotification=ComNotification_SG_VDC2_oVDC2_oVCAN_RADAR_06eddadd_Rx, ComSystemTemplateSignalGroupRef=SG_VDC2
          4 x ComGroupSignal, all with ComSignalEndianness=LITTLE_ENDIAN, ComSignalAccess=ACCESS_UNCLEAR:
            YawRate_oVDC2_oVCAN_RADAR_bf77bc8a_Rx: ComBitPosition=24, ComBitSize=16, ComSignalInitValue=32113, ComSignalType=UINT16, ComHandleId=2945, ComSystemTemplateSystemSignalRef=YawRate
            LongitudinalAcceleration_oVDC2_oVCAN_RADAR_f355ad7e_Rx: ComBitPosition=56, ComBitSize=8, ComSignalInitValue=125, ComSignalType=UINT8, ComHandleId=2943, ComSystemTemplateSystemSignalRef=LongitudinalAcceleration
            LateralAcceleration_oVDC2_oVCAN_RADAR_b3e7a398_Rx: ComBitPosition=40, ComBitSize=16, ComSignalInitValue=32127, ComSignalType=UINT16, ComHandleId=2942, ComSystemTemplateSystemSignalRef=LateralAcceleration
            SteerWheelAngle_oVDC2_oVCAN_RADAR_c890bb33_Rx: ComBitPosition=0, ComBitSize=16, ComSignalInitValue=32127, ComSignalType=UINT16, ComHandleId=2944, ComSystemTemplateSystemSignalRef=SteerWheelAngle
        SG_VI_oVI_oVCAN_RADAR_7241e1af_Rx: ComSignalGroupAccess=ACCESS_UNCLEAR, ComHandleId=61, ComSystemTemplateSignalGroupRef=SG_VI
          VehicleIdentification_oVI_oVCAN_RADAR_4b86485f_Rx (ComGroupSignal):
            ComBitPosition = 0
            ComBitSize = 8
            ComSignalEndianness = LITTLE_ENDIAN
            ComSignalInitValue = 0
            ComSignalType = UINT8
            ComSignalAccess = ACCESS_UNCLEAR
            ComHandleId = 2947
            ComSystemTemplateSystemSignalRef = VehicleIdentification
        SG_OEL_oOEL_oVCAN_RADAR_400a2f4d_Rx: ComSignalGroupAccess=ACCESS_NEEDED_BY_SWC_OR_COM, ComHandleId=56, ComFirstTimeout=0.5, ComNotification=ComNotification_SG_OEL_oOEL_oVCAN_RADAR_400a2f4d_Rx, ComTimeout=0.1, ComTimeoutNotification=ComTimeoutNotification_SG_OEL_oOEL_oVCAN_RADAR_400a2f4d_Rx, ComSystemTemplateSignalGroupRef=SG_OEL
          3 x ComGroupSignal, all with ComSignalEndianness=LITTLE_ENDIAN, ComSignalInitValue=0, ComSignalType=UINT8, ComSignalAccess=ACCESS_UNCLEAR:
            TurnSignalSwitch_oOEL_oVCAN_RADAR_e6019fee_Rx: ComBitPosition=8, ComBitSize=4, ComHandleId=2925, ComSystemTemplateSystemSignalRef=TurnSignalSwitch
            HazardLightSwitch_oOEL_oVCAN_RADAR_6e3514e2_Rx: ComBitPosition=12, ComBitSize=2, ComHandleId=2923, ComSystemTemplateSystemSignalRef=HazardLightSwitch
            HighLowBeamSwitch_oOEL_oVCAN_RADAR_71269e88_Rx: ComBitPosition=14, ComBitSize=2, ComHandleId=2924, ComSystemTemplateSystemSignalRef=HighLowBeamSwitch
        SG_GW_CLS_Tx_4_oGW_CLS_Tx_4_oPCAN_RADAR_474ec459_Rx: ComTimeout=0.1, ComSignalGroupAccess=ACCESS_NEEDED_BY_SWC_OR_COM, ComHandleId=46, ComFirstTimeout=0.5, ComNotification=ComNotification_SG_GW_CLS_Tx_4_oGW_CLS_Tx_4_oPCAN_RADAR_474ec459_Rx, ComTimeoutNotification=ComTimeoutNotification_SG_GW_CLS_Tx_4_oGW_CLS_Tx_4_oPCAN_RADAR_474ec459_Rx, ComSystemTemplateSignalGroupRef=SG_GW_CLS_Tx_4
          ReverseSwitchInfo_oGW_CLS_Tx_4_oPCAN_RADAR_82207cae_Rx (ComGroupSignal):
            ComBitPosition = 28
            ComBitSize = 2
            ComSignalEndianness = LITTLE_ENDIAN
            ComSignalInitValue = 0
            ComSignalType = UINT8
            ComSignalAccess = ACCESS_UNCLEAR
            ComHandleId = 2893
            ComSystemTemplateSystemSignalRef = ReverseSwitchInfo
          Ignition_oGW_CLS_Tx_4_oPCAN_RADAR_6b7ac456_Rx (ComGroupSignal):
            ComBitPosition = 32
            ComBitSize = 2
            ComSignalEndianness = LITTLE_ENDIAN
            ComSignalInitValue = 0
            ComSignalType = UINT8
            ComSignalAccess = ACCESS_UNCLEAR
            ComHandleId = 2892
            ComSystemTemplateSystemSignalRef = Ignition
      28 x ComIPduGroup:
        RDR02_oPCAN_RADAR_Tx_9f750495: ComIPduGroupHandleId=1, variation-point=post-build-variant-condition{matching-criterion=RDR_POS, value=1}
        RDR02_oPCAN_RADAR_Rx_c92fa313: ComIPduGroupHandleId=0, variation-point=post-build-variant-condition{matching-criterion=RDR_POS, value=1}
        RDR02_oVCAN_RADAR_Tx_0xD0_587f6b3f: ComIPduGroupHandleId=3, variation-point=post-build-variant-condition{matching-criterion=RDR_POS, value=1}
        RDR02_oVCAN_RADAR_Rx_BC_d6312b45: ComIPduGroupHandleId=2, variation-point=post-build-variant-condition{matching-criterion=RDR_POS, value=1}
        RDR03_oPCAN_RADAR_Rx_67473282: ComIPduGroupHandleId=0, variation-point=post-build-variant-condition{matching-criterion=RDR_POS, value=2}
        RDR03_oPCAN_RADAR_Tx_311d9504: ComIPduGroupHandleId=1, variation-point=post-build-variant-condition{matching-criterion=RDR_POS, value=2}
        RDR03_oVCAN_RADAR_Tx_0xD0_c7a5e8a1: ComIPduGroupHandleId=3, variation-point=post-build-variant-condition{matching-criterion=RDR_POS, value=2}
        RDR03_oVCAN_RADAR_Rx_BC_01d3ab1d: ComIPduGroupHandleId=2, variation-point=post-build-variant-condition{matching-criterion=RDR_POS, value=2}
        RDR04_oPCAN_RADAR_Rx_9abecaf7: ComIPduGroupHandleId=0, variation-point=post-build-variant-condition{matching-criterion=RDR_POS, value=3}
        RDR04_oPCAN_RADAR_Tx_cce46d71: ComIPduGroupHandleId=1, variation-point=post-build-variant-condition{matching-criterion=RDR_POS, value=3}
        RDR04_oVCAN_RADAR_Tx_0xD0_ae426ef9: ComIPduGroupHandleId=3, variation-point=post-build-variant-condition{matching-criterion=RDR_POS, value=3}
        RDR04_oVCAN_RADAR_Rx_BC_4bed2056: ComIPduGroupHandleId=2, variation-point=post-build-variant-condition{matching-criterion=RDR_POS, value=3}
        RDR05_oPCAN_RADAR_Rx_34d65b66: ComIPduGroupHandleId=0, variation-point=post-build-variant-condition{matching-criterion=RDR_POS, value=4}
        RDR05_oPCAN_RADAR_Tx_628cfce0: ComIPduGroupHandleId=1, variation-point=post-build-variant-condition{matching-criterion=RDR_POS, value=4}
        RDR05_oVCAN_RADAR_Rx_BC_9c0fa00e: ComIPduGroupHandleId=2, variation-point=post-build-variant-condition{matching-criterion=RDR_POS, value=4}
        RDR05_oVCAN_RADAR_Tx_0xD0_3198ed67: ComIPduGroupHandleId=3, variation-point=post-build-variant-condition{matching-criterion=RDR_POS, value=4}
        RDR06_oPCAN_RADAR_Rx_1d1eef94: ComIPduGroupHandleId=0, variation-point=post-build-variant-condition{matching-criterion=RDR_POS, value=5}
        RDR06_oPCAN_RADAR_Tx_4b444812: ComIPduGroupHandleId=1, variation-point=post-build-variant-condition{matching-criterion=RDR_POS, value=5}
        RDR06_oVCAN_RADAR_Tx_0xD0_4a866f84: ComIPduGroupHandleId=3, variation-point=post-build-variant-condition{matching-criterion=RDR_POS, value=5}
        RDR06_oVCAN_RADAR_Rx_BC_3f5926a7: ComIPduGroupHandleId=2, variation-point=post-build-variant-condition{matching-criterion=RDR_POS, value=5}
        RDR07_oPCAN_RADAR_Tx_e52cd983: ComIPduGroupHandleId=1, variation-point=post-build-variant-condition{matching-criterion=RDR_POS, value=6}
        RDR07_oPCAN_RADAR_Rx_b3767e05: ComIPduGroupHandleId=0, variation-point=post-build-variant-condition{matching-criterion=RDR_POS, value=6}
        RDR07_oVCAN_RADAR_Rx_BC_e8bba6ff: ComIPduGroupHandleId=2, variation-point=post-build-variant-condition{matching-criterion=RDR_POS, value=6}
        RDR07_oVCAN_RADAR_Tx_0xD0_d55cec1a: ComIPduGroupHandleId=3, variation-point=post-build-variant-condition{matching-criterion=RDR_POS, value=6}
        RDR08_oPCAN_RADAR_Rx_3d9c193f: ComIPduGroupHandleId=0, variation-point=post-build-variant-condition{matching-criterion=RDR_POS, value=7}
        RDR08_oPCAN_RADAR_Tx_6bc6beb9: ComIPduGroupHandleId=1, variation-point=post-build-variant-condition{matching-criterion=RDR_POS, value=7}
        RDR08_oVCAN_RADAR_Tx_0xD0_99496334: ComIPduGroupHandleId=3, variation-point=post-build-variant-condition{matching-criterion=RDR_POS, value=7}
        RDR08_oVCAN_RADAR_Rx_BC_ab243031: ComIPduGroupHandleId=2, variation-point=post-build-variant-condition{matching-criterion=RDR_POS, value=7}
    ComGeneral:
      ComConfigurationUseDet = true
      ComEnableSignalGroupArrayApi = true
      ComMetaDataSupport = false
      ComRetryFailedTransmitRequests = false
      ComVersionInfoApi = false
      ComSafeBswChecks = true
      ComDescriptionGateway = false
      ComStrictRepetitionPeriod = false
      ComMixedModePeriodicSuppression = false
      ComSignalGateway = NONE
      ComMultiPartition = false
      ComUserCbkHeaderFile = Appl_Cbk.h
