[part 12 of 20: package /ActiveEcuC]
AUTOSAR XML (schema 00053)
package /ActiveEcuC  (continued)
  module config Com: implementation-config-variant=VARIANT-PRE-COMPILE, module-description=Com_Impl  (continued)
    ComConfig: ComConfigurationId=0, ComRxImmediateNotificationCacheSize=0, ComRxDeferredNotificationCacheSize=1  (continued)
      109 x ComSignalGroup, all with ComSignalGroupAccess=ACCESS_NEEDED_BY_SWC_OR_COM, ComSignalGroupArrayAccess=true:  (continued)
        SG_Detections_121_124_oRDR_DETECTION_121_124_oPCAN_RADAR_a895174b_Tx: ComTransferProperty=TRIGGERED, ComHandleId=32, ComSystemTemplateSignalGroupRef=SG_Detections_121_124
          83 x ComGroupSignal, all with ComSignalEndianness=LITTLE_ENDIAN, ComTransferProperty=PENDING, ComSignalAccess=ACCESS_NEEDED_BY_SWC_OR_COM:
            DET_SUPER_RES_TARGET_122_oRDR_DETECTION_121_124_oPCAN_RADAR_734d6519_Tx: ComBitPosition=199, ComBitSize=1, ComSignalInitValue=0, ComSignalType=BOOLEAN, ComHandleId=2631, ComSystemTemplateSystemSignalRef=DET_SUPER_RES_TARGET_122
            DET_ELEVATION_122_oRDR_DETECTION_121_124_oPCAN_RADAR_ac7440b6_Tx: ComBitPosition=184, ComBitSize=8, ComSignalInitValue=0, ComSignalType=UINT8, ComHandleId=2576, ComSystemTemplateSystemSignalRef=DET_ELEVATION_122
            DET_ELEVATION_ERR_121_oRDR_DETECTION_121_124_oPCAN_RADAR_4fada33d_Tx: ComBitPosition=80, ComBitSize=6, ComSignalInitValue=0, ComSignalType=UINT8, ComHandleId=2579, ComSystemTemplateSystemSignalRef=DET_ELEVATION_ERR_121
            DET_EXISTENCE_PROB_122_oRDR_DETECTION_121_124_oPCAN_RADAR_f9d2ada3_Tx: ComBitPosition=224, ComBitSize=6, ComSignalInitValue=0, ComSignalType=UINT8, ComHandleId=2584, ComSystemTemplateSystemSignalRef=DET_EXISTENCE_PROB_122
            DET_EXISTENCE_PROB_124_oRDR_DETECTION_121_124_oPCAN_RADAR_30125a5f_Tx: ComBitPosition=448, ComBitSize=6, ComSignalInitValue=0, ComSignalType=UINT8, ComHandleId=2586, ComSystemTemplateSystemSignalRef=DET_EXISTENCE_PROB_124
            DET_SUPER_RES_TARGET_121_oRDR_DETECTION_121_124_oPCAN_RADAR_17ad1ee7_Tx: ComBitPosition=87, ComBitSize=1, ComSignalInitValue=0, ComSignalType=BOOLEAN, ComHandleId=2630, ComSystemTemplateSystemSignalRef=DET_SUPER_RES_TARGET_121
            DET_RANGE_122_oRDR_DETECTION_121_124_oPCAN_RADAR_6d5cec01_Tx: ComBitPosition=136, ComBitSize=15, ComSignalInitValue=0, ComSignalType=UINT16, ComHandleId=2607, ComSystemTemplateSystemSignalRef=DET_RANGE_122
            DET_MH_CYCLE_COUNTER_121_124_oRDR_DETECTION_121_124_oPCAN_RADAR_a8686477_Tx: ComBitPosition=16, ComBitSize=8, ComSignalInitValue=0, ComSignalType=UINT8, ComHandleId=2596, ComSystemTemplateSystemSignalRef=DET_MH_CYCLE_COUNTER_121_124
            DET_AZIMUTH_123_oRDR_DETECTION_121_124_oPCAN_RADAR_e8b74b2f_Tx: ComBitPosition=312, ComBitSize=13, ComSignalInitValue=0, ComSignalType=UINT16, ComHandleId=2553, ComSystemTemplateSystemSignalRef=DET_AZIMUTH_123
            DET_BI_STATIC_FLAG_124_oRDR_DETECTION_121_124_oPCAN_RADAR_e22b28c3_Tx: ComBitPosition=440, ComBitSize=1, ComSignalInitValue=0, ComSignalType=BOOLEAN, ComHandleId=2566, ComSystemTemplateSystemSignalRef=DET_BI_STATIC_FLAG_124
            DET_BI_STATIC_FLAG_122_oRDR_DETECTION_121_124_oPCAN_RADAR_2bebdf3f_Tx: ComBitPosition=216, ComBitSize=1, ComSignalInitValue=0, ComSignalType=BOOLEAN, ComHandleId=2564, ComSystemTemplateSystemSignalRef=DET_BI_STATIC_FLAG_122
            DET_CONFD_AZIMUTH_123_oRDR_DETECTION_121_124_oPCAN_RADAR_ea5141e5_Tx: ComBitPosition=342, ComBitSize=2, ComSignalInitValue=0, ComSignalType=UINT8, ComHandleId=2569, ComSystemTemplateSystemSignalRef=DET_CONFD_AZIMUTH_123
            DET_SNR_124_oRDR_DETECTION_121_124_oPCAN_RADAR_8b14ba80_Tx: ComBitPosition=456, ComBitSize=8, ComSignalInitValue=0, ComSignalType=UINT8, ComHandleId=2629, ComSystemTemplateSystemSignalRef=DET_SNR_124
            DET_SUPER_RES_TARGET_123_oRDR_DETECTION_121_124_oPCAN_RADAR_e63db18c_Tx: ComBitPosition=311, ComBitSize=1, ComSignalInitValue=0, ComSignalType=BOOLEAN, ComHandleId=2632, ComSystemTemplateSystemSignalRef=DET_SUPER_RES_TARGET_123
            DET_ELEVATION_124_oRDR_DETECTION_121_124_oPCAN_RADAR_65b4b74a_Tx: ComBitPosition=408, ComBitSize=8, ComSignalInitValue=0, ComSignalType=UINT8, ComHandleId=2578, ComSystemTemplateSystemSignalRef=DET_ELEVATION_124
            DET_EXISTENCE_PROB_123_oRDR_DETECTION_121_124_oPCAN_RADAR_6ca27936_Tx: ComBitPosition=336, ComBitSize=6, ComSignalInitValue=0, ComSignalType=UINT8, ComHandleId=2585, ComSystemTemplateSystemSignalRef=DET_EXISTENCE_PROB_123
            DET_AZIMUTH_ERR_122_oRDR_DETECTION_121_124_oPCAN_RADAR_d9720a4f_Tx: ComBitPosition=217, ComBitSize=7, ComSignalInitValue=0, ComSignalType=UINT8, ComHandleId=2556, ComSystemTemplateSystemSignalRef=DET_AZIMUTH_ERR_122
            DET_SNR_123_oRDR_DETECTION_121_124_oPCAN_RADAR_d7a499e9_Tx: ComBitPosition=344, ComBitSize=8, ComSignalInitValue=0, ComSignalType=UINT8, ComHandleId=2628, ComSystemTemplateSystemSignalRef=DET_SNR_123
            DET_SUPER_RES_TARGET_124_oRDR_DETECTION_121_124_oPCAN_RADAR_ba8d92e5_Tx: ComBitPosition=423, ComBitSize=1, ComSignalInitValue=0, ComSignalType=BOOLEAN, ComHandleId=2633, ComSystemTemplateSystemSignalRef=DET_SUPER_RES_TARGET_124
            DET_CONFD_AZIMUTH_124_oRDR_DETECTION_121_124_oPCAN_RADAR_b6e1628c_Tx: ComBitPosition=454, ComBitSize=2, ComSignalInitValue=0, ComSignalType=UINT8, ComHandleId=2570, ComSystemTemplateSystemSignalRef=DET_CONFD_AZIMUTH_124
            DET_RANGE_VELOCITY_ERR_121_oRDR_DETECTION_121_124_oPCAN_RADAR_73a1ae68_Tx: ComBitPosition=64, ComBitSize=8, ComSignalInitValue=0, ComSignalType=UINT8, ComHandleId=2618, ComSystemTemplateSystemSignalRef=DET_RANGE_VELOCITY_ERR_121
            DET_RANGE_123_oRDR_DETECTION_121_124_oPCAN_RADAR_f82c3894_Tx: ComBitPosition=248, ComBitSize=15, ComSignalInitValue=0, ComSignalType=UINT16, ComHandleId=2608, ComSystemTemplateSystemSignalRef=DET_RANGE_123
            DET_RANGE_VELOCITY_123_oRDR_DETECTION_121_124_oPCAN_RADAR_8d8afab1_Tx: ComBitPosition=272, ComBitSize=15, ComSignalInitValue=16384, ComSignalType=UINT16, ComHandleId=2616, ComSystemTemplateSystemSignalRef=DET_RANGE_VELOCITY_123
            DET_RANGE_ERR_124_oRDR_DETECTION_121_124_oPCAN_RADAR_0374a194_Tx: ComBitPosition=376, ComBitSize=7, ComSignalInitValue=0, ComSignalType=UINT8, ComHandleId=2613, ComSystemTemplateSystemSignalRef=DET_RANGE_ERR_124
            DET_AZIMUTH_ERR_123_oRDR_DETECTION_121_124_oPCAN_RADAR_4c02deda_Tx: ComBitPosition=329, ComBitSize=7, ComSignalInitValue=0, ComSignalType=UINT8, ComHandleId=2557, ComSystemTemplateSystemSignalRef=DET_AZIMUTH_ERR_123
            DET_CONFD_ELEVATION_121_oRDR_DETECTION_121_124_oPCAN_RADAR_1954ef74_Tx: ComBitPosition=101, ComBitSize=2, ComSignalInitValue=0, ComSignalType=UINT8, ComHandleId=2571, ComSystemTemplateSystemSignalRef=DET_CONFD_ELEVATION_121
            DET_ELEVATION_123_oRDR_DETECTION_121_124_oPCAN_RADAR_39049423_Tx: ComBitPosition=296, ComBitSize=8, ComSignalInitValue=0, ComSignalType=UINT8, ComHandleId=2577, ComSystemTemplateSystemSignalRef=DET_ELEVATION_123
            DET_ELEVATION_ERR_124_oRDR_DETECTION_121_124_oPCAN_RADAR_e28d2f3f_Tx: ComBitPosition=416, ComBitSize=6, ComSignalInitValue=0, ComSignalType=UINT8, ComHandleId=2582, ComSystemTemplateSystemSignalRef=DET_ELEVATION_ERR_124
            DET_RANGE_ERR_123_oRDR_DETECTION_121_124_oPCAN_RADAR_5fc482fd_Tx: ComBitPosition=264, ComBitSize=7, ComSignalInitValue=0, ComSignalType=UINT8, ComHandleId=2612, ComSystemTemplateSystemSignalRef=DET_RANGE_ERR_123
            DET_CONFD_ELEVATION_122_oRDR_DETECTION_121_124_oPCAN_RADAR_7db4948a_Tx: ComBitPosition=213, ComBitSize=2, ComSignalInitValue=0, ComSignalType=UINT8, ComHandleId=2572, ComSystemTemplateSystemSignalRef=DET_CONFD_ELEVATION_122
            DET_ELEVATION_ERR_122_oRDR_DETECTION_121_124_oPCAN_RADAR_2b4dd8c3_Tx: ComBitPosition=192, ComBitSize=6, ComSignalInitValue=0, ComSignalType=UINT8, ComHandleId=2580, ComSystemTemplateSystemSignalRef=DET_ELEVATION_ERR_122
            DET_RANGE_121_oRDR_DETECTION_121_124_oPCAN_RADAR_09bc97ff_Tx: ComBitPosition=24, ComBitSize=15, ComSignalInitValue=0, ComSignalType=UINT16, ComHandleId=2606, ComSystemTemplateSystemSignalRef=DET_RANGE_121
            DET_BI_STATIC_FLAG_121_oRDR_DETECTION_121_124_oPCAN_RADAR_4f0ba4c1_Tx: ComBitPosition=104, ComBitSize=1, ComSignalInitValue=0, ComSignalType=BOOLEAN, ComHandleId=2563, ComSystemTemplateSystemSignalRef=DET_BI_STATIC_FLAG_121
            DET_MH_SCAN_INDEX_4LSB_121_124_oRDR_DETECTION_121_124_oPCAN_RADAR_644241fb_Tx: ComBitPosition=476, ComBitSize=4, ComSignalInitValue=0, ComSignalType=UINT8, ComHandleId=2597, ComSystemTemplateSystemSignalRef=DET_MH_SCAN_INDEX_4LSB_121_124
            DET_RCS_122_oRDR_DETECTION_121_124_oPCAN_RADAR_9f7a197e_Tx: ComBitPosition=240, ComBitSize=8, ComSignalInitValue=128, ComSignalType=UINT8, ComHandleId=2623, ComSystemTemplateSystemSignalRef=DET_RCS_122
            DET_CONFD_ELEVATION_124_oRDR_DETECTION_121_124_oPCAN_RADAR_b4746376_Tx: ComBitPosition=437, ComBitSize=2, ComSignalInitValue=0, ComSignalType=UINT8, ComHandleId=2574, ComSystemTemplateSystemSignalRef=DET_CONFD_ELEVATION_124
            DET_AZIMUTH_ERR_124_oRDR_DETECTION_121_124_oPCAN_RADAR_10b2fdb3_Tx: ComBitPosition=441, ComBitSize=7, ComSignalInitValue=0, ComSignalType=UINT8, ComHandleId=2558, ComSystemTemplateSystemSignalRef=DET_AZIMUTH_ERR_124
            DET_RANGE_VELOCITY_ERR_123_oRDR_DETECTION_121_124_oPCAN_RADAR_82310103_Tx: ComBitPosition=288, ComBitSize=8, ComSignalInitValue=0, ComSignalType=UINT8, ComHandleId=2620, ComSystemTemplateSystemSignalRef=DET_RANGE_VELOCITY_ERR_123
            DET_RANGE_VELOCITY_124_oRDR_DETECTION_121_124_oPCAN_RADAR_d13ad9d8_Tx: ComBitPosition=384, ComBitSize=15, ComSignalInitValue=16384, ComSignalType=UINT16, ComHandleId=2617, ComSystemTemplateSystemSignalRef=DET_RANGE_VELOCITY_124
            DET_CONFD_AZIMUTH_122_oRDR_DETECTION_121_124_oPCAN_RADAR_7f219570_Tx: ComBitPosition=230, ComBitSize=2, ComSignalInitValue=0, ComSignalType=UINT8, ComHandleId=2568, ComSystemTemplateSystemSignalRef=DET_CONFD_AZIMUTH_122
            DET_AZIMUTH_124_oRDR_DETECTION_121_124_oPCAN_RADAR_b4076846_Tx: ComBitPosition=424, ComBitSize=13, ComSignalInitValue=0, ComSignalType=UINT16, ComHandleId=2554, ComSystemTemplateSystemSignalRef=DET_AZIMUTH_124
            DET_RANGE_ERR_121_oRDR_DETECTION_121_124_oPCAN_RADAR_ae542d96_Tx: ComBitPosition=40, ComBitSize=7, ComSignalInitValue=0, ComSignalType=UINT8, ComHandleId=2610, ComSystemTemplateSystemSignalRef=DET_RANGE_ERR_121
            DET_CONFD_AZIMUTH_121_oRDR_DETECTION_121_124_oPCAN_RADAR_1bc1ee8e_Tx: ComBitPosition=118, ComBitSize=2, ComSignalInitValue=0, ComSignalType=UINT8, ComHandleId=2567, ComSystemTemplateSystemSignalRef=DET_CONFD_AZIMUTH_121
            DET_BI_STATIC_FLAG_123_oRDR_DETECTION_121_124_oPCAN_RADAR_be9b0baa_Tx: ComBitPosition=328, ComBitSize=1, ComSignalInitValue=0, ComSignalType=BOOLEAN, ComHandleId=2565, ComSystemTemplateSystemSignalRef=DET_BI_STATIC_FLAG_123
            DET_RANGE_VELOCITY_ERR_124_oRDR_DETECTION_121_124_oPCAN_RADAR_de81226a_Tx: ComBitPosition=400, ComBitSize=8, ComSignalInitValue=0, ComSignalType=UINT8, ComHandleId=2621, ComSystemTemplateSystemSignalRef=DET_RANGE_VELOCITY_ERR_124
            DET_RANGE_VELOCITY_ERR_122_oRDR_DETECTION_121_124_oPCAN_RADAR_1741d596_Tx: ComBitPosition=176, ComBitSize=8, ComSignalInitValue=0, ComSignalType=UINT8, ComHandleId=2619, ComSystemTemplateSystemSignalRef=DET_RANGE_VELOCITY_ERR_122
            DET_AZIMUTH_ERR_121_oRDR_DETECTION_121_124_oPCAN_RADAR_bd9271b1_Tx: ComBitPosition=105, ComBitSize=7, ComSignalInitValue=0, ComSignalType=UINT8, ComHandleId=2555, ComSystemTemplateSystemSignalRef=DET_AZIMUTH_ERR_121
            DET_HVC_FLAG_122_oRDR_DETECTION_121_124_oPCAN_RADAR_18a6eedc_Tx: ComBitPosition=198, ComBitSize=1, ComSignalInitValue=0, ComSignalType=BOOLEAN, ComHandleId=2588, ComSystemTemplateSystemSignalRef=DET_HVC_FLAG_122
            DET_ELEVATION_121_oRDR_DETECTION_121_124_oPCAN_RADAR_c8943b48_Tx: ComBitPosition=72, ComBitSize=8, ComSignalInitValue=0, ComSignalType=UINT8, ComHandleId=2575, ComSystemTemplateSystemSignalRef=DET_ELEVATION_121
            DET_SNR_122_oRDR_DETECTION_121_124_oPCAN_RADAR_42d44d7c_Tx: ComBitPosition=232, ComBitSize=8, ComSignalInitValue=0, ComSignalType=UINT8, ComHandleId=2627, ComSystemTemplateSystemSignalRef=DET_SNR_122
            DET_MH_CRC16_121_124_oRDR_DETECTION_121_124_oPCAN_RADAR_2c1dc540_Tx: ComBitPosition=0, ComBitSize=16, ComSignalInitValue=0, ComSignalType=UINT16, ComHandleId=2595, ComSystemTemplateSystemSignalRef=DET_MH_CRC16_121_124
            DET_CONFD_ELEVATION_123_oRDR_DETECTION_121_124_oPCAN_RADAR_e8c4401f_Tx: ComBitPosition=325, ComBitSize=2, ComSignalInitValue=0, ComSignalType=UINT8, ComHandleId=2573, ComSystemTemplateSystemSignalRef=DET_CONFD_ELEVATION_123
            DET_RANGE_ERR_122_oRDR_DETECTION_121_124_oPCAN_RADAR_cab45668_Tx: ComBitPosition=152, ComBitSize=7, ComSignalInitValue=0, ComSignalType=UINT8, ComHandleId=2611, ComSystemTemplateSystemSignalRef=DET_RANGE_ERR_122
            DET_RANGE_VELOCITY_122_oRDR_DETECTION_121_124_oPCAN_RADAR_18fa2e24_Tx: ComBitPosition=160, ComBitSize=15, ComSignalInitValue=16384, ComSignalType=UINT16, ComHandleId=2615, ComSystemTemplateSystemSignalRef=DET_RANGE_VELOCITY_122
            DET_RCS_121_oRDR_DETECTION_121_124_oPCAN_RADAR_fb9a6280_Tx: ComBitPosition=128, ComBitSize=8, ComSignalInitValue=128, ComSignalType=UINT8, ComHandleId=2622, ComSystemTemplateSystemSignalRef=DET_RCS_121
            DET_RANGE_124_oRDR_DETECTION_121_124_oPCAN_RADAR_a49c1bfd_Tx: ComBitPosition=360, ComBitSize=15, ComSignalInitValue=0, ComSignalType=UINT16, ComHandleId=2609, ComSystemTemplateSystemSignalRef=DET_RANGE_124
            DET_HVC_FLAG_121_oRDR_DETECTION_121_124_oPCAN_RADAR_7c469522_Tx: ComBitPosition=86, ComBitSize=1, ComSignalInitValue=0, ComSignalType=BOOLEAN, ComHandleId=2587, ComSystemTemplateSystemSignalRef=DET_HVC_FLAG_121
            DET_HVC_FLAG_124_oRDR_DETECTION_121_124_oPCAN_RADAR_d1661920_Tx: ComBitPosition=422, ComBitSize=1, ComSignalInitValue=0, ComSignalType=BOOLEAN, ComHandleId=2590, ComSystemTemplateSystemSignalRef=DET_HVC_FLAG_124
            DET_HVC_FLAG_123_oRDR_DETECTION_121_124_oPCAN_RADAR_8dd63a49_Tx: ComBitPosition=310, ComBitSize=1, ComSignalInitValue=0, ComSignalType=BOOLEAN, ComHandleId=2589, ComSystemTemplateSystemSignalRef=DET_HVC_FLAG_123
            DET_RCS_124_oRDR_DETECTION_121_124_oPCAN_RADAR_56baee82_Tx: ComBitPosition=464, ComBitSize=8, ComSignalInitValue=128, ComSignalType=UINT8, ComHandleId=2625, ComSystemTemplateSystemSignalRef=DET_RCS_124
            DET_SNR_121_oRDR_DETECTION_121_124_oPCAN_RADAR_26343682_Tx: ComBitPosition=120, ComBitSize=8, ComSignalInitValue=0, ComSignalType=UINT8, ComHandleId=2626, ComSystemTemplateSystemSignalRef=DET_SNR_121
            DET_EXISTENCE_PROB_121_oRDR_DETECTION_121_124_oPCAN_RADAR_9d32d65d_Tx: ComBitPosition=112, ComBitSize=6, ComSignalInitValue=0, ComSignalType=UINT8, ComHandleId=2583, ComSystemTemplateSystemSignalRef=DET_EXISTENCE_PROB_121
            DET_ELEVATION_ERR_123_oRDR_DETECTION_121_124_oPCAN_RADAR_be3d0c56_Tx: ComBitPosition=304, ComBitSize=6, ComSignalInitValue=0, ComSignalType=UINT8, ComHandleId=2581, ComSystemTemplateSystemSignalRef=DET_ELEVATION_ERR_123
            DET_RCS_123_oRDR_DETECTION_121_124_oPCAN_RADAR_0a0acdeb_Tx: ComBitPosition=352, ComBitSize=8, ComSignalInitValue=128, ComSignalType=UINT8, ComHandleId=2624, ComSystemTemplateSystemSignalRef=DET_RCS_123
            DET_AZIMUTH_121_oRDR_DETECTION_121_124_oPCAN_RADAR_1927e444_Tx: ComBitPosition=88, ComBitSize=13, ComSignalInitValue=0, ComSignalType=UINT16, ComHandleId=2551, ComSystemTemplateSystemSignalRef=DET_AZIMUTH_121
            DET_RANGE_VELOCITY_121_oRDR_DETECTION_121_124_oPCAN_RADAR_7c1a55da_Tx: ComBitPosition=48, ComBitSize=15, ComSignalInitValue=16384, ComSignalType=UINT16, ComHandleId=2614, ComSystemTemplateSystemSignalRef=DET_RANGE_VELOCITY_121
            DET_AZIMUTH_122_oRDR_DETECTION_121_124_oPCAN_RADAR_7dc79fba_Tx: ComBitPosition=200, ComBitSize=13, ComSignalInitValue=0, ComSignalType=UINT16, ComHandleId=2552, ComSystemTemplateSystemSignalRef=DET_AZIMUTH_122
            DET_BELOW_RAIN_THOLD_121_oRDR_DETECTION_121_124_oPCAN_RADAR_cc267784_Tx: ComBitPosition=39, ComBitSize=1, ComSignalInitValue=0, ComSignalType=UINT8, ComHandleId=2559, ComSystemTemplateSystemSignalRef=DET_BELOW_RAIN_THOLD_121
            DET_MTD_124_oRDR_DETECTION_121_124_oPCAN_RADAR_3c871046_Tx: ComBitPosition=383, ComBitSize=1, ComSignalInitValue=0, ComSignalType=UINT8, ComHandleId=2601, ComSystemTemplateSystemSignalRef=DET_MTD_124
            DET_IDM_123_oRDR_DETECTION_121_124_oPCAN_RADAR_068401f4_Tx: ComBitPosition=287, ComBitSize=1, ComSignalInitValue=0, ComSignalType=UINT8, ComHandleId=2593, ComSystemTemplateSystemSignalRef=DET_IDM_123
            DET_BELOW_RAIN_THOLD_123_oRDR_DETECTION_121_124_oPCAN_RADAR_3db6d8ef_Tx: ComBitPosition=263, ComBitSize=1, ComSignalInitValue=0, ComSignalType=UINT8, ComHandleId=2561, ComSystemTemplateSystemSignalRef=DET_BELOW_RAIN_THOLD_123
            DET_PROB_1STAZHYPO_123_oRDR_DETECTION_121_124_oPCAN_RADAR_f383dbe2_Tx: ComBitPosition=327, ComBitSize=1, ComSignalInitValue=0, ComSignalType=BOOLEAN, ComHandleId=2604, ComSystemTemplateSystemSignalRef=DET_PROB_1STAZHYPO_123
            DET_IDM_122_oRDR_DETECTION_121_124_oPCAN_RADAR_93f4d561_Tx: ComBitPosition=175, ComBitSize=1, ComSignalInitValue=0, ComSignalType=UINT8, ComHandleId=2592, ComSystemTemplateSystemSignalRef=DET_IDM_122
            DET_MTD_123_oRDR_DETECTION_121_124_oPCAN_RADAR_6037332f_Tx: ComBitPosition=271, ComBitSize=1, ComSignalInitValue=0, ComSignalType=UINT8, ComHandleId=2600, ComSystemTemplateSystemSignalRef=DET_MTD_123
            DET_BELOW_RAIN_THOLD_122_oRDR_DETECTION_121_124_oPCAN_RADAR_a8c60c7a_Tx: ComBitPosition=151, ComBitSize=1, ComSignalInitValue=0, ComSignalType=UINT8, ComHandleId=2560, ComSystemTemplateSystemSignalRef=DET_BELOW_RAIN_THOLD_122
            DET_PROB_1STAZHYPO_122_oRDR_DETECTION_121_124_oPCAN_RADAR_66f30f77_Tx: ComBitPosition=215, ComBitSize=1, ComSignalInitValue=0, ComSignalType=BOOLEAN, ComHandleId=2603, ComSystemTemplateSystemSignalRef=DET_PROB_1STAZHYPO_122
            DET_IDM_121_oRDR_DETECTION_121_124_oPCAN_RADAR_f714ae9f_Tx: ComBitPosition=63, ComBitSize=1, ComSignalInitValue=0, ComSignalType=UINT8, ComHandleId=2591, ComSystemTemplateSystemSignalRef=DET_IDM_121
            DET_PROB_1STAZHYPO_121_oRDR_DETECTION_121_124_oPCAN_RADAR_02137489_Tx: ComBitPosition=103, ComBitSize=1, ComSignalInitValue=0, ComSignalType=BOOLEAN, ComHandleId=2602, ComSystemTemplateSystemSignalRef=DET_PROB_1STAZHYPO_121
            DET_MTD_121_oRDR_DETECTION_121_124_oPCAN_RADAR_91a79c44_Tx: ComBitPosition=47, ComBitSize=1, ComSignalInitValue=0, ComSignalType=UINT8, ComHandleId=2598, ComSystemTemplateSystemSignalRef=DET_MTD_121
            DET_BELOW_RAIN_THOLD_124_oRDR_DETECTION_121_124_oPCAN_RADAR_6106fb86_Tx: ComBitPosition=375, ComBitSize=1, ComSignalInitValue=0, ComSignalType=UINT8, ComHandleId=2562, ComSystemTemplateSystemSignalRef=DET_BELOW_RAIN_THOLD_124
            DET_MTD_122_oRDR_DETECTION_121_124_oPCAN_RADAR_f547e7ba_Tx: ComBitPosition=159, ComBitSize=1, ComSignalInitValue=0, ComSignalType=UINT8, ComHandleId=2599, ComSystemTemplateSystemSignalRef=DET_MTD_122
            DET_IDM_124_oRDR_DETECTION_121_124_oPCAN_RADAR_5a34229d_Tx: ComBitPosition=399, ComBitSize=1, ComSignalInitValue=0, ComSignalType=UINT8, ComHandleId=2594, ComSystemTemplateSystemSignalRef=DET_IDM_124
            DET_PROB_1STAZHYPO_124_oRDR_DETECTION_121_124_oPCAN_RADAR_af33f88b_Tx: ComBitPosition=439, ComBitSize=1, ComSignalInitValue=0, ComSignalType=BOOLEAN, ComHandleId=2605, ComSystemTemplateSystemSignalRef=DET_PROB_1STAZHYPO_124
        SG_AlignmentStatus2_oRDR_ALIGNMENT_STATUS_002_oPCAN_RADAR_1945d616_Tx: ComTransferProperty=TRIGGERED, ComHandleId=1, ComSystemTemplateSignalGroupRef=SG_AlignmentStatus2
          19 x ComGroupSignal, all with ComSignalEndianness=LITTLE_ENDIAN, ComTransferProperty=PENDING, ComSignalAccess=ACCESS_NEEDED_BY_SWC_OR_COM:
            STS_Measured_Range_oRDR_ALIGNMENT_STATUS_002_oPCAN_RADAR_44d7db0c_Tx: ComBitPosition=312, ComBitSize=14, ComSignalInitValue=0, ComSignalType=UINT16, ComHandleId=59, ComSystemTemplateSystemSignalRef=STS_Measured_Range
            STS_AlignmentServiceStatus_oRDR_ALIGNMENT_STATUS_002_oPCAN_RADAR_d03a7577_Tx: ComBitPosition=308, ComBitSize=3, ComSignalInitValue=0, ComSignalType=UINT8, ComHandleId=44, ComSystemTemplateSystemSignalRef=STS_AlignmentServiceStatus
            STS_AlignmentStaticStatus_oRDR_ALIGNMENT_STATUS_002_oPCAN_RADAR_ed9fe891_Tx: ComBitPosition=304, ComBitSize=3, ComSignalInitValue=0, ComSignalType=UINT8, ComHandleId=46, ComSystemTemplateSystemSignalRef=STS_AlignmentStaticStatus
            STS_ImpactByInterference_oRDR_ALIGNMENT_STATUS_002_oPCAN_RADAR_ea495887_Tx: ComBitPosition=307, ComBitSize=1, ComSignalInitValue=0, ComSignalType=BOOLEAN, ComHandleId=53, ComSystemTemplateSystemSignalRef=STS_ImpactByInterference
            STS_AlignmentShortTrackStatus_oRDR_ALIGNMENT_STATUS_002_oPCAN_RADAR_a985d45d_Tx: ComBitPosition=107, ComBitSize=3, ComSignalInitValue=0, ComSignalType=UINT8, ComHandleId=45, ComSystemTemplateSystemSignalRef=STS_AlignmentShortTrackStatus
            AL_STS_002_CYCLE_COUNTER_oRDR_ALIGNMENT_STATUS_002_oPCAN_RADAR_ac113952_Tx: ComBitPosition=16, ComBitSize=8, ComSignalInitValue=0, ComSignalType=UINT8, ComHandleId=42, ComSystemTemplateSystemSignalRef=AL_STS_002_CYCLE_COUNTER
            STS_DistanceAbsolute_oRDR_ALIGNMENT_STATUS_002_oPCAN_RADAR_350fb8c0_Tx: ComBitPosition=112, ComBitSize=32, ComSignalInitValue=0, ComSignalType=UINT32, ComHandleId=49, ComSystemTemplateSystemSignalRef=STS_DistanceAbsolute
            AL_STS_002_MH_CRC16_oRDR_ALIGNMENT_STATUS_002_oPCAN_RADAR_fd433470_Tx: ComBitPosition=0, ComBitSize=16, ComSignalInitValue=0, ComSignalType=UINT16, ComHandleId=43, ComSystemTemplateSystemSignalRef=AL_STS_002_MH_CRC16
            STS_MeasuredRangeRateStd_oRDR_ALIGNMENT_STATUS_002_oPCAN_RADAR_f4643d07_Tx: ComBitPosition=40, ComBitSize=16, ComSignalInitValue=0, ComSignalType=SINT16, ComHandleId=55, ComSystemTemplateSystemSignalRef=STS_MeasuredRangeRateStd
            STS_VehicleCondition_oRDR_ALIGNMENT_STATUS_002_oPCAN_RADAR_27e73dc1_Tx: ComBitPosition=104, ComBitSize=3, ComSignalInitValue=6, ComSignalType=UINT8, ComHandleId=60, ComSystemTemplateSystemSignalRef=STS_VehicleCondition
            STS_DistanceEffective_oRDR_ALIGNMENT_STATUS_002_oPCAN_RADAR_ba39d7ae_Tx: ComBitPosition=176, ComBitSize=32, ComSignalInitValue=0, ComSignalType=UINT32, ComHandleId=50, ComSystemTemplateSystemSignalRef=STS_DistanceEffective
            STS_AverageSpeed_oRDR_ALIGNMENT_STATUS_002_oPCAN_RADAR_12d3a902_Tx: ComBitPosition=240, ComBitSize=32, ComSignalInitValue=0, ComSignalType=UINT32, ComHandleId=48, ComSystemTemplateSystemSignalRef=STS_AverageSpeed
            STS_DurationAbsolute_oRDR_ALIGNMENT_STATUS_002_oPCAN_RADAR_b6d3be34_Tx: ComBitPosition=208, ComBitSize=32, ComSignalInitValue=0, ComSignalType=UINT32, ComHandleId=51, ComSystemTemplateSystemSignalRef=STS_DurationAbsolute
            STS_DurationEffective_oRDR_ALIGNMENT_STATUS_002_oPCAN_RADAR_006a3dad_Tx: ComBitPosition=272, ComBitSize=32, ComSignalInitValue=0, ComSignalType=UINT32, ComHandleId=52, ComSystemTemplateSystemSignalRef=STS_DurationEffective
            STS_MeasuredRangeRate_oRDR_ALIGNMENT_STATUS_002_oPCAN_RADAR_d6bd6aa0_Tx: ComBitPosition=69, ComBitSize=18, ComSignalInitValue=0, ComSignalType=SINT32, ComHandleId=56, ComSystemTemplateSystemSignalRef=STS_MeasuredRangeRate
            STS_AverageNumberOfDetections_oRDR_ALIGNMENT_STATUS_002_oPCAN_RADAR_e5f0325a_Tx: ComBitPosition=144, ComBitSize=32, ComSignalInitValue=0, ComSignalType=UINT32, ComHandleId=47, ComSystemTemplateSystemSignalRef=STS_AverageNumberOfDetections
            STS_MeasuredRangeStd_oRDR_ALIGNMENT_STATUS_002_oPCAN_RADAR_9735a635_Tx: ComBitPosition=24, ComBitSize=16, ComSignalInitValue=0, ComSignalType=UINT16, ComHandleId=57, ComSystemTemplateSystemSignalRef=STS_MeasuredRangeStd
            STS_MeasuredRawAmplitude_oRDR_ALIGNMENT_STATUS_002_oPCAN_RADAR_0c70d370_Tx: ComBitPosition=56, ComBitSize=13, ComSignalInitValue=0, ComSignalType=SINT16, ComHandleId=58, ComSystemTemplateSystemSignalRef=STS_MeasuredRawAmplitude
            STS_MeasuredAmpSTD_oRDR_ALIGNMENT_STATUS_002_oPCAN_RADAR_c894f01f_Tx: ComBitPosition=88, ComBitSize=15, ComSignalInitValue=0, ComSignalType=UINT16, ComHandleId=54, ComSystemTemplateSystemSignalRef=STS_MeasuredAmpSTD
        SG_AlignmentStatus1_oRDR_ALIGNMENT_STATUS_001_oPCAN_RADAR_7714a623_Tx: ComTransferProperty=TRIGGERED, ComHandleId=0, ComSystemTemplateSignalGroupRef=SG_AlignmentStatus1
          42 x ComGroupSignal, all with ComSignalEndianness=LITTLE_ENDIAN, ComTransferProperty=PENDING, ComSignalAccess=ACCESS_NEEDED_BY_SWC_OR_COM:
            AL_STS_001_CYCLE_COUNTER_oRDR_ALIGNMENT_STATUS_001_oPCAN_RADAR_92b2855f_Tx: ComBitPosition=16, ComBitSize=8, ComSignalInitValue=0, ComSignalType=UINT8, ComHandleId=0, ComSystemTemplateSystemSignalRef=AL_STS_001_CYCLE_COUNTER
            STS_AutoAlignmentFailRootCause_oRDR_ALIGNMENT_STATUS_001_oPCAN_RADAR_e1073ec5_Tx: ComBitPosition=144, ComBitSize=5, ComSignalInitValue=5, ComSignalType=UINT8, ComHandleId=14, ComSystemTemplateSystemSignalRef=STS_AutoAlignmentFailRootCause
            STS_InitAlignmentResultAzimuth_oRDR_ALIGNMENT_STATUS_001_oPCAN_RADAR_ae7ace17_Tx: ComBitPosition=272, ComBitSize=15, ComSignalInitValue=0, ComSignalType=SINT16, ComHandleId=31, ComSystemTemplateSystemSignalRef=STS_InitAlignmentResultAzimuth
            STS_InitAlignRsltElevationUpdate_oRDR_ALIGNMENT_STATUS_001_oPCAN_RADAR_25205dfc_Tx: ComBitPosition=24, ComBitSize=16, ComSignalInitValue=0, ComSignalType=UINT16, ComHandleId=29, ComSystemTemplateSystemSignalRef=STS_InitAlignRsltElevationUpdate
            STS_CoordinateSystemInput_oRDR_ALIGNMENT_STATUS_001_oPCAN_RADAR_ac54169a_Tx: ComBitPosition=59, ComBitSize=2, ComSignalInitValue=0, ComSignalType=UINT8, ComHandleId=21, ComSystemTemplateSystemSignalRef=STS_CoordinateSystemInput
            STS_AACurrentElevation_oRDR_ALIGNMENT_STATUS_001_oPCAN_RADAR_68c02683_Tx: ComBitPosition=207, ComBitSize=11, ComSignalType=SINT16 if post-build-variant-condition{matching-criterion=RDR_POS, value=0}, ComSignalType=SINT16 if post-build-variant-condition{matching-criterion=RDR_POS, value=7}, ComSignalType=SINT16 if post-build-variant-condition{matching-criterion=RDR_POS, value=3}, ComSignalType=SINT16 if post-build-variant-condition{matching-criterion=RDR_POS, value=1}, ComSignalType=SINT16 if post-build-variant-condition{matching-criterion=RDR_POS, value=4}, ComSignalType=SINT16 if post-build-variant-condition{matching-criterion=RDR_POS, value=5}, ComSignalType=SINT16 if post-build-variant-condition{matching-criterion=RDR_POS, value=2}, ComSignalType=SINT16 if post-build-variant-condition{matching-criterion=RDR_POS, value=6}, ComSignalInitValue=0, ComHandleId=4, ComSystemTemplateSystemSignalRef=STS_AACurrentElevation
            STS_HostSpdCompensationFactorQF_oRDR_ALIGNMENT_STATUS_001_oPCAN_RADAR_23e2637e_Tx: ComBitPosition=61, ComBitSize=2, ComSignalInitValue=0, ComSignalType=UINT8, ComHandleId=26, ComSystemTemplateSystemSignalRef=STS_HostSpdCompensationFactorQF
            STS_AlignmentError_oRDR_ALIGNMENT_STATUS_001_oPCAN_RADAR_c2060acd_Tx: ComBitPosition=128, ComBitSize=5, ComSignalInitValue=0, ComSignalType=UINT8, ComHandleId=11, ComSystemTemplateSystemSignalRef=STS_AlignmentError
            STS_AzimuthErrorNegative_oRDR_ALIGNMENT_STATUS_001_oPCAN_RADAR_6e4fe47d_Tx: ComBitPosition=96, ComBitSize=15, ComSignalInitValue=0, ComSignalType=SINT16, ComHandleId=15, ComSystemTemplateSystemSignalRef=STS_AzimuthErrorNegative
            STS_CalDisplay_oRDR_ALIGNMENT_STATUS_001_oPCAN_RADAR_ffd10a71_Tx: ComBitPosition=95, ComBitSize=1, ComSignalInitValue=0, ComSignalType=UINT8, ComHandleId=19, ComSystemTemplateSystemSignalRef=STS_CalDisplay
            STS_InitAlignResultAzimuthUpdate_oRDR_ALIGNMENT_STATUS_001_oPCAN_RADAR_450388ed_Tx: ComBitPosition=64, ComBitSize=16, ComSignalInitValue=0, ComSignalType=UINT16, ComHandleId=28, ComSystemTemplateSystemSignalRef=STS_InitAlignResultAzimuthUpdate
            STS_RadarTypeInput_oRDR_ALIGNMENT_STATUS_001_oPCAN_RADAR_72f1a9b3_Tx: ComBitPosition=124, ComBitSize=3, ComSignalInitValue=0, ComSignalType=UINT8, ComHandleId=35, ComSystemTemplateSystemSignalRef=STS_RadarTypeInput
            STS_StartElevation_oRDR_ALIGNMENT_STATUS_001_oPCAN_RADAR_cc01a387_Tx: ComBitPosition=48, ComBitSize=11, ComSignalInitValue=0, ComSignalType=SINT16, ComHandleId=40, ComSystemTemplateSystemSignalRef=STS_StartElevation
            STS_AAElevationStd_oRDR_ALIGNMENT_STATUS_001_oPCAN_RADAR_36e93c09_Tx: ComBitPosition=257, ComBitSize=14, ComSignalInitValue=0, ComSignalType=UINT16, ComHandleId=6, ComSystemTemplateSystemSignalRef=STS_AAElevationStd
            STS_InitAlignmentResultElevation_oRDR_ALIGNMENT_STATUS_001_oPCAN_RADAR_e96bbe52_Tx: ComBitPosition=298, ComBitSize=14, ComSignalInitValue=0, ComSignalType=SINT16, ComHandleId=32, ComSystemTemplateSystemSignalRef=STS_InitAlignmentResultElevation
            STS_AlignmentModeIn_oRDR_ALIGNMENT_STATUS_001_oPCAN_RADAR_b9199e71_Tx: ComBitPosition=92, ComBitSize=3, ComSignalInitValue=0, ComSignalType=UINT8, ComHandleId=12, ComSystemTemplateSystemSignalRef=STS_AlignmentModeIn
            STS_ElevationErrorNegative_oRDR_ALIGNMENT_STATUS_001_oPCAN_RADAR_8ad967c2_Tx: ComBitPosition=287, ComBitSize=11, ComSignalInitValue=0, ComSignalType=SINT16, ComHandleId=22, ComSystemTemplateSystemSignalRef=STS_ElevationErrorNegative
            STS_AzimuthUpdates_oRDR_ALIGNMENT_STATUS_001_oPCAN_RADAR_57325300_Tx: ComBitPosition=320, ComBitSize=32, ComSignalInitValue=0, ComSignalType=UINT32, ComHandleId=18, ComSystemTemplateSystemSignalRef=STS_AzimuthUpdates
            STS_ElevationUpdates_oRDR_ALIGNMENT_STATUS_001_oPCAN_RADAR_5f349f48_Tx: ComBitPosition=352, ComBitSize=32, ComSignalInitValue=0, ComSignalType=UINT32, ComHandleId=25, ComSystemTemplateSystemSignalRef=STS_ElevationUpdates
            STS_AlignmentAzimuth_oRDR_ALIGNMENT_STATUS_001_oPCAN_RADAR_90bea827_Tx: ComBitPosition=384, ComBitSize=15, ComSignalInitValue=10000, ComSignalType=SINT16 if post-build-variant-condition{matching-criterion=RDR_POS, value=0}, ComSignalType=SINT16 if post-build-variant-condition{matching-criterion=RDR_POS, value=7}, ComSignalType=SINT16 if post-build-variant-condition{matching-criterion=RDR_POS, value=3}, ComSignalType=SINT16 if post-build-variant-condition{matching-criterion=RDR_POS, value=1}, ComSignalType=SINT16 if post-build-variant-condition{matching-criterion=RDR_POS, value=4}, ComSignalType=SINT16 if post-build-variant-condition{matching-criterion=RDR_POS, value=5}, ComSignalType=SINT16 if post-build-variant-condition{matching-criterion=RDR_POS, value=2}, ComSignalType=SINT16 if post-build-variant-condition{matching-criterion=RDR_POS, value=6}, ComHandleId=9, ComSystemTemplateSystemSignalRef=STS_AlignmentAzimuth
            STS_ElevationErrorPositive_oRDR_ALIGNMENT_STATUS_001_oPCAN_RADAR_3ae99fc9_Tx: ComBitPosition=232, ComBitSize=11, ComSignalInitValue=0, ComSignalType=SINT16, ComHandleId=23, ComSystemTemplateSystemSignalRef=STS_ElevationErrorPositive
            STS_RollErrorPositive_oRDR_ALIGNMENT_STATUS_001_oPCAN_RADAR_36a4a6d1_Tx: ComBitPosition=221, ComBitSize=10, ComSignalInitValue=0, ComSignalType=SINT16, ComHandleId=37, ComSystemTemplateSystemSignalRef=STS_RollErrorPositive
            STS_AlignmentElevation_oRDR_ALIGNMENT_STATUS_001_oPCAN_RADAR_92fc7208_Tx: ComBitPosition=400, ComBitSize=15, ComSignalInitValue=10000, ComSignalType=SINT16 if post-build-variant-condition{matching-criterion=RDR_POS, value=0}, ComSignalType=SINT16 if post-build-variant-condition{matching-criterion=RDR_POS, value=7}, ComSignalType=SINT16 if post-build-variant-condition{matching-criterion=RDR_POS, value=3}, ComSignalType=SINT16 if post-build-variant-condition{matching-criterion=RDR_POS, value=1}, ComSignalType=SINT16 if post-build-variant-condition{matching-criterion=RDR_POS, value=4}, ComSignalType=SINT16 if post-build-variant-condition{matching-criterion=RDR_POS, value=5}, ComSignalType=SINT16 if post-build-variant-condition{matching-criterion=RDR_POS, value=2}, ComSignalType=SINT16 if post-build-variant-condition{matching-criterion=RDR_POS, value=6}, ComHandleId=10, ComSystemTemplateSystemSignalRef=STS_AlignmentElevation
            STS_AzimuthStd_oRDR_ALIGNMENT_STATUS_001_oPCAN_RADAR_b46beb44_Tx: ComBitPosition=164, ComBitSize=13, ComSignalInitValue=0, ComSignalType=UINT16, ComHandleId=17, ComSystemTemplateSystemSignalRef=STS_AzimuthStd
            STS_HostSpeedCompensationFactor_oRDR_ALIGNMENT_STATUS_001_oPCAN_RADAR_9815558a_Tx: ComBitPosition=313, ComBitSize=7, ComSignalInitValue=100, ComSignalType=UINT8, ComHandleId=27, ComSystemTemplateSystemSignalRef=STS_HostSpeedCompensationFactor
            STS_InitAlignRsltHostSpdCompFac_oRDR_ALIGNMENT_STATUS_001_oPCAN_RADAR_cdf9488e_Tx: ComBitPosition=40, ComBitSize=7, ComSignalInitValue=100, ComSignalType=UINT8, ComHandleId=30, ComSystemTemplateSystemSignalRef=STS_InitAlignRsltHostSpdCompFac
            STS_StartAzimuth_oRDR_ALIGNMENT_STATUS_001_oPCAN_RADAR_61586fd0_Tx: ComBitPosition=149, ComBitSize=15, ComSignalInitValue=0, ComSignalType=SINT16, ComHandleId=39, ComSystemTemplateSystemSignalRef=STS_StartAzimuth
            STS_AlignmentAutoStatus_oRDR_ALIGNMENT_STATUS_001_oPCAN_RADAR_3df406fe_Tx: ComBitPosition=133, ComBitSize=3, ComSignalInitValue=0, ComSignalType=UINT8, ComHandleId=8, ComSystemTemplateSystemSignalRef=STS_AlignmentAutoStatus
            AL_STS_001_MH_CRC16_oRDR_ALIGNMENT_STATUS_001_oPCAN_RADAR_065b6dda_Tx: ComBitPosition=0, ComBitSize=16, ComSignalInitValue=0, ComSignalType=UINT16, ComHandleId=1, ComSystemTemplateSystemSignalRef=AL_STS_001_MH_CRC16
            STS_AlignmentModeOut_oRDR_ALIGNMENT_STATUS_001_oPCAN_RADAR_53f81498_Tx: ComBitPosition=218, ComBitSize=3, ComSignalInitValue=0, ComSignalType=UINT8, ComHandleId=13, ComSystemTemplateSystemSignalRef=STS_AlignmentModeOut
            STS_ElevationStd_oRDR_ALIGNMENT_STATUS_001_oPCAN_RADAR_0035801e_Tx: ComBitPosition=111, ComBitSize=13, ComSignalInitValue=0, ComSignalType=UINT16, ComHandleId=24, ComSystemTemplateSystemSignalRef=STS_ElevationStd
            STS_AAAzimuthStd_oRDR_ALIGNMENT_STATUS_001_oPCAN_RADAR_226582e8_Tx: ComBitPosition=243, ComBitSize=14, ComSignalInitValue=0, ComSignalType=UINT16, ComHandleId=2, ComSystemTemplateSystemSignalRef=STS_AAAzimuthStd
            STS_ProgressPercent_oRDR_ALIGNMENT_STATUS_001_oPCAN_RADAR_357c0985_Tx: ComBitPosition=136, ComBitSize=7, ComSignalInitValue=0, ComSignalType=UINT8, ComHandleId=34, ComSystemTemplateSystemSignalRef=STS_ProgressPercent
            STS_CalTime_oRDR_ALIGNMENT_STATUS_001_oPCAN_RADAR_429dbd7e_Tx: ComBitPosition=80, ComBitSize=12, ComSignalInitValue=0, ComSignalType=UINT16, ComHandleId=20, ComSystemTemplateSystemSignalRef=STS_CalTime
            STS_InitLastSuccessfulAlignMode_oRDR_ALIGNMENT_STATUS_001_oPCAN_RADAR_b93d4ccd_Tx: ComBitPosition=478, ComBitSize=3, ComSignalInitValue=0, ComSignalType=UINT8, ComHandleId=33, ComSystemTemplateSystemSignalRef=STS_InitLastSuccessfulAlignMode
            STS_AzimuthErrorPositive_oRDR_ALIGNMENT_STATUS_001_oPCAN_RADAR_de7f1c76_Tx: ComBitPosition=192, ComBitSize=15, ComSignalInitValue=0, ComSignalType=SINT16, ComHandleId=16, ComSystemTemplateSystemSignalRef=STS_AzimuthErrorPositive
            STS_AACurrentAzimuth_oRDR_ALIGNMENT_STATUS_001_oPCAN_RADAR_fa4b534a_Tx: ComBitPosition=177, ComBitSize=15, ComSignalInitValue=15708, ComSignalType=SINT16 if post-build-variant-condition{matching-criterion=RDR_POS, value=0}, ComSignalType=SINT16 if post-build-variant-condition{matching-criterion=RDR_POS, value=7}, ComSignalType=SINT16 if post-build-variant-condition{matching-criterion=RDR_POS, value=3}, ComSignalType=SINT16 if post-build-variant-condition{matching-criterion=RDR_POS, value=1}, ComSignalType=SINT16 if post-build-variant-condition{matching-criterion=RDR_POS, value=4}, ComSignalType=SINT16 if post-build-variant-condition{matching-criterion=RDR_POS, value=5}, ComSignalType=SINT16 if post-build-variant-condition{matching-criterion=RDR_POS, value=2}, ComSignalType=SINT16 if post-build-variant-condition{matching-criterion=RDR_POS, value=6}, ComHandleId=3, ComSystemTemplateSystemSignalRef=STS_AACurrentAzimuth
            STS_AACurrentRoll_oRDR_ALIGNMENT_STATUS_001_oPCAN_RADAR_4f5a9f3e_Tx: ComBitPosition=481, ComBitSize=15, ComSignalInitValue=0, ComSignalType=SINT16, ComHandleId=5, ComSystemTemplateSystemSignalRef=STS_AACurrentRoll
            STS_StartRoll_oRDR_ALIGNMENT_STATUS_001_oPCAN_RADAR_ecd3f1a2_Tx: ComBitPosition=496, ComBitSize=15, ComSignalInitValue=0, ComSignalType=SINT16, ComHandleId=41, ComSystemTemplateSystemSignalRef=STS_StartRoll
            STS_Roll_Updates_oRDR_ALIGNMENT_STATUS_001_oPCAN_RADAR_519c95ca_Tx: ComBitPosition=416, ComBitSize=32, ComSignalInitValue=0, ComSignalType=UINT32, ComHandleId=38, ComSystemTemplateSystemSignalRef=STS_Roll_Updates
            STS_RollErrorNegative_oRDR_ALIGNMENT_STATUS_001_oPCAN_RADAR_86945eda_Tx: ComBitPosition=448, ComBitSize=15, ComSignalInitValue=0, ComSignalType=SINT16, ComHandleId=36, ComSystemTemplateSystemSignalRef=STS_RollErrorNegative
            STS_AARoll_Std_oRDR_ALIGNMENT_STATUS_001_oPCAN_RADAR_d9930952_Tx: ComBitPosition=464, ComBitSize=14, ComSignalInitValue=0, ComSignalType=UINT16, ComHandleId=7, ComSystemTemplateSystemSignalRef=STS_AARoll_Std
        SG_Detections_005_008_oRDR_DETECTION_005_008_oPCAN_RADAR_ae8ba1f7_Tx: ComTransferProperty=TRIGGERED, ComHandleId=3, ComSystemTemplateSignalGroupRef=SG_Detections_005_008
          83 x ComGroupSignal, all with ComSignalEndianness=LITTLE_ENDIAN, ComTransferProperty=PENDING, ComSignalAccess=ACCESS_NEEDED_BY_SWC_OR_COM:
            DET_CONFD_ELEVATION_006_oRDR_DETECTION_005_008_oPCAN_RADAR_71ec732a_Tx: ComBitPosition=213, ComBitSize=2, ComSignalInitValue=0, ComSignalType=UINT8, ComHandleId=165, ComSystemTemplateSystemSignalRef=DET_CONFD_ELEVATION_006
            DET_ELEVATION_ERR_006_oRDR_DETECTION_005_008_oPCAN_RADAR_27153f63_Tx: ComBitPosition=192, ComBitSize=6, ComSignalInitValue=0, ComSignalType=UINT8, ComHandleId=173, ComSystemTemplateSystemSignalRef=DET_ELEVATION_ERR_006
            DET_RANGE_ERR_006_oRDR_DETECTION_005_008_oPCAN_RADAR_c6ecb1c8_Tx: ComBitPosition=152, ComBitSize=7, ComSignalInitValue=0, ComSignalType=UINT8, ComHandleId=204, ComSystemTemplateSystemSignalRef=DET_RANGE_ERR_006
            DET_AZIMUTH_008_oRDR_DETECTION_005_008_oPCAN_RADAR_c8ff3ec8_Tx: ComBitPosition=424, ComBitSize=13, ComSignalInitValue=0, ComSignalType=UINT16, ComHandleId=147, ComSystemTemplateSystemSignalRef=DET_AZIMUTH_008
            DET_BI_STATIC_FLAG_008_oRDR_DETECTION_005_008_oPCAN_RADAR_9ed37e4d_Tx: ComBitPosition=440, ComBitSize=1, ComSignalInitValue=0, ComSignalType=BOOLEAN, ComHandleId=159, ComSystemTemplateSystemSignalRef=DET_BI_STATIC_FLAG_008
            DET_RANGE_VELOCITY_ERR_007_oRDR_DETECTION_005_008_oPCAN_RADAR_8e69e6a3_Tx: ComBitPosition=288, ComBitSize=8, ComSignalInitValue=0, ComSignalType=UINT8, ComHandleId=213, ComSystemTemplateSystemSignalRef=DET_RANGE_VELOCITY_ERR_007
            DET_ELEVATION_006_oRDR_DETECTION_005_008_oPCAN_RADAR_a02ca716_Tx: ComBitPosition=184, ComBitSize=8, ComSignalInitValue=0, ComSignalType=UINT8, ComHandleId=169, ComSystemTemplateSystemSignalRef=DET_ELEVATION_006
            DET_EXISTENCE_PROB_007_oRDR_DETECTION_005_008_oPCAN_RADAR_60fa9e96_Tx: ComBitPosition=336, ComBitSize=6, ComSignalInitValue=0, ComSignalType=UINT8, ComHandleId=178, ComSystemTemplateSystemSignalRef=DET_EXISTENCE_PROB_007
            DET_RANGE_005_oRDR_DETECTION_005_008_oPCAN_RADAR_05e4705f_Tx: ComBitPosition=24, ComBitSize=15, ComSignalInitValue=0, ComSignalType=UINT16, ComHandleId=199, ComSystemTemplateSystemSignalRef=DET_RANGE_005
            DET_RANGE_VELOCITY_008_oRDR_DETECTION_005_008_oPCAN_RADAR_adc28f56_Tx: ComBitPosition=384, ComBitSize=15, ComSignalInitValue=16384, ComSignalType=UINT16, ComHandleId=210, ComSystemTemplateSystemSignalRef=DET_RANGE_VELOCITY_008
            DET_AZIMUTH_ERR_008_oRDR_DETECTION_005_008_oPCAN_RADAR_6c4aab3d_Tx: ComBitPosition=441, ComBitSize=7, ComSignalInitValue=0, ComSignalType=UINT8, ComHandleId=151, ComSystemTemplateSystemSignalRef=DET_AZIMUTH_ERR_008
            DET_MH_SCAN_INDEX_4LSB_005_008_oRDR_DETECTION_005_008_oPCAN_RADAR_625cf747_Tx: ComBitPosition=476, ComBitSize=4, ComSignalInitValue=0, ComSignalType=UINT8, ComHandleId=190, ComSystemTemplateSystemSignalRef=DET_MH_SCAN_INDEX_4LSB_005_008
            DET_SNR_006_oRDR_DETECTION_005_008_oPCAN_RADAR_4e8caadc_Tx: ComBitPosition=232, ComBitSize=8, ComSignalInitValue=0, ComSignalType=UINT8, ComHandleId=220, ComSystemTemplateSystemSignalRef=DET_SNR_006
            DET_AZIMUTH_006_oRDR_DETECTION_005_008_oPCAN_RADAR_719f781a_Tx: ComBitPosition=200, ComBitSize=13, ComSignalInitValue=0, ComSignalType=UINT16, ComHandleId=145, ComSystemTemplateSystemSignalRef=DET_AZIMUTH_006
            DET_BI_STATIC_FLAG_007_oRDR_DETECTION_005_008_oPCAN_RADAR_b2c3ec0a_Tx: ComBitPosition=328, ComBitSize=1, ComSignalInitValue=0, ComSignalType=BOOLEAN, ComHandleId=158, ComSystemTemplateSystemSignalRef=DET_BI_STATIC_FLAG_007
            DET_BI_STATIC_FLAG_006_oRDR_DETECTION_005_008_oPCAN_RADAR_27b3389f_Tx: ComBitPosition=216, ComBitSize=1, ComSignalInitValue=0, ComSignalType=BOOLEAN, ComHandleId=157, ComSystemTemplateSystemSignalRef=DET_BI_STATIC_FLAG_006
            DET_ELEVATION_ERR_005_oRDR_DETECTION_005_008_oPCAN_RADAR_43f5449d_Tx: ComBitPosition=80, ComBitSize=6, ComSignalInitValue=0, ComSignalType=UINT8, ComHandleId=172, ComSystemTemplateSystemSignalRef=DET_ELEVATION_ERR_005
            DET_BI_STATIC_FLAG_005_oRDR_DETECTION_005_008_oPCAN_RADAR_43534361_Tx: ComBitPosition=104, ComBitSize=1, ComSignalInitValue=0, ComSignalType=BOOLEAN, ComHandleId=156, ComSystemTemplateSystemSignalRef=DET_BI_STATIC_FLAG_005
            DET_CONFD_AZIMUTH_005_oRDR_DETECTION_005_008_oPCAN_RADAR_1799092e_Tx: ComBitPosition=118, ComBitSize=2, ComSignalInitValue=0, ComSignalType=UINT8, ComHandleId=160, ComSystemTemplateSystemSignalRef=DET_CONFD_AZIMUTH_005
            DET_CONFD_AZIMUTH_008_oRDR_DETECTION_005_008_oPCAN_RADAR_ca193402_Tx: ComBitPosition=454, ComBitSize=2, ComSignalInitValue=0, ComSignalType=UINT8, ComHandleId=163, ComSystemTemplateSystemSignalRef=DET_CONFD_AZIMUTH_008
            DET_CONFD_AZIMUTH_007_oRDR_DETECTION_005_008_oPCAN_RADAR_e609a645_Tx: ComBitPosition=342, ComBitSize=2, ComSignalInitValue=0, ComSignalType=UINT8, ComHandleId=162, ComSystemTemplateSystemSignalRef=DET_CONFD_AZIMUTH_007
            DET_RCS_007_oRDR_DETECTION_005_008_oPCAN_RADAR_06522a4b_Tx: ComBitPosition=352, ComBitSize=8, ComSignalInitValue=128, ComSignalType=UINT8, ComHandleId=217, ComSystemTemplateSystemSignalRef=DET_RCS_007
            DET_SNR_007_oRDR_DETECTION_005_008_oPCAN_RADAR_dbfc7e49_Tx: ComBitPosition=344, ComBitSize=8, ComSignalInitValue=0, ComSignalType=UINT8, ComHandleId=221, ComSystemTemplateSystemSignalRef=DET_SNR_007
            DET_SUPER_RES_TARGET_006_oRDR_DETECTION_005_008_oPCAN_RADAR_7f1582b9_Tx: ComBitPosition=199, ComBitSize=1, ComSignalInitValue=0, ComSignalType=BOOLEAN, ComHandleId=224, ComSystemTemplateSystemSignalRef=DET_SUPER_RES_TARGET_006
            DET_HVC_FLAG_008_oRDR_DETECTION_005_008_oPCAN_RADAR_ad9e4fae_Tx: ComBitPosition=422, ComBitSize=1, ComSignalInitValue=0, ComSignalType=BOOLEAN, ComHandleId=183, ComSystemTemplateSystemSignalRef=DET_HVC_FLAG_008
            DET_SUPER_RES_TARGET_005_oRDR_DETECTION_005_008_oPCAN_RADAR_1bf5f947_Tx: ComBitPosition=87, ComBitSize=1, ComSignalInitValue=0, ComSignalType=BOOLEAN, ComHandleId=223, ComSystemTemplateSystemSignalRef=DET_SUPER_RES_TARGET_005
            DET_HVC_FLAG_005_oRDR_DETECTION_005_008_oPCAN_RADAR_701e7282_Tx: ComBitPosition=86, ComBitSize=1, ComSignalInitValue=0, ComSignalType=BOOLEAN, ComHandleId=180, ComSystemTemplateSystemSignalRef=DET_HVC_FLAG_005
            DET_AZIMUTH_007_oRDR_DETECTION_005_008_oPCAN_RADAR_e4efac8f_Tx: ComBitPosition=312, ComBitSize=13, ComSignalInitValue=0, ComSignalType=UINT16, ComHandleId=146, ComSystemTemplateSystemSignalRef=DET_AZIMUTH_007
            DET_EXISTENCE_PROB_008_oRDR_DETECTION_005_008_oPCAN_RADAR_4cea0cd1_Tx: ComBitPosition=448, ComBitSize=6, ComSignalInitValue=0, ComSignalType=UINT8, ComHandleId=179, ComSystemTemplateSystemSignalRef=DET_EXISTENCE_PROB_008
            DET_CONFD_ELEVATION_007_oRDR_DETECTION_005_008_oPCAN_RADAR_e49ca7bf_Tx: ComBitPosition=325, ComBitSize=2, ComSignalInitValue=0, ComSignalType=UINT8, ComHandleId=166, ComSystemTemplateSystemSignalRef=DET_CONFD_ELEVATION_007
            DET_SNR_005_oRDR_DETECTION_005_008_oPCAN_RADAR_2a6cd122_Tx: ComBitPosition=120, ComBitSize=8, ComSignalInitValue=0, ComSignalType=UINT8, ComHandleId=219, ComSystemTemplateSystemSignalRef=DET_SNR_005
            DET_RANGE_VELOCITY_ERR_005_oRDR_DETECTION_005_008_oPCAN_RADAR_7ff949c8_Tx: ComBitPosition=64, ComBitSize=8, ComSignalInitValue=0, ComSignalType=UINT8, ComHandleId=211, ComSystemTemplateSystemSignalRef=DET_RANGE_VELOCITY_ERR_005
            DET_RANGE_006_oRDR_DETECTION_005_008_oPCAN_RADAR_61040ba1_Tx: ComBitPosition=136, ComBitSize=15, ComSignalInitValue=0, ComSignalType=UINT16, ComHandleId=200, ComSystemTemplateSystemSignalRef=DET_RANGE_006
            DET_RANGE_ERR_007_oRDR_DETECTION_005_008_oPCAN_RADAR_539c655d_Tx: ComBitPosition=264, ComBitSize=7, ComSignalInitValue=0, ComSignalType=UINT8, ComHandleId=205, ComSystemTemplateSystemSignalRef=DET_RANGE_ERR_007
            DET_RANGE_ERR_008_oRDR_DETECTION_005_008_oPCAN_RADAR_7f8cf71a_Tx: ComBitPosition=376, ComBitSize=7, ComSignalInitValue=0, ComSignalType=UINT8, ComHandleId=206, ComSystemTemplateSystemSignalRef=DET_RANGE_ERR_008
            DET_ELEVATION_ERR_008_oRDR_DETECTION_005_008_oPCAN_RADAR_9e7579b1_Tx: ComBitPosition=416, ComBitSize=6, ComSignalInitValue=0, ComSignalType=UINT8, ComHandleId=175, ComSystemTemplateSystemSignalRef=DET_ELEVATION_ERR_008
            DET_HVC_FLAG_006_oRDR_DETECTION_005_008_oPCAN_RADAR_14fe097c_Tx: ComBitPosition=198, ComBitSize=1, ComSignalInitValue=0, ComSignalType=BOOLEAN, ComHandleId=181, ComSystemTemplateSystemSignalRef=DET_HVC_FLAG_006
            DET_MH_CYCLE_COUNTER_005_008_oRDR_DETECTION_005_008_oPCAN_RADAR_ae76d2cb_Tx: ComBitPosition=16, ComBitSize=8, ComSignalInitValue=0, ComSignalType=UINT8, ComHandleId=189, ComSystemTemplateSystemSignalRef=DET_MH_CYCLE_COUNTER_005_008
            DET_MH_CRC16_005_008_oRDR_DETECTION_005_008_oPCAN_RADAR_2a0373fc_Tx: ComBitPosition=0, ComBitSize=16, ComSignalInitValue=0, ComSignalType=UINT16, ComHandleId=188, ComSystemTemplateSystemSignalRef=DET_MH_CRC16_005_008
            DET_CONFD_AZIMUTH_006_oRDR_DETECTION_005_008_oPCAN_RADAR_737972d0_Tx: ComBitPosition=230, ComBitSize=2, ComSignalInitValue=0, ComSignalType=UINT8, ComHandleId=161, ComSystemTemplateSystemSignalRef=DET_CONFD_AZIMUTH_006
            DET_CONFD_ELEVATION_008_oRDR_DETECTION_005_008_oPCAN_RADAR_c88c35f8_Tx: ComBitPosition=437, ComBitSize=2, ComSignalInitValue=0, ComSignalType=UINT8, ComHandleId=167, ComSystemTemplateSystemSignalRef=DET_CONFD_ELEVATION_008
            DET_RANGE_007_oRDR_DETECTION_005_008_oPCAN_RADAR_f474df34_Tx: ComBitPosition=248, ComBitSize=15, ComSignalInitValue=0, ComSignalType=UINT16, ComHandleId=201, ComSystemTemplateSystemSignalRef=DET_RANGE_007
            DET_SUPER_RES_TARGET_007_oRDR_DETECTION_005_008_oPCAN_RADAR_ea65562c_Tx: ComBitPosition=311, ComBitSize=1, ComSignalInitValue=0, ComSignalType=BOOLEAN, ComHandleId=225, ComSystemTemplateSystemSignalRef=DET_SUPER_RES_TARGET_007
            DET_RANGE_VELOCITY_006_oRDR_DETECTION_005_008_oPCAN_RADAR_14a2c984_Tx: ComBitPosition=160, ComBitSize=15, ComSignalInitValue=16384, ComSignalType=UINT16, ComHandleId=208, ComSystemTemplateSystemSignalRef=DET_RANGE_VELOCITY_006
            DET_RANGE_008_oRDR_DETECTION_005_008_oPCAN_RADAR_d8644d73_Tx: ComBitPosition=360, ComBitSize=15, ComSignalInitValue=0, ComSignalType=UINT16, ComHandleId=202, ComSystemTemplateSystemSignalRef=DET_RANGE_008
            DET_HVC_FLAG_007_oRDR_DETECTION_005_008_oPCAN_RADAR_818edde9_Tx: ComBitPosition=310, ComBitSize=1, ComSignalInitValue=0, ComSignalType=BOOLEAN, ComHandleId=182, ComSystemTemplateSystemSignalRef=DET_HVC_FLAG_007
            DET_RANGE_VELOCITY_ERR_008_oRDR_DETECTION_005_008_oPCAN_RADAR_a27974e4_Tx: ComBitPosition=400, ComBitSize=8, ComSignalInitValue=0, ComSignalType=UINT8, ComHandleId=214, ComSystemTemplateSystemSignalRef=DET_RANGE_VELOCITY_ERR_008
            DET_ELEVATION_005_oRDR_DETECTION_005_008_oPCAN_RADAR_c4ccdce8_Tx: ComBitPosition=72, ComBitSize=8, ComSignalInitValue=0, ComSignalType=UINT8, ComHandleId=168, ComSystemTemplateSystemSignalRef=DET_ELEVATION_005
            DET_EXISTENCE_PROB_005_oRDR_DETECTION_005_008_oPCAN_RADAR_916a31fd_Tx: ComBitPosition=112, ComBitSize=6, ComSignalInitValue=0, ComSignalType=UINT8, ComHandleId=176, ComSystemTemplateSystemSignalRef=DET_EXISTENCE_PROB_005
            DET_ELEVATION_ERR_007_oRDR_DETECTION_005_008_oPCAN_RADAR_b265ebf6_Tx: ComBitPosition=304, ComBitSize=6, ComSignalInitValue=0, ComSignalType=UINT8, ComHandleId=174, ComSystemTemplateSystemSignalRef=DET_ELEVATION_ERR_007
            DET_RCS_005_oRDR_DETECTION_005_008_oPCAN_RADAR_f7c28520_Tx: ComBitPosition=128, ComBitSize=8, ComSignalInitValue=128, ComSignalType=UINT8, ComHandleId=215, ComSystemTemplateSystemSignalRef=DET_RCS_005
            DET_SNR_008_oRDR_DETECTION_005_008_oPCAN_RADAR_f7ecec0e_Tx: ComBitPosition=456, ComBitSize=8, ComSignalInitValue=0, ComSignalType=UINT8, ComHandleId=222, ComSystemTemplateSystemSignalRef=DET_SNR_008
            DET_EXISTENCE_PROB_006_oRDR_DETECTION_005_008_oPCAN_RADAR_f58a4a03_Tx: ComBitPosition=224, ComBitSize=6, ComSignalInitValue=0, ComSignalType=UINT8, ComHandleId=177, ComSystemTemplateSystemSignalRef=DET_EXISTENCE_PROB_006
            DET_RANGE_VELOCITY_007_oRDR_DETECTION_005_008_oPCAN_RADAR_81d21d11_Tx: ComBitPosition=272, ComBitSize=15, ComSignalInitValue=16384, ComSignalType=UINT16, ComHandleId=209, ComSystemTemplateSystemSignalRef=DET_RANGE_VELOCITY_007
            DET_AZIMUTH_ERR_005_oRDR_DETECTION_005_008_oPCAN_RADAR_b1ca9611_Tx: ComBitPosition=105, ComBitSize=7, ComSignalInitValue=0, ComSignalType=UINT8, ComHandleId=148, ComSystemTemplateSystemSignalRef=DET_AZIMUTH_ERR_005
            DET_ELEVATION_007_oRDR_DETECTION_005_008_oPCAN_RADAR_355c7383_Tx: ComBitPosition=296, ComBitSize=8, ComSignalInitValue=0, ComSignalType=UINT8, ComHandleId=170, ComSystemTemplateSystemSignalRef=DET_ELEVATION_007
            DET_RCS_006_oRDR_DETECTION_005_008_oPCAN_RADAR_9322fede_Tx: ComBitPosition=240, ComBitSize=8, ComSignalInitValue=128, ComSignalType=UINT8, ComHandleId=216, ComSystemTemplateSystemSignalRef=DET_RCS_006
            DET_RANGE_VELOCITY_005_oRDR_DETECTION_005_008_oPCAN_RADAR_7042b27a_Tx: ComBitPosition=48, ComBitSize=15, ComSignalInitValue=16384, ComSignalType=UINT16, ComHandleId=207, ComSystemTemplateSystemSignalRef=DET_RANGE_VELOCITY_005
            DET_AZIMUTH_ERR_007_oRDR_DETECTION_005_008_oPCAN_RADAR_405a397a_Tx: ComBitPosition=329, ComBitSize=7, ComSignalInitValue=0, ComSignalType=UINT8, ComHandleId=150, ComSystemTemplateSystemSignalRef=DET_AZIMUTH_ERR_007
            DET_CONFD_ELEVATION_005_oRDR_DETECTION_005_008_oPCAN_RADAR_150c08d4_Tx: ComBitPosition=101, ComBitSize=2, ComSignalInitValue=0, ComSignalType=UINT8, ComHandleId=164, ComSystemTemplateSystemSignalRef=DET_CONFD_ELEVATION_005
            DET_RANGE_ERR_005_oRDR_DETECTION_005_008_oPCAN_RADAR_a20cca36_Tx: ComBitPosition=40, ComBitSize=7, ComSignalInitValue=0, ComSignalType=UINT8, ComHandleId=203, ComSystemTemplateSystemSignalRef=DET_RANGE_ERR_005
            DET_AZIMUTH_ERR_006_oRDR_DETECTION_005_008_oPCAN_RADAR_d52aedef_Tx: ComBitPosition=217, ComBitSize=7, ComSignalInitValue=0, ComSignalType=UINT8, ComHandleId=149, ComSystemTemplateSystemSignalRef=DET_AZIMUTH_ERR_006
            DET_RCS_008_oRDR_DETECTION_005_008_oPCAN_RADAR_2a42b80c_Tx: ComBitPosition=464, ComBitSize=8, ComSignalInitValue=128, ComSignalType=UINT8, ComHandleId=218, ComSystemTemplateSystemSignalRef=DET_RCS_008
            DET_ELEVATION_008_oRDR_DETECTION_005_008_oPCAN_RADAR_194ce1c4_Tx: ComBitPosition=408, ComBitSize=8, ComSignalInitValue=0, ComSignalType=UINT8, ComHandleId=171, ComSystemTemplateSystemSignalRef=DET_ELEVATION_008
            DET_AZIMUTH_005_oRDR_DETECTION_005_008_oPCAN_RADAR_157f03e4_Tx: ComBitPosition=88, ComBitSize=13, ComSignalInitValue=0, ComSignalType=UINT16, ComHandleId=144, ComSystemTemplateSystemSignalRef=DET_AZIMUTH_005
            DET_SUPER_RES_TARGET_008_oRDR_DETECTION_005_008_oPCAN_RADAR_c675c46b_Tx: ComBitPosition=423, ComBitSize=1, ComSignalInitValue=0, ComSignalType=BOOLEAN, ComHandleId=226, ComSystemTemplateSystemSignalRef=DET_SUPER_RES_TARGET_008
            DET_RANGE_VELOCITY_ERR_006_oRDR_DETECTION_005_008_oPCAN_RADAR_1b193236_Tx: ComBitPosition=176, ComBitSize=8, ComSignalInitValue=0, ComSignalType=UINT8, ComHandleId=212, ComSystemTemplateSystemSignalRef=DET_RANGE_VELOCITY_ERR_006
            DET_PROB_1STAZHYPO_007_oRDR_DETECTION_005_008_oPCAN_RADAR_ffdb3c42_Tx: ComBitPosition=327, ComBitSize=1, ComSignalInitValue=0, ComSignalType=BOOLEAN, ComHandleId=197, ComSystemTemplateSystemSignalRef=DET_PROB_1STAZHYPO_007
            DET_PROB_1STAZHYPO_006_oRDR_DETECTION_005_008_oPCAN_RADAR_6aabe8d7_Tx: ComBitPosition=215, ComBitSize=1, ComSignalInitValue=0, ComSignalType=BOOLEAN, ComHandleId=196, ComSystemTemplateSystemSignalRef=DET_PROB_1STAZHYPO_006
            DET_PROB_1STAZHYPO_008_oRDR_DETECTION_005_008_oPCAN_RADAR_d3cbae05_Tx: ComBitPosition=439, ComBitSize=1, ComSignalInitValue=0, ComSignalType=BOOLEAN, ComHandleId=198, ComSystemTemplateSystemSignalRef=DET_PROB_1STAZHYPO_008
            DET_IDM_005_oRDR_DETECTION_005_008_oPCAN_RADAR_fb4c493f_Tx: ComBitPosition=63, ComBitSize=1, ComSignalInitValue=0, ComSignalType=UINT8, ComHandleId=184, ComSystemTemplateSystemSignalRef=DET_IDM_005
            DET_PROB_1STAZHYPO_005_oRDR_DETECTION_005_008_oPCAN_RADAR_0e4b9329_Tx: ComBitPosition=103, ComBitSize=1, ComSignalInitValue=0, ComSignalType=BOOLEAN, ComHandleId=195, ComSystemTemplateSystemSignalRef=DET_PROB_1STAZHYPO_005
            DET_MTD_005_oRDR_DETECTION_005_008_oPCAN_RADAR_9dff7be4_Tx: ComBitPosition=47, ComBitSize=1, ComSignalInitValue=0, ComSignalType=UINT8, ComHandleId=191, ComSystemTemplateSystemSignalRef=DET_MTD_005
            DET_MTD_006_oRDR_DETECTION_005_008_oPCAN_RADAR_f91f001a_Tx: ComBitPosition=159, ComBitSize=1, ComSignalInitValue=0, ComSignalType=UINT8, ComHandleId=192, ComSystemTemplateSystemSignalRef=DET_MTD_006
            DET_BELOW_RAIN_THOLD_008_oRDR_DETECTION_005_008_oPCAN_RADAR_1dfead08_Tx: ComBitPosition=375, ComBitSize=1, ComSignalInitValue=0, ComSignalType=UINT8, ComHandleId=155, ComSystemTemplateSystemSignalRef=DET_BELOW_RAIN_THOLD_008
            DET_IDM_006_oRDR_DETECTION_005_008_oPCAN_RADAR_9fac32c1_Tx: ComBitPosition=175, ComBitSize=1, ComSignalInitValue=0, ComSignalType=UINT8, ComHandleId=185, ComSystemTemplateSystemSignalRef=DET_IDM_006
            DET_BELOW_RAIN_THOLD_007_oRDR_DETECTION_005_008_oPCAN_RADAR_31ee3f4f_Tx: ComBitPosition=263, ComBitSize=1, ComSignalInitValue=0, ComSignalType=UINT8, ComHandleId=154, ComSystemTemplateSystemSignalRef=DET_BELOW_RAIN_THOLD_007
            DET_IDM_007_oRDR_DETECTION_005_008_oPCAN_RADAR_0adce654_Tx: ComBitPosition=287, ComBitSize=1, ComSignalInitValue=0, ComSignalType=UINT8, ComHandleId=186, ComSystemTemplateSystemSignalRef=DET_IDM_007
            DET_IDM_008_oRDR_DETECTION_005_008_oPCAN_RADAR_26cc7413_Tx: ComBitPosition=399, ComBitSize=1, ComSignalInitValue=0, ComSignalType=UINT8, ComHandleId=187, ComSystemTemplateSystemSignalRef=DET_IDM_008
            DET_MTD_008_oRDR_DETECTION_005_008_oPCAN_RADAR_407f46c8_Tx: ComBitPosition=383, ComBitSize=1, ComSignalInitValue=0, ComSignalType=UINT8, ComHandleId=194, ComSystemTemplateSystemSignalRef=DET_MTD_008
            DET_BELOW_RAIN_THOLD_005_oRDR_DETECTION_005_008_oPCAN_RADAR_c07e9024_Tx: ComBitPosition=39, ComBitSize=1, ComSignalInitValue=0, ComSignalType=UINT8, ComHandleId=152, ComSystemTemplateSystemSignalRef=DET_BELOW_RAIN_THOLD_005
            DET_MTD_007_oRDR_DETECTION_005_008_oPCAN_RADAR_6c6fd48f_Tx: ComBitPosition=271, ComBitSize=1, ComSignalInitValue=0, ComSignalType=UINT8, ComHandleId=193, ComSystemTemplateSystemSignalRef=DET_MTD_007
            DET_BELOW_RAIN_THOLD_006_oRDR_DETECTION_005_008_oPCAN_RADAR_a49eebda_Tx: ComBitPosition=151, ComBitSize=1, ComSignalInitValue=0, ComSignalType=UINT8, ComHandleId=153, ComSystemTemplateSystemSignalRef=DET_BELOW_RAIN_THOLD_006
        SG_Detections_209_212_oRDR_DETECTION_209_212_oPCAN_RADAR_b2a1c0f4_Tx: ComTransferProperty=TRIGGERED, ComHandleId=54, ComSystemTemplateSignalGroupRef=SG_Detections_209_212
          83 x ComGroupSignal, all with ComSignalEndianness=LITTLE_ENDIAN, ComTransferProperty=PENDING, ComSignalAccess=ACCESS_NEEDED_BY_SWC_OR_COM:
            DET_CONFD_ELEVATION_210_oRDR_DETECTION_209_212_oPCAN_RADAR_16c6362d_Tx: ComBitPosition=213, ComBitSize=2, ComSignalInitValue=0, ComSignalType=UINT8, ComHandleId=4398, ComSystemTemplateSystemSignalRef=DET_CONFD_ELEVATION_210
            DET_RANGE_VELOCITY_ERR_211_oRDR_DETECTION_209_212_oPCAN_RADAR_e943a3a4_Tx: ComBitPosition=288, ComBitSize=8, ComSignalInitValue=0, ComSignalType=UINT8, ComHandleId=4446, ComSystemTemplateSystemSignalRef=DET_RANGE_VELOCITY_ERR_211
            DET_RANGE_212_oRDR_DETECTION_209_212_oPCAN_RADAR_f7bee1cd_Tx: ComBitPosition=360, ComBitSize=15, ComSignalInitValue=0, ComSignalType=UINT16, ComHandleId=4435, ComSystemTemplateSystemSignalRef=DET_RANGE_212
            DET_ELEVATION_210_oRDR_DETECTION_209_212_oPCAN_RADAR_c706e211_Tx: ComBitPosition=184, ComBitSize=8, ComSignalInitValue=0, ComSignalType=UINT8, ComHandleId=4402, ComSystemTemplateSystemSignalRef=DET_ELEVATION_210
            DET_RANGE_ERR_209_oRDR_DETECTION_209_212_oPCAN_RADAR_c4e6866b_Tx: ComBitPosition=40, ComBitSize=7, ComSignalInitValue=0, ComSignalType=UINT8, ComHandleId=4436, ComSystemTemplateSystemSignalRef=DET_RANGE_ERR_209
            DET_BI_STATIC_FLAG_211_oRDR_DETECTION_209_212_oPCAN_RADAR_d5e9a90d_Tx: ComBitPosition=328, ComBitSize=1, ComSignalInitValue=0, ComSignalType=BOOLEAN, ComHandleId=4391, ComSystemTemplateSystemSignalRef=DET_BI_STATIC_FLAG_211
            DET_RANGE_ERR_211_oRDR_DETECTION_209_212_oPCAN_RADAR_34b6205a_Tx: ComBitPosition=264, ComBitSize=7, ComSignalInitValue=0, ComSignalType=UINT8, ComHandleId=4438, ComSystemTemplateSystemSignalRef=DET_RANGE_ERR_211
            DET_ELEVATION_ERR_211_oRDR_DETECTION_209_212_oPCAN_RADAR_d54faef1_Tx: ComBitPosition=304, ComBitSize=6, ComSignalInitValue=0, ComSignalType=UINT8, ComHandleId=4407, ComSystemTemplateSystemSignalRef=DET_ELEVATION_ERR_211
            DET_CONFD_AZIMUTH_212_oRDR_DETECTION_209_212_oPCAN_RADAR_e5c398bc_Tx: ComBitPosition=454, ComBitSize=2, ComSignalInitValue=0, ComSignalType=UINT8, ComHandleId=4396, ComSystemTemplateSystemSignalRef=DET_CONFD_AZIMUTH_212
            DET_MH_CRC16_209_212_oRDR_DETECTION_209_212_oPCAN_RADAR_362912ff_Tx: ComBitPosition=0, ComBitSize=16, ComSignalInitValue=0, ComSignalType=UINT16, ComHandleId=4421, ComSystemTemplateSystemSignalRef=DET_MH_CRC16_209_212
            DET_RANGE_VELOCITY_ERR_210_oRDR_DETECTION_209_212_oPCAN_RADAR_7c337731_Tx: ComBitPosition=176, ComBitSize=8, ComSignalInitValue=0, ComSignalType=UINT8, ComHandleId=4445, ComSystemTemplateSystemSignalRef=DET_RANGE_VELOCITY_ERR_210
            DET_RCS_211_oRDR_DETECTION_209_212_oPCAN_RADAR_61786f4c_Tx: ComBitPosition=352, ComBitSize=8, ComSignalInitValue=128, ComSignalType=UINT8, ComHandleId=4450, ComSystemTemplateSystemSignalRef=DET_RCS_211
            DET_RANGE_VELOCITY_ERR_209_oRDR_DETECTION_209_212_oPCAN_RADAR_19130595_Tx: ComBitPosition=64, ComBitSize=8, ComSignalInitValue=0, ComSignalType=UINT8, ComHandleId=4444, ComSystemTemplateSystemSignalRef=DET_RANGE_VELOCITY_ERR_209
            DET_HVC_FLAG_210_oRDR_DETECTION_209_212_oPCAN_RADAR_73d44c7b_Tx: ComBitPosition=198, ComBitSize=1, ComSignalInitValue=0, ComSignalType=BOOLEAN, ComHandleId=4414, ComSystemTemplateSystemSignalRef=DET_HVC_FLAG_210
            DET_EXISTENCE_PROB_212_oRDR_DETECTION_209_212_oPCAN_RADAR_6330a06f_Tx: ComBitPosition=448, ComBitSize=6, ComSignalInitValue=0, ComSignalType=UINT8, ComHandleId=4412, ComSystemTemplateSystemSignalRef=DET_EXISTENCE_PROB_212
            DET_SUPER_RES_TARGET_210_oRDR_DETECTION_209_212_oPCAN_RADAR_183fc7be_Tx: ComBitPosition=199, ComBitSize=1, ComSignalInitValue=0, ComSignalType=BOOLEAN, ComHandleId=4457, ComSystemTemplateSystemSignalRef=DET_SUPER_RES_TARGET_210
            DET_EXISTENCE_PROB_211_oRDR_DETECTION_209_212_oPCAN_RADAR_07d0db91_Tx: ComBitPosition=336, ComBitSize=6, ComSignalInitValue=0, ComSignalType=UINT8, ComHandleId=4411, ComSystemTemplateSystemSignalRef=DET_EXISTENCE_PROB_211
            DET_CONFD_ELEVATION_212_oRDR_DETECTION_209_212_oPCAN_RADAR_e7569946_Tx: ComBitPosition=437, ComBitSize=2, ComSignalInitValue=0, ComSignalType=UINT8, ComHandleId=4400, ComSystemTemplateSystemSignalRef=DET_CONFD_ELEVATION_212
            DET_RANGE_VELOCITY_210_oRDR_DETECTION_209_212_oPCAN_RADAR_73888c83_Tx: ComBitPosition=160, ComBitSize=15, ComSignalInitValue=16384, ComSignalType=UINT16, ComHandleId=4441, ComSystemTemplateSystemSignalRef=DET_RANGE_VELOCITY_210
            DET_SUPER_RES_TARGET_209_oRDR_DETECTION_209_212_oPCAN_RADAR_7d1fb51a_Tx: ComBitPosition=87, ComBitSize=1, ComSignalInitValue=0, ComSignalType=BOOLEAN, ComHandleId=4456, ComSystemTemplateSystemSignalRef=DET_SUPER_RES_TARGET_209
            DET_SUPER_RES_TARGET_212_oRDR_DETECTION_209_212_oPCAN_RADAR_e9af68d5_Tx: ComBitPosition=423, ComBitSize=1, ComSignalInitValue=0, ComSignalType=BOOLEAN, ComHandleId=4459, ComSystemTemplateSystemSignalRef=DET_SUPER_RES_TARGET_212
            DET_BI_STATIC_FLAG_210_oRDR_DETECTION_209_212_oPCAN_RADAR_40997d98_Tx: ComBitPosition=216, ComBitSize=1, ComSignalInitValue=0, ComSignalType=BOOLEAN, ComHandleId=4390, ComSystemTemplateSystemSignalRef=DET_BI_STATIC_FLAG_210
            DET_RANGE_211_oRDR_DETECTION_209_212_oPCAN_RADAR_935e9a33_Tx: ComBitPosition=248, ComBitSize=15, ComSignalInitValue=0, ComSignalType=UINT16, ComHandleId=4434, ComSystemTemplateSystemSignalRef=DET_RANGE_211
            DET_SUPER_RES_TARGET_211_oRDR_DETECTION_209_212_oPCAN_RADAR_8d4f132b_Tx: ComBitPosition=311, ComBitSize=1, ComSignalInitValue=0, ComSignalType=BOOLEAN, ComHandleId=4458, ComSystemTemplateSystemSignalRef=DET_SUPER_RES_TARGET_211
            DET_AZIMUTH_ERR_212_oRDR_DETECTION_209_212_oPCAN_RADAR_43900783_Tx: ComBitPosition=441, ComBitSize=7, ComSignalInitValue=0, ComSignalType=UINT8, ComHandleId=4384, ComSystemTemplateSystemSignalRef=DET_AZIMUTH_ERR_212
            DET_SNR_209_oRDR_DETECTION_209_212_oPCAN_RADAR_4c869d7f_Tx: ComBitPosition=120, ComBitSize=8, ComSignalInitValue=0, ComSignalType=UINT8, ComHandleId=4452, ComSystemTemplateSystemSignalRef=DET_SNR_209
            DET_RCS_210_oRDR_DETECTION_209_212_oPCAN_RADAR_f408bbd9_Tx: ComBitPosition=240, ComBitSize=8, ComSignalInitValue=128, ComSignalType=UINT8, ComHandleId=4449, ComSystemTemplateSystemSignalRef=DET_RCS_210
            DET_ELEVATION_211_oRDR_DETECTION_209_212_oPCAN_RADAR_52763684_Tx: ComBitPosition=296, ComBitSize=8, ComSignalInitValue=0, ComSignalType=UINT8, ComHandleId=4403, ComSystemTemplateSystemSignalRef=DET_ELEVATION_211
            DET_HVC_FLAG_209_oRDR_DETECTION_209_212_oPCAN_RADAR_16f43edf_Tx: ComBitPosition=86, ComBitSize=1, ComSignalInitValue=0, ComSignalType=BOOLEAN, ComHandleId=4413, ComSystemTemplateSystemSignalRef=DET_HVC_FLAG_209
            DET_ELEVATION_212_oRDR_DETECTION_209_212_oPCAN_RADAR_36964d7a_Tx: ComBitPosition=408, ComBitSize=8, ComSignalInitValue=0, ComSignalType=UINT8, ComHandleId=4404, ComSystemTemplateSystemSignalRef=DET_ELEVATION_212
            DET_EXISTENCE_PROB_209_oRDR_DETECTION_209_212_oPCAN_RADAR_f7807da0_Tx: ComBitPosition=112, ComBitSize=6, ComSignalInitValue=0, ComSignalType=UINT8, ComHandleId=4409, ComSystemTemplateSystemSignalRef=DET_EXISTENCE_PROB_209
            DET_MH_SCAN_INDEX_4LSB_209_212_oRDR_DETECTION_209_212_oPCAN_RADAR_7e769644_Tx: ComBitPosition=476, ComBitSize=4, ComSignalInitValue=0, ComSignalType=UINT8, ComHandleId=4423, ComSystemTemplateSystemSignalRef=DET_MH_SCAN_INDEX_4LSB_209_212
            DET_CONFD_AZIMUTH_211_oRDR_DETECTION_209_212_oPCAN_RADAR_8123e342_Tx: ComBitPosition=342, ComBitSize=2, ComSignalInitValue=0, ComSignalType=UINT8, ComHandleId=4395, ComSystemTemplateSystemSignalRef=DET_CONFD_AZIMUTH_211
            DET_RANGE_VELOCITY_212_oRDR_DETECTION_209_212_oPCAN_RADAR_821823e8_Tx: ComBitPosition=384, ComBitSize=15, ComSignalInitValue=16384, ComSignalType=UINT16, ComHandleId=4443, ComSystemTemplateSystemSignalRef=DET_RANGE_VELOCITY_212
            DET_ELEVATION_ERR_209_oRDR_DETECTION_209_212_oPCAN_RADAR_251f08c0_Tx: ComBitPosition=80, ComBitSize=6, ComSignalInitValue=0, ComSignalType=UINT8, ComHandleId=4405, ComSystemTemplateSystemSignalRef=DET_ELEVATION_ERR_209
            DET_BI_STATIC_FLAG_209_oRDR_DETECTION_209_212_oPCAN_RADAR_25b90f3c_Tx: ComBitPosition=104, ComBitSize=1, ComSignalInitValue=0, ComSignalType=BOOLEAN, ComHandleId=4389, ComSystemTemplateSystemSignalRef=DET_BI_STATIC_FLAG_209
            DET_HVC_FLAG_212_oRDR_DETECTION_209_212_oPCAN_RADAR_8244e310_Tx: ComBitPosition=422, ComBitSize=1, ComSignalInitValue=0, ComSignalType=BOOLEAN, ComHandleId=4416, ComSystemTemplateSystemSignalRef=DET_HVC_FLAG_212
            DET_ELEVATION_ERR_212_oRDR_DETECTION_209_212_oPCAN_RADAR_b1afd50f_Tx: ComBitPosition=416, ComBitSize=6, ComSignalInitValue=0, ComSignalType=UINT8, ComHandleId=4408, ComSystemTemplateSystemSignalRef=DET_ELEVATION_ERR_212
            DET_AZIMUTH_211_oRDR_DETECTION_209_212_oPCAN_RADAR_83c5e988_Tx: ComBitPosition=312, ComBitSize=13, ComSignalInitValue=0, ComSignalType=UINT16, ComHandleId=4379, ComSystemTemplateSystemSignalRef=DET_AZIMUTH_211
            DET_RANGE_209_oRDR_DETECTION_209_212_oPCAN_RADAR_630e3c02_Tx: ComBitPosition=24, ComBitSize=15, ComSignalInitValue=0, ComSignalType=UINT16, ComHandleId=4432, ComSystemTemplateSystemSignalRef=DET_RANGE_209
            DET_RANGE_ERR_210_oRDR_DETECTION_209_212_oPCAN_RADAR_a1c6f4cf_Tx: ComBitPosition=152, ComBitSize=7, ComSignalInitValue=0, ComSignalType=UINT8, ComHandleId=4437, ComSystemTemplateSystemSignalRef=DET_RANGE_ERR_210
            DET_RANGE_ERR_212_oRDR_DETECTION_209_212_oPCAN_RADAR_50565ba4_Tx: ComBitPosition=376, ComBitSize=7, ComSignalInitValue=0, ComSignalType=UINT8, ComHandleId=4439, ComSystemTemplateSystemSignalRef=DET_RANGE_ERR_212
            DET_SNR_212_oRDR_DETECTION_209_212_oPCAN_RADAR_d83640b0_Tx: ComBitPosition=456, ComBitSize=8, ComSignalInitValue=0, ComSignalType=UINT8, ComHandleId=4455, ComSystemTemplateSystemSignalRef=DET_SNR_212
            DET_HVC_FLAG_211_oRDR_DETECTION_209_212_oPCAN_RADAR_e6a498ee_Tx: ComBitPosition=310, ComBitSize=1, ComSignalInitValue=0, ComSignalType=BOOLEAN, ComHandleId=4415, ComSystemTemplateSystemSignalRef=DET_HVC_FLAG_211
            DET_RCS_212_oRDR_DETECTION_209_212_oPCAN_RADAR_059814b2_Tx: ComBitPosition=464, ComBitSize=8, ComSignalInitValue=128, ComSignalType=UINT8, ComHandleId=4451, ComSystemTemplateSystemSignalRef=DET_RCS_212
            DET_AZIMUTH_ERR_210_oRDR_DETECTION_209_212_oPCAN_RADAR_b200a8e8_Tx: ComBitPosition=217, ComBitSize=7, ComSignalInitValue=0, ComSignalType=UINT8, ComHandleId=4382, ComSystemTemplateSystemSignalRef=DET_AZIMUTH_ERR_210
            DET_ELEVATION_ERR_210_oRDR_DETECTION_209_212_oPCAN_RADAR_403f7a64_Tx: ComBitPosition=192, ComBitSize=6, ComSignalInitValue=0, ComSignalType=UINT8, ComHandleId=4406, ComSystemTemplateSystemSignalRef=DET_ELEVATION_ERR_210
            DET_AZIMUTH_209_oRDR_DETECTION_209_212_oPCAN_RADAR_73954fb9_Tx: ComBitPosition=88, ComBitSize=13, ComSignalInitValue=0, ComSignalType=UINT16, ComHandleId=4377, ComSystemTemplateSystemSignalRef=DET_AZIMUTH_209
            DET_CONFD_AZIMUTH_209_oRDR_DETECTION_209_212_oPCAN_RADAR_71734573_Tx: ComBitPosition=118, ComBitSize=2, ComSignalInitValue=0, ComSignalType=UINT8, ComHandleId=4393, ComSystemTemplateSystemSignalRef=DET_CONFD_AZIMUTH_209
            DET_AZIMUTH_210_oRDR_DETECTION_209_212_oPCAN_RADAR_16b53d1d_Tx: ComBitPosition=200, ComBitSize=13, ComSignalInitValue=0, ComSignalType=UINT16, ComHandleId=4378, ComSystemTemplateSystemSignalRef=DET_AZIMUTH_210
            DET_RCS_209_oRDR_DETECTION_209_212_oPCAN_RADAR_9128c97d_Tx: ComBitPosition=128, ComBitSize=8, ComSignalInitValue=128, ComSignalType=UINT8, ComHandleId=4448, ComSystemTemplateSystemSignalRef=DET_RCS_209
            DET_AZIMUTH_212_oRDR_DETECTION_209_212_oPCAN_RADAR_e7259276_Tx: ComBitPosition=424, ComBitSize=13, ComSignalInitValue=0, ComSignalType=UINT16, ComHandleId=4380, ComSystemTemplateSystemSignalRef=DET_AZIMUTH_212
            DET_ELEVATION_209_oRDR_DETECTION_209_212_oPCAN_RADAR_a22690b5_Tx: ComBitPosition=72, ComBitSize=8, ComSignalInitValue=0, ComSignalType=UINT8, ComHandleId=4401, ComSystemTemplateSystemSignalRef=DET_ELEVATION_209
            DET_RANGE_VELOCITY_209_oRDR_DETECTION_209_212_oPCAN_RADAR_16a8fe27_Tx: ComBitPosition=48, ComBitSize=15, ComSignalInitValue=16384, ComSignalType=UINT16, ComHandleId=4440, ComSystemTemplateSystemSignalRef=DET_RANGE_VELOCITY_209
            DET_BI_STATIC_FLAG_212_oRDR_DETECTION_209_212_oPCAN_RADAR_b109d2f3_Tx: ComBitPosition=440, ComBitSize=1, ComSignalInitValue=0, ComSignalType=BOOLEAN, ComHandleId=4392, ComSystemTemplateSystemSignalRef=DET_BI_STATIC_FLAG_212
            DET_CONFD_AZIMUTH_210_oRDR_DETECTION_209_212_oPCAN_RADAR_145337d7_Tx: ComBitPosition=230, ComBitSize=2, ComSignalInitValue=0, ComSignalType=UINT8, ComHandleId=4394, ComSystemTemplateSystemSignalRef=DET_CONFD_AZIMUTH_210
            DET_RANGE_210_oRDR_DETECTION_209_212_oPCAN_RADAR_062e4ea6_Tx: ComBitPosition=136, ComBitSize=15, ComSignalInitValue=0, ComSignalType=UINT16, ComHandleId=4433, ComSystemTemplateSystemSignalRef=DET_RANGE_210
            DET_CONFD_ELEVATION_209_oRDR_DETECTION_209_212_oPCAN_RADAR_73e64489_Tx: ComBitPosition=101, ComBitSize=2, ComSignalInitValue=0, ComSignalType=UINT8, ComHandleId=4397, ComSystemTemplateSystemSignalRef=DET_CONFD_ELEVATION_209
            DET_CONFD_ELEVATION_211_oRDR_DETECTION_209_212_oPCAN_RADAR_83b6e2b8_Tx: ComBitPosition=325, ComBitSize=2, ComSignalInitValue=0, ComSignalType=UINT8, ComHandleId=4399, ComSystemTemplateSystemSignalRef=DET_CONFD_ELEVATION_211
            DET_AZIMUTH_ERR_209_oRDR_DETECTION_209_212_oPCAN_RADAR_d720da4c_Tx: ComBitPosition=105, ComBitSize=7, ComSignalInitValue=0, ComSignalType=UINT8, ComHandleId=4381, ComSystemTemplateSystemSignalRef=DET_AZIMUTH_ERR_209
            DET_SNR_211_oRDR_DETECTION_209_212_oPCAN_RADAR_bcd63b4e_Tx: ComBitPosition=344, ComBitSize=8, ComSignalInitValue=0, ComSignalType=UINT8, ComHandleId=4454, ComSystemTemplateSystemSignalRef=DET_SNR_211
            DET_MH_CYCLE_COUNTER_209_212_oRDR_DETECTION_209_212_oPCAN_RADAR_b25cb3c8_Tx: ComBitPosition=16, ComBitSize=8, ComSignalInitValue=0, ComSignalType=UINT8, ComHandleId=4422, ComSystemTemplateSystemSignalRef=DET_MH_CYCLE_COUNTER_209_212
            DET_AZIMUTH_ERR_211_oRDR_DETECTION_209_212_oPCAN_RADAR_27707c7d_Tx: ComBitPosition=329, ComBitSize=7, ComSignalInitValue=0, ComSignalType=UINT8, ComHandleId=4383, ComSystemTemplateSystemSignalRef=DET_AZIMUTH_ERR_211
            DET_SNR_210_oRDR_DETECTION_209_212_oPCAN_RADAR_29a6efdb_Tx: ComBitPosition=232, ComBitSize=8, ComSignalInitValue=0, ComSignalType=UINT8, ComHandleId=4453, ComSystemTemplateSystemSignalRef=DET_SNR_210
            DET_RANGE_VELOCITY_211_oRDR_DETECTION_209_212_oPCAN_RADAR_e6f85816_Tx: ComBitPosition=272, ComBitSize=15, ComSignalInitValue=16384, ComSignalType=UINT16, ComHandleId=4442, ComSystemTemplateSystemSignalRef=DET_RANGE_VELOCITY_211
            DET_RANGE_VELOCITY_ERR_212_oRDR_DETECTION_209_212_oPCAN_RADAR_8da3d85a_Tx: ComBitPosition=400, ComBitSize=8, ComSignalInitValue=0, ComSignalType=UINT8, ComHandleId=4447, ComSystemTemplateSystemSignalRef=DET_RANGE_VELOCITY_ERR_212
            DET_EXISTENCE_PROB_210_oRDR_DETECTION_209_212_oPCAN_RADAR_92a00f04_Tx: ComBitPosition=224, ComBitSize=6, ComSignalInitValue=0, ComSignalType=UINT8, ComHandleId=4410, ComSystemTemplateSystemSignalRef=DET_EXISTENCE_PROB_210
            DET_IDM_212_oRDR_DETECTION_209_212_oPCAN_RADAR_0916d8ad_Tx: ComBitPosition=399, ComBitSize=1, ComSignalInitValue=0, ComSignalType=UINT8, ComHandleId=4420, ComSystemTemplateSystemSignalRef=DET_IDM_212
            DET_PROB_1STAZHYPO_211_oRDR_DETECTION_209_212_oPCAN_RADAR_98f17945_Tx: ComBitPosition=327, ComBitSize=1, ComSignalInitValue=0, ComSignalType=BOOLEAN, ComHandleId=4430, ComSystemTemplateSystemSignalRef=DET_PROB_1STAZHYPO_211
            DET_IDM_211_oRDR_DETECTION_209_212_oPCAN_RADAR_6df6a353_Tx: ComBitPosition=287, ComBitSize=1, ComSignalInitValue=0, ComSignalType=UINT8, ComHandleId=4419, ComSystemTemplateSystemSignalRef=DET_IDM_211
            DET_PROB_1STAZHYPO_212_oRDR_DETECTION_209_212_oPCAN_RADAR_fc1102bb_Tx: ComBitPosition=439, ComBitSize=1, ComSignalInitValue=0, ComSignalType=BOOLEAN, ComHandleId=4431, ComSystemTemplateSystemSignalRef=DET_PROB_1STAZHYPO_212
            DET_PROB_1STAZHYPO_210_oRDR_DETECTION_209_212_oPCAN_RADAR_0d81add0_Tx: ComBitPosition=215, ComBitSize=1, ComSignalInitValue=0, ComSignalType=BOOLEAN, ComHandleId=4429, ComSystemTemplateSystemSignalRef=DET_PROB_1STAZHYPO_210
            DET_BELOW_RAIN_THOLD_211_oRDR_DETECTION_209_212_oPCAN_RADAR_56c47a48_Tx: ComBitPosition=263, ComBitSize=1, ComSignalInitValue=0, ComSignalType=UINT8, ComHandleId=4387, ComSystemTemplateSystemSignalRef=DET_BELOW_RAIN_THOLD_211
            DET_PROB_1STAZHYPO_209_oRDR_DETECTION_209_212_oPCAN_RADAR_68a1df74_Tx: ComBitPosition=103, ComBitSize=1, ComSignalInitValue=0, ComSignalType=BOOLEAN, ComHandleId=4428, ComSystemTemplateSystemSignalRef=DET_PROB_1STAZHYPO_209
            DET_BELOW_RAIN_THOLD_209_oRDR_DETECTION_209_212_oPCAN_RADAR_a694dc79_Tx: ComBitPosition=39, ComBitSize=1, ComSignalInitValue=0, ComSignalType=UINT8, ComHandleId=4385, ComSystemTemplateSystemSignalRef=DET_BELOW_RAIN_THOLD_209
            DET_MTD_211_oRDR_DETECTION_209_212_oPCAN_RADAR_0b459188_Tx: ComBitPosition=271, ComBitSize=1, ComSignalInitValue=0, ComSignalType=UINT8, ComHandleId=4426, ComSystemTemplateSystemSignalRef=DET_MTD_211
            DET_MTD_209_oRDR_DETECTION_209_212_oPCAN_RADAR_fb1537b9_Tx: ComBitPosition=47, ComBitSize=1, ComSignalInitValue=0, ComSignalType=UINT8, ComHandleId=4424, ComSystemTemplateSystemSignalRef=DET_MTD_209
            DET_MTD_210_oRDR_DETECTION_209_212_oPCAN_RADAR_9e35451d_Tx: ComBitPosition=159, ComBitSize=1, ComSignalInitValue=0, ComSignalType=UINT8, ComHandleId=4425, ComSystemTemplateSystemSignalRef=DET_MTD_210
            DET_MTD_212_oRDR_DETECTION_209_212_oPCAN_RADAR_6fa5ea76_Tx: ComBitPosition=383, ComBitSize=1, ComSignalInitValue=0, ComSignalType=UINT8, ComHandleId=4427, ComSystemTemplateSystemSignalRef=DET_MTD_212
            DET_BELOW_RAIN_THOLD_210_oRDR_DETECTION_209_212_oPCAN_RADAR_c3b4aedd_Tx: ComBitPosition=151, ComBitSize=1, ComSignalInitValue=0, ComSignalType=UINT8, ComHandleId=4386, ComSystemTemplateSystemSignalRef=DET_BELOW_RAIN_THOLD_210
            DET_BELOW_RAIN_THOLD_212_oRDR_DETECTION_209_212_oPCAN_RADAR_322401b6_Tx: ComBitPosition=375, ComBitSize=1, ComSignalInitValue=0, ComSignalType=UINT8, ComHandleId=4388, ComSystemTemplateSystemSignalRef=DET_BELOW_RAIN_THOLD_212
            DET_IDM_209_oRDR_DETECTION_209_212_oPCAN_RADAR_9da60562_Tx: ComBitPosition=63, ComBitSize=1, ComSignalInitValue=0, ComSignalType=UINT8, ComHandleId=4417, ComSystemTemplateSystemSignalRef=DET_IDM_209
            DET_IDM_210_oRDR_DETECTION_209_212_oPCAN_RADAR_f88677c6_Tx: ComBitPosition=175, ComBitSize=1, ComSignalInitValue=0, ComSignalType=UINT8, ComHandleId=4418, ComSystemTemplateSystemSignalRef=DET_IDM_210
        SG_VehicleStatus_oSYS_VEHICLE_STATUS_oPCAN_RADAR_0411a809_Rx: ComTimeout=0, ComTransferProperty=PENDING, ComHandleId=62, ComSystemTemplateSignalGroupRef=SG_VehicleStatus
          39 x ComGroupSignal, all with ComSignalAccess=ACCESS_NEEDED_BY_SWC_OR_COM:
            SSTS_SW_VERSION_ADAS_oSYS_VEHICLE_STATUS_oPCAN_RADAR_9ba50e45_Rx: ComBitPosition=248, ComBitSize=32, ComSignalEndianness=LITTLE_ENDIAN, ComSignalInitValue=0, ComSignalType=UINT32, ComHandleId=2958, ComSystemTemplateSystemSignalRef=SSTS_SW_VERSION_ADAS
            SSTS_CAN_PCAN_MINOR_ADAS_oSYS_VEHICLE_STATUS_oPCAN_RADAR_8c9b1f32_Rx: ComBitPosition=24, ComBitSize=8, ComSignalEndianness=LITTLE_ENDIAN, ComSignalInitValue=0, ComSignalType=UINT8, ComHandleId=2949, ComSystemTemplateSystemSignalRef=SSTS_CAN_PCAN_MINOR_ADAS
            SSTS_CAN_PCAN_MAJOR_ADAS_oSYS_VEHICLE_STATUS_oPCAN_RADAR_7162c0e1_Rx: ComBitPosition=240, ComBitSize=8, ComSignalEndianness=LITTLE_ENDIAN, ComSignalInitValue=0, ComSignalType=UINT8, ComHandleId=2948, ComSystemTemplateSystemSignalRef=SSTS_CAN_PCAN_MAJOR_ADAS
            SSTS_VEH_ODOMETER_oSYS_VEHICLE_STATUS_oPCAN_RADAR_751a6302_Rx: ComBitPosition=128, ComBitSize=20, ComSignalEndianness=LITTLE_ENDIAN, ComSignalInitValue=0, ComSignalType=UINT32, ComHandleId=2968, ComSystemTemplateSystemSignalRef=SSTS_VEH_ODOMETER
            SSTS_VEH_AbsoluteTime_Second_oSYS_VEHICLE_STATUS_oPCAN_RADAR_816ad585_Rx: ComBitPosition=96, ComBitSize=6, ComSignalEndianness=LITTLE_ENDIAN, ComSignalInitValue=0, ComSignalType=UINT8, ComHandleId=2966, ComSystemTemplateSystemSignalRef=SSTS_VEH_AbsoluteTime_Second
            SSTS_YAW_RATE_CALC_oSYS_VEHICLE_STATUS_oPCAN_RADAR_070d13a1_Rx: ComBitPosition=38, ComBitSize=10, ComSignalEndianness=LITTLE_ENDIAN, ComSignalInitValue=448, ComSignalType=UINT16, ComHandleId=2986, ComSystemTemplateSystemSignalRef=SSTS_YAW_RATE_CALC
            SSTS_STEERING_ANGLE_oSYS_VEHICLE_STATUS_oPCAN_RADAR_a73dd98d_Rx: ComBitPosition=104, ComBitSize=8, ComSignalEndianness=LITTLE_ENDIAN, ComSignalInitValue=0, ComSignalType=UINT8, ComHandleId=2957, ComSystemTemplateSystemSignalRef=SSTS_STEERING_ANGLE
            SSTS_VEH_SPD_COMP_FACTOR_oSYS_VEHICLE_STATUS_oPCAN_RADAR_3da60ec4_Rx: ComBitPosition=56, ComBitSize=8, ComSignalEndianness=LITTLE_ENDIAN, ComSignalInitValue=0, ComSignalType=SINT8, ComHandleId=2970, ComSystemTemplateSystemSignalRef=SSTS_VEH_SPD_COMP_FACTOR
            SSTS_VEH_AbsoluteTime_Month_oSYS_VEHICLE_STATUS_oPCAN_RADAR_649374da_Rx: ComBitPosition=92, ComBitSize=4, ComSignalEndianness=LITTLE_ENDIAN, ComSignalInitValue=1, ComSignalType=UINT8, ComHandleId=2965, ComSystemTemplateSystemSignalRef=SSTS_VEH_AbsoluteTime_Month
            SSTS_IGN_STATUS_oSYS_VEHICLE_STATUS_oPCAN_RADAR_59077970_Rx: ComBitPosition=88, ComBitSize=3, ComSignalEndianness=LITTLE_ENDIAN, ComSignalInitValue=0, ComSignalType=UINT8, ComHandleId=2953, ComSystemTemplateSystemSignalRef=SSTS_IGN_STATUS
            SSTS_VEH_AbsoluteTime_Minute_oSYS_VEHICLE_STATUS_oPCAN_RADAR_13cd720f_Rx: ComBitPosition=120, ComBitSize=6, ComSignalEndianness=LITTLE_ENDIAN, ComSignalInitValue=0, ComSignalType=UINT8, ComHandleId=2964, ComSystemTemplateSystemSignalRef=SSTS_VEH_AbsoluteTime_Minute
            SSTS_VEH_AbsoluteTime_Day_oSYS_VEHICLE_STATUS_oPCAN_RADAR_98f8a460_Rx: ComBitPosition=80, ComBitSize=5, ComSignalEndianness=LITTLE_ENDIAN, ComSignalInitValue=1, ComSignalType=UINT8, ComHandleId=2962, ComSystemTemplateSystemSignalRef=SSTS_VEH_AbsoluteTime_Day
            SSTS_STEERING_ANGLE_SIGN_oSYS_VEHICLE_STATUS_oPCAN_RADAR_2edd7885_Rx: ComBitPosition=37, ComBitSize=1, ComSignalEndianness=LITTLE_ENDIAN, ComSignalInitValue=0, ComSignalType=BOOLEAN, ComHandleId=2956, ComSystemTemplateSystemSignalRef=SSTS_STEERING_ANGLE_SIGN
            SSTS_VEH_AbsoluteTime_Hour_oSYS_VEHICLE_STATUS_oPCAN_RADAR_711bf042_Rx: ComBitPosition=112, ComBitSize=5, ComSignalEndianness=LITTLE_ENDIAN, ComSignalInitValue=0, ComSignalType=UINT8, ComHandleId=2963, ComSystemTemplateSystemSignalRef=SSTS_VEH_AbsoluteTime_Hour
            SSTS_DRIVE_DIR_oSYS_VEHICLE_STATUS_oPCAN_RADAR_a5d0f7d2_Rx: ComBitPosition=78, ComBitSize=2, ComSignalEndianness=LITTLE_ENDIAN, ComSignalInitValue=0, ComSignalType=UINT8, ComHandleId=2950, ComSystemTemplateSystemSignalRef=SSTS_DRIVE_DIR
            SSTS_MH_VS_CYCLE_COUNTER_oSYS_VEHICLE_STATUS_oPCAN_RADAR_0f7759f5_Rx: ComBitPosition=16, ComBitSize=8, ComSignalEndianness=LITTLE_ENDIAN, ComSignalInitValue=0, ComSignalType=UINT8, ComHandleId=2955, ComSystemTemplateSystemSignalRef=SSTS_MH_VS_CYCLE_COUNTER
            SSTS_YAW_RATE_CALC_QF_oSYS_VEHICLE_STATUS_oPCAN_RADAR_61a6cdee_Rx: ComBitPosition=48, ComBitSize=2, ComSignalEndianness=LITTLE_ENDIAN, ComSignalInitValue=0, ComSignalType=UINT8, ComHandleId=2985, ComSystemTemplateSystemSignalRef=SSTS_YAW_RATE_CALC_QF
            SSTS_MH_VS_CRC16_oSYS_VEHICLE_STATUS_oPCAN_RADAR_c31e8b64_Rx: ComBitPosition=0, ComBitSize=16, ComSignalEndianness=LITTLE_ENDIAN, ComSignalInitValue=0, ComSignalType=UINT16, ComHandleId=2954, ComSystemTemplateSystemSignalRef=SSTS_MH_VS_CRC16
            SSTS_VEH_SYSTEM_VOLTAGE_oSYS_VEHICLE_STATUS_oPCAN_RADAR_1952d612_Rx: ComBitPosition=152, ComBitSize=12, ComSignalEndianness=LITTLE_ENDIAN, ComSignalInitValue=0, ComSignalType=UINT16, ComHandleId=2971, ComSystemTemplateSystemSignalRef=SSTS_VEH_SYSTEM_VOLTAGE
            SSTS_VEH_POWER_MODE_STATUS_oSYS_VEHICLE_STATUS_oPCAN_RADAR_73f4a72e_Rx: ComBitPosition=50, ComBitSize=3, ComSignalEndianness=LITTLE_ENDIAN, ComSignalInitValue=0, ComSignalType=UINT8, ComHandleId=2969, ComSystemTemplateSystemSignalRef=SSTS_VEH_POWER_MODE_STATUS
            SSTS_VEHICLE_SPEED_CALC_oSYS_VEHICLE_STATUS_oPCAN_RADAR_89c9a9e4_Rx: ComBitPosition=64, ComBitSize=14, ComSignalEndianness=LITTLE_ENDIAN, ComSignalInitValue=0, ComSignalType=UINT16, ComHandleId=2960, ComSystemTemplateSystemSignalRef=SSTS_VEHICLE_SPEED_CALC
            SSTS_YAW_RATE_BIAS_oSYS_VEHICLE_STATUS_oPCAN_RADAR_c81bff9c_Rx: ComBitPosition=32, ComBitSize=4, ComSignalEndianness=LITTLE_ENDIAN, ComSignalInitValue=0, ComSignalType=UINT8, ComHandleId=2984, ComSystemTemplateSystemSignalRef=SSTS_YAW_RATE_BIAS
            SSTS_VEHICLE_SPEED_CALC_QF_oSYS_VEHICLE_STATUS_oPCAN_RADAR_95d4c2d0_Rx: ComBitPosition=54, ComBitSize=2, ComSignalEndianness=LITTLE_ENDIAN, ComSignalInitValue=0, ComSignalType=UINT8, ComHandleId=2959, ComSystemTemplateSystemSignalRef=SSTS_VEHICLE_SPEED_CALC_QF
            SSTS_DRIVE_REVERSE_oSYS_VEHICLE_STATUS_oPCAN_RADAR_07d888b2_Rx: ComBitPosition=36, ComBitSize=1, ComSignalEndianness=LITTLE_ENDIAN, ComSignalInitValue=0, ComSignalType=UINT8, ComHandleId=2951, ComSystemTemplateSystemSignalRef=SSTS_DRIVE_REVERSE
            SSTS_GEAR_POSITION_oSYS_VEHICLE_STATUS_oPCAN_RADAR_4533b983_Rx: ComBitPosition=148, ComBitSize=4, ComSignalEndianness=LITTLE_ENDIAN, ComSignalInitValue=0, ComSignalType=UINT8, ComHandleId=2952, ComSystemTemplateSystemSignalRef=SSTS_GEAR_POSITION
            SSTS_VEHICLE_STATE_oSYS_VEHICLE_STATUS_oPCAN_RADAR_9637ee7e_Rx: ComBitPosition=85, ComBitSize=3, ComSignalEndianness=LITTLE_ENDIAN, ComSignalInitValue=0, ComSignalType=UINT8, ComHandleId=2961, ComSystemTemplateSystemSignalRef=SSTS_VEHICLE_STATE
            SSTS_VEH_AbsoluteTime_Year_oSYS_VEHICLE_STATUS_oPCAN_RADAR_3c9d9324_Rx: ComBitPosition=168, ComBitSize=8, ComSignalEndianness=LITTLE_ENDIAN, ComSignalInitValue=0, ComSignalType=UINT8, ComHandleId=2967, ComSystemTemplateSystemSignalRef=SSTS_VEH_AbsoluteTime_Year
            SSTS_VIN_Data_Byte0_oSYS_VEHICLE_STATUS_oPCAN_RADAR_7d65df3e_Rx: ComBitPosition=184, ComBitSize=8, ComSignalEndianness=LITTLE_ENDIAN, ComSignalInitValue=0, ComSignalType=UINT8, ComHandleId=2976, ComSystemTemplateSystemSignalRef=SSTS_VIN_Data_Byte0
            SSTS_VIN_Data_Byte6_oSYS_VEHICLE_STATUS_oPCAN_RADAR_cb4abd14_Rx: ComBitPosition=232, ComBitSize=8, ComSignalEndianness=LITTLE_ENDIAN, ComSignalInitValue=0, ComSignalType=UINT8, ComHandleId=2982, ComSystemTemplateSystemSignalRef=SSTS_VIN_Data_Byte6
            SSTS_VIN_Data_Byte4_oSYS_VEHICLE_STATUS_oPCAN_RADAR_a6af9cf2_Rx: ComBitPosition=216, ComBitSize=8, ComSignalEndianness=LITTLE_ENDIAN, ComSignalInitValue=0, ComSignalType=UINT8, ComHandleId=2980, ComSystemTemplateSystemSignalRef=SSTS_VIN_Data_Byte4
            SSTS_VEH_Status_CMAC_oSYS_VEHICLE_STATUS_oPCAN_RADAR_ac86c39a_Rx: ComBitPosition=472, ComSignalEndianness=opaque, ComSignalInitValue=0 0 0 0 0, ComSignalLength=5, ComSignalType=UINT8_N, ComHandleId=2972, ComSystemTemplateSystemSignalRef=SSTS_VEH_Status_CMAC
            SSTS_VIN_Data_Byte1_oSYS_VEHICLE_STATUS_oPCAN_RADAR_4b974fcd_Rx: ComBitPosition=192, ComBitSize=8, ComSignalEndianness=LITTLE_ENDIAN, ComSignalInitValue=0, ComSignalType=UINT8, ComHandleId=2977, ComSystemTemplateSystemSignalRef=SSTS_VIN_Data_Byte1
            SSTS_VIN_Data_Byte2_oSYS_VEHICLE_STATUS_oPCAN_RADAR_1080fed8_Rx: ComBitPosition=200, ComBitSize=8, ComSignalEndianness=LITTLE_ENDIAN, ComSignalInitValue=0, ComSignalType=UINT8, ComHandleId=2978, ComSystemTemplateSystemSignalRef=SSTS_VIN_Data_Byte2
            SSTS_VEH_Status_FV_oSYS_VEHICLE_STATUS_oPCAN_RADAR_4df6f68e_Rx: ComBitPosition=416, ComSignalEndianness=opaque, ComSignalInitValue=0 0 0 0 0 0 0, ComSignalLength=7, ComSignalType=UINT8_N, ComHandleId=2973, ComSystemTemplateSystemSignalRef=SSTS_VEH_Status_FV
            SSTS_VIN_FrameIdx_oSYS_VEHICLE_STATUS_oPCAN_RADAR_ef68cb69_Rx: ComBitPosition=176, ComBitSize=8, ComSignalEndianness=LITTLE_ENDIAN, ComSignalInitValue=0, ComSignalType=UINT8, ComHandleId=2983, ComSystemTemplateSystemSignalRef=SSTS_VIN_FrameIdx
            SSTS_VIN_Data_Byte3_oSYS_VEHICLE_STATUS_oPCAN_RADAR_26726e2b_Rx: ComBitPosition=208, ComBitSize=8, ComSignalEndianness=LITTLE_ENDIAN, ComSignalInitValue=0, ComSignalType=UINT8, ComHandleId=2979, ComSystemTemplateSystemSignalRef=SSTS_VIN_Data_Byte3
            SSTS_VIN_Data_Byte5_oSYS_VEHICLE_STATUS_oPCAN_RADAR_905d0c01_Rx: ComBitPosition=224, ComBitSize=8, ComSignalEndianness=LITTLE_ENDIAN, ComSignalInitValue=0, ComSignalType=UINT8, ComHandleId=2981, ComSystemTemplateSystemSignalRef=SSTS_VIN_Data_Byte5
            SSTS_VEH_TRAILER_CONNECTED_oSYS_VEHICLE_STATUS_oPCAN_RADAR_377b66dd_Rx: ComBitPosition=53, ComBitSize=1, ComSignalEndianness=LITTLE_ENDIAN, ComSignalInitValue=0, ComSignalType=UINT8, ComHandleId=2974, ComSystemTemplateSystemSignalRef=SSTS_VEH_TRAILER_CONNECTED
            SSTS_VEH_VARIANT_oSYS_VEHICLE_STATUS_oPCAN_RADAR_87a69a77_Rx: ComBitPosition=102, ComBitSize=2, ComSignalEndianness=LITTLE_ENDIAN, ComSignalInitValue=0, ComSignalType=UINT8, ComHandleId=2975, ComSystemTemplateSystemSignalRef=SSTS_VEH_VARIANT
        SG_Detections_161_164_oRDR_DETECTION_161_164_oPCAN_RADAR_c27e57ef_Tx: ComTransferProperty=TRIGGERED, ComHandleId=42, ComSystemTemplateSignalGroupRef=SG_Detections_161_164
          83 x ComGroupSignal, all with ComSignalEndianness=LITTLE_ENDIAN, ComTransferProperty=PENDING, ComSignalAccess=ACCESS_NEEDED_BY_SWC_OR_COM:
            DET_CONFD_AZIMUTH_164_oRDR_DETECTION_161_164_oPCAN_RADAR_cab66c2e_Tx: ComBitPosition=454, ComBitSize=2, ComSignalInitValue=0, ComSignalType=UINT8, ComHandleId=3400, ComSystemTemplateSystemSignalRef=DET_CONFD_AZIMUTH_164
            DET_SNR_164_oRDR_DETECTION_161_164_oPCAN_RADAR_f743b422_Tx: ComBitPosition=456, ComBitSize=8, ComSignalInitValue=0, ComSignalType=UINT8, ComHandleId=3459, ComSystemTemplateSystemSignalRef=DET_SNR_164
            DET_CONFD_ELEVATION_164_oRDR_DETECTION_161_164_oPCAN_RADAR_c8236dd4_Tx: ComBitPosition=437, ComBitSize=2, ComSignalInitValue=0, ComSignalType=UINT8, ComHandleId=3404, ComSystemTemplateSystemSignalRef=DET_CONFD_ELEVATION_164
            DET_RANGE_ERR_164_oRDR_DETECTION_161_164_oPCAN_RADAR_7f23af36_Tx: ComBitPosition=376, ComBitSize=7, ComSignalInitValue=0, ComSignalType=UINT8, ComHandleId=3443, ComSystemTemplateSystemSignalRef=DET_RANGE_ERR_164
            DET_AZIMUTH_162_oRDR_DETECTION_161_164_oPCAN_RADAR_01909118_Tx: ComBitPosition=200, ComBitSize=13, ComSignalInitValue=0, ComSignalType=UINT16, ComHandleId=3382, ComSystemTemplateSystemSignalRef=DET_AZIMUTH_162
            DET_AZIMUTH_ERR_164_oRDR_DETECTION_161_164_oPCAN_RADAR_6ce5f311_Tx: ComBitPosition=441, ComBitSize=7, ComSignalInitValue=0, ComSignalType=UINT8, ComHandleId=3388, ComSystemTemplateSystemSignalRef=DET_AZIMUTH_ERR_164
            DET_CONFD_AZIMUTH_163_oRDR_DETECTION_161_164_oPCAN_RADAR_96064f47_Tx: ComBitPosition=342, ComBitSize=2, ComSignalInitValue=0, ComSignalType=UINT8, ComHandleId=3399, ComSystemTemplateSystemSignalRef=DET_CONFD_AZIMUTH_163
            DET_RANGE_164_oRDR_DETECTION_161_164_oPCAN_RADAR_d8cb155f_Tx: ComBitPosition=360, ComBitSize=15, ComSignalInitValue=0, ComSignalType=UINT16, ComHandleId=3439, ComSystemTemplateSystemSignalRef=DET_RANGE_164
            DET_CONFD_AZIMUTH_161_oRDR_DETECTION_161_164_oPCAN_RADAR_6796e02c_Tx: ComBitPosition=118, ComBitSize=2, ComSignalInitValue=0, ComSignalType=UINT8, ComHandleId=3397, ComSystemTemplateSystemSignalRef=DET_CONFD_AZIMUTH_161
            DET_RANGE_VELOCITY_ERR_163_oRDR_DETECTION_161_164_oPCAN_RADAR_fe660fa1_Tx: ComBitPosition=288, ComBitSize=8, ComSignalInitValue=0, ComSignalType=UINT8, ComHandleId=3450, ComSystemTemplateSystemSignalRef=DET_RANGE_VELOCITY_ERR_163
            DET_ELEVATION_ERR_164_oRDR_DETECTION_161_164_oPCAN_RADAR_9eda219d_Tx: ComBitPosition=416, ComBitSize=6, ComSignalInitValue=0, ComSignalType=UINT8, ComHandleId=3412, ComSystemTemplateSystemSignalRef=DET_ELEVATION_ERR_164
            DET_RANGE_ERR_162_oRDR_DETECTION_161_164_oPCAN_RADAR_b6e358ca_Tx: ComBitPosition=152, ComBitSize=7, ComSignalInitValue=0, ComSignalType=UINT8, ComHandleId=3441, ComSystemTemplateSystemSignalRef=DET_RANGE_ERR_162
            DET_CONFD_ELEVATION_163_oRDR_DETECTION_161_164_oPCAN_RADAR_94934ebd_Tx: ComBitPosition=325, ComBitSize=2, ComSignalInitValue=0, ComSignalType=UINT8, ComHandleId=3403, ComSystemTemplateSystemSignalRef=DET_CONFD_ELEVATION_163
            DET_SUPER_RES_TARGET_164_oRDR_DETECTION_161_164_oPCAN_RADAR_c6da9c47_Tx: ComBitPosition=423, ComBitSize=1, ComSignalInitValue=0, ComSignalType=BOOLEAN, ComHandleId=3463, ComSystemTemplateSystemSignalRef=DET_SUPER_RES_TARGET_164
            DET_EXISTENCE_PROB_161_oRDR_DETECTION_161_164_oPCAN_RADAR_e165d8ff_Tx: ComBitPosition=112, ComBitSize=6, ComSignalInitValue=0, ComSignalType=UINT8, ComHandleId=3413, ComSystemTemplateSystemSignalRef=DET_EXISTENCE_PROB_161
            DET_CONFD_AZIMUTH_162_oRDR_DETECTION_161_164_oPCAN_RADAR_03769bd2_Tx: ComBitPosition=230, ComBitSize=2, ComSignalInitValue=0, ComSignalType=UINT8, ComHandleId=3398, ComSystemTemplateSystemSignalRef=DET_CONFD_AZIMUTH_162
            DET_RCS_162_oRDR_DETECTION_161_164_oPCAN_RADAR_e32d17dc_Tx: ComBitPosition=240, ComBitSize=8, ComSignalInitValue=128, ComSignalType=UINT8, ComHandleId=3453, ComSystemTemplateSystemSignalRef=DET_RCS_162
            DET_AZIMUTH_161_oRDR_DETECTION_161_164_oPCAN_RADAR_6570eae6_Tx: ComBitPosition=88, ComBitSize=13, ComSignalInitValue=0, ComSignalType=UINT16, ComHandleId=3381, ComSystemTemplateSystemSignalRef=DET_AZIMUTH_161
            DET_RANGE_VELOCITY_163_oRDR_DETECTION_161_164_oPCAN_RADAR_f1ddf413_Tx: ComBitPosition=272, ComBitSize=15, ComSignalInitValue=16384, ComSignalType=UINT16, ComHandleId=3446, ComSystemTemplateSystemSignalRef=DET_RANGE_VELOCITY_163
            DET_ELEVATION_ERR_163_oRDR_DETECTION_161_164_oPCAN_RADAR_c26a02f4_Tx: ComBitPosition=304, ComBitSize=6, ComSignalInitValue=0, ComSignalType=UINT8, ComHandleId=3411, ComSystemTemplateSystemSignalRef=DET_ELEVATION_ERR_163
            DET_HVC_FLAG_162_oRDR_DETECTION_161_164_oPCAN_RADAR_64f1e07e_Tx: ComBitPosition=198, ComBitSize=1, ComSignalInitValue=0, ComSignalType=BOOLEAN, ComHandleId=3418, ComSystemTemplateSystemSignalRef=DET_HVC_FLAG_162
            DET_ELEVATION_162_oRDR_DETECTION_161_164_oPCAN_RADAR_d0234e14_Tx: ComBitPosition=184, ComBitSize=8, ComSignalInitValue=0, ComSignalType=UINT8, ComHandleId=3406, ComSystemTemplateSystemSignalRef=DET_ELEVATION_162
            DET_ELEVATION_164_oRDR_DETECTION_161_164_oPCAN_RADAR_19e3b9e8_Tx: ComBitPosition=408, ComBitSize=8, ComSignalInitValue=0, ComSignalType=UINT8, ComHandleId=3408, ComSystemTemplateSystemSignalRef=DET_ELEVATION_164
            DET_ELEVATION_ERR_162_oRDR_DETECTION_161_164_oPCAN_RADAR_571ad661_Tx: ComBitPosition=192, ComBitSize=6, ComSignalInitValue=0, ComSignalType=UINT8, ComHandleId=3410, ComSystemTemplateSystemSignalRef=DET_ELEVATION_ERR_162
            DET_AZIMUTH_163_oRDR_DETECTION_161_164_oPCAN_RADAR_94e0458d_Tx: ComBitPosition=312, ComBitSize=13, ComSignalInitValue=0, ComSignalType=UINT16, ComHandleId=3383, ComSystemTemplateSystemSignalRef=DET_AZIMUTH_163
            DET_BI_STATIC_FLAG_164_oRDR_DETECTION_161_164_oPCAN_RADAR_9e7c2661_Tx: ComBitPosition=440, ComBitSize=1, ComSignalInitValue=0, ComSignalType=BOOLEAN, ComHandleId=3396, ComSystemTemplateSystemSignalRef=DET_BI_STATIC_FLAG_164
            DET_CONFD_ELEVATION_162_oRDR_DETECTION_161_164_oPCAN_RADAR_01e39a28_Tx: ComBitPosition=213, ComBitSize=2, ComSignalInitValue=0, ComSignalType=UINT8, ComHandleId=3402, ComSystemTemplateSystemSignalRef=DET_CONFD_ELEVATION_162
            DET_RANGE_ERR_161_oRDR_DETECTION_161_164_oPCAN_RADAR_d2032334_Tx: ComBitPosition=40, ComBitSize=7, ComSignalInitValue=0, ComSignalType=UINT8, ComHandleId=3440, ComSystemTemplateSystemSignalRef=DET_RANGE_ERR_161
            DET_SUPER_RES_TARGET_163_oRDR_DETECTION_161_164_oPCAN_RADAR_9a6abf2e_Tx: ComBitPosition=311, ComBitSize=1, ComSignalInitValue=0, ComSignalType=BOOLEAN, ComHandleId=3462, ComSystemTemplateSystemSignalRef=DET_SUPER_RES_TARGET_163
            DET_RANGE_VELOCITY_161_oRDR_DETECTION_161_164_oPCAN_RADAR_004d5b78_Tx: ComBitPosition=48, ComBitSize=15, ComSignalInitValue=16384, ComSignalType=UINT16, ComHandleId=3444, ComSystemTemplateSystemSignalRef=DET_RANGE_VELOCITY_161
            DET_MH_SCAN_INDEX_4LSB_161_164_oRDR_DETECTION_161_164_oPCAN_RADAR_0ea9015f_Tx: ComBitPosition=476, ComBitSize=4, ComSignalInitValue=0, ComSignalType=UINT8, ComHandleId=3427, ComSystemTemplateSystemSignalRef=DET_MH_SCAN_INDEX_4LSB_161_164
            DET_RANGE_161_oRDR_DETECTION_161_164_oPCAN_RADAR_75eb995d_Tx: ComBitPosition=24, ComBitSize=15, ComSignalInitValue=0, ComSignalType=UINT16, ComHandleId=3436, ComSystemTemplateSystemSignalRef=DET_RANGE_161
            DET_AZIMUTH_ERR_163_oRDR_DETECTION_161_164_oPCAN_RADAR_3055d078_Tx: ComBitPosition=329, ComBitSize=7, ComSignalInitValue=0, ComSignalType=UINT8, ComHandleId=3387, ComSystemTemplateSystemSignalRef=DET_AZIMUTH_ERR_163
            DET_RANGE_VELOCITY_ERR_161_oRDR_DETECTION_161_164_oPCAN_RADAR_0ff6a0ca_Tx: ComBitPosition=64, ComBitSize=8, ComSignalInitValue=0, ComSignalType=UINT8, ComHandleId=3448, ComSystemTemplateSystemSignalRef=DET_RANGE_VELOCITY_ERR_161
            DET_RANGE_VELOCITY_ERR_162_oRDR_DETECTION_161_164_oPCAN_RADAR_6b16db34_Tx: ComBitPosition=176, ComBitSize=8, ComSignalInitValue=0, ComSignalType=UINT8, ComHandleId=3449, ComSystemTemplateSystemSignalRef=DET_RANGE_VELOCITY_ERR_162
            DET_BI_STATIC_FLAG_162_oRDR_DETECTION_161_164_oPCAN_RADAR_57bcd19d_Tx: ComBitPosition=216, ComBitSize=1, ComSignalInitValue=0, ComSignalType=BOOLEAN, ComHandleId=3394, ComSystemTemplateSystemSignalRef=DET_BI_STATIC_FLAG_162
            DET_AZIMUTH_ERR_162_oRDR_DETECTION_161_164_oPCAN_RADAR_a52504ed_Tx: ComBitPosition=217, ComBitSize=7, ComSignalInitValue=0, ComSignalType=UINT8, ComHandleId=3386, ComSystemTemplateSystemSignalRef=DET_AZIMUTH_ERR_162
            DET_RANGE_163_oRDR_DETECTION_161_164_oPCAN_RADAR_847b3636_Tx: ComBitPosition=248, ComBitSize=15, ComSignalInitValue=0, ComSignalType=UINT16, ComHandleId=3438, ComSystemTemplateSystemSignalRef=DET_RANGE_163
            DET_ELEVATION_161_oRDR_DETECTION_161_164_oPCAN_RADAR_b4c335ea_Tx: ComBitPosition=72, ComBitSize=8, ComSignalInitValue=0, ComSignalType=UINT8, ComHandleId=3405, ComSystemTemplateSystemSignalRef=DET_ELEVATION_161
            DET_MH_CRC16_161_164_oRDR_DETECTION_161_164_oPCAN_RADAR_46f685e4_Tx: ComBitPosition=0, ComBitSize=16, ComSignalInitValue=0, ComSignalType=UINT16, ComHandleId=3425, ComSystemTemplateSystemSignalRef=DET_MH_CRC16_161_164
            DET_RANGE_VELOCITY_162_oRDR_DETECTION_161_164_oPCAN_RADAR_64ad2086_Tx: ComBitPosition=160, ComBitSize=15, ComSignalInitValue=16384, ComSignalType=UINT16, ComHandleId=3445, ComSystemTemplateSystemSignalRef=DET_RANGE_VELOCITY_162
            DET_SNR_162_oRDR_DETECTION_161_164_oPCAN_RADAR_3e8343de_Tx: ComBitPosition=232, ComBitSize=8, ComSignalInitValue=0, ComSignalType=UINT8, ComHandleId=3457, ComSystemTemplateSystemSignalRef=DET_SNR_162
            DET_RCS_161_oRDR_DETECTION_161_164_oPCAN_RADAR_87cd6c22_Tx: ComBitPosition=128, ComBitSize=8, ComSignalInitValue=128, ComSignalType=UINT8, ComHandleId=3452, ComSystemTemplateSystemSignalRef=DET_RCS_161
            DET_ELEVATION_ERR_161_oRDR_DETECTION_161_164_oPCAN_RADAR_33faad9f_Tx: ComBitPosition=80, ComBitSize=6, ComSignalInitValue=0, ComSignalType=UINT8, ComHandleId=3409, ComSystemTemplateSystemSignalRef=DET_ELEVATION_ERR_161
            DET_HVC_FLAG_161_oRDR_DETECTION_161_164_oPCAN_RADAR_00119b80_Tx: ComBitPosition=86, ComBitSize=1, ComSignalInitValue=0, ComSignalType=BOOLEAN, ComHandleId=3417, ComSystemTemplateSystemSignalRef=DET_HVC_FLAG_161
            DET_RANGE_VELOCITY_164_oRDR_DETECTION_161_164_oPCAN_RADAR_ad6dd77a_Tx: ComBitPosition=384, ComBitSize=15, ComSignalInitValue=16384, ComSignalType=UINT16, ComHandleId=3447, ComSystemTemplateSystemSignalRef=DET_RANGE_VELOCITY_164
            DET_SNR_161_oRDR_DETECTION_161_164_oPCAN_RADAR_5a633820_Tx: ComBitPosition=120, ComBitSize=8, ComSignalInitValue=0, ComSignalType=UINT8, ComHandleId=3456, ComSystemTemplateSystemSignalRef=DET_SNR_161
            DET_ELEVATION_163_oRDR_DETECTION_161_164_oPCAN_RADAR_45539a81_Tx: ComBitPosition=296, ComBitSize=8, ComSignalInitValue=0, ComSignalType=UINT8, ComHandleId=3407, ComSystemTemplateSystemSignalRef=DET_ELEVATION_163
            DET_SUPER_RES_TARGET_161_oRDR_DETECTION_161_164_oPCAN_RADAR_6bfa1045_Tx: ComBitPosition=87, ComBitSize=1, ComSignalInitValue=0, ComSignalType=BOOLEAN, ComHandleId=3460, ComSystemTemplateSystemSignalRef=DET_SUPER_RES_TARGET_161
            DET_RCS_163_oRDR_DETECTION_161_164_oPCAN_RADAR_765dc349_Tx: ComBitPosition=352, ComBitSize=8, ComSignalInitValue=128, ComSignalType=UINT8, ComHandleId=3454, ComSystemTemplateSystemSignalRef=DET_RCS_163
            DET_EXISTENCE_PROB_162_oRDR_DETECTION_161_164_oPCAN_RADAR_8585a301_Tx: ComBitPosition=224, ComBitSize=6, ComSignalInitValue=0, ComSignalType=UINT8, ComHandleId=3414, ComSystemTemplateSystemSignalRef=DET_EXISTENCE_PROB_162
            DET_RCS_164_oRDR_DETECTION_161_164_oPCAN_RADAR_2aede020_Tx: ComBitPosition=464, ComBitSize=8, ComSignalInitValue=128, ComSignalType=UINT8, ComHandleId=3455, ComSystemTemplateSystemSignalRef=DET_RCS_164
            DET_SUPER_RES_TARGET_162_oRDR_DETECTION_161_164_oPCAN_RADAR_0f1a6bbb_Tx: ComBitPosition=199, ComBitSize=1, ComSignalInitValue=0, ComSignalType=BOOLEAN, ComHandleId=3461, ComSystemTemplateSystemSignalRef=DET_SUPER_RES_TARGET_162
            DET_EXISTENCE_PROB_164_oRDR_DETECTION_161_164_oPCAN_RADAR_4c4554fd_Tx: ComBitPosition=448, ComBitSize=6, ComSignalInitValue=0, ComSignalType=UINT8, ComHandleId=3416, ComSystemTemplateSystemSignalRef=DET_EXISTENCE_PROB_164
            DET_MH_CYCLE_COUNTER_161_164_oRDR_DETECTION_161_164_oPCAN_RADAR_c28324d3_Tx: ComBitPosition=16, ComBitSize=8, ComSignalInitValue=0, ComSignalType=UINT8, ComHandleId=3426, ComSystemTemplateSystemSignalRef=DET_MH_CYCLE_COUNTER_161_164
            DET_AZIMUTH_164_oRDR_DETECTION_161_164_oPCAN_RADAR_c85066e4_Tx: ComBitPosition=424, ComBitSize=13, ComSignalInitValue=0, ComSignalType=UINT16, ComHandleId=3384, ComSystemTemplateSystemSignalRef=DET_AZIMUTH_164
            DET_SNR_163_oRDR_DETECTION_161_164_oPCAN_RADAR_abf3974b_Tx: ComBitPosition=344, ComBitSize=8, ComSignalInitValue=0, ComSignalType=UINT8, ComHandleId=3458, ComSystemTemplateSystemSignalRef=DET_SNR_163
            DET_CONFD_ELEVATION_161_oRDR_DETECTION_161_164_oPCAN_RADAR_6503e1d6_Tx: ComBitPosition=101, ComBitSize=2, ComSignalInitValue=0, ComSignalType=UINT8, ComHandleId=3401, ComSystemTemplateSystemSignalRef=DET_CONFD_ELEVATION_161
            DET_BI_STATIC_FLAG_161_oRDR_DETECTION_161_164_oPCAN_RADAR_335caa63_Tx: ComBitPosition=104, ComBitSize=1, ComSignalInitValue=0, ComSignalType=BOOLEAN, ComHandleId=3393, ComSystemTemplateSystemSignalRef=DET_BI_STATIC_FLAG_161
            DET_RANGE_VELOCITY_ERR_164_oRDR_DETECTION_161_164_oPCAN_RADAR_a2d62cc8_Tx: ComBitPosition=400, ComBitSize=8, ComSignalInitValue=0, ComSignalType=UINT8, ComHandleId=3451, ComSystemTemplateSystemSignalRef=DET_RANGE_VELOCITY_ERR_164
            DET_RANGE_162_oRDR_DETECTION_161_164_oPCAN_RADAR_110be2a3_Tx: ComBitPosition=136, ComBitSize=15, ComSignalInitValue=0, ComSignalType=UINT16, ComHandleId=3437, ComSystemTemplateSystemSignalRef=DET_RANGE_162
            DET_RANGE_ERR_163_oRDR_DETECTION_161_164_oPCAN_RADAR_23938c5f_Tx: ComBitPosition=264, ComBitSize=7, ComSignalInitValue=0, ComSignalType=UINT8, ComHandleId=3442, ComSystemTemplateSystemSignalRef=DET_RANGE_ERR_163
            DET_HVC_FLAG_163_oRDR_DETECTION_161_164_oPCAN_RADAR_f18134eb_Tx: ComBitPosition=310, ComBitSize=1, ComSignalInitValue=0, ComSignalType=BOOLEAN, ComHandleId=3419, ComSystemTemplateSystemSignalRef=DET_HVC_FLAG_163
            DET_EXISTENCE_PROB_163_oRDR_DETECTION_161_164_oPCAN_RADAR_10f57794_Tx: ComBitPosition=336, ComBitSize=6, ComSignalInitValue=0, ComSignalType=UINT8, ComHandleId=3415, ComSystemTemplateSystemSignalRef=DET_EXISTENCE_PROB_163
            DET_HVC_FLAG_164_oRDR_DETECTION_161_164_oPCAN_RADAR_ad311782_Tx: ComBitPosition=422, ComBitSize=1, ComSignalInitValue=0, ComSignalType=BOOLEAN, ComHandleId=3420, ComSystemTemplateSystemSignalRef=DET_HVC_FLAG_164
            DET_BI_STATIC_FLAG_163_oRDR_DETECTION_161_164_oPCAN_RADAR_c2cc0508_Tx: ComBitPosition=328, ComBitSize=1, ComSignalInitValue=0, ComSignalType=BOOLEAN, ComHandleId=3395, ComSystemTemplateSystemSignalRef=DET_BI_STATIC_FLAG_163
            DET_AZIMUTH_ERR_161_oRDR_DETECTION_161_164_oPCAN_RADAR_c1c57f13_Tx: ComBitPosition=105, ComBitSize=7, ComSignalInitValue=0, ComSignalType=UINT8, ComHandleId=3385, ComSystemTemplateSystemSignalRef=DET_AZIMUTH_ERR_161
            DET_BELOW_RAIN_THOLD_161_oRDR_DETECTION_161_164_oPCAN_RADAR_b0717926_Tx: ComBitPosition=39, ComBitSize=1, ComSignalInitValue=0, ComSignalType=UINT8, ComHandleId=3389, ComSystemTemplateSystemSignalRef=DET_BELOW_RAIN_THOLD_161
            DET_PROB_1STAZHYPO_161_oRDR_DETECTION_161_164_oPCAN_RADAR_7e447a2b_Tx: ComBitPosition=103, ComBitSize=1, ComSignalInitValue=0, ComSignalType=BOOLEAN, ComHandleId=3432, ComSystemTemplateSystemSignalRef=DET_PROB_1STAZHYPO_161
            DET_IDM_164_oRDR_DETECTION_161_164_oPCAN_RADAR_26632c3f_Tx: ComBitPosition=399, ComBitSize=1, ComSignalInitValue=0, ComSignalType=UINT8, ComHandleId=3424, ComSystemTemplateSystemSignalRef=DET_IDM_164
            DET_PROB_1STAZHYPO_164_oRDR_DETECTION_161_164_oPCAN_RADAR_d364f629_Tx: ComBitPosition=439, ComBitSize=1, ComSignalInitValue=0, ComSignalType=BOOLEAN, ComHandleId=3435, ComSystemTemplateSystemSignalRef=DET_PROB_1STAZHYPO_164
            DET_IDM_161_oRDR_DETECTION_161_164_oPCAN_RADAR_8b43a03d_Tx: ComBitPosition=63, ComBitSize=1, ComSignalInitValue=0, ComSignalType=UINT8, ComHandleId=3421, ComSystemTemplateSystemSignalRef=DET_IDM_161
            DET_IDM_162_oRDR_DETECTION_161_164_oPCAN_RADAR_efa3dbc3_Tx: ComBitPosition=175, ComBitSize=1, ComSignalInitValue=0, ComSignalType=UINT8, ComHandleId=3422, ComSystemTemplateSystemSignalRef=DET_IDM_162
            DET_MTD_161_oRDR_DETECTION_161_164_oPCAN_RADAR_edf092e6_Tx: ComBitPosition=47, ComBitSize=1, ComSignalInitValue=0, ComSignalType=UINT8, ComHandleId=3428, ComSystemTemplateSystemSignalRef=DET_MTD_161
            DET_MTD_163_oRDR_DETECTION_161_164_oPCAN_RADAR_1c603d8d_Tx: ComBitPosition=271, ComBitSize=1, ComSignalInitValue=0, ComSignalType=UINT8, ComHandleId=3430, ComSystemTemplateSystemSignalRef=DET_MTD_163
            DET_IDM_163_oRDR_DETECTION_161_164_oPCAN_RADAR_7ad30f56_Tx: ComBitPosition=287, ComBitSize=1, ComSignalInitValue=0, ComSignalType=UINT8, ComHandleId=3423, ComSystemTemplateSystemSignalRef=DET_IDM_163
            DET_PROB_1STAZHYPO_162_oRDR_DETECTION_161_164_oPCAN_RADAR_1aa401d5_Tx: ComBitPosition=215, ComBitSize=1, ComSignalInitValue=0, ComSignalType=BOOLEAN, ComHandleId=3433, ComSystemTemplateSystemSignalRef=DET_PROB_1STAZHYPO_162
            DET_BELOW_RAIN_THOLD_164_oRDR_DETECTION_161_164_oPCAN_RADAR_1d51f524_Tx: ComBitPosition=375, ComBitSize=1, ComSignalInitValue=0, ComSignalType=UINT8, ComHandleId=3392, ComSystemTemplateSystemSignalRef=DET_BELOW_RAIN_THOLD_164
            DET_MTD_164_oRDR_DETECTION_161_164_oPCAN_RADAR_40d01ee4_Tx: ComBitPosition=383, ComBitSize=1, ComSignalInitValue=0, ComSignalType=UINT8, ComHandleId=3431, ComSystemTemplateSystemSignalRef=DET_MTD_164
            DET_BELOW_RAIN_THOLD_163_oRDR_DETECTION_161_164_oPCAN_RADAR_41e1d64d_Tx: ComBitPosition=263, ComBitSize=1, ComSignalInitValue=0, ComSignalType=UINT8, ComHandleId=3391, ComSystemTemplateSystemSignalRef=DET_BELOW_RAIN_THOLD_163
            DET_MTD_162_oRDR_DETECTION_161_164_oPCAN_RADAR_8910e918_Tx: ComBitPosition=159, ComBitSize=1, ComSignalInitValue=0, ComSignalType=UINT8, ComHandleId=3429, ComSystemTemplateSystemSignalRef=DET_MTD_162
            DET_PROB_1STAZHYPO_163_oRDR_DETECTION_161_164_oPCAN_RADAR_8fd4d540_Tx: ComBitPosition=327, ComBitSize=1, ComSignalInitValue=0, ComSignalType=BOOLEAN, ComHandleId=3434, ComSystemTemplateSystemSignalRef=DET_PROB_1STAZHYPO_163
            DET_BELOW_RAIN_THOLD_162_oRDR_DETECTION_161_164_oPCAN_RADAR_d49102d8_Tx: ComBitPosition=151, ComBitSize=1, ComSignalInitValue=0, ComSignalType=UINT8, ComHandleId=3390, ComSystemTemplateSystemSignalRef=DET_BELOW_RAIN_THOLD_162
        SG_Detections_025_028_oRDR_DETECTION_025_028_oPCAN_RADAR_9bfe01a5_Tx: ComTransferProperty=TRIGGERED, ComHandleId=8, ComSystemTemplateSignalGroupRef=SG_Detections_025_028
          83 x ComGroupSignal, all with ComSignalEndianness=LITTLE_ENDIAN, ComTransferProperty=PENDING, ComSignalAccess=ACCESS_NEEDED_BY_SWC_OR_COM:
            DET_AZIMUTH_026_oRDR_DETECTION_025_028_oPCAN_RADAR_4fb4ff4b_Tx: ComBitPosition=200, ComBitSize=13, ComSignalInitValue=0, ComSignalType=UINT16, ComHandleId=560, ComSystemTemplateSystemSignalRef=DET_AZIMUTH_026
            DET_RANGE_025_oRDR_DETECTION_025_028_oPCAN_RADAR_3bcff70e_Tx: ComBitPosition=24, ComBitSize=15, ComSignalInitValue=0, ComSignalType=UINT16, ComHandleId=614, ComSystemTemplateSystemSignalRef=DET_RANGE_025
            DET_AZIMUTH_027_oRDR_DETECTION_025_028_oPCAN_RADAR_dac42bde_Tx: ComBitPosition=312, ComBitSize=13, ComSignalInitValue=0, ComSignalType=UINT16, ComHandleId=561, ComSystemTemplateSystemSignalRef=DET_AZIMUTH_027
            DET_AZIMUTH_ERR_026_oRDR_DETECTION_025_028_oPCAN_RADAR_eb016abe_Tx: ComBitPosition=217, ComBitSize=7, ComSignalInitValue=0, ComSignalType=UINT8, ComHandleId=564, ComSystemTemplateSystemSignalRef=DET_AZIMUTH_ERR_026
            DET_RANGE_VELOCITY_027_oRDR_DETECTION_025_028_oPCAN_RADAR_bff99a40_Tx: ComBitPosition=272, ComBitSize=15, ComSignalInitValue=16384, ComSignalType=UINT16, ComHandleId=624, ComSystemTemplateSystemSignalRef=DET_RANGE_VELOCITY_027
            DET_BI_STATIC_FLAG_026_oRDR_DETECTION_025_028_oPCAN_RADAR_1998bfce_Tx: ComBitPosition=216, ComBitSize=1, ComSignalInitValue=0, ComSignalType=BOOLEAN, ComHandleId=572, ComSystemTemplateSystemSignalRef=DET_BI_STATIC_FLAG_026
            DET_RCS_028_oRDR_DETECTION_025_028_oPCAN_RADAR_14693f5d_Tx: ComBitPosition=464, ComBitSize=8, ComSignalInitValue=128, ComSignalType=UINT8, ComHandleId=633, ComSystemTemplateSystemSignalRef=DET_RCS_028
            DET_SUPER_RES_TARGET_026_oRDR_DETECTION_025_028_oPCAN_RADAR_413e05e8_Tx: ComBitPosition=199, ComBitSize=1, ComSignalInitValue=0, ComSignalType=BOOLEAN, ComHandleId=639, ComSystemTemplateSystemSignalRef=DET_SUPER_RES_TARGET_026
            DET_EXISTENCE_PROB_028_oRDR_DETECTION_025_028_oPCAN_RADAR_72c18b80_Tx: ComBitPosition=448, ComBitSize=6, ComSignalInitValue=0, ComSignalType=UINT8, ComHandleId=594, ComSystemTemplateSystemSignalRef=DET_EXISTENCE_PROB_028
            DET_SNR_025_oRDR_DETECTION_025_028_oPCAN_RADAR_14475673_Tx: ComBitPosition=120, ComBitSize=8, ComSignalInitValue=0, ComSignalType=UINT8, ComHandleId=634, ComSystemTemplateSystemSignalRef=DET_SNR_025
            DET_CONFD_AZIMUTH_027_oRDR_DETECTION_025_028_oPCAN_RADAR_d8222114_Tx: ComBitPosition=342, ComBitSize=2, ComSignalInitValue=0, ComSignalType=UINT8, ComHandleId=577, ComSystemTemplateSystemSignalRef=DET_CONFD_AZIMUTH_027
            DET_CONFD_AZIMUTH_028_oRDR_DETECTION_025_028_oPCAN_RADAR_f432b353_Tx: ComBitPosition=454, ComBitSize=2, ComSignalInitValue=0, ComSignalType=UINT8, ComHandleId=578, ComSystemTemplateSystemSignalRef=DET_CONFD_AZIMUTH_028
            DET_ELEVATION_ERR_025_oRDR_DETECTION_025_028_oPCAN_RADAR_7ddec3cc_Tx: ComBitPosition=80, ComBitSize=6, ComSignalInitValue=0, ComSignalType=UINT8, ComHandleId=587, ComSystemTemplateSystemSignalRef=DET_ELEVATION_ERR_025
            DET_CONFD_ELEVATION_025_oRDR_DETECTION_025_028_oPCAN_RADAR_2b278f85_Tx: ComBitPosition=101, ComBitSize=2, ComSignalInitValue=0, ComSignalType=UINT8, ComHandleId=579, ComSystemTemplateSystemSignalRef=DET_CONFD_ELEVATION_025
            DET_EXISTENCE_PROB_026_oRDR_DETECTION_025_028_oPCAN_RADAR_cba1cd52_Tx: ComBitPosition=224, ComBitSize=6, ComSignalInitValue=0, ComSignalType=UINT8, ComHandleId=592, ComSystemTemplateSystemSignalRef=DET_EXISTENCE_PROB_026
            DET_SUPER_RES_TARGET_025_oRDR_DETECTION_025_028_oPCAN_RADAR_25de7e16_Tx: ComBitPosition=87, ComBitSize=1, ComSignalInitValue=0, ComSignalType=BOOLEAN, ComHandleId=638, ComSystemTemplateSystemSignalRef=DET_SUPER_RES_TARGET_025
            DET_MH_CYCLE_COUNTER_025_028_oRDR_DETECTION_025_028_oPCAN_RADAR_9b037299_Tx: ComBitPosition=16, ComBitSize=8, ComSignalInitValue=0, ComSignalType=UINT8, ComHandleId=604, ComSystemTemplateSystemSignalRef=DET_MH_CYCLE_COUNTER_025_028
            DET_SNR_027_oRDR_DETECTION_025_028_oPCAN_RADAR_e5d7f918_Tx: ComBitPosition=344, ComBitSize=8, ComSignalInitValue=0, ComSignalType=UINT8, ComHandleId=636, ComSystemTemplateSystemSignalRef=DET_SNR_027
            DET_RANGE_VELOCITY_026_oRDR_DETECTION_025_028_oPCAN_RADAR_2a894ed5_Tx: ComBitPosition=160, ComBitSize=15, ComSignalInitValue=16384, ComSignalType=UINT16, ComHandleId=623, ComSystemTemplateSystemSignalRef=DET_RANGE_VELOCITY_026
            DET_HVC_FLAG_025_oRDR_DETECTION_025_028_oPCAN_RADAR_4e35f5d3_Tx: ComBitPosition=86, ComBitSize=1, ComSignalInitValue=0, ComSignalType=BOOLEAN, ComHandleId=595, ComSystemTemplateSystemSignalRef=DET_HVC_FLAG_025
            DET_HVC_FLAG_027_oRDR_DETECTION_025_028_oPCAN_RADAR_bfa55ab8_Tx: ComBitPosition=310, ComBitSize=1, ComSignalInitValue=0, ComSignalType=BOOLEAN, ComHandleId=597, ComSystemTemplateSystemSignalRef=DET_HVC_FLAG_027
            DET_RCS_025_oRDR_DETECTION_025_028_oPCAN_RADAR_c9e90271_Tx: ComBitPosition=128, ComBitSize=8, ComSignalInitValue=128, ComSignalType=UINT8, ComHandleId=630, ComSystemTemplateSystemSignalRef=DET_RCS_025
            DET_RANGE_ERR_026_oRDR_DETECTION_025_028_oPCAN_RADAR_f8c73699_Tx: ComBitPosition=152, ComBitSize=7, ComSignalInitValue=0, ComSignalType=UINT8, ComHandleId=619, ComSystemTemplateSystemSignalRef=DET_RANGE_ERR_026
            DET_HVC_FLAG_026_oRDR_DETECTION_025_028_oPCAN_RADAR_2ad58e2d_Tx: ComBitPosition=198, ComBitSize=1, ComSignalInitValue=0, ComSignalType=BOOLEAN, ComHandleId=596, ComSystemTemplateSystemSignalRef=DET_HVC_FLAG_026
            DET_RANGE_VELOCITY_ERR_027_oRDR_DETECTION_025_028_oPCAN_RADAR_b04261f2_Tx: ComBitPosition=288, ComBitSize=8, ComSignalInitValue=0, ComSignalType=UINT8, ComHandleId=628, ComSystemTemplateSystemSignalRef=DET_RANGE_VELOCITY_ERR_027
            DET_AZIMUTH_ERR_028_oRDR_DETECTION_025_028_oPCAN_RADAR_52612c6c_Tx: ComBitPosition=441, ComBitSize=7, ComSignalInitValue=0, ComSignalType=UINT8, ComHandleId=566, ComSystemTemplateSystemSignalRef=DET_AZIMUTH_ERR_028
            DET_EXISTENCE_PROB_025_oRDR_DETECTION_025_028_oPCAN_RADAR_af41b6ac_Tx: ComBitPosition=112, ComBitSize=6, ComSignalInitValue=0, ComSignalType=UINT8, ComHandleId=591, ComSystemTemplateSystemSignalRef=DET_EXISTENCE_PROB_025
            DET_AZIMUTH_025_oRDR_DETECTION_025_028_oPCAN_RADAR_2b5484b5_Tx: ComBitPosition=88, ComBitSize=13, ComSignalInitValue=0, ComSignalType=UINT16, ComHandleId=559, ComSystemTemplateSystemSignalRef=DET_AZIMUTH_025
            DET_ELEVATION_027_oRDR_DETECTION_025_028_oPCAN_RADAR_0b77f4d2_Tx: ComBitPosition=296, ComBitSize=8, ComSignalInitValue=0, ComSignalType=UINT8, ComHandleId=585, ComSystemTemplateSystemSignalRef=DET_ELEVATION_027
            DET_RANGE_027_oRDR_DETECTION_025_028_oPCAN_RADAR_ca5f5865_Tx: ComBitPosition=248, ComBitSize=15, ComSignalInitValue=0, ComSignalType=UINT16, ComHandleId=616, ComSystemTemplateSystemSignalRef=DET_RANGE_027
            DET_RANGE_ERR_025_oRDR_DETECTION_025_028_oPCAN_RADAR_9c274d67_Tx: ComBitPosition=40, ComBitSize=7, ComSignalInitValue=0, ComSignalType=UINT8, ComHandleId=618, ComSystemTemplateSystemSignalRef=DET_RANGE_ERR_025
            DET_ELEVATION_028_oRDR_DETECTION_025_028_oPCAN_RADAR_27676695_Tx: ComBitPosition=408, ComBitSize=8, ComSignalInitValue=0, ComSignalType=UINT8, ComHandleId=586, ComSystemTemplateSystemSignalRef=DET_ELEVATION_028
            DET_BI_STATIC_FLAG_028_oRDR_DETECTION_025_028_oPCAN_RADAR_a0f8f91c_Tx: ComBitPosition=440, ComBitSize=1, ComSignalInitValue=0, ComSignalType=BOOLEAN, ComHandleId=574, ComSystemTemplateSystemSignalRef=DET_BI_STATIC_FLAG_028
            DET_CONFD_ELEVATION_027_oRDR_DETECTION_025_028_oPCAN_RADAR_dab720ee_Tx: ComBitPosition=325, ComBitSize=2, ComSignalInitValue=0, ComSignalType=UINT8, ComHandleId=581, ComSystemTemplateSystemSignalRef=DET_CONFD_ELEVATION_027
            DET_SUPER_RES_TARGET_028_oRDR_DETECTION_025_028_oPCAN_RADAR_f85e433a_Tx: ComBitPosition=423, ComBitSize=1, ComSignalInitValue=0, ComSignalType=BOOLEAN, ComHandleId=641, ComSystemTemplateSystemSignalRef=DET_SUPER_RES_TARGET_028
            DET_CONFD_ELEVATION_028_oRDR_DETECTION_025_028_oPCAN_RADAR_f6a7b2a9_Tx: ComBitPosition=437, ComBitSize=2, ComSignalInitValue=0, ComSignalType=UINT8, ComHandleId=582, ComSystemTemplateSystemSignalRef=DET_CONFD_ELEVATION_028
            DET_EXISTENCE_PROB_027_oRDR_DETECTION_025_028_oPCAN_RADAR_5ed119c7_Tx: ComBitPosition=336, ComBitSize=6, ComSignalInitValue=0, ComSignalType=UINT8, ComHandleId=593, ComSystemTemplateSystemSignalRef=DET_EXISTENCE_PROB_027
            DET_AZIMUTH_ERR_025_oRDR_DETECTION_025_028_oPCAN_RADAR_8fe11140_Tx: ComBitPosition=105, ComBitSize=7, ComSignalInitValue=0, ComSignalType=UINT8, ComHandleId=563, ComSystemTemplateSystemSignalRef=DET_AZIMUTH_ERR_025
            DET_RANGE_ERR_027_oRDR_DETECTION_025_028_oPCAN_RADAR_6db7e20c_Tx: ComBitPosition=264, ComBitSize=7, ComSignalInitValue=0, ComSignalType=UINT8, ComHandleId=620, ComSystemTemplateSystemSignalRef=DET_RANGE_ERR_027
            DET_ELEVATION_ERR_027_oRDR_DETECTION_025_028_oPCAN_RADAR_8c4e6ca7_Tx: ComBitPosition=304, ComBitSize=6, ComSignalInitValue=0, ComSignalType=UINT8, ComHandleId=589, ComSystemTemplateSystemSignalRef=DET_ELEVATION_ERR_027
            DET_CONFD_AZIMUTH_025_oRDR_DETECTION_025_028_oPCAN_RADAR_29b28e7f_Tx: ComBitPosition=118, ComBitSize=2, ComSignalInitValue=0, ComSignalType=UINT8, ComHandleId=575, ComSystemTemplateSystemSignalRef=DET_CONFD_AZIMUTH_025
            DET_MH_SCAN_INDEX_4LSB_025_028_oRDR_DETECTION_025_028_oPCAN_RADAR_57295715_Tx: ComBitPosition=476, ComBitSize=4, ComSignalInitValue=0, ComSignalType=UINT8, ComHandleId=605, ComSystemTemplateSystemSignalRef=DET_MH_SCAN_INDEX_4LSB_025_028
            DET_HVC_FLAG_028_oRDR_DETECTION_025_028_oPCAN_RADAR_93b5c8ff_Tx: ComBitPosition=422, ComBitSize=1, ComSignalInitValue=0, ComSignalType=BOOLEAN, ComHandleId=598, ComSystemTemplateSystemSignalRef=DET_HVC_FLAG_028
            DET_RCS_026_oRDR_DETECTION_025_028_oPCAN_RADAR_ad09798f_Tx: ComBitPosition=240, ComBitSize=8, ComSignalInitValue=128, ComSignalType=UINT8, ComHandleId=631, ComSystemTemplateSystemSignalRef=DET_RCS_026
            DET_RANGE_VELOCITY_ERR_028_oRDR_DETECTION_025_028_oPCAN_RADAR_9c52f3b5_Tx: ComBitPosition=400, ComBitSize=8, ComSignalInitValue=0, ComSignalType=UINT8, ComHandleId=629, ComSystemTemplateSystemSignalRef=DET_RANGE_VELOCITY_ERR_028
            DET_AZIMUTH_ERR_027_oRDR_DETECTION_025_028_oPCAN_RADAR_7e71be2b_Tx: ComBitPosition=329, ComBitSize=7, ComSignalInitValue=0, ComSignalType=UINT8, ComHandleId=565, ComSystemTemplateSystemSignalRef=DET_AZIMUTH_ERR_027
            DET_ELEVATION_ERR_028_oRDR_DETECTION_025_028_oPCAN_RADAR_a05efee0_Tx: ComBitPosition=416, ComBitSize=6, ComSignalInitValue=0, ComSignalType=UINT8, ComHandleId=590, ComSystemTemplateSystemSignalRef=DET_ELEVATION_ERR_028
            DET_AZIMUTH_028_oRDR_DETECTION_025_028_oPCAN_RADAR_f6d4b999_Tx: ComBitPosition=424, ComBitSize=13, ComSignalInitValue=0, ComSignalType=UINT16, ComHandleId=562, ComSystemTemplateSystemSignalRef=DET_AZIMUTH_028
            DET_ELEVATION_ERR_026_oRDR_DETECTION_025_028_oPCAN_RADAR_193eb832_Tx: ComBitPosition=192, ComBitSize=6, ComSignalInitValue=0, ComSignalType=UINT8, ComHandleId=588, ComSystemTemplateSystemSignalRef=DET_ELEVATION_ERR_026
            DET_RANGE_028_oRDR_DETECTION_025_028_oPCAN_RADAR_e64fca22_Tx: ComBitPosition=360, ComBitSize=15, ComSignalInitValue=0, ComSignalType=UINT16, ComHandleId=617, ComSystemTemplateSystemSignalRef=DET_RANGE_028
            DET_RANGE_VELOCITY_ERR_026_oRDR_DETECTION_025_028_oPCAN_RADAR_2532b567_Tx: ComBitPosition=176, ComBitSize=8, ComSignalInitValue=0, ComSignalType=UINT8, ComHandleId=627, ComSystemTemplateSystemSignalRef=DET_RANGE_VELOCITY_ERR_026
            DET_SNR_026_oRDR_DETECTION_025_028_oPCAN_RADAR_70a72d8d_Tx: ComBitPosition=232, ComBitSize=8, ComSignalInitValue=0, ComSignalType=UINT8, ComHandleId=635, ComSystemTemplateSystemSignalRef=DET_SNR_026
            DET_MH_CRC16_025_028_oRDR_DETECTION_025_028_oPCAN_RADAR_1f76d3ae_Tx: ComBitPosition=0, ComBitSize=16, ComSignalInitValue=0, ComSignalType=UINT16, ComHandleId=603, ComSystemTemplateSystemSignalRef=DET_MH_CRC16_025_028
            DET_RANGE_VELOCITY_028_oRDR_DETECTION_025_028_oPCAN_RADAR_93e90807_Tx: ComBitPosition=384, ComBitSize=15, ComSignalInitValue=16384, ComSignalType=UINT16, ComHandleId=625, ComSystemTemplateSystemSignalRef=DET_RANGE_VELOCITY_028
            DET_ELEVATION_025_oRDR_DETECTION_025_028_oPCAN_RADAR_fae75bb9_Tx: ComBitPosition=72, ComBitSize=8, ComSignalInitValue=0, ComSignalType=UINT8, ComHandleId=583, ComSystemTemplateSystemSignalRef=DET_ELEVATION_025
            DET_CONFD_AZIMUTH_026_oRDR_DETECTION_025_028_oPCAN_RADAR_4d52f581_Tx: ComBitPosition=230, ComBitSize=2, ComSignalInitValue=0, ComSignalType=UINT8, ComHandleId=576, ComSystemTemplateSystemSignalRef=DET_CONFD_AZIMUTH_026
            DET_SUPER_RES_TARGET_027_oRDR_DETECTION_025_028_oPCAN_RADAR_d44ed17d_Tx: ComBitPosition=311, ComBitSize=1, ComSignalInitValue=0, ComSignalType=BOOLEAN, ComHandleId=640, ComSystemTemplateSystemSignalRef=DET_SUPER_RES_TARGET_027
            DET_RANGE_VELOCITY_ERR_025_oRDR_DETECTION_025_028_oPCAN_RADAR_41d2ce99_Tx: ComBitPosition=64, ComBitSize=8, ComSignalInitValue=0, ComSignalType=UINT8, ComHandleId=626, ComSystemTemplateSystemSignalRef=DET_RANGE_VELOCITY_ERR_025
            DET_BI_STATIC_FLAG_027_oRDR_DETECTION_025_028_oPCAN_RADAR_8ce86b5b_Tx: ComBitPosition=328, ComBitSize=1, ComSignalInitValue=0, ComSignalType=BOOLEAN, ComHandleId=573, ComSystemTemplateSystemSignalRef=DET_BI_STATIC_FLAG_027
            DET_CONFD_ELEVATION_026_oRDR_DETECTION_025_028_oPCAN_RADAR_4fc7f47b_Tx: ComBitPosition=213, ComBitSize=2, ComSignalInitValue=0, ComSignalType=UINT8, ComHandleId=580, ComSystemTemplateSystemSignalRef=DET_CONFD_ELEVATION_026
            DET_ELEVATION_026_oRDR_DETECTION_025_028_oPCAN_RADAR_9e072047_Tx: ComBitPosition=184, ComBitSize=8, ComSignalInitValue=0, ComSignalType=UINT8, ComHandleId=584, ComSystemTemplateSystemSignalRef=DET_ELEVATION_026
            DET_RCS_027_oRDR_DETECTION_025_028_oPCAN_RADAR_3879ad1a_Tx: ComBitPosition=352, ComBitSize=8, ComSignalInitValue=128, ComSignalType=UINT8, ComHandleId=632, ComSystemTemplateSystemSignalRef=DET_RCS_027
            DET_RANGE_VELOCITY_025_oRDR_DETECTION_025_028_oPCAN_RADAR_4e69352b_Tx: ComBitPosition=48, ComBitSize=15, ComSignalInitValue=16384, ComSignalType=UINT16, ComHandleId=622, ComSystemTemplateSystemSignalRef=DET_RANGE_VELOCITY_025
            DET_BI_STATIC_FLAG_025_oRDR_DETECTION_025_028_oPCAN_RADAR_7d78c430_Tx: ComBitPosition=104, ComBitSize=1, ComSignalInitValue=0, ComSignalType=BOOLEAN, ComHandleId=571, ComSystemTemplateSystemSignalRef=DET_BI_STATIC_FLAG_025
            DET_RANGE_ERR_028_oRDR_DETECTION_025_028_oPCAN_RADAR_41a7704b_Tx: ComBitPosition=376, ComBitSize=7, ComSignalInitValue=0, ComSignalType=UINT8, ComHandleId=621, ComSystemTemplateSystemSignalRef=DET_RANGE_ERR_028
            DET_SNR_028_oRDR_DETECTION_025_028_oPCAN_RADAR_c9c76b5f_Tx: ComBitPosition=456, ComBitSize=8, ComSignalInitValue=0, ComSignalType=UINT8, ComHandleId=637, ComSystemTemplateSystemSignalRef=DET_SNR_028
            DET_RANGE_026_oRDR_DETECTION_025_028_oPCAN_RADAR_5f2f8cf0_Tx: ComBitPosition=136, ComBitSize=15, ComSignalInitValue=0, ComSignalType=UINT16, ComHandleId=615, ComSystemTemplateSystemSignalRef=DET_RANGE_026
            DET_PROB_1STAZHYPO_028_oRDR_DETECTION_025_028_oPCAN_RADAR_ede02954_Tx: ComBitPosition=439, ComBitSize=1, ComSignalInitValue=0, ComSignalType=BOOLEAN, ComHandleId=613, ComSystemTemplateSystemSignalRef=DET_PROB_1STAZHYPO_028
            DET_IDM_028_oRDR_DETECTION_025_028_oPCAN_RADAR_18e7f342_Tx: ComBitPosition=399, ComBitSize=1, ComSignalInitValue=0, ComSignalType=UINT8, ComHandleId=602, ComSystemTemplateSystemSignalRef=DET_IDM_028
            DET_PROB_1STAZHYPO_026_oRDR_DETECTION_025_028_oPCAN_RADAR_54806f86_Tx: ComBitPosition=215, ComBitSize=1, ComSignalInitValue=0, ComSignalType=BOOLEAN, ComHandleId=611, ComSystemTemplateSystemSignalRef=DET_PROB_1STAZHYPO_026
            DET_IDM_026_oRDR_DETECTION_025_028_oPCAN_RADAR_a187b590_Tx: ComBitPosition=175, ComBitSize=1, ComSignalInitValue=0, ComSignalType=UINT8, ComHandleId=600, ComSystemTemplateSystemSignalRef=DET_IDM_026
            DET_MTD_025_oRDR_DETECTION_025_028_oPCAN_RADAR_a3d4fcb5_Tx: ComBitPosition=47, ComBitSize=1, ComSignalInitValue=0, ComSignalType=UINT8, ComHandleId=606, ComSystemTemplateSystemSignalRef=DET_MTD_025
            DET_PROB_1STAZHYPO_025_oRDR_DETECTION_025_028_oPCAN_RADAR_30601478_Tx: ComBitPosition=103, ComBitSize=1, ComSignalInitValue=0, ComSignalType=BOOLEAN, ComHandleId=610, ComSystemTemplateSystemSignalRef=DET_PROB_1STAZHYPO_025
            DET_IDM_027_oRDR_DETECTION_025_028_oPCAN_RADAR_34f76105_Tx: ComBitPosition=287, ComBitSize=1, ComSignalInitValue=0, ComSignalType=UINT8, ComHandleId=601, ComSystemTemplateSystemSignalRef=DET_IDM_027
            DET_MTD_026_oRDR_DETECTION_025_028_oPCAN_RADAR_c734874b_Tx: ComBitPosition=159, ComBitSize=1, ComSignalInitValue=0, ComSignalType=UINT8, ComHandleId=607, ComSystemTemplateSystemSignalRef=DET_MTD_026
            DET_PROB_1STAZHYPO_027_oRDR_DETECTION_025_028_oPCAN_RADAR_c1f0bb13_Tx: ComBitPosition=327, ComBitSize=1, ComSignalInitValue=0, ComSignalType=BOOLEAN, ComHandleId=612, ComSystemTemplateSystemSignalRef=DET_PROB_1STAZHYPO_027
            DET_BELOW_RAIN_THOLD_028_oRDR_DETECTION_025_028_oPCAN_RADAR_23d52a59_Tx: ComBitPosition=375, ComBitSize=1, ComSignalInitValue=0, ComSignalType=UINT8, ComHandleId=570, ComSystemTemplateSystemSignalRef=DET_BELOW_RAIN_THOLD_028
            DET_IDM_025_oRDR_DETECTION_025_028_oPCAN_RADAR_c567ce6e_Tx: ComBitPosition=63, ComBitSize=1, ComSignalInitValue=0, ComSignalType=UINT8, ComHandleId=599, ComSystemTemplateSystemSignalRef=DET_IDM_025
            DET_BELOW_RAIN_THOLD_027_oRDR_DETECTION_025_028_oPCAN_RADAR_0fc5b81e_Tx: ComBitPosition=263, ComBitSize=1, ComSignalInitValue=0, ComSignalType=UINT8, ComHandleId=569, ComSystemTemplateSystemSignalRef=DET_BELOW_RAIN_THOLD_027
            DET_BELOW_RAIN_THOLD_025_oRDR_DETECTION_025_028_oPCAN_RADAR_fe551775_Tx: ComBitPosition=39, ComBitSize=1, ComSignalInitValue=0, ComSignalType=UINT8, ComHandleId=567, ComSystemTemplateSystemSignalRef=DET_BELOW_RAIN_THOLD_025
            DET_BELOW_RAIN_THOLD_026_oRDR_DETECTION_025_028_oPCAN_RADAR_9ab56c8b_Tx: ComBitPosition=151, ComBitSize=1, ComSignalInitValue=0, ComSignalType=UINT8, ComHandleId=568, ComSystemTemplateSystemSignalRef=DET_BELOW_RAIN_THOLD_026
            DET_MTD_027_oRDR_DETECTION_025_028_oPCAN_RADAR_524453de_Tx: ComBitPosition=271, ComBitSize=1, ComSignalInitValue=0, ComSignalType=UINT8, ComHandleId=608, ComSystemTemplateSystemSignalRef=DET_MTD_027
            DET_MTD_028_oRDR_DETECTION_025_028_oPCAN_RADAR_7e54c199_Tx: ComBitPosition=383, ComBitSize=1, ComSignalInitValue=0, ComSignalType=UINT8, ComHandleId=609, ComSystemTemplateSystemSignalRef=DET_MTD_028
        SG_Detections_285_288_oRDR_DETECTION_285_288_oPCAN_RADAR_fe0d65c7_Tx: ComTransferProperty=TRIGGERED, ComHandleId=73, ComSystemTemplateSignalGroupRef=SG_Detections_285_288
          83 x ComGroupSignal, all with ComSignalEndianness=LITTLE_ENDIAN, ComTransferProperty=PENDING, ComSignalAccess=ACCESS_NEEDED_BY_SWC_OR_COM:
            DET_RANGE_ERR_288_oRDR_DETECTION_285_288_oPCAN_RADAR_9b70a0bb_Tx: ComBitPosition=376, ComBitSize=7, ComSignalInitValue=0, ComSignalType=UINT8, ComHandleId=6016, ComSystemTemplateSystemSignalRef=DET_RANGE_ERR_288
            DET_SUPER_RES_TARGET_288_oRDR_DETECTION_285_288_oPCAN_RADAR_228993ca_Tx: ComBitPosition=423, ComBitSize=1, ComSignalInitValue=0, ComSignalType=BOOLEAN, ComHandleId=6036, ComSystemTemplateSystemSignalRef=DET_SUPER_RES_TARGET_288
            DET_ELEVATION_287_oRDR_DETECTION_285_288_oPCAN_RADAR_d1a02422_Tx: ComBitPosition=296, ComBitSize=8, ComSignalInitValue=0, ComSignalType=UINT8, ComHandleId=5980, ComSystemTemplateSystemSignalRef=DET_ELEVATION_287
            DET_ELEVATION_ERR_288_oRDR_DETECTION_285_288_oPCAN_RADAR_7a892e10_Tx: ComBitPosition=416, ComBitSize=6, ComSignalInitValue=0, ComSignalType=UINT8, ComHandleId=5985, ComSystemTemplateSystemSignalRef=DET_ELEVATION_ERR_288
            DET_RCS_287_oRDR_DETECTION_285_288_oPCAN_RADAR_e2ae7dea_Tx: ComBitPosition=352, ComBitSize=8, ComSignalInitValue=128, ComSignalType=UINT8, ComHandleId=6027, ComSystemTemplateSystemSignalRef=DET_RCS_287
            DET_ELEVATION_286_oRDR_DETECTION_285_288_oPCAN_RADAR_44d0f0b7_Tx: ComBitPosition=184, ComBitSize=8, ComSignalInitValue=0, ComSignalType=UINT8, ComHandleId=5979, ComSystemTemplateSystemSignalRef=DET_ELEVATION_286
            DET_HVC_FLAG_287_oRDR_DETECTION_285_288_oPCAN_RADAR_65728a48_Tx: ComBitPosition=310, ComBitSize=1, ComSignalInitValue=0, ComSignalType=BOOLEAN, ComHandleId=5992, ComSystemTemplateSystemSignalRef=DET_HVC_FLAG_287
            DET_SUPER_RES_TARGET_286_oRDR_DETECTION_285_288_oPCAN_RADAR_9be9d518_Tx: ComBitPosition=199, ComBitSize=1, ComSignalInitValue=0, ComSignalType=BOOLEAN, ComHandleId=6034, ComSystemTemplateSystemSignalRef=DET_SUPER_RES_TARGET_286
            DET_CONFD_AZIMUTH_285_oRDR_DETECTION_285_288_oPCAN_RADAR_f3655e8f_Tx: ComBitPosition=118, ComBitSize=2, ComSignalInitValue=0, ComSignalType=UINT8, ComHandleId=5970, ComSystemTemplateSystemSignalRef=DET_CONFD_AZIMUTH_285
            DET_RANGE_VELOCITY_285_oRDR_DETECTION_285_288_oPCAN_RADAR_94bee5db_Tx: ComBitPosition=48, ComBitSize=15, ComSignalInitValue=16384, ComSignalType=UINT16, ComHandleId=6017, ComSystemTemplateSystemSignalRef=DET_RANGE_VELOCITY_285
            DET_RCS_288_oRDR_DETECTION_285_288_oPCAN_RADAR_cebeefad_Tx: ComBitPosition=464, ComBitSize=8, ComSignalInitValue=128, ComSignalType=UINT8, ComHandleId=6028, ComSystemTemplateSystemSignalRef=DET_RCS_288
            DET_RANGE_287_oRDR_DETECTION_285_288_oPCAN_RADAR_10888895_Tx: ComBitPosition=248, ComBitSize=15, ComSignalInitValue=0, ComSignalType=UINT16, ComHandleId=6011, ComSystemTemplateSystemSignalRef=DET_RANGE_287
            DET_RANGE_VELOCITY_286_oRDR_DETECTION_285_288_oPCAN_RADAR_f05e9e25_Tx: ComBitPosition=160, ComBitSize=15, ComSignalInitValue=16384, ComSignalType=UINT16, ComHandleId=6018, ComSystemTemplateSystemSignalRef=DET_RANGE_VELOCITY_286
            DET_CONFD_ELEVATION_287_oRDR_DETECTION_285_288_oPCAN_RADAR_0060f01e_Tx: ComBitPosition=325, ComBitSize=2, ComSignalInitValue=0, ComSignalType=UINT8, ComHandleId=5976, ComSystemTemplateSystemSignalRef=DET_CONFD_ELEVATION_287
            DET_CONFD_ELEVATION_285_oRDR_DETECTION_285_288_oPCAN_RADAR_f1f05f75_Tx: ComBitPosition=101, ComBitSize=2, ComSignalInitValue=0, ComSignalType=UINT8, ComHandleId=5974, ComSystemTemplateSystemSignalRef=DET_CONFD_ELEVATION_285
            DET_RANGE_VELOCITY_287_oRDR_DETECTION_285_288_oPCAN_RADAR_652e4ab0_Tx: ComBitPosition=272, ComBitSize=15, ComSignalInitValue=16384, ComSignalType=UINT16, ComHandleId=6019, ComSystemTemplateSystemSignalRef=DET_RANGE_VELOCITY_287
            DET_AZIMUTH_ERR_288_oRDR_DETECTION_285_288_oPCAN_RADAR_88b6fc9c_Tx: ComBitPosition=441, ComBitSize=7, ComSignalInitValue=0, ComSignalType=UINT8, ComHandleId=5961, ComSystemTemplateSystemSignalRef=DET_AZIMUTH_ERR_288
            DET_RANGE_VELOCITY_288_oRDR_DETECTION_285_288_oPCAN_RADAR_493ed8f7_Tx: ComBitPosition=384, ComBitSize=15, ComSignalInitValue=16384, ComSignalType=UINT16, ComHandleId=6020, ComSystemTemplateSystemSignalRef=DET_RANGE_VELOCITY_288
            DET_RANGE_ERR_285_oRDR_DETECTION_285_288_oPCAN_RADAR_46f09d97_Tx: ComBitPosition=40, ComBitSize=7, ComSignalInitValue=0, ComSignalType=UINT8, ComHandleId=6013, ComSystemTemplateSystemSignalRef=DET_RANGE_ERR_285
            DET_RANGE_ERR_286_oRDR_DETECTION_285_288_oPCAN_RADAR_2210e669_Tx: ComBitPosition=152, ComBitSize=7, ComSignalInitValue=0, ComSignalType=UINT8, ComHandleId=6014, ComSystemTemplateSystemSignalRef=DET_RANGE_ERR_286
            DET_ELEVATION_ERR_285_oRDR_DETECTION_285_288_oPCAN_RADAR_a709133c_Tx: ComBitPosition=80, ComBitSize=6, ComSignalInitValue=0, ComSignalType=UINT8, ComHandleId=5982, ComSystemTemplateSystemSignalRef=DET_ELEVATION_ERR_285
            DET_RANGE_285_oRDR_DETECTION_285_288_oPCAN_RADAR_e11827fe_Tx: ComBitPosition=24, ComBitSize=15, ComSignalInitValue=0, ComSignalType=UINT16, ComHandleId=6009, ComSystemTemplateSystemSignalRef=DET_RANGE_285
            DET_AZIMUTH_ERR_287_oRDR_DETECTION_285_288_oPCAN_RADAR_a4a66edb_Tx: ComBitPosition=329, ComBitSize=7, ComSignalInitValue=0, ComSignalType=UINT8, ComHandleId=5960, ComSystemTemplateSystemSignalRef=DET_AZIMUTH_ERR_287
            DET_BI_STATIC_FLAG_285_oRDR_DETECTION_285_288_oPCAN_RADAR_a7af14c0_Tx: ComBitPosition=104, ComBitSize=1, ComSignalInitValue=0, ComSignalType=BOOLEAN, ComHandleId=5966, ComSystemTemplateSystemSignalRef=DET_BI_STATIC_FLAG_285
            DET_HVC_FLAG_285_oRDR_DETECTION_285_288_oPCAN_RADAR_94e22523_Tx: ComBitPosition=86, ComBitSize=1, ComSignalInitValue=0, ComSignalType=BOOLEAN, ComHandleId=5990, ComSystemTemplateSystemSignalRef=DET_HVC_FLAG_285
            DET_RCS_285_oRDR_DETECTION_285_288_oPCAN_RADAR_133ed281_Tx: ComBitPosition=128, ComBitSize=8, ComSignalInitValue=128, ComSignalType=UINT8, ComHandleId=6025, ComSystemTemplateSystemSignalRef=DET_RCS_285
            DET_CONFD_AZIMUTH_288_oRDR_DETECTION_285_288_oPCAN_RADAR_2ee563a3_Tx: ComBitPosition=454, ComBitSize=2, ComSignalInitValue=0, ComSignalType=UINT8, ComHandleId=5973, ComSystemTemplateSystemSignalRef=DET_CONFD_AZIMUTH_288
            DET_RANGE_VELOCITY_ERR_286_oRDR_DETECTION_285_288_oPCAN_RADAR_ffe56597_Tx: ComBitPosition=176, ComBitSize=8, ComSignalInitValue=0, ComSignalType=UINT8, ComHandleId=6022, ComSystemTemplateSystemSignalRef=DET_RANGE_VELOCITY_ERR_286
            DET_AZIMUTH_ERR_286_oRDR_DETECTION_285_288_oPCAN_RADAR_31d6ba4e_Tx: ComBitPosition=217, ComBitSize=7, ComSignalInitValue=0, ComSignalType=UINT8, ComHandleId=5959, ComSystemTemplateSystemSignalRef=DET_AZIMUTH_ERR_286
            DET_SNR_286_oRDR_DETECTION_285_288_oPCAN_RADAR_aa70fd7d_Tx: ComBitPosition=232, ComBitSize=8, ComSignalInitValue=0, ComSignalType=UINT8, ComHandleId=6030, ComSystemTemplateSystemSignalRef=DET_SNR_286
            DET_EXISTENCE_PROB_287_oRDR_DETECTION_285_288_oPCAN_RADAR_8406c937_Tx: ComBitPosition=336, ComBitSize=6, ComSignalInitValue=0, ComSignalType=UINT8, ComHandleId=5988, ComSystemTemplateSystemSignalRef=DET_EXISTENCE_PROB_287
            DET_AZIMUTH_285_oRDR_DETECTION_285_288_oPCAN_RADAR_f1835445_Tx: ComBitPosition=88, ComBitSize=13, ComSignalInitValue=0, ComSignalType=UINT16, ComHandleId=5954, ComSystemTemplateSystemSignalRef=DET_AZIMUTH_285
            DET_CONFD_AZIMUTH_286_oRDR_DETECTION_285_288_oPCAN_RADAR_97852571_Tx: ComBitPosition=230, ComBitSize=2, ComSignalInitValue=0, ComSignalType=UINT8, ComHandleId=5971, ComSystemTemplateSystemSignalRef=DET_CONFD_AZIMUTH_286
            DET_SUPER_RES_TARGET_285_oRDR_DETECTION_285_288_oPCAN_RADAR_ff09aee6_Tx: ComBitPosition=87, ComBitSize=1, ComSignalInitValue=0, ComSignalType=BOOLEAN, ComHandleId=6033, ComSystemTemplateSystemSignalRef=DET_SUPER_RES_TARGET_285
            DET_AZIMUTH_286_oRDR_DETECTION_285_288_oPCAN_RADAR_95632fbb_Tx: ComBitPosition=200, ComBitSize=13, ComSignalInitValue=0, ComSignalType=UINT16, ComHandleId=5955, ComSystemTemplateSystemSignalRef=DET_AZIMUTH_286
            DET_RANGE_286_oRDR_DETECTION_285_288_oPCAN_RADAR_85f85c00_Tx: ComBitPosition=136, ComBitSize=15, ComSignalInitValue=0, ComSignalType=UINT16, ComHandleId=6010, ComSystemTemplateSystemSignalRef=DET_RANGE_286
            DET_RCS_286_oRDR_DETECTION_285_288_oPCAN_RADAR_77dea97f_Tx: ComBitPosition=240, ComBitSize=8, ComSignalInitValue=128, ComSignalType=UINT8, ComHandleId=6026, ComSystemTemplateSystemSignalRef=DET_RCS_286
            DET_SNR_285_oRDR_DETECTION_285_288_oPCAN_RADAR_ce908683_Tx: ComBitPosition=120, ComBitSize=8, ComSignalInitValue=0, ComSignalType=UINT8, ComHandleId=6029, ComSystemTemplateSystemSignalRef=DET_SNR_285
            DET_EXISTENCE_PROB_285_oRDR_DETECTION_285_288_oPCAN_RADAR_7596665c_Tx: ComBitPosition=112, ComBitSize=6, ComSignalInitValue=0, ComSignalType=UINT8, ComHandleId=5986, ComSystemTemplateSystemSignalRef=DET_EXISTENCE_PROB_285
            DET_HVC_FLAG_286_oRDR_DETECTION_285_288_oPCAN_RADAR_f0025edd_Tx: ComBitPosition=198, ComBitSize=1, ComSignalInitValue=0, ComSignalType=BOOLEAN, ComHandleId=5991, ComSystemTemplateSystemSignalRef=DET_HVC_FLAG_286
            DET_RANGE_288_oRDR_DETECTION_285_288_oPCAN_RADAR_3c981ad2_Tx: ComBitPosition=360, ComBitSize=15, ComSignalInitValue=0, ComSignalType=UINT16, ComHandleId=6012, ComSystemTemplateSystemSignalRef=DET_RANGE_288
            DET_MH_SCAN_INDEX_4LSB_285_288_oRDR_DETECTION_285_288_oPCAN_RADAR_32da3377_Tx: ComBitPosition=476, ComBitSize=4, ComSignalInitValue=0, ComSignalType=UINT8, ComHandleId=6000, ComSystemTemplateSystemSignalRef=DET_MH_SCAN_INDEX_4LSB_285_288
            DET_EXISTENCE_PROB_288_oRDR_DETECTION_285_288_oPCAN_RADAR_a8165b70_Tx: ComBitPosition=448, ComBitSize=6, ComSignalInitValue=0, ComSignalType=UINT8, ComHandleId=5989, ComSystemTemplateSystemSignalRef=DET_EXISTENCE_PROB_288
            DET_SUPER_RES_TARGET_287_oRDR_DETECTION_285_288_oPCAN_RADAR_0e99018d_Tx: ComBitPosition=311, ComBitSize=1, ComSignalInitValue=0, ComSignalType=BOOLEAN, ComHandleId=6035, ComSystemTemplateSystemSignalRef=DET_SUPER_RES_TARGET_287
            DET_BI_STATIC_FLAG_288_oRDR_DETECTION_285_288_oPCAN_RADAR_7a2f29ec_Tx: ComBitPosition=440, ComBitSize=1, ComSignalInitValue=0, ComSignalType=BOOLEAN, ComHandleId=5969, ComSystemTemplateSystemSignalRef=DET_BI_STATIC_FLAG_288
            DET_RANGE_VELOCITY_ERR_285_oRDR_DETECTION_285_288_oPCAN_RADAR_9b051e69_Tx: ComBitPosition=64, ComBitSize=8, ComSignalInitValue=0, ComSignalType=UINT8, ComHandleId=6021, ComSystemTemplateSystemSignalRef=DET_RANGE_VELOCITY_ERR_285
            DET_SNR_288_oRDR_DETECTION_285_288_oPCAN_RADAR_1310bbaf_Tx: ComBitPosition=456, ComBitSize=8, ComSignalInitValue=0, ComSignalType=UINT8, ComHandleId=6032, ComSystemTemplateSystemSignalRef=DET_SNR_288
            DET_AZIMUTH_288_oRDR_DETECTION_285_288_oPCAN_RADAR_2c036969_Tx: ComBitPosition=424, ComBitSize=13, ComSignalInitValue=0, ComSignalType=UINT16, ComHandleId=5957, ComSystemTemplateSystemSignalRef=DET_AZIMUTH_288
            DET_ELEVATION_285_oRDR_DETECTION_285_288_oPCAN_RADAR_20308b49_Tx: ComBitPosition=72, ComBitSize=8, ComSignalInitValue=0, ComSignalType=UINT8, ComHandleId=5978, ComSystemTemplateSystemSignalRef=DET_ELEVATION_285
            DET_RANGE_VELOCITY_ERR_287_oRDR_DETECTION_285_288_oPCAN_RADAR_6a95b102_Tx: ComBitPosition=288, ComBitSize=8, ComSignalInitValue=0, ComSignalType=UINT8, ComHandleId=6023, ComSystemTemplateSystemSignalRef=DET_RANGE_VELOCITY_ERR_287
            DET_BI_STATIC_FLAG_287_oRDR_DETECTION_285_288_oPCAN_RADAR_563fbbab_Tx: ComBitPosition=328, ComBitSize=1, ComSignalInitValue=0, ComSignalType=BOOLEAN, ComHandleId=5968, ComSystemTemplateSystemSignalRef=DET_BI_STATIC_FLAG_287
            DET_AZIMUTH_287_oRDR_DETECTION_285_288_oPCAN_RADAR_0013fb2e_Tx: ComBitPosition=312, ComBitSize=13, ComSignalInitValue=0, ComSignalType=UINT16, ComHandleId=5956, ComSystemTemplateSystemSignalRef=DET_AZIMUTH_287
            DET_CONFD_ELEVATION_286_oRDR_DETECTION_285_288_oPCAN_RADAR_9510248b_Tx: ComBitPosition=213, ComBitSize=2, ComSignalInitValue=0, ComSignalType=UINT8, ComHandleId=5975, ComSystemTemplateSystemSignalRef=DET_CONFD_ELEVATION_286
            DET_RANGE_ERR_287_oRDR_DETECTION_285_288_oPCAN_RADAR_b76032fc_Tx: ComBitPosition=264, ComBitSize=7, ComSignalInitValue=0, ComSignalType=UINT8, ComHandleId=6015, ComSystemTemplateSystemSignalRef=DET_RANGE_ERR_287
            DET_EXISTENCE_PROB_286_oRDR_DETECTION_285_288_oPCAN_RADAR_11761da2_Tx: ComBitPosition=224, ComBitSize=6, ComSignalInitValue=0, ComSignalType=UINT8, ComHandleId=5987, ComSystemTemplateSystemSignalRef=DET_EXISTENCE_PROB_286
            DET_HVC_FLAG_288_oRDR_DETECTION_285_288_oPCAN_RADAR_4962180f_Tx: ComBitPosition=422, ComBitSize=1, ComSignalInitValue=0, ComSignalType=BOOLEAN, ComHandleId=5993, ComSystemTemplateSystemSignalRef=DET_HVC_FLAG_288
            DET_CONFD_ELEVATION_288_oRDR_DETECTION_285_288_oPCAN_RADAR_2c706259_Tx: ComBitPosition=437, ComBitSize=2, ComSignalInitValue=0, ComSignalType=UINT8, ComHandleId=5977, ComSystemTemplateSystemSignalRef=DET_CONFD_ELEVATION_288
            DET_ELEVATION_ERR_287_oRDR_DETECTION_285_288_oPCAN_RADAR_5699bc57_Tx: ComBitPosition=304, ComBitSize=6, ComSignalInitValue=0, ComSignalType=UINT8, ComHandleId=5984, ComSystemTemplateSystemSignalRef=DET_ELEVATION_ERR_287
            DET_ELEVATION_ERR_286_oRDR_DETECTION_285_288_oPCAN_RADAR_c3e968c2_Tx: ComBitPosition=192, ComBitSize=6, ComSignalInitValue=0, ComSignalType=UINT8, ComHandleId=5983, ComSystemTemplateSystemSignalRef=DET_ELEVATION_ERR_286
            DET_ELEVATION_288_oRDR_DETECTION_285_288_oPCAN_RADAR_fdb0b665_Tx: ComBitPosition=408, ComBitSize=8, ComSignalInitValue=0, ComSignalType=UINT8, ComHandleId=5981, ComSystemTemplateSystemSignalRef=DET_ELEVATION_288
            DET_AZIMUTH_ERR_285_oRDR_DETECTION_285_288_oPCAN_RADAR_5536c1b0_Tx: ComBitPosition=105, ComBitSize=7, ComSignalInitValue=0, ComSignalType=UINT8, ComHandleId=5958, ComSystemTemplateSystemSignalRef=DET_AZIMUTH_ERR_285
            DET_RANGE_VELOCITY_ERR_288_oRDR_DETECTION_285_288_oPCAN_RADAR_46852345_Tx: ComBitPosition=400, ComBitSize=8, ComSignalInitValue=0, ComSignalType=UINT8, ComHandleId=6024, ComSystemTemplateSystemSignalRef=DET_RANGE_VELOCITY_ERR_288
            DET_SNR_287_oRDR_DETECTION_285_288_oPCAN_RADAR_3f0029e8_Tx: ComBitPosition=344, ComBitSize=8, ComSignalInitValue=0, ComSignalType=UINT8, ComHandleId=6031, ComSystemTemplateSystemSignalRef=DET_SNR_287
            DET_CONFD_AZIMUTH_287_oRDR_DETECTION_285_288_oPCAN_RADAR_02f5f1e4_Tx: ComBitPosition=342, ComBitSize=2, ComSignalInitValue=0, ComSignalType=UINT8, ComHandleId=5972, ComSystemTemplateSystemSignalRef=DET_CONFD_AZIMUTH_287
            DET_MH_CYCLE_COUNTER_285_288_oRDR_DETECTION_285_288_oPCAN_RADAR_fef016fb_Tx: ComBitPosition=16, ComBitSize=8, ComSignalInitValue=0, ComSignalType=UINT8, ComHandleId=5999, ComSystemTemplateSystemSignalRef=DET_MH_CYCLE_COUNTER_285_288
            DET_MH_CRC16_285_288_oRDR_DETECTION_285_288_oPCAN_RADAR_7a85b7cc_Tx: ComBitPosition=0, ComBitSize=16, ComSignalInitValue=0, ComSignalType=UINT16, ComHandleId=5998, ComSystemTemplateSystemSignalRef=DET_MH_CRC16_285_288
            DET_BI_STATIC_FLAG_286_oRDR_DETECTION_285_288_oPCAN_RADAR_c34f6f3e_Tx: ComBitPosition=216, ComBitSize=1, ComSignalInitValue=0, ComSignalType=BOOLEAN, ComHandleId=5967, ComSystemTemplateSystemSignalRef=DET_BI_STATIC_FLAG_286
            DET_MTD_287_oRDR_DETECTION_285_288_oPCAN_RADAR_8893832e_Tx: ComBitPosition=271, ComBitSize=1, ComSignalInitValue=0, ComSignalType=UINT8, ComHandleId=6003, ComSystemTemplateSystemSignalRef=DET_MTD_287
            DET_BELOW_RAIN_THOLD_288_oRDR_DETECTION_285_288_oPCAN_RADAR_f902faa9_Tx: ComBitPosition=375, ComBitSize=1, ComSignalInitValue=0, ComSignalType=UINT8, ComHandleId=5965, ComSystemTemplateSystemSignalRef=DET_BELOW_RAIN_THOLD_288
            DET_BELOW_RAIN_THOLD_287_oRDR_DETECTION_285_288_oPCAN_RADAR_d51268ee_Tx: ComBitPosition=263, ComBitSize=1, ComSignalInitValue=0, ComSignalType=UINT8, ComHandleId=5964, ComSystemTemplateSystemSignalRef=DET_BELOW_RAIN_THOLD_287
            DET_BELOW_RAIN_THOLD_286_oRDR_DETECTION_285_288_oPCAN_RADAR_4062bc7b_Tx: ComBitPosition=151, ComBitSize=1, ComSignalInitValue=0, ComSignalType=UINT8, ComHandleId=5963, ComSystemTemplateSystemSignalRef=DET_BELOW_RAIN_THOLD_286
            DET_MTD_288_oRDR_DETECTION_285_288_oPCAN_RADAR_a4831169_Tx: ComBitPosition=383, ComBitSize=1, ComSignalInitValue=0, ComSignalType=UINT8, ComHandleId=6004, ComSystemTemplateSystemSignalRef=DET_MTD_288
            DET_IDM_288_oRDR_DETECTION_285_288_oPCAN_RADAR_c23023b2_Tx: ComBitPosition=399, ComBitSize=1, ComSignalInitValue=0, ComSignalType=UINT8, ComHandleId=5997, ComSystemTemplateSystemSignalRef=DET_IDM_288
            DET_MTD_286_oRDR_DETECTION_285_288_oPCAN_RADAR_1de357bb_Tx: ComBitPosition=159, ComBitSize=1, ComSignalInitValue=0, ComSignalType=UINT8, ComHandleId=6002, ComSystemTemplateSystemSignalRef=DET_MTD_286
            DET_PROB_1STAZHYPO_286_oRDR_DETECTION_285_288_oPCAN_RADAR_8e57bf76_Tx: ComBitPosition=215, ComBitSize=1, ComSignalInitValue=0, ComSignalType=BOOLEAN, ComHandleId=6006, ComSystemTemplateSystemSignalRef=DET_PROB_1STAZHYPO_286
            DET_PROB_1STAZHYPO_288_oRDR_DETECTION_285_288_oPCAN_RADAR_3737f9a4_Tx: ComBitPosition=439, ComBitSize=1, ComSignalInitValue=0, ComSignalType=BOOLEAN, ComHandleId=6008, ComSystemTemplateSystemSignalRef=DET_PROB_1STAZHYPO_288
            DET_IDM_285_oRDR_DETECTION_285_288_oPCAN_RADAR_1fb01e9e_Tx: ComBitPosition=63, ComBitSize=1, ComSignalInitValue=0, ComSignalType=UINT8, ComHandleId=5994, ComSystemTemplateSystemSignalRef=DET_IDM_285
            DET_PROB_1STAZHYPO_285_oRDR_DETECTION_285_288_oPCAN_RADAR_eab7c488_Tx: ComBitPosition=103, ComBitSize=1, ComSignalInitValue=0, ComSignalType=BOOLEAN, ComHandleId=6005, ComSystemTemplateSystemSignalRef=DET_PROB_1STAZHYPO_285
            DET_MTD_285_oRDR_DETECTION_285_288_oPCAN_RADAR_79032c45_Tx: ComBitPosition=47, ComBitSize=1, ComSignalInitValue=0, ComSignalType=UINT8, ComHandleId=6001, ComSystemTemplateSystemSignalRef=DET_MTD_285
            DET_IDM_286_oRDR_DETECTION_285_288_oPCAN_RADAR_7b506560_Tx: ComBitPosition=175, ComBitSize=1, ComSignalInitValue=0, ComSignalType=UINT8, ComHandleId=5995, ComSystemTemplateSystemSignalRef=DET_IDM_286
            DET_PROB_1STAZHYPO_287_oRDR_DETECTION_285_288_oPCAN_RADAR_1b276be3_Tx: ComBitPosition=327, ComBitSize=1, ComSignalInitValue=0, ComSignalType=BOOLEAN, ComHandleId=6007, ComSystemTemplateSystemSignalRef=DET_PROB_1STAZHYPO_287
            DET_BELOW_RAIN_THOLD_285_oRDR_DETECTION_285_288_oPCAN_RADAR_2482c785_Tx: ComBitPosition=39, ComBitSize=1, ComSignalInitValue=0, ComSignalType=UINT8, ComHandleId=5962, ComSystemTemplateSystemSignalRef=DET_BELOW_RAIN_THOLD_285
            DET_IDM_287_oRDR_DETECTION_285_288_oPCAN_RADAR_ee20b1f5_Tx: ComBitPosition=287, ComBitSize=1, ComSignalInitValue=0, ComSignalType=UINT8, ComHandleId=5996, ComSystemTemplateSystemSignalRef=DET_IDM_287
        SG_Detections_013_016_oRDR_DETECTION_013_016_oPCAN_RADAR_05faeda4_Tx: ComTransferProperty=TRIGGERED, ComHandleId=5, ComSystemTemplateSignalGroupRef=SG_Detections_013_016
          83 x ComGroupSignal, all with ComSignalEndianness=LITTLE_ENDIAN, ComTransferProperty=PENDING, ComSignalAccess=ACCESS_NEEDED_BY_SWC_OR_COM:
            DET_RCS_013_oRDR_DETECTION_013_016_oPCAN_RADAR_917d89ec_Tx: ComBitPosition=128, ComBitSize=8, ComSignalInitValue=128, ComSignalType=UINT8, ComHandleId=381, ComSystemTemplateSystemSignalRef=DET_RCS_013
            DET_RANGE_VELOCITY_013_oRDR_DETECTION_013_016_oPCAN_RADAR_16fdbeb6_Tx: ComBitPosition=48, ComBitSize=15, ComSignalInitValue=16384, ComSignalType=UINT16, ComHandleId=373, ComSystemTemplateSystemSignalRef=DET_RANGE_VELOCITY_013
            DET_RANGE_VELOCITY_ERR_014_oRDR_DETECTION_013_016_oPCAN_RADAR_45f6666d_Tx: ComBitPosition=176, ComBitSize=8, ComSignalInitValue=0, ComSignalType=UINT8, ComHandleId=378, ComSystemTemplateSystemSignalRef=DET_RANGE_VELOCITY_ERR_014
            DET_ELEVATION_015_oRDR_DETECTION_013_016_oPCAN_RADAR_6bb327d8_Tx: ComBitPosition=296, ComBitSize=8, ComSignalInitValue=0, ComSignalType=UINT8, ComHandleId=336, ComSystemTemplateSystemSignalRef=DET_ELEVATION_015
            DET_EXISTENCE_PROB_015_oRDR_DETECTION_013_016_oPCAN_RADAR_3e15cacd_Tx: ComBitPosition=336, ComBitSize=6, ComSignalInitValue=0, ComSignalType=UINT8, ComHandleId=344, ComSystemTemplateSystemSignalRef=DET_EXISTENCE_PROB_015
            DET_RCS_016_oRDR_DETECTION_013_016_oPCAN_RADAR_3c5d05ee_Tx: ComBitPosition=464, ComBitSize=8, ComSignalInitValue=128, ComSignalType=UINT8, ComHandleId=384, ComSystemTemplateSystemSignalRef=DET_RCS_016
            DET_RANGE_VELOCITY_ERR_015_oRDR_DETECTION_013_016_oPCAN_RADAR_d086b2f8_Tx: ComBitPosition=288, ComBitSize=8, ComSignalInitValue=0, ComSignalType=UINT8, ComHandleId=379, ComSystemTemplateSystemSignalRef=DET_RANGE_VELOCITY_ERR_015
            DET_RANGE_VELOCITY_ERR_016_oRDR_DETECTION_013_016_oPCAN_RADAR_b466c906_Tx: ComBitPosition=400, ComBitSize=8, ComSignalInitValue=0, ComSignalType=UINT8, ComHandleId=380, ComSystemTemplateSystemSignalRef=DET_RANGE_VELOCITY_ERR_016
            DET_RANGE_014_oRDR_DETECTION_013_016_oPCAN_RADAR_3feb5ffa_Tx: ComBitPosition=136, ComBitSize=15, ComSignalInitValue=0, ComSignalType=UINT16, ComHandleId=366, ComSystemTemplateSystemSignalRef=DET_RANGE_014
            DET_ELEVATION_ERR_014_oRDR_DETECTION_013_016_oPCAN_RADAR_79fa6b38_Tx: ComBitPosition=192, ComBitSize=6, ComSignalInitValue=0, ComSignalType=UINT8, ComHandleId=339, ComSystemTemplateSystemSignalRef=DET_ELEVATION_ERR_014
            DET_AZIMUTH_ERR_013_oRDR_DETECTION_013_016_oPCAN_RADAR_d7759add_Tx: ComBitPosition=105, ComBitSize=7, ComSignalInitValue=0, ComSignalType=UINT8, ComHandleId=314, ComSystemTemplateSystemSignalRef=DET_AZIMUTH_ERR_013
            DET_MH_CYCLE_COUNTER_013_016_oRDR_DETECTION_013_016_oPCAN_RADAR_05079e98_Tx: ComBitPosition=16, ComBitSize=8, ComSignalInitValue=0, ComSignalType=UINT8, ComHandleId=355, ComSystemTemplateSystemSignalRef=DET_MH_CYCLE_COUNTER_013_016
            DET_ELEVATION_013_oRDR_DETECTION_013_016_oPCAN_RADAR_a273d024_Tx: ComBitPosition=72, ComBitSize=8, ComSignalInitValue=0, ComSignalType=UINT8, ComHandleId=334, ComSystemTemplateSystemSignalRef=DET_ELEVATION_013
            DET_ELEVATION_ERR_015_oRDR_DETECTION_013_016_oPCAN_RADAR_ec8abfad_Tx: ComBitPosition=304, ComBitSize=6, ComSignalInitValue=0, ComSignalType=UINT8, ComHandleId=340, ComSystemTemplateSystemSignalRef=DET_ELEVATION_ERR_015
            DET_RANGE_VELOCITY_014_oRDR_DETECTION_013_016_oPCAN_RADAR_4a4d9ddf_Tx: ComBitPosition=160, ComBitSize=15, ComSignalInitValue=16384, ComSignalType=UINT16, ComHandleId=374, ComSystemTemplateSystemSignalRef=DET_RANGE_VELOCITY_014
            DET_SUPER_RES_TARGET_014_oRDR_DETECTION_013_016_oPCAN_RADAR_21fad6e2_Tx: ComBitPosition=199, ComBitSize=1, ComSignalInitValue=0, ComSignalType=BOOLEAN, ComHandleId=390, ComSystemTemplateSystemSignalRef=DET_SUPER_RES_TARGET_014
            DET_MH_CRC16_013_016_oRDR_DETECTION_013_016_oPCAN_RADAR_81723faf_Tx: ComBitPosition=0, ComBitSize=16, ComSignalInitValue=0, ComSignalType=UINT16, ComHandleId=354, ComSystemTemplateSystemSignalRef=DET_MH_CRC16_013_016
            DET_RANGE_VELOCITY_016_oRDR_DETECTION_013_016_oPCAN_RADAR_bbdd32b4_Tx: ComBitPosition=384, ComBitSize=15, ComSignalInitValue=16384, ComSignalType=UINT16, ComHandleId=376, ComSystemTemplateSystemSignalRef=DET_RANGE_VELOCITY_016
            DET_AZIMUTH_ERR_015_oRDR_DETECTION_013_016_oPCAN_RADAR_1eb56d21_Tx: ComBitPosition=329, ComBitSize=7, ComSignalInitValue=0, ComSignalType=UINT8, ComHandleId=316, ComSystemTemplateSystemSignalRef=DET_AZIMUTH_ERR_015
            DET_RCS_015_oRDR_DETECTION_013_016_oPCAN_RADAR_58bd7e10_Tx: ComBitPosition=352, ComBitSize=8, ComSignalInitValue=128, ComSignalType=UINT8, ComHandleId=383, ComSystemTemplateSystemSignalRef=DET_RCS_015
            DET_BI_STATIC_FLAG_016_oRDR_DETECTION_013_016_oPCAN_RADAR_88ccc3af_Tx: ComBitPosition=440, ComBitSize=1, ComSignalInitValue=0, ComSignalType=BOOLEAN, ComHandleId=325, ComSystemTemplateSystemSignalRef=DET_BI_STATIC_FLAG_016
            DET_ELEVATION_ERR_013_oRDR_DETECTION_013_016_oPCAN_RADAR_254a4851_Tx: ComBitPosition=80, ComBitSize=6, ComSignalInitValue=0, ComSignalType=UINT8, ComHandleId=338, ComSystemTemplateSystemSignalRef=DET_ELEVATION_ERR_013
            DET_MH_SCAN_INDEX_4LSB_013_016_oRDR_DETECTION_013_016_oPCAN_RADAR_c92dbb14_Tx: ComBitPosition=476, ComBitSize=4, ComSignalInitValue=0, ComSignalType=UINT8, ComHandleId=356, ComSystemTemplateSystemSignalRef=DET_MH_SCAN_INDEX_4LSB_013_016
            DET_RANGE_ERR_014_oRDR_DETECTION_013_016_oPCAN_RADAR_9803e593_Tx: ComBitPosition=152, ComBitSize=7, ComSignalInitValue=0, ComSignalType=UINT8, ComHandleId=370, ComSystemTemplateSystemSignalRef=DET_RANGE_ERR_014
            DET_EXISTENCE_PROB_013_oRDR_DETECTION_013_016_oPCAN_RADAR_f7d53d31_Tx: ComBitPosition=112, ComBitSize=6, ComSignalInitValue=0, ComSignalType=UINT8, ComHandleId=342, ComSystemTemplateSystemSignalRef=DET_EXISTENCE_PROB_013
            DET_AZIMUTH_ERR_014_oRDR_DETECTION_013_016_oPCAN_RADAR_8bc5b9b4_Tx: ComBitPosition=217, ComBitSize=7, ComSignalInitValue=0, ComSignalType=UINT8, ComHandleId=315, ComSystemTemplateSystemSignalRef=DET_AZIMUTH_ERR_014
            DET_CONFD_AZIMUTH_013_oRDR_DETECTION_013_016_oPCAN_RADAR_712605e2_Tx: ComBitPosition=118, ComBitSize=2, ComSignalInitValue=0, ComSignalType=UINT8, ComHandleId=326, ComSystemTemplateSystemSignalRef=DET_CONFD_AZIMUTH_013
            DET_SNR_014_oRDR_DETECTION_013_016_oPCAN_RADAR_1063fe87_Tx: ComBitPosition=232, ComBitSize=8, ComSignalInitValue=0, ComSignalType=UINT8, ComHandleId=386, ComSystemTemplateSystemSignalRef=DET_SNR_014
            DET_CONFD_AZIMUTH_014_oRDR_DETECTION_013_016_oPCAN_RADAR_2d96268b_Tx: ComBitPosition=230, ComBitSize=2, ComSignalInitValue=0, ComSignalType=UINT8, ComHandleId=327, ComSystemTemplateSystemSignalRef=DET_CONFD_AZIMUTH_014
            DET_CONFD_ELEVATION_013_oRDR_DETECTION_013_016_oPCAN_RADAR_73b30418_Tx: ComBitPosition=101, ComBitSize=2, ComSignalInitValue=0, ComSignalType=UINT8, ComHandleId=330, ComSystemTemplateSystemSignalRef=DET_CONFD_ELEVATION_013
            DET_AZIMUTH_014_oRDR_DETECTION_013_016_oPCAN_RADAR_2f702c41_Tx: ComBitPosition=200, ComBitSize=13, ComSignalInitValue=0, ComSignalType=UINT16, ComHandleId=311, ComSystemTemplateSystemSignalRef=DET_AZIMUTH_014
            DET_HVC_FLAG_013_oRDR_DETECTION_013_016_oPCAN_RADAR_16a17e4e_Tx: ComBitPosition=86, ComBitSize=1, ComSignalInitValue=0, ComSignalType=BOOLEAN, ComHandleId=346, ComSystemTemplateSystemSignalRef=DET_HVC_FLAG_013
            DET_AZIMUTH_ERR_016_oRDR_DETECTION_013_016_oPCAN_RADAR_7a5516df_Tx: ComBitPosition=441, ComBitSize=7, ComSignalInitValue=0, ComSignalType=UINT8, ComHandleId=317, ComSystemTemplateSystemSignalRef=DET_AZIMUTH_ERR_016
            DET_EXISTENCE_PROB_014_oRDR_DETECTION_013_016_oPCAN_RADAR_ab651e58_Tx: ComBitPosition=224, ComBitSize=6, ComSignalInitValue=0, ComSignalType=UINT8, ComHandleId=343, ComSystemTemplateSystemSignalRef=DET_EXISTENCE_PROB_014
            DET_RANGE_016_oRDR_DETECTION_013_016_oPCAN_RADAR_ce7bf091_Tx: ComBitPosition=360, ComBitSize=15, ComSignalInitValue=0, ComSignalType=UINT16, ComHandleId=368, ComSystemTemplateSystemSignalRef=DET_RANGE_016
            DET_CONFD_ELEVATION_016_oRDR_DETECTION_013_016_oPCAN_RADAR_de93881a_Tx: ComBitPosition=437, ComBitSize=2, ComSignalInitValue=0, ComSignalType=UINT8, ComHandleId=333, ComSystemTemplateSystemSignalRef=DET_CONFD_ELEVATION_016
            DET_ELEVATION_016_oRDR_DETECTION_013_016_oPCAN_RADAR_0f535c26_Tx: ComBitPosition=408, ComBitSize=8, ComSignalInitValue=0, ComSignalType=UINT8, ComHandleId=337, ComSystemTemplateSystemSignalRef=DET_ELEVATION_016
            DET_RANGE_015_oRDR_DETECTION_013_016_oPCAN_RADAR_aa9b8b6f_Tx: ComBitPosition=248, ComBitSize=15, ComSignalInitValue=0, ComSignalType=UINT16, ComHandleId=367, ComSystemTemplateSystemSignalRef=DET_RANGE_015
            DET_RANGE_ERR_015_oRDR_DETECTION_013_016_oPCAN_RADAR_0d733106_Tx: ComBitPosition=264, ComBitSize=7, ComSignalInitValue=0, ComSignalType=UINT8, ComHandleId=371, ComSystemTemplateSystemSignalRef=DET_RANGE_ERR_015
            DET_SNR_016_oRDR_DETECTION_013_016_oPCAN_RADAR_e1f351ec_Tx: ComBitPosition=456, ComBitSize=8, ComSignalInitValue=0, ComSignalType=UINT8, ComHandleId=388, ComSystemTemplateSystemSignalRef=DET_SNR_016
            DET_SUPER_RES_TARGET_015_oRDR_DETECTION_013_016_oPCAN_RADAR_b48a0277_Tx: ComBitPosition=311, ComBitSize=1, ComSignalInitValue=0, ComSignalType=BOOLEAN, ComHandleId=391, ComSystemTemplateSystemSignalRef=DET_SUPER_RES_TARGET_015
            DET_RANGE_VELOCITY_015_oRDR_DETECTION_013_016_oPCAN_RADAR_df3d494a_Tx: ComBitPosition=272, ComBitSize=15, ComSignalInitValue=16384, ComSignalType=UINT16, ComHandleId=375, ComSystemTemplateSystemSignalRef=DET_RANGE_VELOCITY_015
            DET_RANGE_013_oRDR_DETECTION_013_016_oPCAN_RADAR_635b7c93_Tx: ComBitPosition=24, ComBitSize=15, ComSignalInitValue=0, ComSignalType=UINT16, ComHandleId=365, ComSystemTemplateSystemSignalRef=DET_RANGE_013
            DET_AZIMUTH_013_oRDR_DETECTION_013_016_oPCAN_RADAR_73c00f28_Tx: ComBitPosition=88, ComBitSize=13, ComSignalInitValue=0, ComSignalType=UINT16, ComHandleId=310, ComSystemTemplateSystemSignalRef=DET_AZIMUTH_013
            DET_CONFD_AZIMUTH_015_oRDR_DETECTION_013_016_oPCAN_RADAR_b8e6f21e_Tx: ComBitPosition=342, ComBitSize=2, ComSignalInitValue=0, ComSignalType=UINT8, ComHandleId=328, ComSystemTemplateSystemSignalRef=DET_CONFD_AZIMUTH_015
            DET_RANGE_VELOCITY_ERR_013_oRDR_DETECTION_013_016_oPCAN_RADAR_19464504_Tx: ComBitPosition=64, ComBitSize=8, ComSignalInitValue=0, ComSignalType=UINT8, ComHandleId=377, ComSystemTemplateSystemSignalRef=DET_RANGE_VELOCITY_ERR_013
            DET_SNR_015_oRDR_DETECTION_013_016_oPCAN_RADAR_85132a12_Tx: ComBitPosition=344, ComBitSize=8, ComSignalInitValue=0, ComSignalType=UINT8, ComHandleId=387, ComSystemTemplateSystemSignalRef=DET_SNR_015
            DET_SUPER_RES_TARGET_016_oRDR_DETECTION_013_016_oPCAN_RADAR_d06a7989_Tx: ComBitPosition=423, ComBitSize=1, ComSignalInitValue=0, ComSignalType=BOOLEAN, ComHandleId=392, ComSystemTemplateSystemSignalRef=DET_SUPER_RES_TARGET_016
            DET_AZIMUTH_015_oRDR_DETECTION_013_016_oPCAN_RADAR_ba00f8d4_Tx: ComBitPosition=312, ComBitSize=13, ComSignalInitValue=0, ComSignalType=UINT16, ComHandleId=312, ComSystemTemplateSystemSignalRef=DET_AZIMUTH_015
            DET_SUPER_RES_TARGET_013_oRDR_DETECTION_013_016_oPCAN_RADAR_7d4af58b_Tx: ComBitPosition=87, ComBitSize=1, ComSignalInitValue=0, ComSignalType=BOOLEAN, ComHandleId=389, ComSystemTemplateSystemSignalRef=DET_SUPER_RES_TARGET_013
            DET_RANGE_ERR_016_oRDR_DETECTION_013_016_oPCAN_RADAR_69934af8_Tx: ComBitPosition=376, ComBitSize=7, ComSignalInitValue=0, ComSignalType=UINT8, ComHandleId=372, ComSystemTemplateSystemSignalRef=DET_RANGE_ERR_016
            DET_BI_STATIC_FLAG_015_oRDR_DETECTION_013_016_oPCAN_RADAR_ec2cb851_Tx: ComBitPosition=328, ComBitSize=1, ComSignalInitValue=0, ComSignalType=BOOLEAN, ComHandleId=324, ComSystemTemplateSystemSignalRef=DET_BI_STATIC_FLAG_015
            DET_EXISTENCE_PROB_016_oRDR_DETECTION_013_016_oPCAN_RADAR_5af5b133_Tx: ComBitPosition=448, ComBitSize=6, ComSignalInitValue=0, ComSignalType=UINT8, ComHandleId=345, ComSystemTemplateSystemSignalRef=DET_EXISTENCE_PROB_016
            DET_BI_STATIC_FLAG_013_oRDR_DETECTION_013_016_oPCAN_RADAR_25ec4fad_Tx: ComBitPosition=104, ComBitSize=1, ComSignalInitValue=0, ComSignalType=BOOLEAN, ComHandleId=322, ComSystemTemplateSystemSignalRef=DET_BI_STATIC_FLAG_013
            DET_CONFD_ELEVATION_015_oRDR_DETECTION_013_016_oPCAN_RADAR_ba73f3e4_Tx: ComBitPosition=325, ComBitSize=2, ComSignalInitValue=0, ComSignalType=UINT8, ComHandleId=332, ComSystemTemplateSystemSignalRef=DET_CONFD_ELEVATION_015
            DET_BI_STATIC_FLAG_014_oRDR_DETECTION_013_016_oPCAN_RADAR_795c6cc4_Tx: ComBitPosition=216, ComBitSize=1, ComSignalInitValue=0, ComSignalType=BOOLEAN, ComHandleId=323, ComSystemTemplateSystemSignalRef=DET_BI_STATIC_FLAG_014
            DET_HVC_FLAG_014_oRDR_DETECTION_013_016_oPCAN_RADAR_4a115d27_Tx: ComBitPosition=198, ComBitSize=1, ComSignalInitValue=0, ComSignalType=BOOLEAN, ComHandleId=347, ComSystemTemplateSystemSignalRef=DET_HVC_FLAG_014
            DET_HVC_FLAG_015_oRDR_DETECTION_013_016_oPCAN_RADAR_df6189b2_Tx: ComBitPosition=310, ComBitSize=1, ComSignalInitValue=0, ComSignalType=BOOLEAN, ComHandleId=348, ComSystemTemplateSystemSignalRef=DET_HVC_FLAG_015
            DET_RANGE_ERR_013_oRDR_DETECTION_013_016_oPCAN_RADAR_c4b3c6fa_Tx: ComBitPosition=40, ComBitSize=7, ComSignalInitValue=0, ComSignalType=UINT8, ComHandleId=369, ComSystemTemplateSystemSignalRef=DET_RANGE_ERR_013
            DET_ELEVATION_014_oRDR_DETECTION_013_016_oPCAN_RADAR_fec3f34d_Tx: ComBitPosition=184, ComBitSize=8, ComSignalInitValue=0, ComSignalType=UINT8, ComHandleId=335, ComSystemTemplateSystemSignalRef=DET_ELEVATION_014
            DET_RCS_014_oRDR_DETECTION_013_016_oPCAN_RADAR_cdcdaa85_Tx: ComBitPosition=240, ComBitSize=8, ComSignalInitValue=128, ComSignalType=UINT8, ComHandleId=382, ComSystemTemplateSystemSignalRef=DET_RCS_014
            DET_CONFD_AZIMUTH_016_oRDR_DETECTION_013_016_oPCAN_RADAR_dc0689e0_Tx: ComBitPosition=454, ComBitSize=2, ComSignalInitValue=0, ComSignalType=UINT8, ComHandleId=329, ComSystemTemplateSystemSignalRef=DET_CONFD_AZIMUTH_016
            DET_HVC_FLAG_016_oRDR_DETECTION_013_016_oPCAN_RADAR_bb81f24c_Tx: ComBitPosition=422, ComBitSize=1, ComSignalInitValue=0, ComSignalType=BOOLEAN, ComHandleId=349, ComSystemTemplateSystemSignalRef=DET_HVC_FLAG_016
            DET_CONFD_ELEVATION_014_oRDR_DETECTION_013_016_oPCAN_RADAR_2f032771_Tx: ComBitPosition=213, ComBitSize=2, ComSignalInitValue=0, ComSignalType=UINT8, ComHandleId=331, ComSystemTemplateSystemSignalRef=DET_CONFD_ELEVATION_014
            DET_AZIMUTH_016_oRDR_DETECTION_013_016_oPCAN_RADAR_dee0832a_Tx: ComBitPosition=424, ComBitSize=13, ComSignalInitValue=0, ComSignalType=UINT16, ComHandleId=313, ComSystemTemplateSystemSignalRef=DET_AZIMUTH_016
            DET_ELEVATION_ERR_016_oRDR_DETECTION_013_016_oPCAN_RADAR_886ac453_Tx: ComBitPosition=416, ComBitSize=6, ComSignalInitValue=0, ComSignalType=UINT8, ComHandleId=341, ComSystemTemplateSystemSignalRef=DET_ELEVATION_ERR_016
            DET_SNR_013_oRDR_DETECTION_013_016_oPCAN_RADAR_4cd3ddee_Tx: ComBitPosition=120, ComBitSize=8, ComSignalInitValue=0, ComSignalType=UINT8, ComHandleId=385, ComSystemTemplateSystemSignalRef=DET_SNR_013
            DET_IDM_015_oRDR_DETECTION_013_016_oPCAN_RADAR_5433b20f_Tx: ComBitPosition=287, ComBitSize=1, ComSignalInitValue=0, ComSignalType=UINT8, ComHandleId=352, ComSystemTemplateSystemSignalRef=DET_IDM_015
            DET_IDM_014_oRDR_DETECTION_013_016_oPCAN_RADAR_c143669a_Tx: ComBitPosition=175, ComBitSize=1, ComSignalInitValue=0, ComSignalType=UINT8, ComHandleId=351, ComSystemTemplateSystemSignalRef=DET_IDM_014
            DET_PROB_1STAZHYPO_013_oRDR_DETECTION_013_016_oPCAN_RADAR_68f49fe5_Tx: ComBitPosition=103, ComBitSize=1, ComSignalInitValue=0, ComSignalType=BOOLEAN, ComHandleId=361, ComSystemTemplateSystemSignalRef=DET_PROB_1STAZHYPO_013
            DET_PROB_1STAZHYPO_014_oRDR_DETECTION_013_016_oPCAN_RADAR_3444bc8c_Tx: ComBitPosition=215, ComBitSize=1, ComSignalInitValue=0, ComSignalType=BOOLEAN, ComHandleId=362, ComSystemTemplateSystemSignalRef=DET_PROB_1STAZHYPO_014
            DET_BELOW_RAIN_THOLD_015_oRDR_DETECTION_013_016_oPCAN_RADAR_6f016b14_Tx: ComBitPosition=263, ComBitSize=1, ComSignalInitValue=0, ComSignalType=UINT8, ComHandleId=320, ComSystemTemplateSystemSignalRef=DET_BELOW_RAIN_THOLD_015
            DET_BELOW_RAIN_THOLD_014_oRDR_DETECTION_013_016_oPCAN_RADAR_fa71bf81_Tx: ComBitPosition=151, ComBitSize=1, ComSignalInitValue=0, ComSignalType=UINT8, ComHandleId=319, ComSystemTemplateSystemSignalRef=DET_BELOW_RAIN_THOLD_014
            DET_MTD_016_oRDR_DETECTION_013_016_oPCAN_RADAR_5660fb2a_Tx: ComBitPosition=383, ComBitSize=1, ComSignalInitValue=0, ComSignalType=UINT8, ComHandleId=360, ComSystemTemplateSystemSignalRef=DET_MTD_016
            DET_IDM_016_oRDR_DETECTION_013_016_oPCAN_RADAR_30d3c9f1_Tx: ComBitPosition=399, ComBitSize=1, ComSignalInitValue=0, ComSignalType=UINT8, ComHandleId=353, ComSystemTemplateSystemSignalRef=DET_IDM_016
            DET_MTD_013_oRDR_DETECTION_013_016_oPCAN_RADAR_fb407728_Tx: ComBitPosition=47, ComBitSize=1, ComSignalInitValue=0, ComSignalType=UINT8, ComHandleId=357, ComSystemTemplateSystemSignalRef=DET_MTD_013
            DET_PROB_1STAZHYPO_016_oRDR_DETECTION_013_016_oPCAN_RADAR_c5d413e7_Tx: ComBitPosition=439, ComBitSize=1, ComSignalInitValue=0, ComSignalType=BOOLEAN, ComHandleId=364, ComSystemTemplateSystemSignalRef=DET_PROB_1STAZHYPO_016
            DET_IDM_013_oRDR_DETECTION_013_016_oPCAN_RADAR_9df345f3_Tx: ComBitPosition=63, ComBitSize=1, ComSignalInitValue=0, ComSignalType=UINT8, ComHandleId=350, ComSystemTemplateSystemSignalRef=DET_IDM_013
            DET_BELOW_RAIN_THOLD_016_oRDR_DETECTION_013_016_oPCAN_RADAR_0be110ea_Tx: ComBitPosition=375, ComBitSize=1, ComSignalInitValue=0, ComSignalType=UINT8, ComHandleId=321, ComSystemTemplateSystemSignalRef=DET_BELOW_RAIN_THOLD_016
            DET_PROB_1STAZHYPO_015_oRDR_DETECTION_013_016_oPCAN_RADAR_a1346819_Tx: ComBitPosition=327, ComBitSize=1, ComSignalInitValue=0, ComSignalType=BOOLEAN, ComHandleId=363, ComSystemTemplateSystemSignalRef=DET_PROB_1STAZHYPO_015
            DET_BELOW_RAIN_THOLD_013_oRDR_DETECTION_013_016_oPCAN_RADAR_a6c19ce8_Tx: ComBitPosition=39, ComBitSize=1, ComSignalInitValue=0, ComSignalType=UINT8, ComHandleId=318, ComSystemTemplateSystemSignalRef=DET_BELOW_RAIN_THOLD_013
            DET_MTD_015_oRDR_DETECTION_013_016_oPCAN_RADAR_328080d4_Tx: ComBitPosition=271, ComBitSize=1, ComSignalInitValue=0, ComSignalType=UINT8, ComHandleId=359, ComSystemTemplateSystemSignalRef=DET_MTD_015
            DET_MTD_014_oRDR_DETECTION_013_016_oPCAN_RADAR_a7f05441_Tx: ComBitPosition=159, ComBitSize=1, ComSignalInitValue=0, ComSignalType=UINT8, ComHandleId=358, ComSystemTemplateSystemSignalRef=DET_MTD_014
        SG_Detections_017_020_oRDR_DETECTION_017_020_oPCAN_RADAR_e956bb2e_Tx: ComTransferProperty=TRIGGERED, ComHandleId=6, ComSystemTemplateSignalGroupRef=SG_Detections_017_020
          83 x ComGroupSignal, all with ComSignalEndianness=LITTLE_ENDIAN, ComTransferProperty=PENDING, ComSignalAccess=ACCESS_NEEDED_BY_SWC_OR_COM:
            DET_CONFD_AZIMUTH_019_oRDR_DETECTION_017_020_oPCAN_RADAR_5f9ac66e_Tx: ComBitPosition=342, ComBitSize=2, ComSignalInitValue=0, ComSignalType=UINT8, ComHandleId=411, ComSystemTemplateSystemSignalRef=DET_CONFD_AZIMUTH_019
            DET_RANGE_ERR_018_oRDR_DETECTION_017_020_oPCAN_RADAR_7f7fd1e3_Tx: ComBitPosition=152, ComBitSize=7, ComSignalInitValue=0, ComSignalType=UINT8, ComHandleId=453, ComSystemTemplateSystemSignalRef=DET_RANGE_ERR_018
            DET_RANGE_ERR_019_oRDR_DETECTION_017_020_oPCAN_RADAR_ea0f0576_Tx: ComBitPosition=264, ComBitSize=7, ComSignalInitValue=0, ComSignalType=UINT8, ComHandleId=454, ComSystemTemplateSystemSignalRef=DET_RANGE_ERR_019
            DET_RANGE_ERR_020_oRDR_DETECTION_017_020_oPCAN_RADAR_55be5fad_Tx: ComBitPosition=376, ComBitSize=7, ComSignalInitValue=0, ComSignalType=UINT8, ComHandleId=455, ComSystemTemplateSystemSignalRef=DET_RANGE_ERR_020
            DET_SUPER_RES_TARGET_020_oRDR_DETECTION_017_020_oPCAN_RADAR_ec476cdc_Tx: ComBitPosition=423, ComBitSize=1, ComSignalInitValue=0, ComSignalType=BOOLEAN, ComHandleId=475, ComSystemTemplateSystemSignalRef=DET_SUPER_RES_TARGET_020
            DET_CONFD_AZIMUTH_017_oRDR_DETECTION_017_020_oPCAN_RADAR_e6fa80bc_Tx: ComBitPosition=118, ComBitSize=2, ComSignalInitValue=0, ComSignalType=UINT8, ComHandleId=409, ComSystemTemplateSystemSignalRef=DET_CONFD_AZIMUTH_017
            DET_EXISTENCE_PROB_018_oRDR_DETECTION_017_020_oPCAN_RADAR_4c192a28_Tx: ComBitPosition=224, ComBitSize=6, ComSignalInitValue=0, ComSignalType=UINT8, ComHandleId=426, ComSystemTemplateSystemSignalRef=DET_EXISTENCE_PROB_018
            DET_CONFD_ELEVATION_018_oRDR_DETECTION_017_020_oPCAN_RADAR_c87f1301_Tx: ComBitPosition=213, ComBitSize=2, ComSignalInitValue=0, ComSignalType=UINT8, ComHandleId=414, ComSystemTemplateSystemSignalRef=DET_CONFD_ELEVATION_018
            DET_SUPER_RES_TARGET_019_oRDR_DETECTION_017_020_oPCAN_RADAR_53f63607_Tx: ComBitPosition=311, ComBitSize=1, ComSignalInitValue=0, ComSignalType=BOOLEAN, ComHandleId=474, ComSystemTemplateSystemSignalRef=DET_SUPER_RES_TARGET_019
            DET_MH_CYCLE_COUNTER_017_020_oRDR_DETECTION_017_020_oPCAN_RADAR_e9abc812_Tx: ComBitPosition=16, ComBitSize=8, ComSignalInitValue=0, ComSignalType=UINT8, ComHandleId=438, ComSystemTemplateSystemSignalRef=DET_MH_CYCLE_COUNTER_017_020
            DET_ELEVATION_018_oRDR_DETECTION_017_020_oPCAN_RADAR_19bfc73d_Tx: ComBitPosition=184, ComBitSize=8, ComSignalInitValue=0, ComSignalType=UINT8, ComHandleId=418, ComSystemTemplateSystemSignalRef=DET_ELEVATION_018
            DET_HVC_FLAG_019_oRDR_DETECTION_017_020_oPCAN_RADAR_381dbdc2_Tx: ComBitPosition=310, ComBitSize=1, ComSignalInitValue=0, ComSignalType=BOOLEAN, ComHandleId=431, ComSystemTemplateSystemSignalRef=DET_HVC_FLAG_019
            DET_BI_STATIC_FLAG_018_oRDR_DETECTION_017_020_oPCAN_RADAR_9e2058b4_Tx: ComBitPosition=216, ComBitSize=1, ComSignalInitValue=0, ComSignalType=BOOLEAN, ComHandleId=406, ComSystemTemplateSystemSignalRef=DET_BI_STATIC_FLAG_018
            DET_BI_STATIC_FLAG_019_oRDR_DETECTION_017_020_oPCAN_RADAR_0b508c21_Tx: ComBitPosition=328, ComBitSize=1, ComSignalInitValue=0, ComSignalType=BOOLEAN, ComHandleId=407, ComSystemTemplateSystemSignalRef=DET_BI_STATIC_FLAG_019
            DET_ELEVATION_ERR_019_oRDR_DETECTION_017_020_oPCAN_RADAR_0bf68bdd_Tx: ComBitPosition=304, ComBitSize=6, ComSignalInitValue=0, ComSignalType=UINT8, ComHandleId=423, ComSystemTemplateSystemSignalRef=DET_ELEVATION_ERR_019
            DET_SUPER_RES_TARGET_017_oRDR_DETECTION_017_020_oPCAN_RADAR_ea9670d5_Tx: ComBitPosition=87, ComBitSize=1, ComSignalInitValue=0, ComSignalType=BOOLEAN, ComHandleId=472, ComSystemTemplateSystemSignalRef=DET_SUPER_RES_TARGET_017
            DET_CONFD_AZIMUTH_020_oRDR_DETECTION_017_020_oPCAN_RADAR_e02b9cb5_Tx: ComBitPosition=454, ComBitSize=2, ComSignalInitValue=0, ComSignalType=UINT8, ComHandleId=412, ComSystemTemplateSystemSignalRef=DET_CONFD_AZIMUTH_020
            DET_EXISTENCE_PROB_017_oRDR_DETECTION_017_020_oPCAN_RADAR_6009b86f_Tx: ComBitPosition=112, ComBitSize=6, ComSignalInitValue=0, ComSignalType=UINT8, ComHandleId=425, ComSystemTemplateSystemSignalRef=DET_EXISTENCE_PROB_017
            DET_CONFD_ELEVATION_017_oRDR_DETECTION_017_020_oPCAN_RADAR_e46f8146_Tx: ComBitPosition=101, ComBitSize=2, ComSignalInitValue=0, ComSignalType=UINT8, ComHandleId=413, ComSystemTemplateSystemSignalRef=DET_CONFD_ELEVATION_017
            DET_SUPER_RES_TARGET_018_oRDR_DETECTION_017_020_oPCAN_RADAR_c686e292_Tx: ComBitPosition=199, ComBitSize=1, ComSignalInitValue=0, ComSignalType=BOOLEAN, ComHandleId=473, ComSystemTemplateSystemSignalRef=DET_SUPER_RES_TARGET_018
            DET_ELEVATION_019_oRDR_DETECTION_017_020_oPCAN_RADAR_8ccf13a8_Tx: ComBitPosition=296, ComBitSize=8, ComSignalInitValue=0, ComSignalType=UINT8, ComHandleId=419, ComSystemTemplateSystemSignalRef=DET_ELEVATION_019
            DET_ELEVATION_ERR_018_oRDR_DETECTION_017_020_oPCAN_RADAR_9e865f48_Tx: ComBitPosition=192, ComBitSize=6, ComSignalInitValue=0, ComSignalType=UINT8, ComHandleId=422, ComSystemTemplateSystemSignalRef=DET_ELEVATION_ERR_018
            DET_HVC_FLAG_020_oRDR_DETECTION_017_020_oPCAN_RADAR_87ace719_Tx: ComBitPosition=422, ComBitSize=1, ComSignalInitValue=0, ComSignalType=BOOLEAN, ComHandleId=432, ComSystemTemplateSystemSignalRef=DET_HVC_FLAG_020
            DET_RANGE_018_oRDR_DETECTION_017_020_oPCAN_RADAR_d8976b8a_Tx: ComBitPosition=136, ComBitSize=15, ComSignalInitValue=0, ComSignalType=UINT16, ComHandleId=449, ComSystemTemplateSystemSignalRef=DET_RANGE_018
            DET_RANGE_VELOCITY_020_oRDR_DETECTION_017_020_oPCAN_RADAR_87f027e1_Tx: ComBitPosition=384, ComBitSize=15, ComSignalInitValue=16384, ComSignalType=UINT16, ComHandleId=459, ComSystemTemplateSystemSignalRef=DET_RANGE_VELOCITY_020
            DET_RANGE_019_oRDR_DETECTION_017_020_oPCAN_RADAR_4de7bf1f_Tx: ComBitPosition=248, ComBitSize=15, ComSignalInitValue=0, ComSignalType=UINT16, ComHandleId=450, ComSystemTemplateSystemSignalRef=DET_RANGE_019
            DET_AZIMUTH_020_oRDR_DETECTION_017_020_oPCAN_RADAR_e2cd967f_Tx: ComBitPosition=424, ComBitSize=13, ComSignalInitValue=0, ComSignalType=UINT16, ComHandleId=396, ComSystemTemplateSystemSignalRef=DET_AZIMUTH_020
            DET_RANGE_020_oRDR_DETECTION_017_020_oPCAN_RADAR_f256e5c4_Tx: ComBitPosition=360, ComBitSize=15, ComSignalInitValue=0, ComSignalType=UINT16, ComHandleId=451, ComSystemTemplateSystemSignalRef=DET_RANGE_020
            DET_EXISTENCE_PROB_019_oRDR_DETECTION_017_020_oPCAN_RADAR_d969febd_Tx: ComBitPosition=336, ComBitSize=6, ComSignalInitValue=0, ComSignalType=UINT8, ComHandleId=427, ComSystemTemplateSystemSignalRef=DET_EXISTENCE_PROB_019
            DET_RANGE_VELOCITY_018_oRDR_DETECTION_017_020_oPCAN_RADAR_ad31a9af_Tx: ComBitPosition=160, ComBitSize=15, ComSignalInitValue=16384, ComSignalType=UINT16, ComHandleId=457, ComSystemTemplateSystemSignalRef=DET_RANGE_VELOCITY_018
            DET_RANGE_VELOCITY_019_oRDR_DETECTION_017_020_oPCAN_RADAR_38417d3a_Tx: ComBitPosition=272, ComBitSize=15, ComSignalInitValue=16384, ComSignalType=UINT16, ComHandleId=458, ComSystemTemplateSystemSignalRef=DET_RANGE_VELOCITY_019
            DET_BI_STATIC_FLAG_017_oRDR_DETECTION_017_020_oPCAN_RADAR_b230caf3_Tx: ComBitPosition=104, ComBitSize=1, ComSignalInitValue=0, ComSignalType=BOOLEAN, ComHandleId=405, ComSystemTemplateSystemSignalRef=DET_BI_STATIC_FLAG_017
            DET_RANGE_VELOCITY_ERR_017_oRDR_DETECTION_017_020_oPCAN_RADAR_8e9ac05a_Tx: ComBitPosition=64, ComBitSize=8, ComSignalInitValue=0, ComSignalType=UINT8, ComHandleId=460, ComSystemTemplateSystemSignalRef=DET_RANGE_VELOCITY_ERR_017
            DET_CONFD_ELEVATION_020_oRDR_DETECTION_017_020_oPCAN_RADAR_e2be9d4f_Tx: ComBitPosition=437, ComBitSize=2, ComSignalInitValue=0, ComSignalType=UINT8, ComHandleId=416, ComSystemTemplateSystemSignalRef=DET_CONFD_ELEVATION_020
            DET_HVC_FLAG_018_oRDR_DETECTION_017_020_oPCAN_RADAR_ad6d6957_Tx: ComBitPosition=198, ComBitSize=1, ComSignalInitValue=0, ComSignalType=BOOLEAN, ComHandleId=430, ComSystemTemplateSystemSignalRef=DET_HVC_FLAG_018
            DET_AZIMUTH_019_oRDR_DETECTION_017_020_oPCAN_RADAR_5d7ccca4_Tx: ComBitPosition=312, ComBitSize=13, ComSignalInitValue=0, ComSignalType=UINT16, ComHandleId=395, ComSystemTemplateSystemSignalRef=DET_AZIMUTH_019
            DET_ELEVATION_ERR_017_oRDR_DETECTION_017_020_oPCAN_RADAR_b296cd0f_Tx: ComBitPosition=80, ComBitSize=6, ComSignalInitValue=0, ComSignalType=UINT8, ComHandleId=421, ComSystemTemplateSystemSignalRef=DET_ELEVATION_ERR_017
            DET_RANGE_ERR_017_oRDR_DETECTION_017_020_oPCAN_RADAR_536f43a4_Tx: ComBitPosition=40, ComBitSize=7, ComSignalInitValue=0, ComSignalType=UINT8, ComHandleId=452, ComSystemTemplateSystemSignalRef=DET_RANGE_ERR_017
            DET_RCS_018_oRDR_DETECTION_017_020_oPCAN_RADAR_2ab19ef5_Tx: ComBitPosition=240, ComBitSize=8, ComSignalInitValue=128, ComSignalType=UINT8, ComHandleId=465, ComSystemTemplateSystemSignalRef=DET_RCS_018
            DET_CONFD_AZIMUTH_018_oRDR_DETECTION_017_020_oPCAN_RADAR_caea12fb_Tx: ComBitPosition=230, ComBitSize=2, ComSignalInitValue=0, ComSignalType=UINT8, ComHandleId=410, ComSystemTemplateSystemSignalRef=DET_CONFD_AZIMUTH_018
            DET_ELEVATION_020_oRDR_DETECTION_017_020_oPCAN_RADAR_337e4973_Tx: ComBitPosition=408, ComBitSize=8, ComSignalInitValue=0, ComSignalType=UINT8, ComHandleId=420, ComSystemTemplateSystemSignalRef=DET_ELEVATION_020
            DET_RCS_020_oRDR_DETECTION_017_020_oPCAN_RADAR_007010bb_Tx: ComBitPosition=464, ComBitSize=8, ComSignalInitValue=128, ComSignalType=UINT8, ComHandleId=467, ComSystemTemplateSystemSignalRef=DET_RCS_020
            DET_RANGE_017_oRDR_DETECTION_017_020_oPCAN_RADAR_f487f9cd_Tx: ComBitPosition=24, ComBitSize=15, ComSignalInitValue=0, ComSignalType=UINT16, ComHandleId=448, ComSystemTemplateSystemSignalRef=DET_RANGE_017
            DET_AZIMUTH_ERR_017_oRDR_DETECTION_017_020_oPCAN_RADAR_40a91f83_Tx: ComBitPosition=105, ComBitSize=7, ComSignalInitValue=0, ComSignalType=UINT8, ComHandleId=397, ComSystemTemplateSystemSignalRef=DET_AZIMUTH_ERR_017
            DET_AZIMUTH_ERR_020_oRDR_DETECTION_017_020_oPCAN_RADAR_4678038a_Tx: ComBitPosition=441, ComBitSize=7, ComSignalInitValue=0, ComSignalType=UINT8, ComHandleId=400, ComSystemTemplateSystemSignalRef=DET_AZIMUTH_ERR_020
            DET_RCS_019_oRDR_DETECTION_017_020_oPCAN_RADAR_bfc14a60_Tx: ComBitPosition=352, ComBitSize=8, ComSignalInitValue=128, ComSignalType=UINT8, ComHandleId=466, ComSystemTemplateSystemSignalRef=DET_RCS_019
            DET_AZIMUTH_017_oRDR_DETECTION_017_020_oPCAN_RADAR_e41c8a76_Tx: ComBitPosition=88, ComBitSize=13, ComSignalInitValue=0, ComSignalType=UINT16, ComHandleId=393, ComSystemTemplateSystemSignalRef=DET_AZIMUTH_017
            DET_SNR_019_oRDR_DETECTION_017_020_oPCAN_RADAR_626f1e62_Tx: ComBitPosition=344, ComBitSize=8, ComSignalInitValue=0, ComSignalType=UINT8, ComHandleId=470, ComSystemTemplateSystemSignalRef=DET_SNR_019
            DET_HVC_FLAG_017_oRDR_DETECTION_017_020_oPCAN_RADAR_817dfb10_Tx: ComBitPosition=86, ComBitSize=1, ComSignalInitValue=0, ComSignalType=BOOLEAN, ComHandleId=429, ComSystemTemplateSystemSignalRef=DET_HVC_FLAG_017
            DET_RANGE_VELOCITY_ERR_019_oRDR_DETECTION_017_020_oPCAN_RADAR_37fa8688_Tx: ComBitPosition=288, ComBitSize=8, ComSignalInitValue=0, ComSignalType=UINT8, ComHandleId=462, ComSystemTemplateSystemSignalRef=DET_RANGE_VELOCITY_ERR_019
            DET_ELEVATION_ERR_020_oRDR_DETECTION_017_020_oPCAN_RADAR_b447d106_Tx: ComBitPosition=416, ComBitSize=6, ComSignalInitValue=0, ComSignalType=UINT8, ComHandleId=424, ComSystemTemplateSystemSignalRef=DET_ELEVATION_ERR_020
            DET_BI_STATIC_FLAG_020_oRDR_DETECTION_017_020_oPCAN_RADAR_b4e1d6fa_Tx: ComBitPosition=440, ComBitSize=1, ComSignalInitValue=0, ComSignalType=BOOLEAN, ComHandleId=408, ComSystemTemplateSystemSignalRef=DET_BI_STATIC_FLAG_020
            DET_MH_CRC16_017_020_oRDR_DETECTION_017_020_oPCAN_RADAR_6dde6925_Tx: ComBitPosition=0, ComBitSize=16, ComSignalInitValue=0, ComSignalType=UINT16, ComHandleId=437, ComSystemTemplateSystemSignalRef=DET_MH_CRC16_017_020
            DET_RCS_017_oRDR_DETECTION_017_020_oPCAN_RADAR_06a10cb2_Tx: ComBitPosition=128, ComBitSize=8, ComSignalInitValue=128, ComSignalType=UINT8, ComHandleId=464, ComSystemTemplateSystemSignalRef=DET_RCS_017
            DET_SNR_018_oRDR_DETECTION_017_020_oPCAN_RADAR_f71fcaf7_Tx: ComBitPosition=232, ComBitSize=8, ComSignalInitValue=0, ComSignalType=UINT8, ComHandleId=469, ComSystemTemplateSystemSignalRef=DET_SNR_018
            DET_MH_SCAN_INDEX_4LSB_017_020_oRDR_DETECTION_017_020_oPCAN_RADAR_2581ed9e_Tx: ComBitPosition=476, ComBitSize=4, ComSignalInitValue=0, ComSignalType=UINT8, ComHandleId=439, ComSystemTemplateSystemSignalRef=DET_MH_SCAN_INDEX_4LSB_017_020
            DET_RANGE_VELOCITY_ERR_018_oRDR_DETECTION_017_020_oPCAN_RADAR_a28a521d_Tx: ComBitPosition=176, ComBitSize=8, ComSignalInitValue=0, ComSignalType=UINT8, ComHandleId=461, ComSystemTemplateSystemSignalRef=DET_RANGE_VELOCITY_ERR_018
            DET_RANGE_VELOCITY_017_oRDR_DETECTION_017_020_oPCAN_RADAR_81213be8_Tx: ComBitPosition=48, ComBitSize=15, ComSignalInitValue=16384, ComSignalType=UINT16, ComHandleId=456, ComSystemTemplateSystemSignalRef=DET_RANGE_VELOCITY_017
            DET_ELEVATION_017_oRDR_DETECTION_017_020_oPCAN_RADAR_35af557a_Tx: ComBitPosition=72, ComBitSize=8, ComSignalInitValue=0, ComSignalType=UINT8, ComHandleId=417, ComSystemTemplateSystemSignalRef=DET_ELEVATION_017
            DET_RANGE_VELOCITY_ERR_020_oRDR_DETECTION_017_020_oPCAN_RADAR_884bdc53_Tx: ComBitPosition=400, ComBitSize=8, ComSignalInitValue=0, ComSignalType=UINT8, ComHandleId=463, ComSystemTemplateSystemSignalRef=DET_RANGE_VELOCITY_ERR_020
            DET_CONFD_ELEVATION_019_oRDR_DETECTION_017_020_oPCAN_RADAR_5d0fc794_Tx: ComBitPosition=325, ComBitSize=2, ComSignalInitValue=0, ComSignalType=UINT8, ComHandleId=415, ComSystemTemplateSystemSignalRef=DET_CONFD_ELEVATION_019
            DET_SNR_017_oRDR_DETECTION_017_020_oPCAN_RADAR_db0f58b0_Tx: ComBitPosition=120, ComBitSize=8, ComSignalInitValue=0, ComSignalType=UINT8, ComHandleId=468, ComSystemTemplateSystemSignalRef=DET_SNR_017
            DET_SNR_020_oRDR_DETECTION_017_020_oPCAN_RADAR_ddde44b9_Tx: ComBitPosition=456, ComBitSize=8, ComSignalInitValue=0, ComSignalType=UINT8, ComHandleId=471, ComSystemTemplateSystemSignalRef=DET_SNR_020
            DET_AZIMUTH_018_oRDR_DETECTION_017_020_oPCAN_RADAR_c80c1831_Tx: ComBitPosition=200, ComBitSize=13, ComSignalInitValue=0, ComSignalType=UINT16, ComHandleId=394, ComSystemTemplateSystemSignalRef=DET_AZIMUTH_018
            DET_AZIMUTH_ERR_018_oRDR_DETECTION_017_020_oPCAN_RADAR_6cb98dc4_Tx: ComBitPosition=217, ComBitSize=7, ComSignalInitValue=0, ComSignalType=UINT8, ComHandleId=398, ComSystemTemplateSystemSignalRef=DET_AZIMUTH_ERR_018
            DET_AZIMUTH_ERR_019_oRDR_DETECTION_017_020_oPCAN_RADAR_f9c95951_Tx: ComBitPosition=329, ComBitSize=7, ComSignalInitValue=0, ComSignalType=UINT8, ComHandleId=399, ComSystemTemplateSystemSignalRef=DET_AZIMUTH_ERR_019
            DET_EXISTENCE_PROB_020_oRDR_DETECTION_017_020_oPCAN_RADAR_66d8a466_Tx: ComBitPosition=448, ComBitSize=6, ComSignalInitValue=0, ComSignalType=UINT8, ComHandleId=428, ComSystemTemplateSystemSignalRef=DET_EXISTENCE_PROB_020
            DET_BELOW_RAIN_THOLD_018_oRDR_DETECTION_017_020_oPCAN_RADAR_1d0d8bf1_Tx: ComBitPosition=151, ComBitSize=1, ComSignalInitValue=0, ComSignalType=UINT8, ComHandleId=402, ComSystemTemplateSystemSignalRef=DET_BELOW_RAIN_THOLD_018
            DET_IDM_018_oRDR_DETECTION_017_020_oPCAN_RADAR_263f52ea_Tx: ComBitPosition=175, ComBitSize=1, ComSignalInitValue=0, ComSignalType=UINT8, ComHandleId=434, ComSystemTemplateSystemSignalRef=DET_IDM_018
            DET_MTD_017_oRDR_DETECTION_017_020_oPCAN_RADAR_6c9cf276_Tx: ComBitPosition=47, ComBitSize=1, ComSignalInitValue=0, ComSignalType=UINT8, ComHandleId=440, ComSystemTemplateSystemSignalRef=DET_MTD_017
            DET_IDM_019_oRDR_DETECTION_017_020_oPCAN_RADAR_b34f867f_Tx: ComBitPosition=287, ComBitSize=1, ComSignalInitValue=0, ComSignalType=UINT8, ComHandleId=435, ComSystemTemplateSystemSignalRef=DET_IDM_019
            DET_MTD_019_oRDR_DETECTION_017_020_oPCAN_RADAR_d5fcb4a4_Tx: ComBitPosition=271, ComBitSize=1, ComSignalInitValue=0, ComSignalType=UINT8, ComHandleId=442, ComSystemTemplateSystemSignalRef=DET_MTD_019
            DET_PROB_1STAZHYPO_018_oRDR_DETECTION_017_020_oPCAN_RADAR_d33888fc_Tx: ComBitPosition=215, ComBitSize=1, ComSignalInitValue=0, ComSignalType=BOOLEAN, ComHandleId=445, ComSystemTemplateSystemSignalRef=DET_PROB_1STAZHYPO_018
            DET_BELOW_RAIN_THOLD_020_oRDR_DETECTION_017_020_oPCAN_RADAR_37cc05bf_Tx: ComBitPosition=375, ComBitSize=1, ComSignalInitValue=0, ComSignalType=UINT8, ComHandleId=404, ComSystemTemplateSystemSignalRef=DET_BELOW_RAIN_THOLD_020
            DET_PROB_1STAZHYPO_017_oRDR_DETECTION_017_020_oPCAN_RADAR_ff281abb_Tx: ComBitPosition=103, ComBitSize=1, ComSignalInitValue=0, ComSignalType=BOOLEAN, ComHandleId=444, ComSystemTemplateSystemSignalRef=DET_PROB_1STAZHYPO_017
            DET_MTD_018_oRDR_DETECTION_017_020_oPCAN_RADAR_408c6031_Tx: ComBitPosition=159, ComBitSize=1, ComSignalInitValue=0, ComSignalType=UINT8, ComHandleId=441, ComSystemTemplateSystemSignalRef=DET_MTD_018
            DET_IDM_020_oRDR_DETECTION_017_020_oPCAN_RADAR_0cfedca4_Tx: ComBitPosition=399, ComBitSize=1, ComSignalInitValue=0, ComSignalType=UINT8, ComHandleId=436, ComSystemTemplateSystemSignalRef=DET_IDM_020
            DET_BELOW_RAIN_THOLD_019_oRDR_DETECTION_017_020_oPCAN_RADAR_887d5f64_Tx: ComBitPosition=263, ComBitSize=1, ComSignalInitValue=0, ComSignalType=UINT8, ComHandleId=403, ComSystemTemplateSystemSignalRef=DET_BELOW_RAIN_THOLD_019
            DET_IDM_017_oRDR_DETECTION_017_020_oPCAN_RADAR_0a2fc0ad_Tx: ComBitPosition=63, ComBitSize=1, ComSignalInitValue=0, ComSignalType=UINT8, ComHandleId=433, ComSystemTemplateSystemSignalRef=DET_IDM_017
            DET_PROB_1STAZHYPO_019_oRDR_DETECTION_017_020_oPCAN_RADAR_46485c69_Tx: ComBitPosition=327, ComBitSize=1, ComSignalInitValue=0, ComSignalType=BOOLEAN, ComHandleId=446, ComSystemTemplateSystemSignalRef=DET_PROB_1STAZHYPO_019
            DET_BELOW_RAIN_THOLD_017_oRDR_DETECTION_017_020_oPCAN_RADAR_311d19b6_Tx: ComBitPosition=39, ComBitSize=1, ComSignalInitValue=0, ComSignalType=UINT8, ComHandleId=401, ComSystemTemplateSystemSignalRef=DET_BELOW_RAIN_THOLD_017
            DET_PROB_1STAZHYPO_020_oRDR_DETECTION_017_020_oPCAN_RADAR_f9f906b2_Tx: ComBitPosition=439, ComBitSize=1, ComSignalInitValue=0, ComSignalType=BOOLEAN, ComHandleId=447, ComSystemTemplateSystemSignalRef=DET_PROB_1STAZHYPO_020
            DET_MTD_020_oRDR_DETECTION_017_020_oPCAN_RADAR_6a4dee7f_Tx: ComBitPosition=383, ComBitSize=1, ComSignalInitValue=0, ComSignalType=UINT8, ComHandleId=443, ComSystemTemplateSystemSignalRef=DET_MTD_020
