[part 11 of 20: package /ActiveEcuC]
AUTOSAR XML (schema 00053)
package /ActiveEcuC  (continued)
  module config Com: implementation-config-variant=VARIANT-PRE-COMPILE, module-description=Com_Impl  (continued)
    ComConfig: ComConfigurationId=0, ComRxImmediateNotificationCacheSize=0, ComRxDeferredNotificationCacheSize=1  (continued)
      109 x ComSignalGroup, all with ComSignalGroupAccess=ACCESS_NEEDED_BY_SWC_OR_COM, ComSignalGroupArrayAccess=true:  (continued)
        SG_Detections_169_172_oRDR_DETECTION_169_172_oPCAN_RADAR_2ac747c6_Tx: ComTransferProperty=TRIGGERED, ComHandleId=44, ComSystemTemplateSignalGroupRef=SG_Detections_169_172
          83 x ComGroupSignal, all with ComSignalEndianness=LITTLE_ENDIAN, ComTransferProperty=PENDING, ComSignalAccess=ACCESS_NEEDED_BY_SWC_OR_COM:
            DET_CONFD_AZIMUTH_169_oRDR_DETECTION_169_172_oPCAN_RADAR_cccc2037_Tx: ComBitPosition=118, ComBitSize=2, ComSignalInitValue=0, ComSignalType=UINT8, ComHandleId=3563, ComSystemTemplateSystemSignalRef=DET_CONFD_AZIMUTH_169
            DET_CONFD_ELEVATION_169_oRDR_DETECTION_169_172_oPCAN_RADAR_ce5921cd_Tx: ComBitPosition=101, ComBitSize=2, ComSignalInitValue=0, ComSignalType=UINT8, ComHandleId=3567, ComSystemTemplateSystemSignalRef=DET_CONFD_ELEVATION_169
            DET_ELEVATION_ERR_169_oRDR_DETECTION_169_172_oPCAN_RADAR_98a06d84_Tx: ComBitPosition=80, ComBitSize=6, ComSignalInitValue=0, ComSignalType=UINT8, ComHandleId=3575, ComSystemTemplateSystemSignalRef=DET_ELEVATION_ERR_169
            DET_RANGE_172_oRDR_DETECTION_169_172_oPCAN_RADAR_4a018489_Tx: ComBitPosition=360, ComBitSize=15, ComSignalInitValue=0, ComSignalType=UINT16, ComHandleId=3605, ComSystemTemplateSystemSignalRef=DET_RANGE_172
            DET_CONFD_AZIMUTH_170_oRDR_DETECTION_169_172_oPCAN_RADAR_a9ec5293_Tx: ComBitPosition=230, ComBitSize=2, ComSignalInitValue=0, ComSignalType=UINT8, ComHandleId=3564, ComSystemTemplateSystemSignalRef=DET_CONFD_AZIMUTH_170
            DET_RANGE_170_oRDR_DETECTION_169_172_oPCAN_RADAR_bb912be2_Tx: ComBitPosition=136, ComBitSize=15, ComSignalInitValue=0, ComSignalType=UINT16, ComHandleId=3603, ComSystemTemplateSystemSignalRef=DET_RANGE_170
            DET_RCS_170_oRDR_DETECTION_169_172_oPCAN_RADAR_49b7de9d_Tx: ComBitPosition=240, ComBitSize=8, ComSignalInitValue=128, ComSignalType=UINT8, ComHandleId=3619, ComSystemTemplateSystemSignalRef=DET_RCS_170
            DET_BI_STATIC_FLAG_171_oRDR_DETECTION_169_172_oPCAN_RADAR_6856cc49_Tx: ComBitPosition=328, ComBitSize=1, ComSignalInitValue=0, ComSignalType=BOOLEAN, ComHandleId=3561, ComSystemTemplateSystemSignalRef=DET_BI_STATIC_FLAG_171
            DET_ELEVATION_171_oRDR_DETECTION_169_172_oPCAN_RADAR_efc953c0_Tx: ComBitPosition=296, ComBitSize=8, ComSignalInitValue=0, ComSignalType=UINT8, ComHandleId=3573, ComSystemTemplateSystemSignalRef=DET_ELEVATION_171
            DET_RANGE_VELOCITY_172_oRDR_DETECTION_169_172_oPCAN_RADAR_3fa746ac_Tx: ComBitPosition=384, ComBitSize=15, ComSignalInitValue=16384, ComSignalType=UINT16, ComHandleId=3613, ComSystemTemplateSystemSignalRef=DET_RANGE_VELOCITY_172
            DET_AZIMUTH_ERR_169_oRDR_DETECTION_169_172_oPCAN_RADAR_6a9fbf08_Tx: ComBitPosition=105, ComBitSize=7, ComSignalInitValue=0, ComSignalType=UINT8, ComHandleId=3551, ComSystemTemplateSystemSignalRef=DET_AZIMUTH_ERR_169
            DET_RANGE_VELOCITY_ERR_170_oRDR_DETECTION_169_172_oPCAN_RADAR_c18c1275_Tx: ComBitPosition=176, ComBitSize=8, ComSignalInitValue=0, ComSignalType=UINT8, ComHandleId=3615, ComSystemTemplateSystemSignalRef=DET_RANGE_VELOCITY_ERR_170
            DET_ELEVATION_172_oRDR_DETECTION_169_172_oPCAN_RADAR_8b29283e_Tx: ComBitPosition=408, ComBitSize=8, ComSignalInitValue=0, ComSignalType=UINT8, ComHandleId=3574, ComSystemTemplateSystemSignalRef=DET_ELEVATION_172
            DET_SNR_169_oRDR_DETECTION_169_172_oPCAN_RADAR_f139f83b_Tx: ComBitPosition=120, ComBitSize=8, ComSignalInitValue=0, ComSignalType=UINT8, ComHandleId=3622, ComSystemTemplateSystemSignalRef=DET_SNR_169
            DET_RANGE_171_oRDR_DETECTION_169_172_oPCAN_RADAR_2ee1ff77_Tx: ComBitPosition=248, ComBitSize=15, ComSignalInitValue=0, ComSignalType=UINT16, ComHandleId=3604, ComSystemTemplateSystemSignalRef=DET_RANGE_171
            DET_RANGE_VELOCITY_169_oRDR_DETECTION_169_172_oPCAN_RADAR_ab179b63_Tx: ComBitPosition=48, ComBitSize=15, ComSignalInitValue=16384, ComSignalType=UINT16, ComHandleId=3610, ComSystemTemplateSystemSignalRef=DET_RANGE_VELOCITY_169
            DET_SNR_172_oRDR_DETECTION_169_172_oPCAN_RADAR_658925f4_Tx: ComBitPosition=456, ComBitSize=8, ComSignalInitValue=0, ComSignalType=UINT8, ComHandleId=3625, ComSystemTemplateSystemSignalRef=DET_SNR_172
            DET_HVC_FLAG_170_oRDR_DETECTION_169_172_oPCAN_RADAR_ce6b293f_Tx: ComBitPosition=198, ComBitSize=1, ComSignalInitValue=0, ComSignalType=BOOLEAN, ComHandleId=3584, ComSystemTemplateSystemSignalRef=DET_HVC_FLAG_170
            DET_MH_CRC16_169_172_oRDR_DETECTION_169_172_oPCAN_RADAR_ae4f95cd_Tx: ComBitPosition=0, ComBitSize=16, ComSignalInitValue=0, ComSignalType=UINT16, ComHandleId=3591, ComSystemTemplateSystemSignalRef=DET_MH_CRC16_169_172
            DET_ELEVATION_169_oRDR_DETECTION_169_172_oPCAN_RADAR_1f99f5f1_Tx: ComBitPosition=72, ComBitSize=8, ComSignalInitValue=0, ComSignalType=UINT8, ComHandleId=3571, ComSystemTemplateSystemSignalRef=DET_ELEVATION_169
            DET_AZIMUTH_171_oRDR_DETECTION_169_172_oPCAN_RADAR_3e7a8ccc_Tx: ComBitPosition=312, ComBitSize=13, ComSignalInitValue=0, ComSignalType=UINT16, ComHandleId=3549, ComSystemTemplateSystemSignalRef=DET_AZIMUTH_171
            DET_AZIMUTH_ERR_172_oRDR_DETECTION_169_172_oPCAN_RADAR_fe2f62c7_Tx: ComBitPosition=441, ComBitSize=7, ComSignalInitValue=0, ComSignalType=UINT8, ComHandleId=3554, ComSystemTemplateSystemSignalRef=DET_AZIMUTH_ERR_172
            DET_EXISTENCE_PROB_172_oRDR_DETECTION_169_172_oPCAN_RADAR_de8fc52b_Tx: ComBitPosition=448, ComBitSize=6, ComSignalInitValue=0, ComSignalType=UINT8, ComHandleId=3582, ComSystemTemplateSystemSignalRef=DET_EXISTENCE_PROB_172
            DET_CONFD_ELEVATION_171_oRDR_DETECTION_169_172_oPCAN_RADAR_3e0987fc_Tx: ComBitPosition=325, ComBitSize=2, ComSignalInitValue=0, ComSignalType=UINT8, ComHandleId=3569, ComSystemTemplateSystemSignalRef=DET_CONFD_ELEVATION_171
            DET_ELEVATION_ERR_171_oRDR_DETECTION_169_172_oPCAN_RADAR_68f0cbb5_Tx: ComBitPosition=304, ComBitSize=6, ComSignalInitValue=0, ComSignalType=UINT8, ComHandleId=3577, ComSystemTemplateSystemSignalRef=DET_ELEVATION_ERR_171
            DET_RANGE_VELOCITY_ERR_171_oRDR_DETECTION_169_172_oPCAN_RADAR_54fcc6e0_Tx: ComBitPosition=288, ComBitSize=8, ComSignalInitValue=0, ComSignalType=UINT8, ComHandleId=3616, ComSystemTemplateSystemSignalRef=DET_RANGE_VELOCITY_ERR_171
            DET_RANGE_VELOCITY_ERR_172_oRDR_DETECTION_169_172_oPCAN_RADAR_301cbd1e_Tx: ComBitPosition=400, ComBitSize=8, ComSignalInitValue=0, ComSignalType=UINT8, ComHandleId=3617, ComSystemTemplateSystemSignalRef=DET_RANGE_VELOCITY_ERR_172
            DET_MH_SCAN_INDEX_4LSB_169_172_oRDR_DETECTION_169_172_oPCAN_RADAR_e6101176_Tx: ComBitPosition=476, ComBitSize=4, ComSignalInitValue=0, ComSignalType=UINT8, ComHandleId=3593, ComSystemTemplateSystemSignalRef=DET_MH_SCAN_INDEX_4LSB_169_172
            DET_RCS_171_oRDR_DETECTION_169_172_oPCAN_RADAR_dcc70a08_Tx: ComBitPosition=352, ComBitSize=8, ComSignalInitValue=128, ComSignalType=UINT8, ComHandleId=3620, ComSystemTemplateSystemSignalRef=DET_RCS_171
            DET_CONFD_ELEVATION_170_oRDR_DETECTION_169_172_oPCAN_RADAR_ab795369_Tx: ComBitPosition=213, ComBitSize=2, ComSignalInitValue=0, ComSignalType=UINT8, ComHandleId=3568, ComSystemTemplateSystemSignalRef=DET_CONFD_ELEVATION_170
            DET_ELEVATION_ERR_172_oRDR_DETECTION_169_172_oPCAN_RADAR_0c10b04b_Tx: ComBitPosition=416, ComBitSize=6, ComSignalInitValue=0, ComSignalType=UINT8, ComHandleId=3578, ComSystemTemplateSystemSignalRef=DET_ELEVATION_ERR_172
            DET_RANGE_VELOCITY_171_oRDR_DETECTION_169_172_oPCAN_RADAR_5b473d52_Tx: ComBitPosition=272, ComBitSize=15, ComSignalInitValue=16384, ComSignalType=UINT16, ComHandleId=3612, ComSystemTemplateSystemSignalRef=DET_RANGE_VELOCITY_171
            DET_AZIMUTH_169_oRDR_DETECTION_169_172_oPCAN_RADAR_ce2a2afd_Tx: ComBitPosition=88, ComBitSize=13, ComSignalInitValue=0, ComSignalType=UINT16, ComHandleId=3547, ComSystemTemplateSystemSignalRef=DET_AZIMUTH_169
            DET_RANGE_ERR_169_oRDR_DETECTION_169_172_oPCAN_RADAR_7959e32f_Tx: ComBitPosition=40, ComBitSize=7, ComSignalInitValue=0, ComSignalType=UINT8, ComHandleId=3606, ComSystemTemplateSystemSignalRef=DET_RANGE_ERR_169
            DET_EXISTENCE_PROB_170_oRDR_DETECTION_169_172_oPCAN_RADAR_2f1f6a40_Tx: ComBitPosition=224, ComBitSize=6, ComSignalInitValue=0, ComSignalType=UINT8, ComHandleId=3580, ComSystemTemplateSystemSignalRef=DET_EXISTENCE_PROB_170
            DET_RANGE_VELOCITY_170_oRDR_DETECTION_169_172_oPCAN_RADAR_ce37e9c7_Tx: ComBitPosition=160, ComBitSize=15, ComSignalInitValue=16384, ComSignalType=UINT16, ComHandleId=3611, ComSystemTemplateSystemSignalRef=DET_RANGE_VELOCITY_170
            DET_SUPER_RES_TARGET_171_oRDR_DETECTION_169_172_oPCAN_RADAR_30f0766f_Tx: ComBitPosition=311, ComBitSize=1, ComSignalInitValue=0, ComSignalType=BOOLEAN, ComHandleId=3628, ComSystemTemplateSystemSignalRef=DET_SUPER_RES_TARGET_171
            DET_SUPER_RES_TARGET_172_oRDR_DETECTION_169_172_oPCAN_RADAR_54100d91_Tx: ComBitPosition=423, ComBitSize=1, ComSignalInitValue=0, ComSignalType=BOOLEAN, ComHandleId=3629, ComSystemTemplateSystemSignalRef=DET_SUPER_RES_TARGET_172
            DET_AZIMUTH_ERR_170_oRDR_DETECTION_169_172_oPCAN_RADAR_0fbfcdac_Tx: ComBitPosition=217, ComBitSize=7, ComSignalInitValue=0, ComSignalType=UINT8, ComHandleId=3552, ComSystemTemplateSystemSignalRef=DET_AZIMUTH_ERR_170
            DET_AZIMUTH_172_oRDR_DETECTION_169_172_oPCAN_RADAR_5a9af732_Tx: ComBitPosition=424, ComBitSize=13, ComSignalInitValue=0, ComSignalType=UINT16, ComHandleId=3550, ComSystemTemplateSystemSignalRef=DET_AZIMUTH_172
            DET_CONFD_AZIMUTH_172_oRDR_DETECTION_169_172_oPCAN_RADAR_587cfdf8_Tx: ComBitPosition=454, ComBitSize=2, ComSignalInitValue=0, ComSignalType=UINT8, ComHandleId=3566, ComSystemTemplateSystemSignalRef=DET_CONFD_AZIMUTH_172
            DET_ELEVATION_170_oRDR_DETECTION_169_172_oPCAN_RADAR_7ab98755_Tx: ComBitPosition=184, ComBitSize=8, ComSignalInitValue=0, ComSignalType=UINT8, ComHandleId=3572, ComSystemTemplateSystemSignalRef=DET_ELEVATION_170
            DET_EXISTENCE_PROB_169_oRDR_DETECTION_169_172_oPCAN_RADAR_4a3f18e4_Tx: ComBitPosition=112, ComBitSize=6, ComSignalInitValue=0, ComSignalType=UINT8, ComHandleId=3579, ComSystemTemplateSystemSignalRef=DET_EXISTENCE_PROB_169
            DET_BI_STATIC_FLAG_170_oRDR_DETECTION_169_172_oPCAN_RADAR_fd2618dc_Tx: ComBitPosition=216, ComBitSize=1, ComSignalInitValue=0, ComSignalType=BOOLEAN, ComHandleId=3560, ComSystemTemplateSystemSignalRef=DET_BI_STATIC_FLAG_170
            DET_HVC_FLAG_171_oRDR_DETECTION_169_172_oPCAN_RADAR_5b1bfdaa_Tx: ComBitPosition=310, ComBitSize=1, ComSignalInitValue=0, ComSignalType=BOOLEAN, ComHandleId=3585, ComSystemTemplateSystemSignalRef=DET_HVC_FLAG_171
            DET_BI_STATIC_FLAG_172_oRDR_DETECTION_169_172_oPCAN_RADAR_0cb6b7b7_Tx: ComBitPosition=440, ComBitSize=1, ComSignalInitValue=0, ComSignalType=BOOLEAN, ComHandleId=3562, ComSystemTemplateSystemSignalRef=DET_BI_STATIC_FLAG_172
            DET_HVC_FLAG_172_oRDR_DETECTION_169_172_oPCAN_RADAR_3ffb8654_Tx: ComBitPosition=422, ComBitSize=1, ComSignalInitValue=0, ComSignalType=BOOLEAN, ComHandleId=3586, ComSystemTemplateSystemSignalRef=DET_HVC_FLAG_172
            DET_RCS_172_oRDR_DETECTION_169_172_oPCAN_RADAR_b82771f6_Tx: ComBitPosition=464, ComBitSize=8, ComSignalInitValue=128, ComSignalType=UINT8, ComHandleId=3621, ComSystemTemplateSystemSignalRef=DET_RCS_172
            DET_SUPER_RES_TARGET_169_oRDR_DETECTION_169_172_oPCAN_RADAR_c0a0d05e_Tx: ComBitPosition=87, ComBitSize=1, ComSignalInitValue=0, ComSignalType=BOOLEAN, ComHandleId=3626, ComSystemTemplateSystemSignalRef=DET_SUPER_RES_TARGET_169
            DET_HVC_FLAG_169_oRDR_DETECTION_169_172_oPCAN_RADAR_ab4b5b9b_Tx: ComBitPosition=86, ComBitSize=1, ComSignalInitValue=0, ComSignalType=BOOLEAN, ComHandleId=3583, ComSystemTemplateSystemSignalRef=DET_HVC_FLAG_169
            DET_SNR_171_oRDR_DETECTION_169_172_oPCAN_RADAR_01695e0a_Tx: ComBitPosition=344, ComBitSize=8, ComSignalInitValue=0, ComSignalType=UINT8, ComHandleId=3624, ComSystemTemplateSystemSignalRef=DET_SNR_171
            DET_EXISTENCE_PROB_171_oRDR_DETECTION_169_172_oPCAN_RADAR_ba6fbed5_Tx: ComBitPosition=336, ComBitSize=6, ComSignalInitValue=0, ComSignalType=UINT8, ComHandleId=3581, ComSystemTemplateSystemSignalRef=DET_EXISTENCE_PROB_171
            DET_MH_CYCLE_COUNTER_169_172_oRDR_DETECTION_169_172_oPCAN_RADAR_2a3a34fa_Tx: ComBitPosition=16, ComBitSize=8, ComSignalInitValue=0, ComSignalType=UINT8, ComHandleId=3592, ComSystemTemplateSystemSignalRef=DET_MH_CYCLE_COUNTER_169_172
            DET_RANGE_169_oRDR_DETECTION_169_172_oPCAN_RADAR_deb15946_Tx: ComBitPosition=24, ComBitSize=15, ComSignalInitValue=0, ComSignalType=UINT16, ComHandleId=3602, ComSystemTemplateSystemSignalRef=DET_RANGE_169
            DET_AZIMUTH_170_oRDR_DETECTION_169_172_oPCAN_RADAR_ab0a5859_Tx: ComBitPosition=200, ComBitSize=13, ComSignalInitValue=0, ComSignalType=UINT16, ComHandleId=3548, ComSystemTemplateSystemSignalRef=DET_AZIMUTH_170
            DET_ELEVATION_ERR_170_oRDR_DETECTION_169_172_oPCAN_RADAR_fd801f20_Tx: ComBitPosition=192, ComBitSize=6, ComSignalInitValue=0, ComSignalType=UINT8, ComHandleId=3576, ComSystemTemplateSystemSignalRef=DET_ELEVATION_ERR_170
            DET_RANGE_VELOCITY_ERR_169_oRDR_DETECTION_169_172_oPCAN_RADAR_a4ac60d1_Tx: ComBitPosition=64, ComBitSize=8, ComSignalInitValue=0, ComSignalType=UINT8, ComHandleId=3614, ComSystemTemplateSystemSignalRef=DET_RANGE_VELOCITY_ERR_169
            DET_RANGE_ERR_171_oRDR_DETECTION_169_172_oPCAN_RADAR_8909451e_Tx: ComBitPosition=264, ComBitSize=7, ComSignalInitValue=0, ComSignalType=UINT8, ComHandleId=3608, ComSystemTemplateSystemSignalRef=DET_RANGE_ERR_171
            DET_RCS_169_oRDR_DETECTION_169_172_oPCAN_RADAR_2c97ac39_Tx: ComBitPosition=128, ComBitSize=8, ComSignalInitValue=128, ComSignalType=UINT8, ComHandleId=3618, ComSystemTemplateSystemSignalRef=DET_RCS_169
            DET_CONFD_ELEVATION_172_oRDR_DETECTION_169_172_oPCAN_RADAR_5ae9fc02_Tx: ComBitPosition=437, ComBitSize=2, ComSignalInitValue=0, ComSignalType=UINT8, ComHandleId=3570, ComSystemTemplateSystemSignalRef=DET_CONFD_ELEVATION_172
            DET_BI_STATIC_FLAG_169_oRDR_DETECTION_169_172_oPCAN_RADAR_98066a78_Tx: ComBitPosition=104, ComBitSize=1, ComSignalInitValue=0, ComSignalType=BOOLEAN, ComHandleId=3559, ComSystemTemplateSystemSignalRef=DET_BI_STATIC_FLAG_169
            DET_RANGE_ERR_172_oRDR_DETECTION_169_172_oPCAN_RADAR_ede93ee0_Tx: ComBitPosition=376, ComBitSize=7, ComSignalInitValue=0, ComSignalType=UINT8, ComHandleId=3609, ComSystemTemplateSystemSignalRef=DET_RANGE_ERR_172
            DET_AZIMUTH_ERR_171_oRDR_DETECTION_169_172_oPCAN_RADAR_9acf1939_Tx: ComBitPosition=329, ComBitSize=7, ComSignalInitValue=0, ComSignalType=UINT8, ComHandleId=3553, ComSystemTemplateSystemSignalRef=DET_AZIMUTH_ERR_171
            DET_CONFD_AZIMUTH_171_oRDR_DETECTION_169_172_oPCAN_RADAR_3c9c8606_Tx: ComBitPosition=342, ComBitSize=2, ComSignalInitValue=0, ComSignalType=UINT8, ComHandleId=3565, ComSystemTemplateSystemSignalRef=DET_CONFD_AZIMUTH_171
            DET_SNR_170_oRDR_DETECTION_169_172_oPCAN_RADAR_94198a9f_Tx: ComBitPosition=232, ComBitSize=8, ComSignalInitValue=0, ComSignalType=UINT8, ComHandleId=3623, ComSystemTemplateSystemSignalRef=DET_SNR_170
            DET_SUPER_RES_TARGET_170_oRDR_DETECTION_169_172_oPCAN_RADAR_a580a2fa_Tx: ComBitPosition=199, ComBitSize=1, ComSignalInitValue=0, ComSignalType=BOOLEAN, ComHandleId=3627, ComSystemTemplateSystemSignalRef=DET_SUPER_RES_TARGET_170
            DET_RANGE_ERR_170_oRDR_DETECTION_169_172_oPCAN_RADAR_1c79918b_Tx: ComBitPosition=152, ComBitSize=7, ComSignalInitValue=0, ComSignalType=UINT8, ComHandleId=3607, ComSystemTemplateSystemSignalRef=DET_RANGE_ERR_170
            DET_MTD_172_oRDR_DETECTION_169_172_oPCAN_RADAR_d21a8f32_Tx: ComBitPosition=383, ComBitSize=1, ComSignalInitValue=0, ComSignalType=UINT8, ComHandleId=3597, ComSystemTemplateSystemSignalRef=DET_MTD_172
            DET_IDM_172_oRDR_DETECTION_169_172_oPCAN_RADAR_b4a9bde9_Tx: ComBitPosition=399, ComBitSize=1, ComSignalInitValue=0, ComSignalType=UINT8, ComHandleId=3590, ComSystemTemplateSystemSignalRef=DET_IDM_172
            DET_PROB_1STAZHYPO_170_oRDR_DETECTION_169_172_oPCAN_RADAR_b03ec894_Tx: ComBitPosition=215, ComBitSize=1, ComSignalInitValue=0, ComSignalType=BOOLEAN, ComHandleId=3599, ComSystemTemplateSystemSignalRef=DET_PROB_1STAZHYPO_170
            DET_BELOW_RAIN_THOLD_170_oRDR_DETECTION_169_172_oPCAN_RADAR_7e0bcb99_Tx: ComBitPosition=151, ComBitSize=1, ComSignalInitValue=0, ComSignalType=UINT8, ComHandleId=3556, ComSystemTemplateSystemSignalRef=DET_BELOW_RAIN_THOLD_170
            DET_PROB_1STAZHYPO_172_oRDR_DETECTION_169_172_oPCAN_RADAR_41ae67ff_Tx: ComBitPosition=439, ComBitSize=1, ComSignalInitValue=0, ComSignalType=BOOLEAN, ComHandleId=3601, ComSystemTemplateSystemSignalRef=DET_PROB_1STAZHYPO_172
            DET_IDM_169_oRDR_DETECTION_169_172_oPCAN_RADAR_20196026_Tx: ComBitPosition=63, ComBitSize=1, ComSignalInitValue=0, ComSignalType=UINT8, ComHandleId=3587, ComSystemTemplateSystemSignalRef=DET_IDM_169
            DET_BELOW_RAIN_THOLD_169_oRDR_DETECTION_169_172_oPCAN_RADAR_1b2bb93d_Tx: ComBitPosition=39, ComBitSize=1, ComSignalInitValue=0, ComSignalType=UINT8, ComHandleId=3555, ComSystemTemplateSystemSignalRef=DET_BELOW_RAIN_THOLD_169
            DET_BELOW_RAIN_THOLD_171_oRDR_DETECTION_169_172_oPCAN_RADAR_eb7b1f0c_Tx: ComBitPosition=263, ComBitSize=1, ComSignalInitValue=0, ComSignalType=UINT8, ComHandleId=3557, ComSystemTemplateSystemSignalRef=DET_BELOW_RAIN_THOLD_171
            DET_BELOW_RAIN_THOLD_172_oRDR_DETECTION_169_172_oPCAN_RADAR_8f9b64f2_Tx: ComBitPosition=375, ComBitSize=1, ComSignalInitValue=0, ComSignalType=UINT8, ComHandleId=3558, ComSystemTemplateSystemSignalRef=DET_BELOW_RAIN_THOLD_172
            DET_MTD_169_oRDR_DETECTION_169_172_oPCAN_RADAR_46aa52fd_Tx: ComBitPosition=47, ComBitSize=1, ComSignalInitValue=0, ComSignalType=UINT8, ComHandleId=3594, ComSystemTemplateSystemSignalRef=DET_MTD_169
            DET_MTD_171_oRDR_DETECTION_169_172_oPCAN_RADAR_b6faf4cc_Tx: ComBitPosition=271, ComBitSize=1, ComSignalInitValue=0, ComSignalType=UINT8, ComHandleId=3596, ComSystemTemplateSystemSignalRef=DET_MTD_171
            DET_IDM_170_oRDR_DETECTION_169_172_oPCAN_RADAR_45391282_Tx: ComBitPosition=175, ComBitSize=1, ComSignalInitValue=0, ComSignalType=UINT8, ComHandleId=3588, ComSystemTemplateSystemSignalRef=DET_IDM_170
            DET_IDM_171_oRDR_DETECTION_169_172_oPCAN_RADAR_d049c617_Tx: ComBitPosition=287, ComBitSize=1, ComSignalInitValue=0, ComSignalType=UINT8, ComHandleId=3589, ComSystemTemplateSystemSignalRef=DET_IDM_171
            DET_PROB_1STAZHYPO_169_oRDR_DETECTION_169_172_oPCAN_RADAR_d51eba30_Tx: ComBitPosition=103, ComBitSize=1, ComSignalInitValue=0, ComSignalType=BOOLEAN, ComHandleId=3598, ComSystemTemplateSystemSignalRef=DET_PROB_1STAZHYPO_169
            DET_MTD_170_oRDR_DETECTION_169_172_oPCAN_RADAR_238a2059_Tx: ComBitPosition=159, ComBitSize=1, ComSignalInitValue=0, ComSignalType=UINT8, ComHandleId=3595, ComSystemTemplateSystemSignalRef=DET_MTD_170
            DET_PROB_1STAZHYPO_171_oRDR_DETECTION_169_172_oPCAN_RADAR_254e1c01_Tx: ComBitPosition=327, ComBitSize=1, ComSignalInitValue=0, ComSignalType=BOOLEAN, ComHandleId=3600, ComSystemTemplateSystemSignalRef=DET_PROB_1STAZHYPO_171
        SG_Detections_069_072_oRDR_DETECTION_069_072_oPCAN_RADAR_686f657a_Tx: ComTransferProperty=TRIGGERED, ComHandleId=19, ComSystemTemplateSignalGroupRef=SG_Detections_069_072
          83 x ComGroupSignal, all with ComSignalEndianness=LITTLE_ENDIAN, ComTransferProperty=PENDING, ComSignalAccess=ACCESS_NEEDED_BY_SWC_OR_COM:
            DET_EXISTENCE_PROB_070_oRDR_DETECTION_069_072_oPCAN_RADAR_cc8ecc12_Tx: ComBitPosition=224, ComBitSize=6, ComSignalInitValue=0, ComSignalType=UINT8, ComHandleId=1505, ComSystemTemplateSystemSignalRef=DET_EXISTENCE_PROB_070
            DET_SUPER_RES_TARGET_072_oRDR_DETECTION_069_072_oPCAN_RADAR_b781abc3_Tx: ComBitPosition=423, ComBitSize=1, ComSignalInitValue=0, ComSignalType=BOOLEAN, ComHandleId=1554, ComSystemTemplateSystemSignalRef=DET_SUPER_RES_TARGET_072
            DET_AZIMUTH_069_oRDR_DETECTION_069_072_oPCAN_RADAR_2dbb8caf_Tx: ComBitPosition=88, ComBitSize=13, ComSignalInitValue=0, ComSignalType=UINT16, ComHandleId=1472, ComSystemTemplateSystemSignalRef=DET_AZIMUTH_069
            DET_AZIMUTH_ERR_070_oRDR_DETECTION_069_072_oPCAN_RADAR_ec2e6bfe_Tx: ComBitPosition=217, ComBitSize=7, ComSignalInitValue=0, ComSignalType=UINT8, ComHandleId=1477, ComSystemTemplateSystemSignalRef=DET_AZIMUTH_ERR_070
            DET_CONFD_ELEVATION_071_oRDR_DETECTION_069_072_oPCAN_RADAR_dd9821ae_Tx: ComBitPosition=325, ComBitSize=2, ComSignalInitValue=0, ComSignalType=UINT8, ComHandleId=1494, ComSystemTemplateSystemSignalRef=DET_CONFD_ELEVATION_071
            DET_BI_STATIC_FLAG_071_oRDR_DETECTION_069_072_oPCAN_RADAR_8bc76a1b_Tx: ComBitPosition=328, ComBitSize=1, ComSignalInitValue=0, ComSignalType=BOOLEAN, ComHandleId=1486, ComSystemTemplateSystemSignalRef=DET_BI_STATIC_FLAG_071
            DET_HVC_FLAG_069_oRDR_DETECTION_069_072_oPCAN_RADAR_48dafdc9_Tx: ComBitPosition=86, ComBitSize=1, ComSignalInitValue=0, ComSignalType=BOOLEAN, ComHandleId=1508, ComSystemTemplateSystemSignalRef=DET_HVC_FLAG_069
            DET_RANGE_VELOCITY_ERR_072_oRDR_DETECTION_069_072_oPCAN_RADAR_d38d1b4c_Tx: ComBitPosition=400, ComBitSize=8, ComSignalInitValue=0, ComSignalType=UINT8, ComHandleId=1542, ComSystemTemplateSystemSignalRef=DET_RANGE_VELOCITY_ERR_072
            DET_RANGE_ERR_069_oRDR_DETECTION_069_072_oPCAN_RADAR_9ac8457d_Tx: ComBitPosition=40, ComBitSize=7, ComSignalInitValue=0, ComSignalType=UINT8, ComHandleId=1531, ComSystemTemplateSystemSignalRef=DET_RANGE_ERR_069
            DET_AZIMUTH_ERR_072_oRDR_DETECTION_069_072_oPCAN_RADAR_1dbec495_Tx: ComBitPosition=441, ComBitSize=7, ComSignalInitValue=0, ComSignalType=UINT8, ComHandleId=1479, ComSystemTemplateSystemSignalRef=DET_AZIMUTH_ERR_072
            DET_ELEVATION_ERR_072_oRDR_DETECTION_069_072_oPCAN_RADAR_ef811619_Tx: ComBitPosition=416, ComBitSize=6, ComSignalInitValue=0, ComSignalType=UINT8, ComHandleId=1503, ComSystemTemplateSystemSignalRef=DET_ELEVATION_ERR_072
            DET_EXISTENCE_PROB_072_oRDR_DETECTION_069_072_oPCAN_RADAR_3d1e6379_Tx: ComBitPosition=448, ComBitSize=6, ComSignalInitValue=0, ComSignalType=UINT8, ComHandleId=1507, ComSystemTemplateSystemSignalRef=DET_EXISTENCE_PROB_072
            DET_SNR_071_oRDR_DETECTION_069_072_oPCAN_RADAR_e2f8f858_Tx: ComBitPosition=344, ComBitSize=8, ComSignalInitValue=0, ComSignalType=UINT8, ComHandleId=1549, ComSystemTemplateSystemSignalRef=DET_SNR_071
            DET_RANGE_ERR_071_oRDR_DETECTION_069_072_oPCAN_RADAR_6a98e34c_Tx: ComBitPosition=264, ComBitSize=7, ComSignalInitValue=0, ComSignalType=UINT8, ComHandleId=1533, ComSystemTemplateSystemSignalRef=DET_RANGE_ERR_071
            DET_RCS_072_oRDR_DETECTION_069_072_oPCAN_RADAR_5bb6d7a4_Tx: ComBitPosition=464, ComBitSize=8, ComSignalInitValue=128, ComSignalType=UINT8, ComHandleId=1546, ComSystemTemplateSystemSignalRef=DET_RCS_072
            DET_CONFD_AZIMUTH_072_oRDR_DETECTION_069_072_oPCAN_RADAR_bbed5baa_Tx: ComBitPosition=454, ComBitSize=2, ComSignalInitValue=0, ComSignalType=UINT8, ComHandleId=1491, ComSystemTemplateSystemSignalRef=DET_CONFD_AZIMUTH_072
            DET_ELEVATION_ERR_070_oRDR_DETECTION_069_072_oPCAN_RADAR_1e11b972_Tx: ComBitPosition=192, ComBitSize=6, ComSignalInitValue=0, ComSignalType=UINT8, ComHandleId=1501, ComSystemTemplateSystemSignalRef=DET_ELEVATION_ERR_070
            DET_EXISTENCE_PROB_069_oRDR_DETECTION_069_072_oPCAN_RADAR_a9aebeb6_Tx: ComBitPosition=112, ComBitSize=6, ComSignalInitValue=0, ComSignalType=UINT8, ComHandleId=1504, ComSystemTemplateSystemSignalRef=DET_EXISTENCE_PROB_069
            DET_ELEVATION_070_oRDR_DETECTION_069_072_oPCAN_RADAR_99282107_Tx: ComBitPosition=184, ComBitSize=8, ComSignalInitValue=0, ComSignalType=UINT8, ComHandleId=1497, ComSystemTemplateSystemSignalRef=DET_ELEVATION_070
            DET_AZIMUTH_072_oRDR_DETECTION_069_072_oPCAN_RADAR_b90b5160_Tx: ComBitPosition=424, ComBitSize=13, ComSignalInitValue=0, ComSignalType=UINT16, ComHandleId=1475, ComSystemTemplateSystemSignalRef=DET_AZIMUTH_072
            DET_ELEVATION_ERR_069_oRDR_DETECTION_069_072_oPCAN_RADAR_7b31cbd6_Tx: ComBitPosition=80, ComBitSize=6, ComSignalInitValue=0, ComSignalType=UINT8, ComHandleId=1500, ComSystemTemplateSystemSignalRef=DET_ELEVATION_ERR_069
            DET_RANGE_VELOCITY_071_oRDR_DETECTION_069_072_oPCAN_RADAR_b8d69b00_Tx: ComBitPosition=272, ComBitSize=15, ComSignalInitValue=16384, ComSignalType=UINT16, ComHandleId=1537, ComSystemTemplateSystemSignalRef=DET_RANGE_VELOCITY_071
            DET_RCS_071_oRDR_DETECTION_069_072_oPCAN_RADAR_3f56ac5a_Tx: ComBitPosition=352, ComBitSize=8, ComSignalInitValue=128, ComSignalType=UINT8, ComHandleId=1545, ComSystemTemplateSystemSignalRef=DET_RCS_071
            DET_AZIMUTH_ERR_069_oRDR_DETECTION_069_072_oPCAN_RADAR_890e195a_Tx: ComBitPosition=105, ComBitSize=7, ComSignalInitValue=0, ComSignalType=UINT8, ComHandleId=1476, ComSystemTemplateSystemSignalRef=DET_AZIMUTH_ERR_069
            DET_RANGE_VELOCITY_072_oRDR_DETECTION_069_072_oPCAN_RADAR_dc36e0fe_Tx: ComBitPosition=384, ComBitSize=15, ComSignalInitValue=16384, ComSignalType=UINT16, ComHandleId=1538, ComSystemTemplateSystemSignalRef=DET_RANGE_VELOCITY_072
            DET_RANGE_070_oRDR_DETECTION_069_072_oPCAN_RADAR_58008db0_Tx: ComBitPosition=136, ComBitSize=15, ComSignalInitValue=0, ComSignalType=UINT16, ComHandleId=1528, ComSystemTemplateSystemSignalRef=DET_RANGE_070
            DET_SUPER_RES_TARGET_070_oRDR_DETECTION_069_072_oPCAN_RADAR_461104a8_Tx: ComBitPosition=199, ComBitSize=1, ComSignalInitValue=0, ComSignalType=BOOLEAN, ComHandleId=1552, ComSystemTemplateSystemSignalRef=DET_SUPER_RES_TARGET_070
            DET_HVC_FLAG_071_oRDR_DETECTION_069_072_oPCAN_RADAR_b88a5bf8_Tx: ComBitPosition=310, ComBitSize=1, ComSignalInitValue=0, ComSignalType=BOOLEAN, ComHandleId=1510, ComSystemTemplateSystemSignalRef=DET_HVC_FLAG_071
            DET_AZIMUTH_071_oRDR_DETECTION_069_072_oPCAN_RADAR_ddeb2a9e_Tx: ComBitPosition=312, ComBitSize=13, ComSignalInitValue=0, ComSignalType=UINT16, ComHandleId=1474, ComSystemTemplateSystemSignalRef=DET_AZIMUTH_071
            DET_RANGE_072_oRDR_DETECTION_069_072_oPCAN_RADAR_a99022db_Tx: ComBitPosition=360, ComBitSize=15, ComSignalInitValue=0, ComSignalType=UINT16, ComHandleId=1530, ComSystemTemplateSystemSignalRef=DET_RANGE_072
            DET_EXISTENCE_PROB_071_oRDR_DETECTION_069_072_oPCAN_RADAR_59fe1887_Tx: ComBitPosition=336, ComBitSize=6, ComSignalInitValue=0, ComSignalType=UINT8, ComHandleId=1506, ComSystemTemplateSystemSignalRef=DET_EXISTENCE_PROB_071
            DET_RANGE_VELOCITY_069_oRDR_DETECTION_069_072_oPCAN_RADAR_48863d31_Tx: ComBitPosition=48, ComBitSize=15, ComSignalInitValue=16384, ComSignalType=UINT16, ComHandleId=1535, ComSystemTemplateSystemSignalRef=DET_RANGE_VELOCITY_069
            DET_ELEVATION_071_oRDR_DETECTION_069_072_oPCAN_RADAR_0c58f592_Tx: ComBitPosition=296, ComBitSize=8, ComSignalInitValue=0, ComSignalType=UINT8, ComHandleId=1498, ComSystemTemplateSystemSignalRef=DET_ELEVATION_071
            DET_RANGE_071_oRDR_DETECTION_069_072_oPCAN_RADAR_cd705925_Tx: ComBitPosition=248, ComBitSize=15, ComSignalInitValue=0, ComSignalType=UINT16, ComHandleId=1529, ComSystemTemplateSystemSignalRef=DET_RANGE_071
            DET_CONFD_ELEVATION_072_oRDR_DETECTION_069_072_oPCAN_RADAR_b9785a50_Tx: ComBitPosition=437, ComBitSize=2, ComSignalInitValue=0, ComSignalType=UINT8, ComHandleId=1495, ComSystemTemplateSystemSignalRef=DET_CONFD_ELEVATION_072
            DET_HVC_FLAG_072_oRDR_DETECTION_069_072_oPCAN_RADAR_dc6a2006_Tx: ComBitPosition=422, ComBitSize=1, ComSignalInitValue=0, ComSignalType=BOOLEAN, ComHandleId=1511, ComSystemTemplateSystemSignalRef=DET_HVC_FLAG_072
            DET_SNR_072_oRDR_DETECTION_069_072_oPCAN_RADAR_861883a6_Tx: ComBitPosition=456, ComBitSize=8, ComSignalInitValue=0, ComSignalType=UINT8, ComHandleId=1550, ComSystemTemplateSystemSignalRef=DET_SNR_072
            DET_AZIMUTH_ERR_071_oRDR_DETECTION_069_072_oPCAN_RADAR_795ebf6b_Tx: ComBitPosition=329, ComBitSize=7, ComSignalInitValue=0, ComSignalType=UINT8, ComHandleId=1478, ComSystemTemplateSystemSignalRef=DET_AZIMUTH_ERR_071
            DET_SUPER_RES_TARGET_071_oRDR_DETECTION_069_072_oPCAN_RADAR_d361d03d_Tx: ComBitPosition=311, ComBitSize=1, ComSignalInitValue=0, ComSignalType=BOOLEAN, ComHandleId=1553, ComSystemTemplateSystemSignalRef=DET_SUPER_RES_TARGET_071
            DET_ELEVATION_069_oRDR_DETECTION_069_072_oPCAN_RADAR_fc0853a3_Tx: ComBitPosition=72, ComBitSize=8, ComSignalInitValue=0, ComSignalType=UINT8, ComHandleId=1496, ComSystemTemplateSystemSignalRef=DET_ELEVATION_069
            DET_MH_CYCLE_COUNTER_069_072_oRDR_DETECTION_069_072_oPCAN_RADAR_68921646_Tx: ComBitPosition=16, ComBitSize=8, ComSignalInitValue=0, ComSignalType=UINT8, ComHandleId=1517, ComSystemTemplateSystemSignalRef=DET_MH_CYCLE_COUNTER_069_072
            DET_RANGE_VELOCITY_ERR_071_oRDR_DETECTION_069_072_oPCAN_RADAR_b76d60b2_Tx: ComBitPosition=288, ComBitSize=8, ComSignalInitValue=0, ComSignalType=UINT8, ComHandleId=1541, ComSystemTemplateSystemSignalRef=DET_RANGE_VELOCITY_ERR_071
            DET_RANGE_ERR_070_oRDR_DETECTION_069_072_oPCAN_RADAR_ffe837d9_Tx: ComBitPosition=152, ComBitSize=7, ComSignalInitValue=0, ComSignalType=UINT8, ComHandleId=1532, ComSystemTemplateSystemSignalRef=DET_RANGE_ERR_070
            DET_CONFD_ELEVATION_069_oRDR_DETECTION_069_072_oPCAN_RADAR_2dc8879f_Tx: ComBitPosition=101, ComBitSize=2, ComSignalInitValue=0, ComSignalType=UINT8, ComHandleId=1492, ComSystemTemplateSystemSignalRef=DET_CONFD_ELEVATION_069
            DET_CONFD_AZIMUTH_070_oRDR_DETECTION_069_072_oPCAN_RADAR_4a7df4c1_Tx: ComBitPosition=230, ComBitSize=2, ComSignalInitValue=0, ComSignalType=UINT8, ComHandleId=1489, ComSystemTemplateSystemSignalRef=DET_CONFD_AZIMUTH_070
            DET_CONFD_AZIMUTH_071_oRDR_DETECTION_069_072_oPCAN_RADAR_df0d2054_Tx: ComBitPosition=342, ComBitSize=2, ComSignalInitValue=0, ComSignalType=UINT8, ComHandleId=1490, ComSystemTemplateSystemSignalRef=DET_CONFD_AZIMUTH_071
            DET_ELEVATION_072_oRDR_DETECTION_069_072_oPCAN_RADAR_68b88e6c_Tx: ComBitPosition=408, ComBitSize=8, ComSignalInitValue=0, ComSignalType=UINT8, ComHandleId=1499, ComSystemTemplateSystemSignalRef=DET_ELEVATION_072
            DET_ELEVATION_ERR_071_oRDR_DETECTION_069_072_oPCAN_RADAR_8b616de7_Tx: ComBitPosition=304, ComBitSize=6, ComSignalInitValue=0, ComSignalType=UINT8, ComHandleId=1502, ComSystemTemplateSystemSignalRef=DET_ELEVATION_ERR_071
            DET_RANGE_ERR_072_oRDR_DETECTION_069_072_oPCAN_RADAR_0e7898b2_Tx: ComBitPosition=376, ComBitSize=7, ComSignalInitValue=0, ComSignalType=UINT8, ComHandleId=1534, ComSystemTemplateSystemSignalRef=DET_RANGE_ERR_072
            DET_BI_STATIC_FLAG_070_oRDR_DETECTION_069_072_oPCAN_RADAR_1eb7be8e_Tx: ComBitPosition=216, ComBitSize=1, ComSignalInitValue=0, ComSignalType=BOOLEAN, ComHandleId=1485, ComSystemTemplateSystemSignalRef=DET_BI_STATIC_FLAG_070
            DET_RCS_070_oRDR_DETECTION_069_072_oPCAN_RADAR_aa2678cf_Tx: ComBitPosition=240, ComBitSize=8, ComSignalInitValue=128, ComSignalType=UINT8, ComHandleId=1544, ComSystemTemplateSystemSignalRef=DET_RCS_070
            DET_HVC_FLAG_070_oRDR_DETECTION_069_072_oPCAN_RADAR_2dfa8f6d_Tx: ComBitPosition=198, ComBitSize=1, ComSignalInitValue=0, ComSignalType=BOOLEAN, ComHandleId=1509, ComSystemTemplateSystemSignalRef=DET_HVC_FLAG_070
            DET_RANGE_VELOCITY_070_oRDR_DETECTION_069_072_oPCAN_RADAR_2da64f95_Tx: ComBitPosition=160, ComBitSize=15, ComSignalInitValue=16384, ComSignalType=UINT16, ComHandleId=1536, ComSystemTemplateSystemSignalRef=DET_RANGE_VELOCITY_070
            DET_SNR_069_oRDR_DETECTION_069_072_oPCAN_RADAR_12a85e69_Tx: ComBitPosition=120, ComBitSize=8, ComSignalInitValue=0, ComSignalType=UINT8, ComHandleId=1547, ComSystemTemplateSystemSignalRef=DET_SNR_069
            DET_BI_STATIC_FLAG_072_oRDR_DETECTION_069_072_oPCAN_RADAR_ef2711e5_Tx: ComBitPosition=440, ComBitSize=1, ComSignalInitValue=0, ComSignalType=BOOLEAN, ComHandleId=1487, ComSystemTemplateSystemSignalRef=DET_BI_STATIC_FLAG_072
            DET_CONFD_ELEVATION_070_oRDR_DETECTION_069_072_oPCAN_RADAR_48e8f53b_Tx: ComBitPosition=213, ComBitSize=2, ComSignalInitValue=0, ComSignalType=UINT8, ComHandleId=1493, ComSystemTemplateSystemSignalRef=DET_CONFD_ELEVATION_070
            DET_RANGE_069_oRDR_DETECTION_069_072_oPCAN_RADAR_3d20ff14_Tx: ComBitPosition=24, ComBitSize=15, ComSignalInitValue=0, ComSignalType=UINT16, ComHandleId=1527, ComSystemTemplateSystemSignalRef=DET_RANGE_069
            DET_RCS_069_oRDR_DETECTION_069_072_oPCAN_RADAR_cf060a6b_Tx: ComBitPosition=128, ComBitSize=8, ComSignalInitValue=128, ComSignalType=UINT8, ComHandleId=1543, ComSystemTemplateSystemSignalRef=DET_RCS_069
            DET_SUPER_RES_TARGET_069_oRDR_DETECTION_069_072_oPCAN_RADAR_2331760c_Tx: ComBitPosition=87, ComBitSize=1, ComSignalInitValue=0, ComSignalType=BOOLEAN, ComHandleId=1551, ComSystemTemplateSystemSignalRef=DET_SUPER_RES_TARGET_069
            DET_BI_STATIC_FLAG_069_oRDR_DETECTION_069_072_oPCAN_RADAR_7b97cc2a_Tx: ComBitPosition=104, ComBitSize=1, ComSignalInitValue=0, ComSignalType=BOOLEAN, ComHandleId=1484, ComSystemTemplateSystemSignalRef=DET_BI_STATIC_FLAG_069
            DET_MH_CRC16_069_072_oRDR_DETECTION_069_072_oPCAN_RADAR_ece7b771_Tx: ComBitPosition=0, ComBitSize=16, ComSignalInitValue=0, ComSignalType=UINT16, ComHandleId=1516, ComSystemTemplateSystemSignalRef=DET_MH_CRC16_069_072
            DET_RANGE_VELOCITY_ERR_069_oRDR_DETECTION_069_072_oPCAN_RADAR_473dc683_Tx: ComBitPosition=64, ComBitSize=8, ComSignalInitValue=0, ComSignalType=UINT8, ComHandleId=1539, ComSystemTemplateSystemSignalRef=DET_RANGE_VELOCITY_ERR_069
            DET_AZIMUTH_070_oRDR_DETECTION_069_072_oPCAN_RADAR_489bfe0b_Tx: ComBitPosition=200, ComBitSize=13, ComSignalInitValue=0, ComSignalType=UINT16, ComHandleId=1473, ComSystemTemplateSystemSignalRef=DET_AZIMUTH_070
            DET_CONFD_AZIMUTH_069_oRDR_DETECTION_069_072_oPCAN_RADAR_2f5d8665_Tx: ComBitPosition=118, ComBitSize=2, ComSignalInitValue=0, ComSignalType=UINT8, ComHandleId=1488, ComSystemTemplateSystemSignalRef=DET_CONFD_AZIMUTH_069
            DET_SNR_070_oRDR_DETECTION_069_072_oPCAN_RADAR_77882ccd_Tx: ComBitPosition=232, ComBitSize=8, ComSignalInitValue=0, ComSignalType=UINT8, ComHandleId=1548, ComSystemTemplateSystemSignalRef=DET_SNR_070
            DET_RANGE_VELOCITY_ERR_070_oRDR_DETECTION_069_072_oPCAN_RADAR_221db427_Tx: ComBitPosition=176, ComBitSize=8, ComSignalInitValue=0, ComSignalType=UINT8, ComHandleId=1540, ComSystemTemplateSystemSignalRef=DET_RANGE_VELOCITY_ERR_070
            DET_MH_SCAN_INDEX_4LSB_069_072_oRDR_DETECTION_069_072_oPCAN_RADAR_a4b833ca_Tx: ComBitPosition=476, ComBitSize=4, ComSignalInitValue=0, ComSignalType=UINT8, ComHandleId=1518, ComSystemTemplateSystemSignalRef=DET_MH_SCAN_INDEX_4LSB_069_072
            DET_BELOW_RAIN_THOLD_069_oRDR_DETECTION_069_072_oPCAN_RADAR_f8ba1f6f_Tx: ComBitPosition=39, ComBitSize=1, ComSignalInitValue=0, ComSignalType=UINT8, ComHandleId=1480, ComSystemTemplateSystemSignalRef=DET_BELOW_RAIN_THOLD_069
            DET_IDM_071_oRDR_DETECTION_069_072_oPCAN_RADAR_33d86045_Tx: ComBitPosition=287, ComBitSize=1, ComSignalInitValue=0, ComSignalType=UINT8, ComHandleId=1514, ComSystemTemplateSystemSignalRef=DET_IDM_071
            DET_IDM_069_oRDR_DETECTION_069_072_oPCAN_RADAR_c388c674_Tx: ComBitPosition=63, ComBitSize=1, ComSignalInitValue=0, ComSignalType=UINT8, ComHandleId=1512, ComSystemTemplateSystemSignalRef=DET_IDM_069
            DET_BELOW_RAIN_THOLD_071_oRDR_DETECTION_069_072_oPCAN_RADAR_08eab95e_Tx: ComBitPosition=263, ComBitSize=1, ComSignalInitValue=0, ComSignalType=UINT8, ComHandleId=1482, ComSystemTemplateSystemSignalRef=DET_BELOW_RAIN_THOLD_071
            DET_MTD_070_oRDR_DETECTION_069_072_oPCAN_RADAR_c01b860b_Tx: ComBitPosition=159, ComBitSize=1, ComSignalInitValue=0, ComSignalType=UINT8, ComHandleId=1520, ComSystemTemplateSystemSignalRef=DET_MTD_070
            DET_PROB_1STAZHYPO_070_oRDR_DETECTION_069_072_oPCAN_RADAR_53af6ec6_Tx: ComBitPosition=215, ComBitSize=1, ComSignalInitValue=0, ComSignalType=BOOLEAN, ComHandleId=1524, ComSystemTemplateSystemSignalRef=DET_PROB_1STAZHYPO_070
            DET_BELOW_RAIN_THOLD_072_oRDR_DETECTION_069_072_oPCAN_RADAR_6c0ac2a0_Tx: ComBitPosition=375, ComBitSize=1, ComSignalInitValue=0, ComSignalType=UINT8, ComHandleId=1483, ComSystemTemplateSystemSignalRef=DET_BELOW_RAIN_THOLD_072
            DET_MTD_072_oRDR_DETECTION_069_072_oPCAN_RADAR_318b2960_Tx: ComBitPosition=383, ComBitSize=1, ComSignalInitValue=0, ComSignalType=UINT8, ComHandleId=1522, ComSystemTemplateSystemSignalRef=DET_MTD_072
            DET_IDM_070_oRDR_DETECTION_069_072_oPCAN_RADAR_a6a8b4d0_Tx: ComBitPosition=175, ComBitSize=1, ComSignalInitValue=0, ComSignalType=UINT8, ComHandleId=1513, ComSystemTemplateSystemSignalRef=DET_IDM_070
            DET_PROB_1STAZHYPO_071_oRDR_DETECTION_069_072_oPCAN_RADAR_c6dfba53_Tx: ComBitPosition=327, ComBitSize=1, ComSignalInitValue=0, ComSignalType=BOOLEAN, ComHandleId=1525, ComSystemTemplateSystemSignalRef=DET_PROB_1STAZHYPO_071
            DET_IDM_072_oRDR_DETECTION_069_072_oPCAN_RADAR_57381bbb_Tx: ComBitPosition=399, ComBitSize=1, ComSignalInitValue=0, ComSignalType=UINT8, ComHandleId=1515, ComSystemTemplateSystemSignalRef=DET_IDM_072
            DET_BELOW_RAIN_THOLD_070_oRDR_DETECTION_069_072_oPCAN_RADAR_9d9a6dcb_Tx: ComBitPosition=151, ComBitSize=1, ComSignalInitValue=0, ComSignalType=UINT8, ComHandleId=1481, ComSystemTemplateSystemSignalRef=DET_BELOW_RAIN_THOLD_070
            DET_MTD_069_oRDR_DETECTION_069_072_oPCAN_RADAR_a53bf4af_Tx: ComBitPosition=47, ComBitSize=1, ComSignalInitValue=0, ComSignalType=UINT8, ComHandleId=1519, ComSystemTemplateSystemSignalRef=DET_MTD_069
            DET_MTD_071_oRDR_DETECTION_069_072_oPCAN_RADAR_556b529e_Tx: ComBitPosition=271, ComBitSize=1, ComSignalInitValue=0, ComSignalType=UINT8, ComHandleId=1521, ComSystemTemplateSystemSignalRef=DET_MTD_071
            DET_PROB_1STAZHYPO_069_oRDR_DETECTION_069_072_oPCAN_RADAR_368f1c62_Tx: ComBitPosition=103, ComBitSize=1, ComSignalInitValue=0, ComSignalType=BOOLEAN, ComHandleId=1523, ComSystemTemplateSystemSignalRef=DET_PROB_1STAZHYPO_069
            DET_PROB_1STAZHYPO_072_oRDR_DETECTION_069_072_oPCAN_RADAR_a23fc1ad_Tx: ComBitPosition=439, ComBitSize=1, ComSignalInitValue=0, ComSignalType=BOOLEAN, ComHandleId=1526, ComSystemTemplateSystemSignalRef=DET_PROB_1STAZHYPO_072
        SG_Detections_225_228_oRDR_DETECTION_225_228_oPCAN_RADAR_1eae44dd_Tx: ComTransferProperty=TRIGGERED, ComHandleId=58, ComSystemTemplateSignalGroupRef=SG_Detections_225_228
          83 x ComGroupSignal, all with ComSignalEndianness=LITTLE_ENDIAN, ComTransferProperty=PENDING, ComSignalAccess=ACCESS_NEEDED_BY_SWC_OR_COM:
            DET_ELEVATION_227_oRDR_DETECTION_225_228_oPCAN_RADAR_1725be37_Tx: ComBitPosition=296, ComBitSize=8, ComSignalInitValue=0, ComSignalType=UINT8, ComHandleId=4735, ComSystemTemplateSystemSignalRef=DET_ELEVATION_227
            DET_RANGE_ERR_225_oRDR_DETECTION_225_228_oPCAN_RADAR_80750782_Tx: ComBitPosition=40, ComBitSize=7, ComSignalInitValue=0, ComSignalType=UINT8, ComHandleId=4768, ComSystemTemplateSystemSignalRef=DET_RANGE_ERR_225
            DET_AZIMUTH_225_oRDR_DETECTION_225_228_oPCAN_RADAR_3706ce50_Tx: ComBitPosition=88, ComBitSize=13, ComSignalInitValue=0, ComSignalType=UINT16, ComHandleId=4709, ComSystemTemplateSystemSignalRef=DET_AZIMUTH_225
            DET_RCS_228_oRDR_DETECTION_225_228_oPCAN_RADAR_083b75b8_Tx: ComBitPosition=464, ComBitSize=8, ComSignalInitValue=128, ComSignalType=UINT8, ComHandleId=4783, ComSystemTemplateSystemSignalRef=DET_RCS_228
            DET_RANGE_ERR_226_oRDR_DETECTION_225_228_oPCAN_RADAR_e4957c7c_Tx: ComBitPosition=152, ComBitSize=7, ComSignalInitValue=0, ComSignalType=UINT8, ComHandleId=4769, ComSystemTemplateSystemSignalRef=DET_RANGE_ERR_226
            DET_RANGE_VELOCITY_ERR_227_oRDR_DETECTION_225_228_oPCAN_RADAR_ac102b17_Tx: ComBitPosition=288, ComBitSize=8, ComSignalInitValue=0, ComSignalType=UINT8, ComHandleId=4778, ComSystemTemplateSystemSignalRef=DET_RANGE_VELOCITY_ERR_227
            DET_CONFD_AZIMUTH_225_oRDR_DETECTION_225_228_oPCAN_RADAR_35e0c49a_Tx: ComBitPosition=118, ComBitSize=2, ComSignalInitValue=0, ComSignalType=UINT8, ComHandleId=4725, ComSystemTemplateSystemSignalRef=DET_CONFD_AZIMUTH_225
            DET_SNR_225_oRDR_DETECTION_225_228_oPCAN_RADAR_08151c96_Tx: ComBitPosition=120, ComBitSize=8, ComSignalInitValue=0, ComSignalType=UINT8, ComHandleId=4784, ComSystemTemplateSystemSignalRef=DET_SNR_225
            DET_BI_STATIC_FLAG_225_oRDR_DETECTION_225_228_oPCAN_RADAR_612a8ed5_Tx: ComBitPosition=104, ComBitSize=1, ComSignalInitValue=0, ComSignalType=BOOLEAN, ComHandleId=4721, ComSystemTemplateSystemSignalRef=DET_BI_STATIC_FLAG_225
            DET_ELEVATION_226_oRDR_DETECTION_225_228_oPCAN_RADAR_82556aa2_Tx: ComBitPosition=184, ComBitSize=8, ComSignalInitValue=0, ComSignalType=UINT8, ComHandleId=4734, ComSystemTemplateSystemSignalRef=DET_ELEVATION_226
            DET_RCS_227_oRDR_DETECTION_225_228_oPCAN_RADAR_242be7ff_Tx: ComBitPosition=352, ComBitSize=8, ComSignalInitValue=128, ComSignalType=UINT8, ComHandleId=4782, ComSystemTemplateSystemSignalRef=DET_RCS_227
            DET_EXISTENCE_PROB_227_oRDR_DETECTION_225_228_oPCAN_RADAR_42835322_Tx: ComBitPosition=336, ComBitSize=6, ComSignalInitValue=0, ComSignalType=UINT8, ComHandleId=4743, ComSystemTemplateSystemSignalRef=DET_EXISTENCE_PROB_227
            DET_ELEVATION_ERR_225_oRDR_DETECTION_225_228_oPCAN_RADAR_618c8929_Tx: ComBitPosition=80, ComBitSize=6, ComSignalInitValue=0, ComSignalType=UINT8, ComHandleId=4737, ComSystemTemplateSystemSignalRef=DET_ELEVATION_ERR_225
            DET_SNR_226_oRDR_DETECTION_225_228_oPCAN_RADAR_6cf56768_Tx: ComBitPosition=232, ComBitSize=8, ComSignalInitValue=0, ComSignalType=UINT8, ComHandleId=4785, ComSystemTemplateSystemSignalRef=DET_SNR_226
            DET_SUPER_RES_TARGET_227_oRDR_DETECTION_225_228_oPCAN_RADAR_c81c9b98_Tx: ComBitPosition=311, ComBitSize=1, ComSignalInitValue=0, ComSignalType=BOOLEAN, ComHandleId=4790, ComSystemTemplateSystemSignalRef=DET_SUPER_RES_TARGET_227
            DET_BI_STATIC_FLAG_226_oRDR_DETECTION_225_228_oPCAN_RADAR_05caf52b_Tx: ComBitPosition=216, ComBitSize=1, ComSignalInitValue=0, ComSignalType=BOOLEAN, ComHandleId=4722, ComSystemTemplateSystemSignalRef=DET_BI_STATIC_FLAG_226
            DET_EXISTENCE_PROB_226_oRDR_DETECTION_225_228_oPCAN_RADAR_d7f387b7_Tx: ComBitPosition=224, ComBitSize=6, ComSignalInitValue=0, ComSignalType=UINT8, ComHandleId=4742, ComSystemTemplateSystemSignalRef=DET_EXISTENCE_PROB_226
            DET_EXISTENCE_PROB_225_oRDR_DETECTION_225_228_oPCAN_RADAR_b313fc49_Tx: ComBitPosition=112, ComBitSize=6, ComSignalInitValue=0, ComSignalType=UINT8, ComHandleId=4741, ComSystemTemplateSystemSignalRef=DET_EXISTENCE_PROB_225
            DET_RANGE_VELOCITY_227_oRDR_DETECTION_225_228_oPCAN_RADAR_a3abd0a5_Tx: ComBitPosition=272, ComBitSize=15, ComSignalInitValue=16384, ComSignalType=UINT16, ComHandleId=4774, ComSystemTemplateSystemSignalRef=DET_RANGE_VELOCITY_227
            DET_AZIMUTH_226_oRDR_DETECTION_225_228_oPCAN_RADAR_53e6b5ae_Tx: ComBitPosition=200, ComBitSize=13, ComSignalInitValue=0, ComSignalType=UINT16, ComHandleId=4710, ComSystemTemplateSystemSignalRef=DET_AZIMUTH_226
            DET_AZIMUTH_ERR_227_oRDR_DETECTION_225_228_oPCAN_RADAR_6223f4ce_Tx: ComBitPosition=329, ComBitSize=7, ComSignalInitValue=0, ComSignalType=UINT8, ComHandleId=4715, ComSystemTemplateSystemSignalRef=DET_AZIMUTH_ERR_227
            DET_MH_CYCLE_COUNTER_225_228_oRDR_DETECTION_225_228_oPCAN_RADAR_1e5337e1_Tx: ComBitPosition=16, ComBitSize=8, ComSignalInitValue=0, ComSignalType=UINT8, ComHandleId=4754, ComSystemTemplateSystemSignalRef=DET_MH_CYCLE_COUNTER_225_228
            DET_CONFD_ELEVATION_226_oRDR_DETECTION_225_228_oPCAN_RADAR_5395be9e_Tx: ComBitPosition=213, ComBitSize=2, ComSignalInitValue=0, ComSignalType=UINT8, ComHandleId=4730, ComSystemTemplateSystemSignalRef=DET_CONFD_ELEVATION_226
            DET_AZIMUTH_ERR_226_oRDR_DETECTION_225_228_oPCAN_RADAR_f753205b_Tx: ComBitPosition=217, ComBitSize=7, ComSignalInitValue=0, ComSignalType=UINT8, ComHandleId=4714, ComSystemTemplateSystemSignalRef=DET_AZIMUTH_ERR_226
            DET_MH_SCAN_INDEX_4LSB_225_228_oRDR_DETECTION_225_228_oPCAN_RADAR_d279126d_Tx: ComBitPosition=476, ComBitSize=4, ComSignalInitValue=0, ComSignalType=UINT8, ComHandleId=4755, ComSystemTemplateSystemSignalRef=DET_MH_SCAN_INDEX_4LSB_225_228
            DET_CONFD_ELEVATION_228_oRDR_DETECTION_225_228_oPCAN_RADAR_eaf5f84c_Tx: ComBitPosition=437, ComBitSize=2, ComSignalInitValue=0, ComSignalType=UINT8, ComHandleId=4732, ComSystemTemplateSystemSignalRef=DET_CONFD_ELEVATION_228
            DET_AZIMUTH_ERR_225_oRDR_DETECTION_225_228_oPCAN_RADAR_93b35ba5_Tx: ComBitPosition=105, ComBitSize=7, ComSignalInitValue=0, ComSignalType=UINT8, ComHandleId=4713, ComSystemTemplateSystemSignalRef=DET_AZIMUTH_ERR_225
            DET_RANGE_VELOCITY_226_oRDR_DETECTION_225_228_oPCAN_RADAR_36db0430_Tx: ComBitPosition=160, ComBitSize=15, ComSignalInitValue=16384, ComSignalType=UINT16, ComHandleId=4773, ComSystemTemplateSystemSignalRef=DET_RANGE_VELOCITY_226
            DET_AZIMUTH_227_oRDR_DETECTION_225_228_oPCAN_RADAR_c696613b_Tx: ComBitPosition=312, ComBitSize=13, ComSignalInitValue=0, ComSignalType=UINT16, ComHandleId=4711, ComSystemTemplateSystemSignalRef=DET_AZIMUTH_227
            DET_CONFD_ELEVATION_225_oRDR_DETECTION_225_228_oPCAN_RADAR_3775c560_Tx: ComBitPosition=101, ComBitSize=2, ComSignalInitValue=0, ComSignalType=UINT8, ComHandleId=4729, ComSystemTemplateSystemSignalRef=DET_CONFD_ELEVATION_225
            DET_EXISTENCE_PROB_228_oRDR_DETECTION_225_228_oPCAN_RADAR_6e93c165_Tx: ComBitPosition=448, ComBitSize=6, ComSignalInitValue=0, ComSignalType=UINT8, ComHandleId=4744, ComSystemTemplateSystemSignalRef=DET_EXISTENCE_PROB_228
            DET_ELEVATION_ERR_227_oRDR_DETECTION_225_228_oPCAN_RADAR_901c2642_Tx: ComBitPosition=304, ComBitSize=6, ComSignalInitValue=0, ComSignalType=UINT8, ComHandleId=4739, ComSystemTemplateSystemSignalRef=DET_ELEVATION_ERR_227
            DET_SUPER_RES_TARGET_226_oRDR_DETECTION_225_228_oPCAN_RADAR_5d6c4f0d_Tx: ComBitPosition=199, ComBitSize=1, ComSignalInitValue=0, ComSignalType=BOOLEAN, ComHandleId=4789, ComSystemTemplateSystemSignalRef=DET_SUPER_RES_TARGET_226
            DET_SNR_228_oRDR_DETECTION_225_228_oPCAN_RADAR_d59521ba_Tx: ComBitPosition=456, ComBitSize=8, ComSignalInitValue=0, ComSignalType=UINT8, ComHandleId=4787, ComSystemTemplateSystemSignalRef=DET_SNR_228
            DET_SUPER_RES_TARGET_228_oRDR_DETECTION_225_228_oPCAN_RADAR_e40c09df_Tx: ComBitPosition=423, ComBitSize=1, ComSignalInitValue=0, ComSignalType=BOOLEAN, ComHandleId=4791, ComSystemTemplateSystemSignalRef=DET_SUPER_RES_TARGET_228
            DET_RANGE_VELOCITY_ERR_228_oRDR_DETECTION_225_228_oPCAN_RADAR_8000b950_Tx: ComBitPosition=400, ComBitSize=8, ComSignalInitValue=0, ComSignalType=UINT8, ComHandleId=4779, ComSystemTemplateSystemSignalRef=DET_RANGE_VELOCITY_ERR_228
            DET_AZIMUTH_228_oRDR_DETECTION_225_228_oPCAN_RADAR_ea86f37c_Tx: ComBitPosition=424, ComBitSize=13, ComSignalInitValue=0, ComSignalType=UINT16, ComHandleId=4712, ComSystemTemplateSystemSignalRef=DET_AZIMUTH_228
            DET_CONFD_AZIMUTH_226_oRDR_DETECTION_225_228_oPCAN_RADAR_5100bf64_Tx: ComBitPosition=230, ComBitSize=2, ComSignalInitValue=0, ComSignalType=UINT8, ComHandleId=4726, ComSystemTemplateSystemSignalRef=DET_CONFD_AZIMUTH_226
            DET_CONFD_AZIMUTH_227_oRDR_DETECTION_225_228_oPCAN_RADAR_c4706bf1_Tx: ComBitPosition=342, ComBitSize=2, ComSignalInitValue=0, ComSignalType=UINT8, ComHandleId=4727, ComSystemTemplateSystemSignalRef=DET_CONFD_AZIMUTH_227
            DET_ELEVATION_225_oRDR_DETECTION_225_228_oPCAN_RADAR_e6b5115c_Tx: ComBitPosition=72, ComBitSize=8, ComSignalInitValue=0, ComSignalType=UINT8, ComHandleId=4733, ComSystemTemplateSystemSignalRef=DET_ELEVATION_225
            DET_RANGE_227_oRDR_DETECTION_225_228_oPCAN_RADAR_d60d1280_Tx: ComBitPosition=248, ComBitSize=15, ComSignalInitValue=0, ComSignalType=UINT16, ComHandleId=4766, ComSystemTemplateSystemSignalRef=DET_RANGE_227
            DET_HVC_FLAG_227_oRDR_DETECTION_225_228_oPCAN_RADAR_a3f7105d_Tx: ComBitPosition=310, ComBitSize=1, ComSignalInitValue=0, ComSignalType=BOOLEAN, ComHandleId=4747, ComSystemTemplateSystemSignalRef=DET_HVC_FLAG_227
            DET_ELEVATION_228_oRDR_DETECTION_225_228_oPCAN_RADAR_3b352c70_Tx: ComBitPosition=408, ComBitSize=8, ComSignalInitValue=0, ComSignalType=UINT8, ComHandleId=4736, ComSystemTemplateSystemSignalRef=DET_ELEVATION_228
            DET_RCS_226_oRDR_DETECTION_225_228_oPCAN_RADAR_b15b336a_Tx: ComBitPosition=240, ComBitSize=8, ComSignalInitValue=128, ComSignalType=UINT8, ComHandleId=4781, ComSystemTemplateSystemSignalRef=DET_RCS_226
            DET_SNR_227_oRDR_DETECTION_225_228_oPCAN_RADAR_f985b3fd_Tx: ComBitPosition=344, ComBitSize=8, ComSignalInitValue=0, ComSignalType=UINT8, ComHandleId=4786, ComSystemTemplateSystemSignalRef=DET_SNR_227
            DET_HVC_FLAG_228_oRDR_DETECTION_225_228_oPCAN_RADAR_8fe7821a_Tx: ComBitPosition=422, ComBitSize=1, ComSignalInitValue=0, ComSignalType=BOOLEAN, ComHandleId=4748, ComSystemTemplateSystemSignalRef=DET_HVC_FLAG_228
            DET_MH_CRC16_225_228_oRDR_DETECTION_225_228_oPCAN_RADAR_9a2696d6_Tx: ComBitPosition=0, ComBitSize=16, ComSignalInitValue=0, ComSignalType=UINT16, ComHandleId=4753, ComSystemTemplateSystemSignalRef=DET_MH_CRC16_225_228
            DET_RANGE_ERR_228_oRDR_DETECTION_225_228_oPCAN_RADAR_5df53aae_Tx: ComBitPosition=376, ComBitSize=7, ComSignalInitValue=0, ComSignalType=UINT8, ComHandleId=4771, ComSystemTemplateSystemSignalRef=DET_RANGE_ERR_228
            DET_RANGE_VELOCITY_ERR_226_oRDR_DETECTION_225_228_oPCAN_RADAR_3960ff82_Tx: ComBitPosition=176, ComBitSize=8, ComSignalInitValue=0, ComSignalType=UINT8, ComHandleId=4777, ComSystemTemplateSystemSignalRef=DET_RANGE_VELOCITY_ERR_226
            DET_BI_STATIC_FLAG_227_oRDR_DETECTION_225_228_oPCAN_RADAR_90ba21be_Tx: ComBitPosition=328, ComBitSize=1, ComSignalInitValue=0, ComSignalType=BOOLEAN, ComHandleId=4723, ComSystemTemplateSystemSignalRef=DET_BI_STATIC_FLAG_227
            DET_RANGE_ERR_227_oRDR_DETECTION_225_228_oPCAN_RADAR_71e5a8e9_Tx: ComBitPosition=264, ComBitSize=7, ComSignalInitValue=0, ComSignalType=UINT8, ComHandleId=4770, ComSystemTemplateSystemSignalRef=DET_RANGE_ERR_227
            DET_ELEVATION_ERR_228_oRDR_DETECTION_225_228_oPCAN_RADAR_bc0cb405_Tx: ComBitPosition=416, ComBitSize=6, ComSignalInitValue=0, ComSignalType=UINT8, ComHandleId=4740, ComSystemTemplateSystemSignalRef=DET_ELEVATION_ERR_228
            DET_HVC_FLAG_226_oRDR_DETECTION_225_228_oPCAN_RADAR_3687c4c8_Tx: ComBitPosition=198, ComBitSize=1, ComSignalInitValue=0, ComSignalType=BOOLEAN, ComHandleId=4746, ComSystemTemplateSystemSignalRef=DET_HVC_FLAG_226
            DET_SUPER_RES_TARGET_225_oRDR_DETECTION_225_228_oPCAN_RADAR_398c34f3_Tx: ComBitPosition=87, ComBitSize=1, ComSignalInitValue=0, ComSignalType=BOOLEAN, ComHandleId=4788, ComSystemTemplateSystemSignalRef=DET_SUPER_RES_TARGET_225
            DET_HVC_FLAG_225_oRDR_DETECTION_225_228_oPCAN_RADAR_5267bf36_Tx: ComBitPosition=86, ComBitSize=1, ComSignalInitValue=0, ComSignalType=BOOLEAN, ComHandleId=4745, ComSystemTemplateSystemSignalRef=DET_HVC_FLAG_225
            DET_RCS_225_oRDR_DETECTION_225_228_oPCAN_RADAR_d5bb4894_Tx: ComBitPosition=128, ComBitSize=8, ComSignalInitValue=128, ComSignalType=UINT8, ComHandleId=4780, ComSystemTemplateSystemSignalRef=DET_RCS_225
            DET_CONFD_ELEVATION_227_oRDR_DETECTION_225_228_oPCAN_RADAR_c6e56a0b_Tx: ComBitPosition=325, ComBitSize=2, ComSignalInitValue=0, ComSignalType=UINT8, ComHandleId=4731, ComSystemTemplateSystemSignalRef=DET_CONFD_ELEVATION_227
            DET_RANGE_226_oRDR_DETECTION_225_228_oPCAN_RADAR_437dc615_Tx: ComBitPosition=136, ComBitSize=15, ComSignalInitValue=0, ComSignalType=UINT16, ComHandleId=4765, ComSystemTemplateSystemSignalRef=DET_RANGE_226
            DET_RANGE_VELOCITY_ERR_225_oRDR_DETECTION_225_228_oPCAN_RADAR_5d80847c_Tx: ComBitPosition=64, ComBitSize=8, ComSignalInitValue=0, ComSignalType=UINT8, ComHandleId=4776, ComSystemTemplateSystemSignalRef=DET_RANGE_VELOCITY_ERR_225
            DET_BI_STATIC_FLAG_228_oRDR_DETECTION_225_228_oPCAN_RADAR_bcaab3f9_Tx: ComBitPosition=440, ComBitSize=1, ComSignalInitValue=0, ComSignalType=BOOLEAN, ComHandleId=4724, ComSystemTemplateSystemSignalRef=DET_BI_STATIC_FLAG_228
            DET_AZIMUTH_ERR_228_oRDR_DETECTION_225_228_oPCAN_RADAR_4e336689_Tx: ComBitPosition=441, ComBitSize=7, ComSignalInitValue=0, ComSignalType=UINT8, ComHandleId=4716, ComSystemTemplateSystemSignalRef=DET_AZIMUTH_ERR_228
            DET_CONFD_AZIMUTH_228_oRDR_DETECTION_225_228_oPCAN_RADAR_e860f9b6_Tx: ComBitPosition=454, ComBitSize=2, ComSignalInitValue=0, ComSignalType=UINT8, ComHandleId=4728, ComSystemTemplateSystemSignalRef=DET_CONFD_AZIMUTH_228
            DET_ELEVATION_ERR_226_oRDR_DETECTION_225_228_oPCAN_RADAR_056cf2d7_Tx: ComBitPosition=192, ComBitSize=6, ComSignalInitValue=0, ComSignalType=UINT8, ComHandleId=4738, ComSystemTemplateSystemSignalRef=DET_ELEVATION_ERR_226
            DET_RANGE_VELOCITY_225_oRDR_DETECTION_225_228_oPCAN_RADAR_523b7fce_Tx: ComBitPosition=48, ComBitSize=15, ComSignalInitValue=16384, ComSignalType=UINT16, ComHandleId=4772, ComSystemTemplateSystemSignalRef=DET_RANGE_VELOCITY_225
            DET_RANGE_228_oRDR_DETECTION_225_228_oPCAN_RADAR_fa1d80c7_Tx: ComBitPosition=360, ComBitSize=15, ComSignalInitValue=0, ComSignalType=UINT16, ComHandleId=4767, ComSystemTemplateSystemSignalRef=DET_RANGE_228
            DET_RANGE_VELOCITY_228_oRDR_DETECTION_225_228_oPCAN_RADAR_8fbb42e2_Tx: ComBitPosition=384, ComBitSize=15, ComSignalInitValue=16384, ComSignalType=UINT16, ComHandleId=4775, ComSystemTemplateSystemSignalRef=DET_RANGE_VELOCITY_228
            DET_RANGE_225_oRDR_DETECTION_225_228_oPCAN_RADAR_279dbdeb_Tx: ComBitPosition=24, ComBitSize=15, ComSignalInitValue=0, ComSignalType=UINT16, ComHandleId=4764, ComSystemTemplateSystemSignalRef=DET_RANGE_225
            DET_PROB_1STAZHYPO_225_oRDR_DETECTION_225_228_oPCAN_RADAR_2c325e9d_Tx: ComBitPosition=103, ComBitSize=1, ComSignalInitValue=0, ComSignalType=BOOLEAN, ComHandleId=4760, ComSystemTemplateSystemSignalRef=DET_PROB_1STAZHYPO_225
            DET_BELOW_RAIN_THOLD_228_oRDR_DETECTION_225_228_oPCAN_RADAR_3f8760bc_Tx: ComBitPosition=375, ComBitSize=1, ComSignalInitValue=0, ComSignalType=UINT8, ComHandleId=4720, ComSystemTemplateSystemSignalRef=DET_BELOW_RAIN_THOLD_228
            DET_PROB_1STAZHYPO_227_oRDR_DETECTION_225_228_oPCAN_RADAR_dda2f1f6_Tx: ComBitPosition=327, ComBitSize=1, ComSignalInitValue=0, ComSignalType=BOOLEAN, ComHandleId=4762, ComSystemTemplateSystemSignalRef=DET_PROB_1STAZHYPO_227
            DET_IDM_226_oRDR_DETECTION_225_228_oPCAN_RADAR_bdd5ff75_Tx: ComBitPosition=175, ComBitSize=1, ComSignalInitValue=0, ComSignalType=UINT8, ComHandleId=4750, ComSystemTemplateSystemSignalRef=DET_IDM_226
            DET_BELOW_RAIN_THOLD_227_oRDR_DETECTION_225_228_oPCAN_RADAR_1397f2fb_Tx: ComBitPosition=263, ComBitSize=1, ComSignalInitValue=0, ComSignalType=UINT8, ComHandleId=4719, ComSystemTemplateSystemSignalRef=DET_BELOW_RAIN_THOLD_227
            DET_BELOW_RAIN_THOLD_225_oRDR_DETECTION_225_228_oPCAN_RADAR_e2075d90_Tx: ComBitPosition=39, ComBitSize=1, ComSignalInitValue=0, ComSignalType=UINT8, ComHandleId=4717, ComSystemTemplateSystemSignalRef=DET_BELOW_RAIN_THOLD_225
            DET_MTD_227_oRDR_DETECTION_225_228_oPCAN_RADAR_4e16193b_Tx: ComBitPosition=271, ComBitSize=1, ComSignalInitValue=0, ComSignalType=UINT8, ComHandleId=4758, ComSystemTemplateSystemSignalRef=DET_MTD_227
            DET_MTD_228_oRDR_DETECTION_225_228_oPCAN_RADAR_62068b7c_Tx: ComBitPosition=383, ComBitSize=1, ComSignalInitValue=0, ComSignalType=UINT8, ComHandleId=4759, ComSystemTemplateSystemSignalRef=DET_MTD_228
            DET_IDM_228_oRDR_DETECTION_225_228_oPCAN_RADAR_04b5b9a7_Tx: ComBitPosition=399, ComBitSize=1, ComSignalInitValue=0, ComSignalType=UINT8, ComHandleId=4752, ComSystemTemplateSystemSignalRef=DET_IDM_228
            DET_IDM_227_oRDR_DETECTION_225_228_oPCAN_RADAR_28a52be0_Tx: ComBitPosition=287, ComBitSize=1, ComSignalInitValue=0, ComSignalType=UINT8, ComHandleId=4751, ComSystemTemplateSystemSignalRef=DET_IDM_227
            DET_IDM_225_oRDR_DETECTION_225_228_oPCAN_RADAR_d935848b_Tx: ComBitPosition=63, ComBitSize=1, ComSignalInitValue=0, ComSignalType=UINT8, ComHandleId=4749, ComSystemTemplateSystemSignalRef=DET_IDM_225
            DET_MTD_226_oRDR_DETECTION_225_228_oPCAN_RADAR_db66cdae_Tx: ComBitPosition=159, ComBitSize=1, ComSignalInitValue=0, ComSignalType=UINT8, ComHandleId=4757, ComSystemTemplateSystemSignalRef=DET_MTD_226
            DET_BELOW_RAIN_THOLD_226_oRDR_DETECTION_225_228_oPCAN_RADAR_86e7266e_Tx: ComBitPosition=151, ComBitSize=1, ComSignalInitValue=0, ComSignalType=UINT8, ComHandleId=4718, ComSystemTemplateSystemSignalRef=DET_BELOW_RAIN_THOLD_226
            DET_PROB_1STAZHYPO_226_oRDR_DETECTION_225_228_oPCAN_RADAR_48d22563_Tx: ComBitPosition=215, ComBitSize=1, ComSignalInitValue=0, ComSignalType=BOOLEAN, ComHandleId=4761, ComSystemTemplateSystemSignalRef=DET_PROB_1STAZHYPO_226
            DET_MTD_225_oRDR_DETECTION_225_228_oPCAN_RADAR_bf86b650_Tx: ComBitPosition=47, ComBitSize=1, ComSignalInitValue=0, ComSignalType=UINT8, ComHandleId=4756, ComSystemTemplateSystemSignalRef=DET_MTD_225
            DET_PROB_1STAZHYPO_228_oRDR_DETECTION_225_228_oPCAN_RADAR_f1b263b1_Tx: ComBitPosition=439, ComBitSize=1, ComSignalInitValue=0, ComSignalType=BOOLEAN, ComHandleId=4763, ComSystemTemplateSystemSignalRef=DET_PROB_1STAZHYPO_228
        SG_Detections_333_336_oRDR_DETECTION_333_336_oPCAN_RADAR_f7772a32_Tx: ComTransferProperty=TRIGGERED, ComHandleId=85, ComSystemTemplateSignalGroupRef=SG_Detections_333_336
          83 x ComGroupSignal, all with ComSignalEndianness=LITTLE_ENDIAN, ComTransferProperty=PENDING, ComSignalAccess=ACCESS_NEEDED_BY_SWC_OR_COM:
            DET_AZIMUTH_ERR_336_oRDR_DETECTION_333_336_oPCAN_RADAR_bbbd7d39_Tx: ComBitPosition=441, ComBitSize=7, ComSignalInitValue=0, ComSignalType=UINT8, ComHandleId=6957, ComSystemTemplateSystemSignalRef=DET_AZIMUTH_ERR_336
            DET_AZIMUTH_336_oRDR_DETECTION_333_336_oPCAN_RADAR_1f08e8cc_Tx: ComBitPosition=424, ComBitSize=13, ComSignalInitValue=0, ComSignalType=UINT16, ComHandleId=6953, ComSystemTemplateSystemSignalRef=DET_AZIMUTH_336
            DET_CONFD_AZIMUTH_336_oRDR_DETECTION_333_336_oPCAN_RADAR_1deee206_Tx: ComBitPosition=454, ComBitSize=2, ComSignalInitValue=0, ComSignalType=UINT8, ComHandleId=6969, ComSystemTemplateSystemSignalRef=DET_CONFD_AZIMUTH_336
            DET_EXISTENCE_PROB_333_oRDR_DETECTION_333_336_oPCAN_RADAR_363d56d7_Tx: ComBitPosition=112, ComBitSize=6, ComSignalInitValue=0, ComSignalType=UINT8, ComHandleId=6982, ComSystemTemplateSystemSignalRef=DET_EXISTENCE_PROB_333
            DET_AZIMUTH_335_oRDR_DETECTION_333_336_oPCAN_RADAR_7be89332_Tx: ComBitPosition=312, ComBitSize=13, ComSignalInitValue=0, ComSignalType=UINT16, ComHandleId=6952, ComSystemTemplateSystemSignalRef=DET_AZIMUTH_335
            DET_RCS_334_oRDR_DETECTION_333_336_oPCAN_RADAR_0c25c163_Tx: ComBitPosition=240, ComBitSize=8, ComSignalInitValue=128, ComSignalType=UINT8, ComHandleId=7022, ComSystemTemplateSystemSignalRef=DET_RCS_334
            DET_RANGE_VELOCITY_ERR_336_oRDR_DETECTION_333_336_oPCAN_RADAR_758ea2e0_Tx: ComBitPosition=400, ComBitSize=8, ComSignalInitValue=0, ComSignalType=UINT8, ComHandleId=7020, ComSystemTemplateSystemSignalRef=DET_RANGE_VELOCITY_ERR_336
            DET_RCS_336_oRDR_DETECTION_333_336_oPCAN_RADAR_fdb56e08_Tx: ComBitPosition=464, ComBitSize=8, ComSignalInitValue=128, ComSignalType=UINT8, ComHandleId=7024, ComSystemTemplateSystemSignalRef=DET_RCS_336
            DET_AZIMUTH_334_oRDR_DETECTION_333_336_oPCAN_RADAR_ee9847a7_Tx: ComBitPosition=200, ComBitSize=13, ComSignalInitValue=0, ComSignalType=UINT16, ComHandleId=6951, ComSystemTemplateSystemSignalRef=DET_AZIMUTH_334
            DET_ELEVATION_ERR_334_oRDR_DETECTION_333_336_oPCAN_RADAR_b81200de_Tx: ComBitPosition=192, ComBitSize=6, ComSignalInitValue=0, ComSignalType=UINT8, ComHandleId=6979, ComSystemTemplateSystemSignalRef=DET_ELEVATION_ERR_334
            DET_RANGE_VELOCITY_ERR_333_oRDR_DETECTION_333_336_oPCAN_RADAR_d8ae2ee2_Tx: ComBitPosition=64, ComBitSize=8, ComSignalInitValue=0, ComSignalType=UINT8, ComHandleId=7017, ComSystemTemplateSystemSignalRef=DET_RANGE_VELOCITY_ERR_333
            DET_ELEVATION_ERR_335_oRDR_DETECTION_333_336_oPCAN_RADAR_2d62d44b_Tx: ComBitPosition=304, ComBitSize=6, ComSignalInitValue=0, ComSignalType=UINT8, ComHandleId=6980, ComSystemTemplateSystemSignalRef=DET_ELEVATION_ERR_335
            DET_EXISTENCE_PROB_336_oRDR_DETECTION_333_336_oPCAN_RADAR_9b1ddad5_Tx: ComBitPosition=448, ComBitSize=6, ComSignalInitValue=0, ComSignalType=UINT8, ComHandleId=6985, ComSystemTemplateSystemSignalRef=DET_EXISTENCE_PROB_336
            DET_HVC_FLAG_335_oRDR_DETECTION_333_336_oPCAN_RADAR_1e89e254_Tx: ComBitPosition=310, ComBitSize=1, ComSignalInitValue=0, ComSignalType=BOOLEAN, ComHandleId=6988, ComSystemTemplateSystemSignalRef=DET_HVC_FLAG_335
            DET_RANGE_VELOCITY_334_oRDR_DETECTION_333_336_oPCAN_RADAR_8ba5f639_Tx: ComBitPosition=160, ComBitSize=15, ComSignalInitValue=16384, ComSignalType=UINT16, ComHandleId=7014, ComSystemTemplateSystemSignalRef=DET_RANGE_VELOCITY_334
            DET_SUPER_RES_TARGET_334_oRDR_DETECTION_333_336_oPCAN_RADAR_e012bd04_Tx: ComBitPosition=199, ComBitSize=1, ComSignalInitValue=0, ComSignalType=BOOLEAN, ComHandleId=7030, ComSystemTemplateSystemSignalRef=DET_SUPER_RES_TARGET_334
            DET_RANGE_335_oRDR_DETECTION_333_336_oPCAN_RADAR_6b73e089_Tx: ComBitPosition=248, ComBitSize=15, ComSignalInitValue=0, ComSignalType=UINT16, ComHandleId=7007, ComSystemTemplateSystemSignalRef=DET_RANGE_335
            DET_RCS_335_oRDR_DETECTION_333_336_oPCAN_RADAR_995515f6_Tx: ComBitPosition=352, ComBitSize=8, ComSignalInitValue=128, ComSignalType=UINT8, ComHandleId=7023, ComSystemTemplateSystemSignalRef=DET_RCS_335
            DET_SUPER_RES_TARGET_333_oRDR_DETECTION_333_336_oPCAN_RADAR_bca29e6d_Tx: ComBitPosition=87, ComBitSize=1, ComSignalInitValue=0, ComSignalType=BOOLEAN, ComHandleId=7029, ComSystemTemplateSystemSignalRef=DET_SUPER_RES_TARGET_333
            DET_ELEVATION_ERR_333_oRDR_DETECTION_333_336_oPCAN_RADAR_e4a223b7_Tx: ComBitPosition=80, ComBitSize=6, ComSignalInitValue=0, ComSignalType=UINT8, ComHandleId=6978, ComSystemTemplateSystemSignalRef=DET_ELEVATION_ERR_333
            DET_RANGE_ERR_336_oRDR_DETECTION_333_336_oPCAN_RADAR_a87b211e_Tx: ComBitPosition=376, ComBitSize=7, ComSignalInitValue=0, ComSignalType=UINT8, ComHandleId=7012, ComSystemTemplateSystemSignalRef=DET_RANGE_ERR_336
            DET_SNR_335_oRDR_DETECTION_333_336_oPCAN_RADAR_44fb41f4_Tx: ComBitPosition=344, ComBitSize=8, ComSignalInitValue=0, ComSignalType=UINT8, ComHandleId=7027, ComSystemTemplateSystemSignalRef=DET_SNR_335
            DET_AZIMUTH_333_oRDR_DETECTION_333_336_oPCAN_RADAR_b22864ce_Tx: ComBitPosition=88, ComBitSize=13, ComSignalInitValue=0, ComSignalType=UINT16, ComHandleId=6950, ComSystemTemplateSystemSignalRef=DET_AZIMUTH_333
            DET_CONFD_AZIMUTH_334_oRDR_DETECTION_333_336_oPCAN_RADAR_ec7e4d6d_Tx: ComBitPosition=230, ComBitSize=2, ComSignalInitValue=0, ComSignalType=UINT8, ComHandleId=6967, ComSystemTemplateSystemSignalRef=DET_CONFD_AZIMUTH_334
            DET_MH_CYCLE_COUNTER_333_336_oRDR_DETECTION_333_336_oPCAN_RADAR_f78a590e_Tx: ComBitPosition=16, ComBitSize=8, ComSignalInitValue=0, ComSignalType=UINT8, ComHandleId=6995, ComSystemTemplateSystemSignalRef=DET_MH_CYCLE_COUNTER_333_336
            DET_RANGE_VELOCITY_335_oRDR_DETECTION_333_336_oPCAN_RADAR_1ed522ac_Tx: ComBitPosition=272, ComBitSize=15, ComSignalInitValue=16384, ComSignalType=UINT16, ComHandleId=7015, ComSystemTemplateSystemSignalRef=DET_RANGE_VELOCITY_335
            DET_EXISTENCE_PROB_334_oRDR_DETECTION_333_336_oPCAN_RADAR_6a8d75be_Tx: ComBitPosition=224, ComBitSize=6, ComSignalInitValue=0, ComSignalType=UINT8, ComHandleId=6983, ComSystemTemplateSystemSignalRef=DET_EXISTENCE_PROB_334
            DET_HVC_FLAG_333_oRDR_DETECTION_333_336_oPCAN_RADAR_d74915a8_Tx: ComBitPosition=86, ComBitSize=1, ComSignalInitValue=0, ComSignalType=BOOLEAN, ComHandleId=6986, ComSystemTemplateSystemSignalRef=DET_HVC_FLAG_333
            DET_ELEVATION_ERR_336_oRDR_DETECTION_333_336_oPCAN_RADAR_4982afb5_Tx: ComBitPosition=416, ComBitSize=6, ComSignalInitValue=0, ComSignalType=UINT8, ComHandleId=6981, ComSystemTemplateSystemSignalRef=DET_ELEVATION_ERR_336
            DET_MH_SCAN_INDEX_4LSB_333_336_oRDR_DETECTION_333_336_oPCAN_RADAR_3ba07c82_Tx: ComBitPosition=476, ComBitSize=4, ComSignalInitValue=0, ComSignalType=UINT8, ComHandleId=6996, ComSystemTemplateSystemSignalRef=DET_MH_SCAN_INDEX_4LSB_333_336
            DET_HVC_FLAG_336_oRDR_DETECTION_333_336_oPCAN_RADAR_7a6999aa_Tx: ComBitPosition=422, ComBitSize=1, ComSignalInitValue=0, ComSignalType=BOOLEAN, ComHandleId=6989, ComSystemTemplateSystemSignalRef=DET_HVC_FLAG_336
            DET_RANGE_334_oRDR_DETECTION_333_336_oPCAN_RADAR_fe03341c_Tx: ComBitPosition=136, ComBitSize=15, ComSignalInitValue=0, ComSignalType=UINT16, ComHandleId=7006, ComSystemTemplateSystemSignalRef=DET_RANGE_334
            DET_ELEVATION_334_oRDR_DETECTION_333_336_oPCAN_RADAR_3f2b98ab_Tx: ComBitPosition=184, ComBitSize=8, ComSignalInitValue=0, ComSignalType=UINT8, ComHandleId=6975, ComSystemTemplateSystemSignalRef=DET_ELEVATION_334
            DET_MH_CRC16_333_336_oRDR_DETECTION_333_336_oPCAN_RADAR_73fff839_Tx: ComBitPosition=0, ComBitSize=16, ComSignalInitValue=0, ComSignalType=UINT16, ComHandleId=6994, ComSystemTemplateSystemSignalRef=DET_MH_CRC16_333_336
            DET_SNR_334_oRDR_DETECTION_333_336_oPCAN_RADAR_d18b9561_Tx: ComBitPosition=232, ComBitSize=8, ComSignalInitValue=0, ComSignalType=UINT8, ComHandleId=7026, ComSystemTemplateSystemSignalRef=DET_SNR_334
            DET_CONFD_AZIMUTH_335_oRDR_DETECTION_333_336_oPCAN_RADAR_790e99f8_Tx: ComBitPosition=342, ComBitSize=2, ComSignalInitValue=0, ComSignalType=UINT8, ComHandleId=6968, ComSystemTemplateSystemSignalRef=DET_CONFD_AZIMUTH_335
            DET_EXISTENCE_PROB_335_oRDR_DETECTION_333_336_oPCAN_RADAR_fffda12b_Tx: ComBitPosition=336, ComBitSize=6, ComSignalInitValue=0, ComSignalType=UINT8, ComHandleId=6984, ComSystemTemplateSystemSignalRef=DET_EXISTENCE_PROB_335
            DET_BI_STATIC_FLAG_335_oRDR_DETECTION_333_336_oPCAN_RADAR_2dc4d3b7_Tx: ComBitPosition=328, ComBitSize=1, ComSignalInitValue=0, ComSignalType=BOOLEAN, ComHandleId=6964, ComSystemTemplateSystemSignalRef=DET_BI_STATIC_FLAG_335
            DET_HVC_FLAG_334_oRDR_DETECTION_333_336_oPCAN_RADAR_8bf936c1_Tx: ComBitPosition=198, ComBitSize=1, ComSignalInitValue=0, ComSignalType=BOOLEAN, ComHandleId=6987, ComSystemTemplateSystemSignalRef=DET_HVC_FLAG_334
            DET_RANGE_336_oRDR_DETECTION_333_336_oPCAN_RADAR_0f939b77_Tx: ComBitPosition=360, ComBitSize=15, ComSignalInitValue=0, ComSignalType=UINT16, ComHandleId=7008, ComSystemTemplateSystemSignalRef=DET_RANGE_336
            DET_RCS_333_oRDR_DETECTION_333_336_oPCAN_RADAR_5095e20a_Tx: ComBitPosition=128, ComBitSize=8, ComSignalInitValue=128, ComSignalType=UINT8, ComHandleId=7021, ComSystemTemplateSystemSignalRef=DET_RCS_333
            DET_ELEVATION_335_oRDR_DETECTION_333_336_oPCAN_RADAR_aa5b4c3e_Tx: ComBitPosition=296, ComBitSize=8, ComSignalInitValue=0, ComSignalType=UINT8, ComHandleId=6976, ComSystemTemplateSystemSignalRef=DET_ELEVATION_335
            DET_SUPER_RES_TARGET_335_oRDR_DETECTION_333_336_oPCAN_RADAR_75626991_Tx: ComBitPosition=311, ComBitSize=1, ComSignalInitValue=0, ComSignalType=BOOLEAN, ComHandleId=7031, ComSystemTemplateSystemSignalRef=DET_SUPER_RES_TARGET_335
            DET_RANGE_VELOCITY_336_oRDR_DETECTION_333_336_oPCAN_RADAR_7a355952_Tx: ComBitPosition=384, ComBitSize=15, ComSignalInitValue=16384, ComSignalType=UINT16, ComHandleId=7016, ComSystemTemplateSystemSignalRef=DET_RANGE_VELOCITY_336
            DET_BI_STATIC_FLAG_334_oRDR_DETECTION_333_336_oPCAN_RADAR_b8b40722_Tx: ComBitPosition=216, ComBitSize=1, ComSignalInitValue=0, ComSignalType=BOOLEAN, ComHandleId=6963, ComSystemTemplateSystemSignalRef=DET_BI_STATIC_FLAG_334
            DET_CONFD_ELEVATION_336_oRDR_DETECTION_333_336_oPCAN_RADAR_1f7be3fc_Tx: ComBitPosition=437, ComBitSize=2, ComSignalInitValue=0, ComSignalType=UINT8, ComHandleId=6973, ComSystemTemplateSystemSignalRef=DET_CONFD_ELEVATION_336
            DET_RANGE_ERR_335_oRDR_DETECTION_333_336_oPCAN_RADAR_cc9b5ae0_Tx: ComBitPosition=264, ComBitSize=7, ComSignalInitValue=0, ComSignalType=UINT8, ComHandleId=7011, ComSystemTemplateSystemSignalRef=DET_RANGE_ERR_335
            DET_RANGE_VELOCITY_ERR_335_oRDR_DETECTION_333_336_oPCAN_RADAR_116ed91e_Tx: ComBitPosition=288, ComBitSize=8, ComSignalInitValue=0, ComSignalType=UINT8, ComHandleId=7019, ComSystemTemplateSystemSignalRef=DET_RANGE_VELOCITY_ERR_335
            DET_CONFD_AZIMUTH_333_oRDR_DETECTION_333_336_oPCAN_RADAR_b0ce6e04_Tx: ComBitPosition=118, ComBitSize=2, ComSignalInitValue=0, ComSignalType=UINT8, ComHandleId=6966, ComSystemTemplateSystemSignalRef=DET_CONFD_AZIMUTH_333
            DET_ELEVATION_333_oRDR_DETECTION_333_336_oPCAN_RADAR_639bbbc2_Tx: ComBitPosition=72, ComBitSize=8, ComSignalInitValue=0, ComSignalType=UINT8, ComHandleId=6974, ComSystemTemplateSystemSignalRef=DET_ELEVATION_333
            DET_RANGE_ERR_334_oRDR_DETECTION_333_336_oPCAN_RADAR_59eb8e75_Tx: ComBitPosition=152, ComBitSize=7, ComSignalInitValue=0, ComSignalType=UINT8, ComHandleId=7010, ComSystemTemplateSystemSignalRef=DET_RANGE_ERR_334
            DET_SNR_333_oRDR_DETECTION_333_336_oPCAN_RADAR_8d3bb608_Tx: ComBitPosition=120, ComBitSize=8, ComSignalInitValue=0, ComSignalType=UINT8, ComHandleId=7025, ComSystemTemplateSystemSignalRef=DET_SNR_333
            DET_CONFD_ELEVATION_333_oRDR_DETECTION_333_336_oPCAN_RADAR_b25b6ffe_Tx: ComBitPosition=101, ComBitSize=2, ComSignalInitValue=0, ComSignalType=UINT8, ComHandleId=6970, ComSystemTemplateSystemSignalRef=DET_CONFD_ELEVATION_333
            DET_SUPER_RES_TARGET_336_oRDR_DETECTION_333_336_oPCAN_RADAR_1182126f_Tx: ComBitPosition=423, ComBitSize=1, ComSignalInitValue=0, ComSignalType=BOOLEAN, ComHandleId=7032, ComSystemTemplateSystemSignalRef=DET_SUPER_RES_TARGET_336
            DET_SNR_336_oRDR_DETECTION_333_336_oPCAN_RADAR_201b3a0a_Tx: ComBitPosition=456, ComBitSize=8, ComSignalInitValue=0, ComSignalType=UINT8, ComHandleId=7028, ComSystemTemplateSystemSignalRef=DET_SNR_336
            DET_RANGE_VELOCITY_ERR_334_oRDR_DETECTION_333_336_oPCAN_RADAR_841e0d8b_Tx: ComBitPosition=176, ComBitSize=8, ComSignalInitValue=0, ComSignalType=UINT8, ComHandleId=7018, ComSystemTemplateSystemSignalRef=DET_RANGE_VELOCITY_ERR_334
            DET_BI_STATIC_FLAG_336_oRDR_DETECTION_333_336_oPCAN_RADAR_4924a849_Tx: ComBitPosition=440, ComBitSize=1, ComSignalInitValue=0, ComSignalType=BOOLEAN, ComHandleId=6965, ComSystemTemplateSystemSignalRef=DET_BI_STATIC_FLAG_336
            DET_RANGE_333_oRDR_DETECTION_333_336_oPCAN_RADAR_a2b31775_Tx: ComBitPosition=24, ComBitSize=15, ComSignalInitValue=0, ComSignalType=UINT16, ComHandleId=7005, ComSystemTemplateSystemSignalRef=DET_RANGE_333
            DET_RANGE_ERR_333_oRDR_DETECTION_333_336_oPCAN_RADAR_055bad1c_Tx: ComBitPosition=40, ComBitSize=7, ComSignalInitValue=0, ComSignalType=UINT8, ComHandleId=7009, ComSystemTemplateSystemSignalRef=DET_RANGE_ERR_333
            DET_CONFD_ELEVATION_335_oRDR_DETECTION_333_336_oPCAN_RADAR_7b9b9802_Tx: ComBitPosition=325, ComBitSize=2, ComSignalInitValue=0, ComSignalType=UINT8, ComHandleId=6972, ComSystemTemplateSystemSignalRef=DET_CONFD_ELEVATION_335
            DET_RANGE_VELOCITY_333_oRDR_DETECTION_333_336_oPCAN_RADAR_d715d550_Tx: ComBitPosition=48, ComBitSize=15, ComSignalInitValue=16384, ComSignalType=UINT16, ComHandleId=7013, ComSystemTemplateSystemSignalRef=DET_RANGE_VELOCITY_333
            DET_CONFD_ELEVATION_334_oRDR_DETECTION_333_336_oPCAN_RADAR_eeeb4c97_Tx: ComBitPosition=213, ComBitSize=2, ComSignalInitValue=0, ComSignalType=UINT8, ComHandleId=6971, ComSystemTemplateSystemSignalRef=DET_CONFD_ELEVATION_334
            DET_AZIMUTH_ERR_333_oRDR_DETECTION_333_336_oPCAN_RADAR_169df13b_Tx: ComBitPosition=105, ComBitSize=7, ComSignalInitValue=0, ComSignalType=UINT8, ComHandleId=6954, ComSystemTemplateSystemSignalRef=DET_AZIMUTH_ERR_333
            DET_BI_STATIC_FLAG_333_oRDR_DETECTION_333_336_oPCAN_RADAR_e404244b_Tx: ComBitPosition=104, ComBitSize=1, ComSignalInitValue=0, ComSignalType=BOOLEAN, ComHandleId=6962, ComSystemTemplateSystemSignalRef=DET_BI_STATIC_FLAG_333
            DET_ELEVATION_336_oRDR_DETECTION_333_336_oPCAN_RADAR_cebb37c0_Tx: ComBitPosition=408, ComBitSize=8, ComSignalInitValue=0, ComSignalType=UINT8, ComHandleId=6977, ComSystemTemplateSystemSignalRef=DET_ELEVATION_336
            DET_AZIMUTH_ERR_334_oRDR_DETECTION_333_336_oPCAN_RADAR_4a2dd252_Tx: ComBitPosition=217, ComBitSize=7, ComSignalInitValue=0, ComSignalType=UINT8, ComHandleId=6955, ComSystemTemplateSystemSignalRef=DET_AZIMUTH_ERR_334
            DET_AZIMUTH_ERR_335_oRDR_DETECTION_333_336_oPCAN_RADAR_df5d06c7_Tx: ComBitPosition=329, ComBitSize=7, ComSignalInitValue=0, ComSignalType=UINT8, ComHandleId=6956, ComSystemTemplateSystemSignalRef=DET_AZIMUTH_ERR_335
            DET_IDM_334_oRDR_DETECTION_333_336_oPCAN_RADAR_00ab0d7c_Tx: ComBitPosition=175, ComBitSize=1, ComSignalInitValue=0, ComSignalType=UINT8, ComHandleId=6991, ComSystemTemplateSystemSignalRef=DET_IDM_334
            DET_BELOW_RAIN_THOLD_336_oRDR_DETECTION_333_336_oPCAN_RADAR_ca097b0c_Tx: ComBitPosition=375, ComBitSize=1, ComSignalInitValue=0, ComSignalType=UINT8, ComHandleId=6961, ComSystemTemplateSystemSignalRef=DET_BELOW_RAIN_THOLD_336
            DET_BELOW_RAIN_THOLD_335_oRDR_DETECTION_333_336_oPCAN_RADAR_aee900f2_Tx: ComBitPosition=263, ComBitSize=1, ComSignalInitValue=0, ComSignalType=UINT8, ComHandleId=6960, ComSystemTemplateSystemSignalRef=DET_BELOW_RAIN_THOLD_335
            DET_PROB_1STAZHYPO_335_oRDR_DETECTION_333_336_oPCAN_RADAR_60dc03ff_Tx: ComBitPosition=327, ComBitSize=1, ComSignalInitValue=0, ComSignalType=BOOLEAN, ComHandleId=7003, ComSystemTemplateSystemSignalRef=DET_PROB_1STAZHYPO_335
            DET_MTD_336_oRDR_DETECTION_333_336_oPCAN_RADAR_978890cc_Tx: ComBitPosition=383, ComBitSize=1, ComSignalInitValue=0, ComSignalType=UINT8, ComHandleId=7000, ComSystemTemplateSystemSignalRef=DET_MTD_336
            DET_IDM_333_oRDR_DETECTION_333_336_oPCAN_RADAR_5c1b2e15_Tx: ComBitPosition=63, ComBitSize=1, ComSignalInitValue=0, ComSignalType=UINT8, ComHandleId=6990, ComSystemTemplateSystemSignalRef=DET_IDM_333
            DET_MTD_334_oRDR_DETECTION_333_336_oPCAN_RADAR_66183fa7_Tx: ComBitPosition=159, ComBitSize=1, ComSignalInitValue=0, ComSignalType=UINT8, ComHandleId=6998, ComSystemTemplateSystemSignalRef=DET_MTD_334
            DET_PROB_1STAZHYPO_336_oRDR_DETECTION_333_336_oPCAN_RADAR_043c7801_Tx: ComBitPosition=439, ComBitSize=1, ComSignalInitValue=0, ComSignalType=BOOLEAN, ComHandleId=7004, ComSystemTemplateSystemSignalRef=DET_PROB_1STAZHYPO_336
            DET_IDM_336_oRDR_DETECTION_333_336_oPCAN_RADAR_f13ba217_Tx: ComBitPosition=399, ComBitSize=1, ComSignalInitValue=0, ComSignalType=UINT8, ComHandleId=6993, ComSystemTemplateSystemSignalRef=DET_IDM_336
            DET_MTD_333_oRDR_DETECTION_333_336_oPCAN_RADAR_3aa81cce_Tx: ComBitPosition=47, ComBitSize=1, ComSignalInitValue=0, ComSignalType=UINT8, ComHandleId=6997, ComSystemTemplateSystemSignalRef=DET_MTD_333
            DET_BELOW_RAIN_THOLD_333_oRDR_DETECTION_333_336_oPCAN_RADAR_6729f70e_Tx: ComBitPosition=39, ComBitSize=1, ComSignalInitValue=0, ComSignalType=UINT8, ComHandleId=6958, ComSystemTemplateSystemSignalRef=DET_BELOW_RAIN_THOLD_333
            DET_IDM_335_oRDR_DETECTION_333_336_oPCAN_RADAR_95dbd9e9_Tx: ComBitPosition=287, ComBitSize=1, ComSignalInitValue=0, ComSignalType=UINT8, ComHandleId=6992, ComSystemTemplateSystemSignalRef=DET_IDM_335
            DET_MTD_335_oRDR_DETECTION_333_336_oPCAN_RADAR_f368eb32_Tx: ComBitPosition=271, ComBitSize=1, ComSignalInitValue=0, ComSignalType=UINT8, ComHandleId=6999, ComSystemTemplateSystemSignalRef=DET_MTD_335
            DET_PROB_1STAZHYPO_333_oRDR_DETECTION_333_336_oPCAN_RADAR_a91cf403_Tx: ComBitPosition=103, ComBitSize=1, ComSignalInitValue=0, ComSignalType=BOOLEAN, ComHandleId=7001, ComSystemTemplateSystemSignalRef=DET_PROB_1STAZHYPO_333
            DET_PROB_1STAZHYPO_334_oRDR_DETECTION_333_336_oPCAN_RADAR_f5acd76a_Tx: ComBitPosition=215, ComBitSize=1, ComSignalInitValue=0, ComSignalType=BOOLEAN, ComHandleId=7002, ComSystemTemplateSystemSignalRef=DET_PROB_1STAZHYPO_334
            DET_BELOW_RAIN_THOLD_334_oRDR_DETECTION_333_336_oPCAN_RADAR_3b99d467_Tx: ComBitPosition=151, ComBitSize=1, ComSignalInitValue=0, ComSignalType=UINT8, ComHandleId=6959, ComSystemTemplateSystemSignalRef=DET_BELOW_RAIN_THOLD_334
        SG_Detections_133_136_oRDR_DETECTION_133_136_oPCAN_RADAR_72276f4a_Tx: ComTransferProperty=TRIGGERED, ComHandleId=35, ComSystemTemplateSignalGroupRef=SG_Detections_133_136
          83 x ComGroupSignal, all with ComSignalEndianness=LITTLE_ENDIAN, ComTransferProperty=PENDING, ComSignalAccess=ACCESS_NEEDED_BY_SWC_OR_COM:
            DET_EXISTENCE_PROB_136_oRDR_DETECTION_133_136_oPCAN_RADAR_874f9030_Tx: ComBitPosition=448, ComBitSize=6, ComSignalInitValue=0, ComSignalType=UINT8, ComHandleId=2835, ComSystemTemplateSystemSignalRef=DET_EXISTENCE_PROB_136
            DET_RCS_135_oRDR_DETECTION_133_136_oPCAN_RADAR_85075f13_Tx: ComBitPosition=352, ComBitSize=8, ComSignalInitValue=128, ComSignalType=UINT8, ComHandleId=2873, ComSystemTemplateSystemSignalRef=DET_RCS_135
            DET_RANGE_VELOCITY_134_oRDR_DETECTION_133_136_oPCAN_RADAR_97f7bcdc_Tx: ComBitPosition=160, ComBitSize=15, ComSignalInitValue=16384, ComSignalType=UINT16, ComHandleId=2864, ComSystemTemplateSystemSignalRef=DET_RANGE_VELOCITY_134
            DET_SUPER_RES_TARGET_136_oRDR_DETECTION_133_136_oPCAN_RADAR_0dd0588a_Tx: ComBitPosition=423, ComBitSize=1, ComSignalInitValue=0, ComSignalType=BOOLEAN, ComHandleId=2882, ComSystemTemplateSystemSignalRef=DET_SUPER_RES_TARGET_136
            DET_SUPER_RES_TARGET_134_oRDR_DETECTION_133_136_oPCAN_RADAR_fc40f7e1_Tx: ComBitPosition=199, ComBitSize=1, ComSignalInitValue=0, ComSignalType=BOOLEAN, ComHandleId=2880, ComSystemTemplateSystemSignalRef=DET_SUPER_RES_TARGET_134
            DET_RCS_134_oRDR_DETECTION_133_136_oPCAN_RADAR_10778b86_Tx: ComBitPosition=240, ComBitSize=8, ComSignalInitValue=128, ComSignalType=UINT8, ComHandleId=2872, ComSystemTemplateSystemSignalRef=DET_RCS_134
            DET_MH_CYCLE_COUNTER_133_136_oRDR_DETECTION_133_136_oPCAN_RADAR_72da1c76_Tx: ComBitPosition=16, ComBitSize=8, ComSignalInitValue=0, ComSignalType=UINT8, ComHandleId=2845, ComSystemTemplateSystemSignalRef=DET_MH_CYCLE_COUNTER_133_136
            DET_AZIMUTH_134_oRDR_DETECTION_133_136_oPCAN_RADAR_f2ca0d42_Tx: ComBitPosition=200, ComBitSize=13, ComSignalInitValue=0, ComSignalType=UINT16, ComHandleId=2801, ComSystemTemplateSystemSignalRef=DET_AZIMUTH_134
            DET_AZIMUTH_ERR_134_oRDR_DETECTION_133_136_oPCAN_RADAR_567f98b7_Tx: ComBitPosition=217, ComBitSize=7, ComSignalInitValue=0, ComSignalType=UINT8, ComHandleId=2805, ComSystemTemplateSystemSignalRef=DET_AZIMUTH_ERR_134
            DET_ELEVATION_ERR_135_oRDR_DETECTION_133_136_oPCAN_RADAR_31309eae_Tx: ComBitPosition=304, ComBitSize=6, ComSignalInitValue=0, ComSignalType=UINT8, ComHandleId=2830, ComSystemTemplateSystemSignalRef=DET_ELEVATION_ERR_135
            DET_RANGE_VELOCITY_136_oRDR_DETECTION_133_136_oPCAN_RADAR_666713b7_Tx: ComBitPosition=384, ComBitSize=15, ComSignalInitValue=16384, ComSignalType=UINT16, ComHandleId=2866, ComSystemTemplateSystemSignalRef=DET_RANGE_VELOCITY_136
            DET_SNR_136_oRDR_DETECTION_133_136_oPCAN_RADAR_3c4970ef_Tx: ComBitPosition=456, ComBitSize=8, ComSignalInitValue=0, ComSignalType=UINT8, ComHandleId=2878, ComSystemTemplateSystemSignalRef=DET_SNR_136
            DET_HVC_FLAG_134_oRDR_DETECTION_133_136_oPCAN_RADAR_97ab7c24_Tx: ComBitPosition=198, ComBitSize=1, ComSignalInitValue=0, ComSignalType=BOOLEAN, ComHandleId=2837, ComSystemTemplateSystemSignalRef=DET_HVC_FLAG_134
            DET_RANGE_VELOCITY_ERR_136_oRDR_DETECTION_133_136_oPCAN_RADAR_69dce805_Tx: ComBitPosition=400, ComBitSize=8, ComSignalInitValue=0, ComSignalType=UINT8, ComHandleId=2870, ComSystemTemplateSystemSignalRef=DET_RANGE_VELOCITY_ERR_136
            DET_AZIMUTH_136_oRDR_DETECTION_133_136_oPCAN_RADAR_035aa229_Tx: ComBitPosition=424, ComBitSize=13, ComSignalInitValue=0, ComSignalType=UINT16, ComHandleId=2803, ComSystemTemplateSystemSignalRef=DET_AZIMUTH_136
            DET_RANGE_VELOCITY_133_oRDR_DETECTION_133_136_oPCAN_RADAR_cb479fb5_Tx: ComBitPosition=48, ComBitSize=15, ComSignalInitValue=16384, ComSignalType=UINT16, ComHandleId=2863, ComSystemTemplateSystemSignalRef=DET_RANGE_VELOCITY_133
            DET_SNR_134_oRDR_DETECTION_133_136_oPCAN_RADAR_cdd9df84_Tx: ComBitPosition=232, ComBitSize=8, ComSignalInitValue=0, ComSignalType=UINT8, ComHandleId=2876, ComSystemTemplateSystemSignalRef=DET_SNR_134
            DET_BI_STATIC_FLAG_136_oRDR_DETECTION_133_136_oPCAN_RADAR_5576e2ac_Tx: ComBitPosition=440, ComBitSize=1, ComSignalInitValue=0, ComSignalType=BOOLEAN, ComHandleId=2815, ComSystemTemplateSystemSignalRef=DET_BI_STATIC_FLAG_136
            DET_RANGE_136_oRDR_DETECTION_133_136_oPCAN_RADAR_13c1d192_Tx: ComBitPosition=360, ComBitSize=15, ComSignalInitValue=0, ComSignalType=UINT16, ComHandleId=2858, ComSystemTemplateSystemSignalRef=DET_RANGE_136
            DET_CONFD_ELEVATION_136_oRDR_DETECTION_133_136_oPCAN_RADAR_0329a919_Tx: ComBitPosition=437, ComBitSize=2, ComSignalInitValue=0, ComSignalType=UINT8, ComHandleId=2823, ComSystemTemplateSystemSignalRef=DET_CONFD_ELEVATION_136
            DET_ELEVATION_ERR_134_oRDR_DETECTION_133_136_oPCAN_RADAR_a4404a3b_Tx: ComBitPosition=192, ComBitSize=6, ComSignalInitValue=0, ComSignalType=UINT8, ComHandleId=2829, ComSystemTemplateSystemSignalRef=DET_ELEVATION_ERR_134
            DET_RANGE_VELOCITY_ERR_135_oRDR_DETECTION_133_136_oPCAN_RADAR_0d3c93fb_Tx: ComBitPosition=288, ComBitSize=8, ComSignalInitValue=0, ComSignalType=UINT8, ComHandleId=2869, ComSystemTemplateSystemSignalRef=DET_RANGE_VELOCITY_ERR_135
            DET_SUPER_RES_TARGET_135_oRDR_DETECTION_133_136_oPCAN_RADAR_69302374_Tx: ComBitPosition=311, ComBitSize=1, ComSignalInitValue=0, ComSignalType=BOOLEAN, ComHandleId=2881, ComSystemTemplateSystemSignalRef=DET_SUPER_RES_TARGET_135
            DET_RANGE_133_oRDR_DETECTION_133_136_oPCAN_RADAR_bee15d90_Tx: ComBitPosition=24, ComBitSize=15, ComSignalInitValue=0, ComSignalType=UINT16, ComHandleId=2855, ComSystemTemplateSystemSignalRef=DET_RANGE_133
            DET_CONFD_ELEVATION_133_oRDR_DETECTION_133_136_oPCAN_RADAR_ae09251b_Tx: ComBitPosition=101, ComBitSize=2, ComSignalInitValue=0, ComSignalType=UINT8, ComHandleId=2820, ComSystemTemplateSystemSignalRef=DET_CONFD_ELEVATION_133
            DET_AZIMUTH_ERR_136_oRDR_DETECTION_133_136_oPCAN_RADAR_a7ef37dc_Tx: ComBitPosition=441, ComBitSize=7, ComSignalInitValue=0, ComSignalType=UINT8, ComHandleId=2807, ComSystemTemplateSystemSignalRef=DET_AZIMUTH_ERR_136
            DET_CONFD_AZIMUTH_135_oRDR_DETECTION_133_136_oPCAN_RADAR_655cd31d_Tx: ComBitPosition=342, ComBitSize=2, ComSignalInitValue=0, ComSignalType=UINT8, ComHandleId=2818, ComSystemTemplateSystemSignalRef=DET_CONFD_AZIMUTH_135
            DET_SNR_135_oRDR_DETECTION_133_136_oPCAN_RADAR_58a90b11_Tx: ComBitPosition=344, ComBitSize=8, ComSignalInitValue=0, ComSignalType=UINT8, ComHandleId=2877, ComSystemTemplateSystemSignalRef=DET_SNR_135
            DET_MH_SCAN_INDEX_4LSB_133_136_oRDR_DETECTION_133_136_oPCAN_RADAR_bef039fa_Tx: ComBitPosition=476, ComBitSize=4, ComSignalInitValue=0, ComSignalType=UINT8, ComHandleId=2846, ComSystemTemplateSystemSignalRef=DET_MH_SCAN_INDEX_4LSB_133_136
            DET_RANGE_135_oRDR_DETECTION_133_136_oPCAN_RADAR_7721aa6c_Tx: ComBitPosition=248, ComBitSize=15, ComSignalInitValue=0, ComSignalType=UINT16, ComHandleId=2857, ComSystemTemplateSystemSignalRef=DET_RANGE_135
            DET_AZIMUTH_ERR_133_oRDR_DETECTION_133_136_oPCAN_RADAR_0acfbbde_Tx: ComBitPosition=105, ComBitSize=7, ComSignalInitValue=0, ComSignalType=UINT8, ComHandleId=2804, ComSystemTemplateSystemSignalRef=DET_AZIMUTH_ERR_133
            DET_RCS_133_oRDR_DETECTION_133_136_oPCAN_RADAR_4cc7a8ef_Tx: ComBitPosition=128, ComBitSize=8, ComSignalInitValue=128, ComSignalType=UINT8, ComHandleId=2871, ComSystemTemplateSystemSignalRef=DET_RCS_133
            DET_HVC_FLAG_136_oRDR_DETECTION_133_136_oPCAN_RADAR_663bd34f_Tx: ComBitPosition=422, ComBitSize=1, ComSignalInitValue=0, ComSignalType=BOOLEAN, ComHandleId=2839, ComSystemTemplateSystemSignalRef=DET_HVC_FLAG_136
            DET_CONFD_AZIMUTH_133_oRDR_DETECTION_133_136_oPCAN_RADAR_ac9c24e1_Tx: ComBitPosition=118, ComBitSize=2, ComSignalInitValue=0, ComSignalType=UINT8, ComHandleId=2816, ComSystemTemplateSystemSignalRef=DET_CONFD_AZIMUTH_133
            DET_RANGE_ERR_134_oRDR_DETECTION_133_136_oPCAN_RADAR_45b9c490_Tx: ComBitPosition=152, ComBitSize=7, ComSignalInitValue=0, ComSignalType=UINT8, ComHandleId=2860, ComSystemTemplateSystemSignalRef=DET_RANGE_ERR_134
            DET_RANGE_VELOCITY_ERR_133_oRDR_DETECTION_133_136_oPCAN_RADAR_c4fc6407_Tx: ComBitPosition=64, ComBitSize=8, ComSignalInitValue=0, ComSignalType=UINT8, ComHandleId=2867, ComSystemTemplateSystemSignalRef=DET_RANGE_VELOCITY_ERR_133
            DET_AZIMUTH_ERR_135_oRDR_DETECTION_133_136_oPCAN_RADAR_c30f4c22_Tx: ComBitPosition=329, ComBitSize=7, ComSignalInitValue=0, ComSignalType=UINT8, ComHandleId=2806, ComSystemTemplateSystemSignalRef=DET_AZIMUTH_ERR_135
            DET_BI_STATIC_FLAG_134_oRDR_DETECTION_133_136_oPCAN_RADAR_a4e64dc7_Tx: ComBitPosition=216, ComBitSize=1, ComSignalInitValue=0, ComSignalType=BOOLEAN, ComHandleId=2813, ComSystemTemplateSystemSignalRef=DET_BI_STATIC_FLAG_134
            DET_ELEVATION_136_oRDR_DETECTION_133_136_oPCAN_RADAR_d2e97d25_Tx: ComBitPosition=408, ComBitSize=8, ComSignalInitValue=0, ComSignalType=UINT8, ComHandleId=2827, ComSystemTemplateSystemSignalRef=DET_ELEVATION_136
            DET_ELEVATION_135_oRDR_DETECTION_133_136_oPCAN_RADAR_b60906db_Tx: ComBitPosition=296, ComBitSize=8, ComSignalInitValue=0, ComSignalType=UINT8, ComHandleId=2826, ComSystemTemplateSystemSignalRef=DET_ELEVATION_135
            DET_RANGE_VELOCITY_135_oRDR_DETECTION_133_136_oPCAN_RADAR_02876849_Tx: ComBitPosition=272, ComBitSize=15, ComSignalInitValue=16384, ComSignalType=UINT16, ComHandleId=2865, ComSystemTemplateSystemSignalRef=DET_RANGE_VELOCITY_135
            DET_RANGE_VELOCITY_ERR_134_oRDR_DETECTION_133_136_oPCAN_RADAR_984c476e_Tx: ComBitPosition=176, ComBitSize=8, ComSignalInitValue=0, ComSignalType=UINT8, ComHandleId=2868, ComSystemTemplateSystemSignalRef=DET_RANGE_VELOCITY_ERR_134
            DET_RANGE_134_oRDR_DETECTION_133_136_oPCAN_RADAR_e2517ef9_Tx: ComBitPosition=136, ComBitSize=15, ComSignalInitValue=0, ComSignalType=UINT16, ComHandleId=2856, ComSystemTemplateSystemSignalRef=DET_RANGE_134
            DET_AZIMUTH_133_oRDR_DETECTION_133_136_oPCAN_RADAR_ae7a2e2b_Tx: ComBitPosition=88, ComBitSize=13, ComSignalInitValue=0, ComSignalType=UINT16, ComHandleId=2800, ComSystemTemplateSystemSignalRef=DET_AZIMUTH_133
            DET_ELEVATION_ERR_136_oRDR_DETECTION_133_136_oPCAN_RADAR_55d0e550_Tx: ComBitPosition=416, ComBitSize=6, ComSignalInitValue=0, ComSignalType=UINT8, ComHandleId=2831, ComSystemTemplateSystemSignalRef=DET_ELEVATION_ERR_136
            DET_CONFD_ELEVATION_134_oRDR_DETECTION_133_136_oPCAN_RADAR_f2b90672_Tx: ComBitPosition=213, ComBitSize=2, ComSignalInitValue=0, ComSignalType=UINT8, ComHandleId=2821, ComSystemTemplateSystemSignalRef=DET_CONFD_ELEVATION_134
            DET_SNR_133_oRDR_DETECTION_133_136_oPCAN_RADAR_9169fced_Tx: ComBitPosition=120, ComBitSize=8, ComSignalInitValue=0, ComSignalType=UINT8, ComHandleId=2875, ComSystemTemplateSystemSignalRef=DET_SNR_133
            DET_AZIMUTH_135_oRDR_DETECTION_133_136_oPCAN_RADAR_67bad9d7_Tx: ComBitPosition=312, ComBitSize=13, ComSignalInitValue=0, ComSignalType=UINT16, ComHandleId=2802, ComSystemTemplateSystemSignalRef=DET_AZIMUTH_135
            DET_RCS_136_oRDR_DETECTION_133_136_oPCAN_RADAR_e1e724ed_Tx: ComBitPosition=464, ComBitSize=8, ComSignalInitValue=128, ComSignalType=UINT8, ComHandleId=2874, ComSystemTemplateSystemSignalRef=DET_RCS_136
            DET_EXISTENCE_PROB_133_oRDR_DETECTION_133_136_oPCAN_RADAR_2a6f1c32_Tx: ComBitPosition=112, ComBitSize=6, ComSignalInitValue=0, ComSignalType=UINT8, ComHandleId=2832, ComSystemTemplateSystemSignalRef=DET_EXISTENCE_PROB_133
            DET_EXISTENCE_PROB_134_oRDR_DETECTION_133_136_oPCAN_RADAR_76df3f5b_Tx: ComBitPosition=224, ComBitSize=6, ComSignalInitValue=0, ComSignalType=UINT8, ComHandleId=2833, ComSystemTemplateSystemSignalRef=DET_EXISTENCE_PROB_134
            DET_RANGE_ERR_135_oRDR_DETECTION_133_136_oPCAN_RADAR_d0c91005_Tx: ComBitPosition=264, ComBitSize=7, ComSignalInitValue=0, ComSignalType=UINT8, ComHandleId=2861, ComSystemTemplateSystemSignalRef=DET_RANGE_ERR_135
            DET_RANGE_ERR_136_oRDR_DETECTION_133_136_oPCAN_RADAR_b4296bfb_Tx: ComBitPosition=376, ComBitSize=7, ComSignalInitValue=0, ComSignalType=UINT8, ComHandleId=2862, ComSystemTemplateSystemSignalRef=DET_RANGE_ERR_136
            DET_SUPER_RES_TARGET_133_oRDR_DETECTION_133_136_oPCAN_RADAR_a0f0d488_Tx: ComBitPosition=87, ComBitSize=1, ComSignalInitValue=0, ComSignalType=BOOLEAN, ComHandleId=2879, ComSystemTemplateSystemSignalRef=DET_SUPER_RES_TARGET_133
            DET_EXISTENCE_PROB_135_oRDR_DETECTION_133_136_oPCAN_RADAR_e3afebce_Tx: ComBitPosition=336, ComBitSize=6, ComSignalInitValue=0, ComSignalType=UINT8, ComHandleId=2834, ComSystemTemplateSystemSignalRef=DET_EXISTENCE_PROB_135
            DET_MH_CRC16_133_136_oRDR_DETECTION_133_136_oPCAN_RADAR_f6afbd41_Tx: ComBitPosition=0, ComBitSize=16, ComSignalInitValue=0, ComSignalType=UINT16, ComHandleId=2844, ComSystemTemplateSystemSignalRef=DET_MH_CRC16_133_136
            DET_HVC_FLAG_133_oRDR_DETECTION_133_136_oPCAN_RADAR_cb1b5f4d_Tx: ComBitPosition=86, ComBitSize=1, ComSignalInitValue=0, ComSignalType=BOOLEAN, ComHandleId=2836, ComSystemTemplateSystemSignalRef=DET_HVC_FLAG_133
            DET_ELEVATION_134_oRDR_DETECTION_133_136_oPCAN_RADAR_2379d24e_Tx: ComBitPosition=184, ComBitSize=8, ComSignalInitValue=0, ComSignalType=UINT8, ComHandleId=2825, ComSystemTemplateSystemSignalRef=DET_ELEVATION_134
            DET_CONFD_AZIMUTH_134_oRDR_DETECTION_133_136_oPCAN_RADAR_f02c0788_Tx: ComBitPosition=230, ComBitSize=2, ComSignalInitValue=0, ComSignalType=UINT8, ComHandleId=2817, ComSystemTemplateSystemSignalRef=DET_CONFD_AZIMUTH_134
            DET_ELEVATION_ERR_133_oRDR_DETECTION_133_136_oPCAN_RADAR_f8f06952_Tx: ComBitPosition=80, ComBitSize=6, ComSignalInitValue=0, ComSignalType=UINT8, ComHandleId=2828, ComSystemTemplateSystemSignalRef=DET_ELEVATION_ERR_133
            DET_BI_STATIC_FLAG_133_oRDR_DETECTION_133_136_oPCAN_RADAR_f8566eae_Tx: ComBitPosition=104, ComBitSize=1, ComSignalInitValue=0, ComSignalType=BOOLEAN, ComHandleId=2812, ComSystemTemplateSystemSignalRef=DET_BI_STATIC_FLAG_133
            DET_ELEVATION_133_oRDR_DETECTION_133_136_oPCAN_RADAR_7fc9f127_Tx: ComBitPosition=72, ComBitSize=8, ComSignalInitValue=0, ComSignalType=UINT8, ComHandleId=2824, ComSystemTemplateSystemSignalRef=DET_ELEVATION_133
            DET_BI_STATIC_FLAG_135_oRDR_DETECTION_133_136_oPCAN_RADAR_31969952_Tx: ComBitPosition=328, ComBitSize=1, ComSignalInitValue=0, ComSignalType=BOOLEAN, ComHandleId=2814, ComSystemTemplateSystemSignalRef=DET_BI_STATIC_FLAG_135
            DET_CONFD_ELEVATION_135_oRDR_DETECTION_133_136_oPCAN_RADAR_67c9d2e7_Tx: ComBitPosition=325, ComBitSize=2, ComSignalInitValue=0, ComSignalType=UINT8, ComHandleId=2822, ComSystemTemplateSystemSignalRef=DET_CONFD_ELEVATION_135
            DET_RANGE_ERR_133_oRDR_DETECTION_133_136_oPCAN_RADAR_1909e7f9_Tx: ComBitPosition=40, ComBitSize=7, ComSignalInitValue=0, ComSignalType=UINT8, ComHandleId=2859, ComSystemTemplateSystemSignalRef=DET_RANGE_ERR_133
            DET_HVC_FLAG_135_oRDR_DETECTION_133_136_oPCAN_RADAR_02dba8b1_Tx: ComBitPosition=310, ComBitSize=1, ComSignalInitValue=0, ComSignalType=BOOLEAN, ComHandleId=2838, ComSystemTemplateSystemSignalRef=DET_HVC_FLAG_135
            DET_CONFD_AZIMUTH_136_oRDR_DETECTION_133_136_oPCAN_RADAR_01bca8e3_Tx: ComBitPosition=454, ComBitSize=2, ComSignalInitValue=0, ComSignalType=UINT8, ComHandleId=2819, ComSystemTemplateSystemSignalRef=DET_CONFD_AZIMUTH_136
            DET_IDM_134_oRDR_DETECTION_133_136_oPCAN_RADAR_1cf94799_Tx: ComBitPosition=175, ComBitSize=1, ComSignalInitValue=0, ComSignalType=UINT8, ComHandleId=2841, ComSystemTemplateSystemSignalRef=DET_IDM_134
            DET_MTD_136_oRDR_DETECTION_133_136_oPCAN_RADAR_8bdada29_Tx: ComBitPosition=383, ComBitSize=1, ComSignalInitValue=0, ComSignalType=UINT8, ComHandleId=2850, ComSystemTemplateSystemSignalRef=DET_MTD_136
            DET_MTD_133_oRDR_DETECTION_133_136_oPCAN_RADAR_26fa562b_Tx: ComBitPosition=47, ComBitSize=1, ComSignalInitValue=0, ComSignalType=UINT8, ComHandleId=2847, ComSystemTemplateSystemSignalRef=DET_MTD_133
            DET_IDM_133_oRDR_DETECTION_133_136_oPCAN_RADAR_404964f0_Tx: ComBitPosition=63, ComBitSize=1, ComSignalInitValue=0, ComSignalType=UINT8, ComHandleId=2840, ComSystemTemplateSystemSignalRef=DET_IDM_133
            DET_BELOW_RAIN_THOLD_134_oRDR_DETECTION_133_136_oPCAN_RADAR_27cb9e82_Tx: ComBitPosition=151, ComBitSize=1, ComSignalInitValue=0, ComSignalType=UINT8, ComHandleId=2809, ComSystemTemplateSystemSignalRef=DET_BELOW_RAIN_THOLD_134
            DET_BELOW_RAIN_THOLD_133_oRDR_DETECTION_133_136_oPCAN_RADAR_7b7bbdeb_Tx: ComBitPosition=39, ComBitSize=1, ComSignalInitValue=0, ComSignalType=UINT8, ComHandleId=2808, ComSystemTemplateSystemSignalRef=DET_BELOW_RAIN_THOLD_133
            DET_BELOW_RAIN_THOLD_136_oRDR_DETECTION_133_136_oPCAN_RADAR_d65b31e9_Tx: ComBitPosition=375, ComBitSize=1, ComSignalInitValue=0, ComSignalType=UINT8, ComHandleId=2811, ComSystemTemplateSystemSignalRef=DET_BELOW_RAIN_THOLD_136
            DET_MTD_134_oRDR_DETECTION_133_136_oPCAN_RADAR_7a4a7542_Tx: ComBitPosition=159, ComBitSize=1, ComSignalInitValue=0, ComSignalType=UINT8, ComHandleId=2848, ComSystemTemplateSystemSignalRef=DET_MTD_134
            DET_MTD_135_oRDR_DETECTION_133_136_oPCAN_RADAR_ef3aa1d7_Tx: ComBitPosition=271, ComBitSize=1, ComSignalInitValue=0, ComSignalType=UINT8, ComHandleId=2849, ComSystemTemplateSystemSignalRef=DET_MTD_135
            DET_IDM_135_oRDR_DETECTION_133_136_oPCAN_RADAR_8989930c_Tx: ComBitPosition=287, ComBitSize=1, ComSignalInitValue=0, ComSignalType=UINT8, ComHandleId=2842, ComSystemTemplateSystemSignalRef=DET_IDM_135
            DET_PROB_1STAZHYPO_135_oRDR_DETECTION_133_136_oPCAN_RADAR_7c8e491a_Tx: ComBitPosition=327, ComBitSize=1, ComSignalInitValue=0, ComSignalType=BOOLEAN, ComHandleId=2853, ComSystemTemplateSystemSignalRef=DET_PROB_1STAZHYPO_135
            DET_PROB_1STAZHYPO_136_oRDR_DETECTION_133_136_oPCAN_RADAR_186e32e4_Tx: ComBitPosition=439, ComBitSize=1, ComSignalInitValue=0, ComSignalType=BOOLEAN, ComHandleId=2854, ComSystemTemplateSystemSignalRef=DET_PROB_1STAZHYPO_136
            DET_IDM_136_oRDR_DETECTION_133_136_oPCAN_RADAR_ed69e8f2_Tx: ComBitPosition=399, ComBitSize=1, ComSignalInitValue=0, ComSignalType=UINT8, ComHandleId=2843, ComSystemTemplateSystemSignalRef=DET_IDM_136
            DET_PROB_1STAZHYPO_134_oRDR_DETECTION_133_136_oPCAN_RADAR_e9fe9d8f_Tx: ComBitPosition=215, ComBitSize=1, ComSignalInitValue=0, ComSignalType=BOOLEAN, ComHandleId=2852, ComSystemTemplateSystemSignalRef=DET_PROB_1STAZHYPO_134
            DET_BELOW_RAIN_THOLD_135_oRDR_DETECTION_133_136_oPCAN_RADAR_b2bb4a17_Tx: ComBitPosition=263, ComBitSize=1, ComSignalInitValue=0, ComSignalType=UINT8, ComHandleId=2810, ComSystemTemplateSystemSignalRef=DET_BELOW_RAIN_THOLD_135
            DET_PROB_1STAZHYPO_133_oRDR_DETECTION_133_136_oPCAN_RADAR_b54ebee6_Tx: ComBitPosition=103, ComBitSize=1, ComSignalInitValue=0, ComSignalType=BOOLEAN, ComHandleId=2851, ComSystemTemplateSystemSignalRef=DET_PROB_1STAZHYPO_133
        SG_Detections_153_156_oRDR_DETECTION_153_156_oPCAN_RADAR_2db98fbc_Tx: ComTransferProperty=TRIGGERED, ComHandleId=40, ComSystemTemplateSignalGroupRef=SG_Detections_153_156
          83 x ComGroupSignal, all with ComSignalEndianness=LITTLE_ENDIAN, ComTransferProperty=PENDING, ComSignalAccess=ACCESS_NEEDED_BY_SWC_OR_COM:
            DET_CONFD_ELEVATION_155_oRDR_DETECTION_153_156_oPCAN_RADAR_25b55b14_Tx: ComBitPosition=325, ComBitSize=2, ComSignalInitValue=0, ComSignalType=UINT8, ComHandleId=3237, ComSystemTemplateSystemSignalRef=DET_CONFD_ELEVATION_155
            DET_MH_CRC16_153_156_oRDR_DETECTION_153_156_oPCAN_RADAR_a9315db7_Tx: ComBitPosition=0, ComBitSize=16, ComSignalInitValue=0, ComSignalType=UINT16, ComHandleId=3259, ComSystemTemplateSystemSignalRef=DET_MH_CRC16_153_156
            DET_RANGE_154_oRDR_DETECTION_153_156_oPCAN_RADAR_a02df70a_Tx: ComBitPosition=136, ComBitSize=15, ComSignalInitValue=0, ComSignalType=UINT16, ComHandleId=3271, ComSystemTemplateSystemSignalRef=DET_RANGE_154
            DET_RCS_153_oRDR_DETECTION_153_156_oPCAN_RADAR_0ebb211c_Tx: ComBitPosition=128, ComBitSize=8, ComSignalInitValue=128, ComSignalType=UINT8, ComHandleId=3286, ComSystemTemplateSystemSignalRef=DET_RCS_153
            DET_SNR_153_oRDR_DETECTION_153_156_oPCAN_RADAR_d315751e_Tx: ComBitPosition=120, ComBitSize=8, ComSignalInitValue=0, ComSignalType=UINT8, ComHandleId=3290, ComSystemTemplateSystemSignalRef=DET_SNR_153
            DET_EXISTENCE_PROB_153_oRDR_DETECTION_153_156_oPCAN_RADAR_681395c1_Tx: ComBitPosition=112, ComBitSize=6, ComSignalInitValue=0, ComSignalType=UINT8, ComHandleId=3247, ComSystemTemplateSystemSignalRef=DET_EXISTENCE_PROB_153
            DET_CONFD_ELEVATION_154_oRDR_DETECTION_153_156_oPCAN_RADAR_b0c58f81_Tx: ComBitPosition=213, ComBitSize=2, ComSignalInitValue=0, ComSignalType=UINT8, ComHandleId=3236, ComSystemTemplateSystemSignalRef=DET_CONFD_ELEVATION_154
            DET_RANGE_156_oRDR_DETECTION_153_156_oPCAN_RADAR_51bd5861_Tx: ComBitPosition=360, ComBitSize=15, ComSignalInitValue=0, ComSignalType=UINT16, ComHandleId=3273, ComSystemTemplateSystemSignalRef=DET_RANGE_156
            DET_HVC_FLAG_156_oRDR_DETECTION_153_156_oPCAN_RADAR_24475abc_Tx: ComBitPosition=422, ComBitSize=1, ComSignalInitValue=0, ComSignalType=BOOLEAN, ComHandleId=3254, ComSystemTemplateSystemSignalRef=DET_HVC_FLAG_156
            DET_BI_STATIC_FLAG_154_oRDR_DETECTION_153_156_oPCAN_RADAR_e69ac434_Tx: ComBitPosition=216, ComBitSize=1, ComSignalInitValue=0, ComSignalType=BOOLEAN, ComHandleId=3228, ComSystemTemplateSystemSignalRef=DET_BI_STATIC_FLAG_154
            DET_CONFD_AZIMUTH_153_oRDR_DETECTION_153_156_oPCAN_RADAR_eee0ad12_Tx: ComBitPosition=118, ComBitSize=2, ComSignalInitValue=0, ComSignalType=UINT8, ComHandleId=3231, ComSystemTemplateSystemSignalRef=DET_CONFD_AZIMUTH_153
            DET_ELEVATION_ERR_154_oRDR_DETECTION_153_156_oPCAN_RADAR_e63cc3c8_Tx: ComBitPosition=192, ComBitSize=6, ComSignalInitValue=0, ComSignalType=UINT8, ComHandleId=3244, ComSystemTemplateSystemSignalRef=DET_ELEVATION_ERR_154
            DET_RANGE_VELOCITY_153_oRDR_DETECTION_153_156_oPCAN_RADAR_893b1646_Tx: ComBitPosition=48, ComBitSize=15, ComSignalInitValue=16384, ComSignalType=UINT16, ComHandleId=3278, ComSystemTemplateSystemSignalRef=DET_RANGE_VELOCITY_153
            DET_EXISTENCE_PROB_156_oRDR_DETECTION_153_156_oPCAN_RADAR_c53319c3_Tx: ComBitPosition=448, ComBitSize=6, ComSignalInitValue=0, ComSignalType=UINT8, ComHandleId=3250, ComSystemTemplateSystemSignalRef=DET_EXISTENCE_PROB_156
            DET_AZIMUTH_ERR_156_oRDR_DETECTION_153_156_oPCAN_RADAR_e593be2f_Tx: ComBitPosition=441, ComBitSize=7, ComSignalInitValue=0, ComSignalType=UINT8, ComHandleId=3222, ComSystemTemplateSystemSignalRef=DET_AZIMUTH_ERR_156
            DET_RANGE_VELOCITY_155_oRDR_DETECTION_153_156_oPCAN_RADAR_40fbe1ba_Tx: ComBitPosition=272, ComBitSize=15, ComSignalInitValue=16384, ComSignalType=UINT16, ComHandleId=3280, ComSystemTemplateSystemSignalRef=DET_RANGE_VELOCITY_155
            DET_CONFD_ELEVATION_156_oRDR_DETECTION_153_156_oPCAN_RADAR_415520ea_Tx: ComBitPosition=437, ComBitSize=2, ComSignalInitValue=0, ComSignalType=UINT8, ComHandleId=3238, ComSystemTemplateSystemSignalRef=DET_CONFD_ELEVATION_156
            DET_ELEVATION_155_oRDR_DETECTION_153_156_oPCAN_RADAR_f4758f28_Tx: ComBitPosition=296, ComBitSize=8, ComSignalInitValue=0, ComSignalType=UINT8, ComHandleId=3241, ComSystemTemplateSystemSignalRef=DET_ELEVATION_155
            DET_MH_SCAN_INDEX_4LSB_153_156_oRDR_DETECTION_153_156_oPCAN_RADAR_e16ed90c_Tx: ComBitPosition=476, ComBitSize=4, ComSignalInitValue=0, ComSignalType=UINT8, ComHandleId=3261, ComSystemTemplateSystemSignalRef=DET_MH_SCAN_INDEX_4LSB_153_156
            DET_BI_STATIC_FLAG_155_oRDR_DETECTION_153_156_oPCAN_RADAR_73ea10a1_Tx: ComBitPosition=328, ComBitSize=1, ComSignalInitValue=0, ComSignalType=BOOLEAN, ComHandleId=3229, ComSystemTemplateSystemSignalRef=DET_BI_STATIC_FLAG_155
            DET_RANGE_ERR_154_oRDR_DETECTION_153_156_oPCAN_RADAR_07c54d63_Tx: ComBitPosition=152, ComBitSize=7, ComSignalInitValue=0, ComSignalType=UINT8, ComHandleId=3275, ComSystemTemplateSystemSignalRef=DET_RANGE_ERR_154
            DET_HVC_FLAG_153_oRDR_DETECTION_153_156_oPCAN_RADAR_8967d6be_Tx: ComBitPosition=86, ComBitSize=1, ComSignalInitValue=0, ComSignalType=BOOLEAN, ComHandleId=3251, ComSystemTemplateSystemSignalRef=DET_HVC_FLAG_153
            DET_ELEVATION_154_oRDR_DETECTION_153_156_oPCAN_RADAR_61055bbd_Tx: ComBitPosition=184, ComBitSize=8, ComSignalInitValue=0, ComSignalType=UINT8, ComHandleId=3240, ComSystemTemplateSystemSignalRef=DET_ELEVATION_154
            DET_HVC_FLAG_154_oRDR_DETECTION_153_156_oPCAN_RADAR_d5d7f5d7_Tx: ComBitPosition=198, ComBitSize=1, ComSignalInitValue=0, ComSignalType=BOOLEAN, ComHandleId=3252, ComSystemTemplateSystemSignalRef=DET_HVC_FLAG_154
            DET_CONFD_AZIMUTH_155_oRDR_DETECTION_153_156_oPCAN_RADAR_27205aee_Tx: ComBitPosition=342, ComBitSize=2, ComSignalInitValue=0, ComSignalType=UINT8, ComHandleId=3233, ComSystemTemplateSystemSignalRef=DET_CONFD_AZIMUTH_155
            DET_CONFD_AZIMUTH_154_oRDR_DETECTION_153_156_oPCAN_RADAR_b2508e7b_Tx: ComBitPosition=230, ComBitSize=2, ComSignalInitValue=0, ComSignalType=UINT8, ComHandleId=3232, ComSystemTemplateSystemSignalRef=DET_CONFD_AZIMUTH_154
            DET_ELEVATION_153_oRDR_DETECTION_153_156_oPCAN_RADAR_3db578d4_Tx: ComBitPosition=72, ComBitSize=8, ComSignalInitValue=0, ComSignalType=UINT8, ComHandleId=3239, ComSystemTemplateSystemSignalRef=DET_ELEVATION_153
            DET_SNR_155_oRDR_DETECTION_153_156_oPCAN_RADAR_1ad582e2_Tx: ComBitPosition=344, ComBitSize=8, ComSignalInitValue=0, ComSignalType=UINT8, ComHandleId=3292, ComSystemTemplateSystemSignalRef=DET_SNR_155
            DET_RCS_154_oRDR_DETECTION_153_156_oPCAN_RADAR_520b0275_Tx: ComBitPosition=240, ComBitSize=8, ComSignalInitValue=128, ComSignalType=UINT8, ComHandleId=3287, ComSystemTemplateSystemSignalRef=DET_RCS_154
            DET_EXISTENCE_PROB_155_oRDR_DETECTION_153_156_oPCAN_RADAR_a1d3623d_Tx: ComBitPosition=336, ComBitSize=6, ComSignalInitValue=0, ComSignalType=UINT8, ComHandleId=3249, ComSystemTemplateSystemSignalRef=DET_EXISTENCE_PROB_155
            DET_MH_CYCLE_COUNTER_153_156_oRDR_DETECTION_153_156_oPCAN_RADAR_2d44fc80_Tx: ComBitPosition=16, ComBitSize=8, ComSignalInitValue=0, ComSignalType=UINT8, ComHandleId=3260, ComSystemTemplateSystemSignalRef=DET_MH_CYCLE_COUNTER_153_156
            DET_RCS_156_oRDR_DETECTION_153_156_oPCAN_RADAR_a39bad1e_Tx: ComBitPosition=464, ComBitSize=8, ComSignalInitValue=128, ComSignalType=UINT8, ComHandleId=3289, ComSystemTemplateSystemSignalRef=DET_RCS_156
            DET_RCS_155_oRDR_DETECTION_153_156_oPCAN_RADAR_c77bd6e0_Tx: ComBitPosition=352, ComBitSize=8, ComSignalInitValue=128, ComSignalType=UINT8, ComHandleId=3288, ComSystemTemplateSystemSignalRef=DET_RCS_155
            DET_SNR_154_oRDR_DETECTION_153_156_oPCAN_RADAR_8fa55677_Tx: ComBitPosition=232, ComBitSize=8, ComSignalInitValue=0, ComSignalType=UINT8, ComHandleId=3291, ComSystemTemplateSystemSignalRef=DET_SNR_154
            DET_SUPER_RES_TARGET_156_oRDR_DETECTION_153_156_oPCAN_RADAR_4facd179_Tx: ComBitPosition=423, ComBitSize=1, ComSignalInitValue=0, ComSignalType=BOOLEAN, ComHandleId=3297, ComSystemTemplateSystemSignalRef=DET_SUPER_RES_TARGET_156
            DET_HVC_FLAG_155_oRDR_DETECTION_153_156_oPCAN_RADAR_40a72142_Tx: ComBitPosition=310, ComBitSize=1, ComSignalInitValue=0, ComSignalType=BOOLEAN, ComHandleId=3253, ComSystemTemplateSystemSignalRef=DET_HVC_FLAG_155
            DET_RANGE_VELOCITY_ERR_155_oRDR_DETECTION_153_156_oPCAN_RADAR_4f401a08_Tx: ComBitPosition=288, ComBitSize=8, ComSignalInitValue=0, ComSignalType=UINT8, ComHandleId=3284, ComSystemTemplateSystemSignalRef=DET_RANGE_VELOCITY_ERR_155
            DET_CONFD_ELEVATION_153_oRDR_DETECTION_153_156_oPCAN_RADAR_ec75ace8_Tx: ComBitPosition=101, ComBitSize=2, ComSignalInitValue=0, ComSignalType=UINT8, ComHandleId=3235, ComSystemTemplateSystemSignalRef=DET_CONFD_ELEVATION_153
            DET_RANGE_VELOCITY_ERR_154_oRDR_DETECTION_153_156_oPCAN_RADAR_da30ce9d_Tx: ComBitPosition=176, ComBitSize=8, ComSignalInitValue=0, ComSignalType=UINT8, ComHandleId=3283, ComSystemTemplateSystemSignalRef=DET_RANGE_VELOCITY_ERR_154
            DET_AZIMUTH_156_oRDR_DETECTION_153_156_oPCAN_RADAR_41262bda_Tx: ComBitPosition=424, ComBitSize=13, ComSignalInitValue=0, ComSignalType=UINT16, ComHandleId=3218, ComSystemTemplateSystemSignalRef=DET_AZIMUTH_156
            DET_RANGE_ERR_153_oRDR_DETECTION_153_156_oPCAN_RADAR_5b756e0a_Tx: ComBitPosition=40, ComBitSize=7, ComSignalInitValue=0, ComSignalType=UINT8, ComHandleId=3274, ComSystemTemplateSystemSignalRef=DET_RANGE_ERR_153
            DET_CONFD_AZIMUTH_156_oRDR_DETECTION_153_156_oPCAN_RADAR_43c02110_Tx: ComBitPosition=454, ComBitSize=2, ComSignalInitValue=0, ComSignalType=UINT8, ComHandleId=3234, ComSystemTemplateSystemSignalRef=DET_CONFD_AZIMUTH_156
            DET_SNR_156_oRDR_DETECTION_153_156_oPCAN_RADAR_7e35f91c_Tx: ComBitPosition=456, ComBitSize=8, ComSignalInitValue=0, ComSignalType=UINT8, ComHandleId=3293, ComSystemTemplateSystemSignalRef=DET_SNR_156
            DET_SUPER_RES_TARGET_153_oRDR_DETECTION_153_156_oPCAN_RADAR_e28c5d7b_Tx: ComBitPosition=87, ComBitSize=1, ComSignalInitValue=0, ComSignalType=BOOLEAN, ComHandleId=3294, ComSystemTemplateSystemSignalRef=DET_SUPER_RES_TARGET_153
            DET_AZIMUTH_155_oRDR_DETECTION_153_156_oPCAN_RADAR_25c65024_Tx: ComBitPosition=312, ComBitSize=13, ComSignalInitValue=0, ComSignalType=UINT16, ComHandleId=3217, ComSystemTemplateSystemSignalRef=DET_AZIMUTH_155
            DET_BI_STATIC_FLAG_153_oRDR_DETECTION_153_156_oPCAN_RADAR_ba2ae75d_Tx: ComBitPosition=104, ComBitSize=1, ComSignalInitValue=0, ComSignalType=BOOLEAN, ComHandleId=3227, ComSystemTemplateSystemSignalRef=DET_BI_STATIC_FLAG_153
            DET_RANGE_VELOCITY_ERR_156_oRDR_DETECTION_153_156_oPCAN_RADAR_2ba061f6_Tx: ComBitPosition=400, ComBitSize=8, ComSignalInitValue=0, ComSignalType=UINT8, ComHandleId=3285, ComSystemTemplateSystemSignalRef=DET_RANGE_VELOCITY_ERR_156
            DET_AZIMUTH_ERR_153_oRDR_DETECTION_153_156_oPCAN_RADAR_48b3322d_Tx: ComBitPosition=105, ComBitSize=7, ComSignalInitValue=0, ComSignalType=UINT8, ComHandleId=3219, ComSystemTemplateSystemSignalRef=DET_AZIMUTH_ERR_153
            DET_BI_STATIC_FLAG_156_oRDR_DETECTION_153_156_oPCAN_RADAR_170a6b5f_Tx: ComBitPosition=440, ComBitSize=1, ComSignalInitValue=0, ComSignalType=BOOLEAN, ComHandleId=3230, ComSystemTemplateSystemSignalRef=DET_BI_STATIC_FLAG_156
            DET_RANGE_ERR_156_oRDR_DETECTION_153_156_oPCAN_RADAR_f655e208_Tx: ComBitPosition=376, ComBitSize=7, ComSignalInitValue=0, ComSignalType=UINT8, ComHandleId=3277, ComSystemTemplateSystemSignalRef=DET_RANGE_ERR_156
            DET_RANGE_ERR_155_oRDR_DETECTION_153_156_oPCAN_RADAR_92b599f6_Tx: ComBitPosition=264, ComBitSize=7, ComSignalInitValue=0, ComSignalType=UINT8, ComHandleId=3276, ComSystemTemplateSystemSignalRef=DET_RANGE_ERR_155
            DET_RANGE_155_oRDR_DETECTION_153_156_oPCAN_RADAR_355d239f_Tx: ComBitPosition=248, ComBitSize=15, ComSignalInitValue=0, ComSignalType=UINT16, ComHandleId=3272, ComSystemTemplateSystemSignalRef=DET_RANGE_155
            DET_EXISTENCE_PROB_154_oRDR_DETECTION_153_156_oPCAN_RADAR_34a3b6a8_Tx: ComBitPosition=224, ComBitSize=6, ComSignalInitValue=0, ComSignalType=UINT8, ComHandleId=3248, ComSystemTemplateSystemSignalRef=DET_EXISTENCE_PROB_154
            DET_SUPER_RES_TARGET_154_oRDR_DETECTION_153_156_oPCAN_RADAR_be3c7e12_Tx: ComBitPosition=199, ComBitSize=1, ComSignalInitValue=0, ComSignalType=BOOLEAN, ComHandleId=3295, ComSystemTemplateSystemSignalRef=DET_SUPER_RES_TARGET_154
            DET_AZIMUTH_154_oRDR_DETECTION_153_156_oPCAN_RADAR_b0b684b1_Tx: ComBitPosition=200, ComBitSize=13, ComSignalInitValue=0, ComSignalType=UINT16, ComHandleId=3216, ComSystemTemplateSystemSignalRef=DET_AZIMUTH_154
            DET_RANGE_VELOCITY_154_oRDR_DETECTION_153_156_oPCAN_RADAR_d58b352f_Tx: ComBitPosition=160, ComBitSize=15, ComSignalInitValue=16384, ComSignalType=UINT16, ComHandleId=3279, ComSystemTemplateSystemSignalRef=DET_RANGE_VELOCITY_154
            DET_ELEVATION_ERR_156_oRDR_DETECTION_153_156_oPCAN_RADAR_17ac6ca3_Tx: ComBitPosition=416, ComBitSize=6, ComSignalInitValue=0, ComSignalType=UINT8, ComHandleId=3246, ComSystemTemplateSystemSignalRef=DET_ELEVATION_ERR_156
            DET_AZIMUTH_153_oRDR_DETECTION_153_156_oPCAN_RADAR_ec06a7d8_Tx: ComBitPosition=88, ComBitSize=13, ComSignalInitValue=0, ComSignalType=UINT16, ComHandleId=3215, ComSystemTemplateSystemSignalRef=DET_AZIMUTH_153
            DET_RANGE_VELOCITY_ERR_153_oRDR_DETECTION_153_156_oPCAN_RADAR_8680edf4_Tx: ComBitPosition=64, ComBitSize=8, ComSignalInitValue=0, ComSignalType=UINT8, ComHandleId=3282, ComSystemTemplateSystemSignalRef=DET_RANGE_VELOCITY_ERR_153
            DET_ELEVATION_ERR_155_oRDR_DETECTION_153_156_oPCAN_RADAR_734c175d_Tx: ComBitPosition=304, ComBitSize=6, ComSignalInitValue=0, ComSignalType=UINT8, ComHandleId=3245, ComSystemTemplateSystemSignalRef=DET_ELEVATION_ERR_155
            DET_ELEVATION_ERR_153_oRDR_DETECTION_153_156_oPCAN_RADAR_ba8ce0a1_Tx: ComBitPosition=80, ComBitSize=6, ComSignalInitValue=0, ComSignalType=UINT8, ComHandleId=3243, ComSystemTemplateSystemSignalRef=DET_ELEVATION_ERR_153
            DET_RANGE_153_oRDR_DETECTION_153_156_oPCAN_RADAR_fc9dd463_Tx: ComBitPosition=24, ComBitSize=15, ComSignalInitValue=0, ComSignalType=UINT16, ComHandleId=3270, ComSystemTemplateSystemSignalRef=DET_RANGE_153
            DET_AZIMUTH_ERR_155_oRDR_DETECTION_153_156_oPCAN_RADAR_8173c5d1_Tx: ComBitPosition=329, ComBitSize=7, ComSignalInitValue=0, ComSignalType=UINT8, ComHandleId=3221, ComSystemTemplateSystemSignalRef=DET_AZIMUTH_ERR_155
            DET_RANGE_VELOCITY_156_oRDR_DETECTION_153_156_oPCAN_RADAR_241b9a44_Tx: ComBitPosition=384, ComBitSize=15, ComSignalInitValue=16384, ComSignalType=UINT16, ComHandleId=3281, ComSystemTemplateSystemSignalRef=DET_RANGE_VELOCITY_156
            DET_SUPER_RES_TARGET_155_oRDR_DETECTION_153_156_oPCAN_RADAR_2b4caa87_Tx: ComBitPosition=311, ComBitSize=1, ComSignalInitValue=0, ComSignalType=BOOLEAN, ComHandleId=3296, ComSystemTemplateSystemSignalRef=DET_SUPER_RES_TARGET_155
            DET_AZIMUTH_ERR_154_oRDR_DETECTION_153_156_oPCAN_RADAR_14031144_Tx: ComBitPosition=217, ComBitSize=7, ComSignalInitValue=0, ComSignalType=UINT8, ComHandleId=3220, ComSystemTemplateSystemSignalRef=DET_AZIMUTH_ERR_154
            DET_ELEVATION_156_oRDR_DETECTION_153_156_oPCAN_RADAR_9095f4d6_Tx: ComBitPosition=408, ComBitSize=8, ComSignalInitValue=0, ComSignalType=UINT8, ComHandleId=3242, ComSystemTemplateSystemSignalRef=DET_ELEVATION_156
            DET_PROB_1STAZHYPO_154_oRDR_DETECTION_153_156_oPCAN_RADAR_ab82147c_Tx: ComBitPosition=215, ComBitSize=1, ComSignalInitValue=0, ComSignalType=BOOLEAN, ComHandleId=3267, ComSystemTemplateSystemSignalRef=DET_PROB_1STAZHYPO_154
            DET_PROB_1STAZHYPO_155_oRDR_DETECTION_153_156_oPCAN_RADAR_3ef2c0e9_Tx: ComBitPosition=327, ComBitSize=1, ComSignalInitValue=0, ComSignalType=BOOLEAN, ComHandleId=3268, ComSystemTemplateSystemSignalRef=DET_PROB_1STAZHYPO_155
            DET_BELOW_RAIN_THOLD_153_oRDR_DETECTION_153_156_oPCAN_RADAR_39073418_Tx: ComBitPosition=39, ComBitSize=1, ComSignalInitValue=0, ComSignalType=UINT8, ComHandleId=3223, ComSystemTemplateSystemSignalRef=DET_BELOW_RAIN_THOLD_153
            DET_BELOW_RAIN_THOLD_154_oRDR_DETECTION_153_156_oPCAN_RADAR_65b71771_Tx: ComBitPosition=151, ComBitSize=1, ComSignalInitValue=0, ComSignalType=UINT8, ComHandleId=3224, ComSystemTemplateSystemSignalRef=DET_BELOW_RAIN_THOLD_154
            DET_IDM_156_oRDR_DETECTION_153_156_oPCAN_RADAR_af156101_Tx: ComBitPosition=399, ComBitSize=1, ComSignalInitValue=0, ComSignalType=UINT8, ComHandleId=3258, ComSystemTemplateSystemSignalRef=DET_IDM_156
            DET_PROB_1STAZHYPO_153_oRDR_DETECTION_153_156_oPCAN_RADAR_f7323715_Tx: ComBitPosition=103, ComBitSize=1, ComSignalInitValue=0, ComSignalType=BOOLEAN, ComHandleId=3266, ComSystemTemplateSystemSignalRef=DET_PROB_1STAZHYPO_153
            DET_IDM_153_oRDR_DETECTION_153_156_oPCAN_RADAR_0235ed03_Tx: ComBitPosition=63, ComBitSize=1, ComSignalInitValue=0, ComSignalType=UINT8, ComHandleId=3255, ComSystemTemplateSystemSignalRef=DET_IDM_153
            DET_MTD_154_oRDR_DETECTION_153_156_oPCAN_RADAR_3836fcb1_Tx: ComBitPosition=159, ComBitSize=1, ComSignalInitValue=0, ComSignalType=UINT8, ComHandleId=3263, ComSystemTemplateSystemSignalRef=DET_MTD_154
            DET_IDM_154_oRDR_DETECTION_153_156_oPCAN_RADAR_5e85ce6a_Tx: ComBitPosition=175, ComBitSize=1, ComSignalInitValue=0, ComSignalType=UINT8, ComHandleId=3256, ComSystemTemplateSystemSignalRef=DET_IDM_154
            DET_PROB_1STAZHYPO_156_oRDR_DETECTION_153_156_oPCAN_RADAR_5a12bb17_Tx: ComBitPosition=439, ComBitSize=1, ComSignalInitValue=0, ComSignalType=BOOLEAN, ComHandleId=3269, ComSystemTemplateSystemSignalRef=DET_PROB_1STAZHYPO_156
            DET_BELOW_RAIN_THOLD_155_oRDR_DETECTION_153_156_oPCAN_RADAR_f0c7c3e4_Tx: ComBitPosition=263, ComBitSize=1, ComSignalInitValue=0, ComSignalType=UINT8, ComHandleId=3225, ComSystemTemplateSystemSignalRef=DET_BELOW_RAIN_THOLD_155
            DET_MTD_156_oRDR_DETECTION_153_156_oPCAN_RADAR_c9a653da_Tx: ComBitPosition=383, ComBitSize=1, ComSignalInitValue=0, ComSignalType=UINT8, ComHandleId=3265, ComSystemTemplateSystemSignalRef=DET_MTD_156
            DET_IDM_155_oRDR_DETECTION_153_156_oPCAN_RADAR_cbf51aff_Tx: ComBitPosition=287, ComBitSize=1, ComSignalInitValue=0, ComSignalType=UINT8, ComHandleId=3257, ComSystemTemplateSystemSignalRef=DET_IDM_155
            DET_MTD_153_oRDR_DETECTION_153_156_oPCAN_RADAR_6486dfd8_Tx: ComBitPosition=47, ComBitSize=1, ComSignalInitValue=0, ComSignalType=UINT8, ComHandleId=3262, ComSystemTemplateSystemSignalRef=DET_MTD_153
            DET_BELOW_RAIN_THOLD_156_oRDR_DETECTION_153_156_oPCAN_RADAR_9427b81a_Tx: ComBitPosition=375, ComBitSize=1, ComSignalInitValue=0, ComSignalType=UINT8, ComHandleId=3226, ComSystemTemplateSystemSignalRef=DET_BELOW_RAIN_THOLD_156
            DET_MTD_155_oRDR_DETECTION_153_156_oPCAN_RADAR_ad462824_Tx: ComBitPosition=271, ComBitSize=1, ComSignalInitValue=0, ComSignalType=UINT8, ComHandleId=3264, ComSystemTemplateSystemSignalRef=DET_MTD_155
        SG_Detections_313_316_oRDR_DETECTION_313_316_oPCAN_RADAR_c2028a60_Tx: ComTransferProperty=TRIGGERED, ComHandleId=80, ComSystemTemplateSignalGroupRef=SG_Detections_313_316
          83 x ComGroupSignal, all with ComSignalEndianness=LITTLE_ENDIAN, ComTransferProperty=PENDING, ComSignalAccess=ACCESS_NEEDED_BY_SWC_OR_COM:
            DET_RANGE_VELOCITY_313_oRDR_DETECTION_313_316_oPCAN_RADAR_e93e5201_Tx: ComBitPosition=48, ComBitSize=15, ComSignalInitValue=16384, ComSignalType=UINT16, ComHandleId=6598, ComSystemTemplateSystemSignalRef=DET_RANGE_VELOCITY_313
            DET_SNR_315_oRDR_DETECTION_313_316_oPCAN_RADAR_7ad0c6a5_Tx: ComBitPosition=344, ComBitSize=8, ComSignalInitValue=0, ComSignalType=UINT8, ComHandleId=6612, ComSystemTemplateSystemSignalRef=DET_SNR_315
            DET_BI_STATIC_FLAG_316_oRDR_DETECTION_313_316_oPCAN_RADAR_770f2f18_Tx: ComBitPosition=440, ComBitSize=1, ComSignalInitValue=0, ComSignalType=BOOLEAN, ComHandleId=6550, ComSystemTemplateSystemSignalRef=DET_BI_STATIC_FLAG_316
            DET_SUPER_RES_TARGET_314_oRDR_DETECTION_313_316_oPCAN_RADAR_de393a55_Tx: ComBitPosition=199, ComBitSize=1, ComSignalInitValue=0, ComSignalType=BOOLEAN, ComHandleId=6615, ComSystemTemplateSystemSignalRef=DET_SUPER_RES_TARGET_314
            DET_AZIMUTH_ERR_316_oRDR_DETECTION_313_316_oPCAN_RADAR_8596fa68_Tx: ComBitPosition=441, ComBitSize=7, ComSignalInitValue=0, ComSignalType=UINT8, ComHandleId=6542, ComSystemTemplateSystemSignalRef=DET_AZIMUTH_ERR_316
            DET_RANGE_VELOCITY_ERR_314_oRDR_DETECTION_313_316_oPCAN_RADAR_ba358ada_Tx: ComBitPosition=176, ComBitSize=8, ComSignalInitValue=0, ComSignalType=UINT8, ComHandleId=6603, ComSystemTemplateSystemSignalRef=DET_RANGE_VELOCITY_ERR_314
            DET_AZIMUTH_ERR_313_oRDR_DETECTION_313_316_oPCAN_RADAR_28b6766a_Tx: ComBitPosition=105, ComBitSize=7, ComSignalInitValue=0, ComSignalType=UINT8, ComHandleId=6539, ComSystemTemplateSystemSignalRef=DET_AZIMUTH_ERR_313
            DET_HVC_FLAG_314_oRDR_DETECTION_313_316_oPCAN_RADAR_b5d2b190_Tx: ComBitPosition=198, ComBitSize=1, ComSignalInitValue=0, ComSignalType=BOOLEAN, ComHandleId=6572, ComSystemTemplateSystemSignalRef=DET_HVC_FLAG_314
            DET_ELEVATION_316_oRDR_DETECTION_313_316_oPCAN_RADAR_f090b091_Tx: ComBitPosition=408, ComBitSize=8, ComSignalInitValue=0, ComSignalType=UINT8, ComHandleId=6562, ComSystemTemplateSystemSignalRef=DET_ELEVATION_316
            DET_CONFD_AZIMUTH_314_oRDR_DETECTION_313_316_oPCAN_RADAR_d255ca3c_Tx: ComBitPosition=230, ComBitSize=2, ComSignalInitValue=0, ComSignalType=UINT8, ComHandleId=6552, ComSystemTemplateSystemSignalRef=DET_CONFD_AZIMUTH_314
            DET_MH_CYCLE_COUNTER_313_316_oRDR_DETECTION_313_316_oPCAN_RADAR_c2fff95c_Tx: ComBitPosition=16, ComBitSize=8, ComSignalInitValue=0, ComSignalType=UINT8, ComHandleId=6580, ComSystemTemplateSystemSignalRef=DET_MH_CYCLE_COUNTER_313_316
            DET_ELEVATION_ERR_314_oRDR_DETECTION_313_316_oPCAN_RADAR_8639878f_Tx: ComBitPosition=192, ComBitSize=6, ComSignalInitValue=0, ComSignalType=UINT8, ComHandleId=6564, ComSystemTemplateSystemSignalRef=DET_ELEVATION_ERR_314
            DET_RANGE_VELOCITY_316_oRDR_DETECTION_313_316_oPCAN_RADAR_441ede03_Tx: ComBitPosition=384, ComBitSize=15, ComSignalInitValue=16384, ComSignalType=UINT16, ComHandleId=6601, ComSystemTemplateSystemSignalRef=DET_RANGE_VELOCITY_316
            DET_SUPER_RES_TARGET_316_oRDR_DETECTION_313_316_oPCAN_RADAR_2fa9953e_Tx: ComBitPosition=423, ComBitSize=1, ComSignalInitValue=0, ComSignalType=BOOLEAN, ComHandleId=6617, ComSystemTemplateSystemSignalRef=DET_SUPER_RES_TARGET_316
            DET_RANGE_ERR_315_oRDR_DETECTION_313_316_oPCAN_RADAR_f2b0ddb1_Tx: ComBitPosition=264, ComBitSize=7, ComSignalInitValue=0, ComSignalType=UINT8, ComHandleId=6596, ComSystemTemplateSystemSignalRef=DET_RANGE_ERR_315
            DET_RANGE_ERR_316_oRDR_DETECTION_313_316_oPCAN_RADAR_9650a64f_Tx: ComBitPosition=376, ComBitSize=7, ComSignalInitValue=0, ComSignalType=UINT8, ComHandleId=6597, ComSystemTemplateSystemSignalRef=DET_RANGE_ERR_316
            DET_ELEVATION_ERR_316_oRDR_DETECTION_313_316_oPCAN_RADAR_77a928e4_Tx: ComBitPosition=416, ComBitSize=6, ComSignalInitValue=0, ComSignalType=UINT8, ComHandleId=6566, ComSystemTemplateSystemSignalRef=DET_ELEVATION_ERR_316
            DET_AZIMUTH_313_oRDR_DETECTION_313_316_oPCAN_RADAR_8c03e39f_Tx: ComBitPosition=88, ComBitSize=13, ComSignalInitValue=0, ComSignalType=UINT16, ComHandleId=6535, ComSystemTemplateSystemSignalRef=DET_AZIMUTH_313
            DET_AZIMUTH_314_oRDR_DETECTION_313_316_oPCAN_RADAR_d0b3c0f6_Tx: ComBitPosition=200, ComBitSize=13, ComSignalInitValue=0, ComSignalType=UINT16, ComHandleId=6536, ComSystemTemplateSystemSignalRef=DET_AZIMUTH_314
            DET_RANGE_ERR_313_oRDR_DETECTION_313_316_oPCAN_RADAR_3b702a4d_Tx: ComBitPosition=40, ComBitSize=7, ComSignalInitValue=0, ComSignalType=UINT8, ComHandleId=6594, ComSystemTemplateSystemSignalRef=DET_RANGE_ERR_313
            DET_ELEVATION_ERR_315_oRDR_DETECTION_313_316_oPCAN_RADAR_1349531a_Tx: ComBitPosition=304, ComBitSize=6, ComSignalInitValue=0, ComSignalType=UINT8, ComHandleId=6565, ComSystemTemplateSystemSignalRef=DET_ELEVATION_ERR_315
            DET_RANGE_ERR_314_oRDR_DETECTION_313_316_oPCAN_RADAR_67c00924_Tx: ComBitPosition=152, ComBitSize=7, ComSignalInitValue=0, ComSignalType=UINT8, ComHandleId=6595, ComSystemTemplateSystemSignalRef=DET_RANGE_ERR_314
            DET_MH_CRC16_313_316_oRDR_DETECTION_313_316_oPCAN_RADAR_468a586b_Tx: ComBitPosition=0, ComBitSize=16, ComSignalInitValue=0, ComSignalType=UINT16, ComHandleId=6579, ComSystemTemplateSystemSignalRef=DET_MH_CRC16_313_316
            DET_RANGE_VELOCITY_314_oRDR_DETECTION_313_316_oPCAN_RADAR_b58e7168_Tx: ComBitPosition=160, ComBitSize=15, ComSignalInitValue=16384, ComSignalType=UINT16, ComHandleId=6599, ComSystemTemplateSystemSignalRef=DET_RANGE_VELOCITY_314
            DET_RCS_313_oRDR_DETECTION_313_316_oPCAN_RADAR_6ebe655b_Tx: ComBitPosition=128, ComBitSize=8, ComSignalInitValue=128, ComSignalType=UINT8, ComHandleId=6606, ComSystemTemplateSystemSignalRef=DET_RCS_313
            DET_SNR_314_oRDR_DETECTION_313_316_oPCAN_RADAR_efa01230_Tx: ComBitPosition=232, ComBitSize=8, ComSignalInitValue=0, ComSignalType=UINT8, ComHandleId=6611, ComSystemTemplateSystemSignalRef=DET_SNR_314
            DET_SNR_313_oRDR_DETECTION_313_316_oPCAN_RADAR_b3103159_Tx: ComBitPosition=120, ComBitSize=8, ComSignalInitValue=0, ComSignalType=UINT8, ComHandleId=6610, ComSystemTemplateSystemSignalRef=DET_SNR_313
            DET_ELEVATION_315_oRDR_DETECTION_313_316_oPCAN_RADAR_9470cb6f_Tx: ComBitPosition=296, ComBitSize=8, ComSignalInitValue=0, ComSignalType=UINT8, ComHandleId=6561, ComSystemTemplateSystemSignalRef=DET_ELEVATION_315
            DET_RANGE_314_oRDR_DETECTION_313_316_oPCAN_RADAR_c028b34d_Tx: ComBitPosition=136, ComBitSize=15, ComSignalInitValue=0, ComSignalType=UINT16, ComHandleId=6591, ComSystemTemplateSystemSignalRef=DET_RANGE_314
            DET_ELEVATION_313_oRDR_DETECTION_313_316_oPCAN_RADAR_5db03c93_Tx: ComBitPosition=72, ComBitSize=8, ComSignalInitValue=0, ComSignalType=UINT8, ComHandleId=6559, ComSystemTemplateSystemSignalRef=DET_ELEVATION_313
            DET_ELEVATION_314_oRDR_DETECTION_313_316_oPCAN_RADAR_01001ffa_Tx: ComBitPosition=184, ComBitSize=8, ComSignalInitValue=0, ComSignalType=UINT8, ComHandleId=6560, ComSystemTemplateSystemSignalRef=DET_ELEVATION_314
            DET_RANGE_VELOCITY_ERR_315_oRDR_DETECTION_313_316_oPCAN_RADAR_2f455e4f_Tx: ComBitPosition=288, ComBitSize=8, ComSignalInitValue=0, ComSignalType=UINT8, ComHandleId=6604, ComSystemTemplateSystemSignalRef=DET_RANGE_VELOCITY_ERR_315
            DET_AZIMUTH_315_oRDR_DETECTION_313_316_oPCAN_RADAR_45c31463_Tx: ComBitPosition=312, ComBitSize=13, ComSignalInitValue=0, ComSignalType=UINT16, ComHandleId=6537, ComSystemTemplateSystemSignalRef=DET_AZIMUTH_315
            DET_AZIMUTH_ERR_314_oRDR_DETECTION_313_316_oPCAN_RADAR_74065503_Tx: ComBitPosition=217, ComBitSize=7, ComSignalInitValue=0, ComSignalType=UINT8, ComHandleId=6540, ComSystemTemplateSystemSignalRef=DET_AZIMUTH_ERR_314
            DET_RANGE_313_oRDR_DETECTION_313_316_oPCAN_RADAR_9c989024_Tx: ComBitPosition=24, ComBitSize=15, ComSignalInitValue=0, ComSignalType=UINT16, ComHandleId=6590, ComSystemTemplateSystemSignalRef=DET_RANGE_313
            DET_EXISTENCE_PROB_316_oRDR_DETECTION_313_316_oPCAN_RADAR_a5365d84_Tx: ComBitPosition=448, ComBitSize=6, ComSignalInitValue=0, ComSignalType=UINT8, ComHandleId=6570, ComSystemTemplateSystemSignalRef=DET_EXISTENCE_PROB_316
            DET_RANGE_VELOCITY_315_oRDR_DETECTION_313_316_oPCAN_RADAR_20fea5fd_Tx: ComBitPosition=272, ComBitSize=15, ComSignalInitValue=16384, ComSignalType=UINT16, ComHandleId=6600, ComSystemTemplateSystemSignalRef=DET_RANGE_VELOCITY_315
            DET_AZIMUTH_ERR_315_oRDR_DETECTION_313_316_oPCAN_RADAR_e1768196_Tx: ComBitPosition=329, ComBitSize=7, ComSignalInitValue=0, ComSignalType=UINT8, ComHandleId=6541, ComSystemTemplateSystemSignalRef=DET_AZIMUTH_ERR_315
            DET_SUPER_RES_TARGET_315_oRDR_DETECTION_313_316_oPCAN_RADAR_4b49eec0_Tx: ComBitPosition=311, ComBitSize=1, ComSignalInitValue=0, ComSignalType=BOOLEAN, ComHandleId=6616, ComSystemTemplateSystemSignalRef=DET_SUPER_RES_TARGET_315
            DET_AZIMUTH_316_oRDR_DETECTION_313_316_oPCAN_RADAR_21236f9d_Tx: ComBitPosition=424, ComBitSize=13, ComSignalInitValue=0, ComSignalType=UINT16, ComHandleId=6538, ComSystemTemplateSystemSignalRef=DET_AZIMUTH_316
            DET_MH_SCAN_INDEX_4LSB_313_316_oRDR_DETECTION_313_316_oPCAN_RADAR_0ed5dcd0_Tx: ComBitPosition=476, ComBitSize=4, ComSignalInitValue=0, ComSignalType=UINT8, ComHandleId=6581, ComSystemTemplateSystemSignalRef=DET_MH_SCAN_INDEX_4LSB_313_316
            DET_RCS_315_oRDR_DETECTION_313_316_oPCAN_RADAR_a77e92a7_Tx: ComBitPosition=352, ComBitSize=8, ComSignalInitValue=128, ComSignalType=UINT8, ComHandleId=6608, ComSystemTemplateSystemSignalRef=DET_RCS_315
            DET_EXISTENCE_PROB_315_oRDR_DETECTION_313_316_oPCAN_RADAR_c1d6267a_Tx: ComBitPosition=336, ComBitSize=6, ComSignalInitValue=0, ComSignalType=UINT8, ComHandleId=6569, ComSystemTemplateSystemSignalRef=DET_EXISTENCE_PROB_315
            DET_HVC_FLAG_316_oRDR_DETECTION_313_316_oPCAN_RADAR_44421efb_Tx: ComBitPosition=422, ComBitSize=1, ComSignalInitValue=0, ComSignalType=BOOLEAN, ComHandleId=6574, ComSystemTemplateSystemSignalRef=DET_HVC_FLAG_316
            DET_CONFD_AZIMUTH_316_oRDR_DETECTION_313_316_oPCAN_RADAR_23c56557_Tx: ComBitPosition=454, ComBitSize=2, ComSignalInitValue=0, ComSignalType=UINT8, ComHandleId=6554, ComSystemTemplateSystemSignalRef=DET_CONFD_AZIMUTH_316
            DET_CONFD_ELEVATION_315_oRDR_DETECTION_313_316_oPCAN_RADAR_45b01f53_Tx: ComBitPosition=325, ComBitSize=2, ComSignalInitValue=0, ComSignalType=UINT8, ComHandleId=6557, ComSystemTemplateSystemSignalRef=DET_CONFD_ELEVATION_315
            DET_CONFD_AZIMUTH_315_oRDR_DETECTION_313_316_oPCAN_RADAR_47251ea9_Tx: ComBitPosition=342, ComBitSize=2, ComSignalInitValue=0, ComSignalType=UINT8, ComHandleId=6553, ComSystemTemplateSystemSignalRef=DET_CONFD_AZIMUTH_315
            DET_HVC_FLAG_313_oRDR_DETECTION_313_316_oPCAN_RADAR_e96292f9_Tx: ComBitPosition=86, ComBitSize=1, ComSignalInitValue=0, ComSignalType=BOOLEAN, ComHandleId=6571, ComSystemTemplateSystemSignalRef=DET_HVC_FLAG_313
            DET_SNR_316_oRDR_DETECTION_313_316_oPCAN_RADAR_1e30bd5b_Tx: ComBitPosition=456, ComBitSize=8, ComSignalInitValue=0, ComSignalType=UINT8, ComHandleId=6613, ComSystemTemplateSystemSignalRef=DET_SNR_316
            DET_EXISTENCE_PROB_313_oRDR_DETECTION_313_316_oPCAN_RADAR_0816d186_Tx: ComBitPosition=112, ComBitSize=6, ComSignalInitValue=0, ComSignalType=UINT8, ComHandleId=6567, ComSystemTemplateSystemSignalRef=DET_EXISTENCE_PROB_313
            DET_ELEVATION_ERR_313_oRDR_DETECTION_313_316_oPCAN_RADAR_da89a4e6_Tx: ComBitPosition=80, ComBitSize=6, ComSignalInitValue=0, ComSignalType=UINT8, ComHandleId=6563, ComSystemTemplateSystemSignalRef=DET_ELEVATION_ERR_313
            DET_RANGE_316_oRDR_DETECTION_313_316_oPCAN_RADAR_31b81c26_Tx: ComBitPosition=360, ComBitSize=15, ComSignalInitValue=0, ComSignalType=UINT16, ComHandleId=6593, ComSystemTemplateSystemSignalRef=DET_RANGE_316
            DET_CONFD_ELEVATION_313_oRDR_DETECTION_313_316_oPCAN_RADAR_8c70e8af_Tx: ComBitPosition=101, ComBitSize=2, ComSignalInitValue=0, ComSignalType=UINT8, ComHandleId=6555, ComSystemTemplateSystemSignalRef=DET_CONFD_ELEVATION_313
            DET_EXISTENCE_PROB_314_oRDR_DETECTION_313_316_oPCAN_RADAR_54a6f2ef_Tx: ComBitPosition=224, ComBitSize=6, ComSignalInitValue=0, ComSignalType=UINT8, ComHandleId=6568, ComSystemTemplateSystemSignalRef=DET_EXISTENCE_PROB_314
            DET_CONFD_AZIMUTH_313_oRDR_DETECTION_313_316_oPCAN_RADAR_8ee5e955_Tx: ComBitPosition=118, ComBitSize=2, ComSignalInitValue=0, ComSignalType=UINT8, ComHandleId=6551, ComSystemTemplateSystemSignalRef=DET_CONFD_AZIMUTH_313
            DET_RANGE_VELOCITY_ERR_313_oRDR_DETECTION_313_316_oPCAN_RADAR_e685a9b3_Tx: ComBitPosition=64, ComBitSize=8, ComSignalInitValue=0, ComSignalType=UINT8, ComHandleId=6602, ComSystemTemplateSystemSignalRef=DET_RANGE_VELOCITY_ERR_313
            DET_RCS_314_oRDR_DETECTION_313_316_oPCAN_RADAR_320e4632_Tx: ComBitPosition=240, ComBitSize=8, ComSignalInitValue=128, ComSignalType=UINT8, ComHandleId=6607, ComSystemTemplateSystemSignalRef=DET_RCS_314
            DET_CONFD_ELEVATION_316_oRDR_DETECTION_313_316_oPCAN_RADAR_215064ad_Tx: ComBitPosition=437, ComBitSize=2, ComSignalInitValue=0, ComSignalType=UINT8, ComHandleId=6558, ComSystemTemplateSystemSignalRef=DET_CONFD_ELEVATION_316
            DET_BI_STATIC_FLAG_314_oRDR_DETECTION_313_316_oPCAN_RADAR_869f8073_Tx: ComBitPosition=216, ComBitSize=1, ComSignalInitValue=0, ComSignalType=BOOLEAN, ComHandleId=6548, ComSystemTemplateSystemSignalRef=DET_BI_STATIC_FLAG_314
            DET_HVC_FLAG_315_oRDR_DETECTION_313_316_oPCAN_RADAR_20a26505_Tx: ComBitPosition=310, ComBitSize=1, ComSignalInitValue=0, ComSignalType=BOOLEAN, ComHandleId=6573, ComSystemTemplateSystemSignalRef=DET_HVC_FLAG_315
            DET_CONFD_ELEVATION_314_oRDR_DETECTION_313_316_oPCAN_RADAR_d0c0cbc6_Tx: ComBitPosition=213, ComBitSize=2, ComSignalInitValue=0, ComSignalType=UINT8, ComHandleId=6556, ComSystemTemplateSystemSignalRef=DET_CONFD_ELEVATION_314
            DET_RANGE_VELOCITY_ERR_316_oRDR_DETECTION_313_316_oPCAN_RADAR_4ba525b1_Tx: ComBitPosition=400, ComBitSize=8, ComSignalInitValue=0, ComSignalType=UINT8, ComHandleId=6605, ComSystemTemplateSystemSignalRef=DET_RANGE_VELOCITY_ERR_316
            DET_RANGE_315_oRDR_DETECTION_313_316_oPCAN_RADAR_555867d8_Tx: ComBitPosition=248, ComBitSize=15, ComSignalInitValue=0, ComSignalType=UINT16, ComHandleId=6592, ComSystemTemplateSystemSignalRef=DET_RANGE_315
            DET_RCS_316_oRDR_DETECTION_313_316_oPCAN_RADAR_c39ee959_Tx: ComBitPosition=464, ComBitSize=8, ComSignalInitValue=128, ComSignalType=UINT8, ComHandleId=6609, ComSystemTemplateSystemSignalRef=DET_RCS_316
            DET_SUPER_RES_TARGET_313_oRDR_DETECTION_313_316_oPCAN_RADAR_8289193c_Tx: ComBitPosition=87, ComBitSize=1, ComSignalInitValue=0, ComSignalType=BOOLEAN, ComHandleId=6614, ComSystemTemplateSystemSignalRef=DET_SUPER_RES_TARGET_313
            DET_BI_STATIC_FLAG_313_oRDR_DETECTION_313_316_oPCAN_RADAR_da2fa31a_Tx: ComBitPosition=104, ComBitSize=1, ComSignalInitValue=0, ComSignalType=BOOLEAN, ComHandleId=6547, ComSystemTemplateSystemSignalRef=DET_BI_STATIC_FLAG_313
            DET_BI_STATIC_FLAG_315_oRDR_DETECTION_313_316_oPCAN_RADAR_13ef54e6_Tx: ComBitPosition=328, ComBitSize=1, ComSignalInitValue=0, ComSignalType=BOOLEAN, ComHandleId=6549, ComSystemTemplateSystemSignalRef=DET_BI_STATIC_FLAG_315
            DET_PROB_1STAZHYPO_314_oRDR_DETECTION_313_316_oPCAN_RADAR_cb87503b_Tx: ComBitPosition=215, ComBitSize=1, ComSignalInitValue=0, ComSignalType=BOOLEAN, ComHandleId=6587, ComSystemTemplateSystemSignalRef=DET_PROB_1STAZHYPO_314
            DET_BELOW_RAIN_THOLD_315_oRDR_DETECTION_313_316_oPCAN_RADAR_90c287a3_Tx: ComBitPosition=263, ComBitSize=1, ComSignalInitValue=0, ComSignalType=UINT8, ComHandleId=6545, ComSystemTemplateSystemSignalRef=DET_BELOW_RAIN_THOLD_315
            DET_MTD_316_oRDR_DETECTION_313_316_oPCAN_RADAR_a9a3179d_Tx: ComBitPosition=383, ComBitSize=1, ComSignalInitValue=0, ComSignalType=UINT8, ComHandleId=6585, ComSystemTemplateSystemSignalRef=DET_MTD_316
            DET_IDM_316_oRDR_DETECTION_313_316_oPCAN_RADAR_cf102546_Tx: ComBitPosition=399, ComBitSize=1, ComSignalInitValue=0, ComSignalType=UINT8, ComHandleId=6578, ComSystemTemplateSystemSignalRef=DET_IDM_316
            DET_MTD_313_oRDR_DETECTION_313_316_oPCAN_RADAR_04839b9f_Tx: ComBitPosition=47, ComBitSize=1, ComSignalInitValue=0, ComSignalType=UINT8, ComHandleId=6582, ComSystemTemplateSystemSignalRef=DET_MTD_313
            DET_BELOW_RAIN_THOLD_316_oRDR_DETECTION_313_316_oPCAN_RADAR_f422fc5d_Tx: ComBitPosition=375, ComBitSize=1, ComSignalInitValue=0, ComSignalType=UINT8, ComHandleId=6546, ComSystemTemplateSystemSignalRef=DET_BELOW_RAIN_THOLD_316
            DET_IDM_314_oRDR_DETECTION_313_316_oPCAN_RADAR_3e808a2d_Tx: ComBitPosition=175, ComBitSize=1, ComSignalInitValue=0, ComSignalType=UINT8, ComHandleId=6576, ComSystemTemplateSystemSignalRef=DET_IDM_314
            DET_IDM_315_oRDR_DETECTION_313_316_oPCAN_RADAR_abf05eb8_Tx: ComBitPosition=287, ComBitSize=1, ComSignalInitValue=0, ComSignalType=UINT8, ComHandleId=6577, ComSystemTemplateSystemSignalRef=DET_IDM_315
            DET_MTD_314_oRDR_DETECTION_313_316_oPCAN_RADAR_5833b8f6_Tx: ComBitPosition=159, ComBitSize=1, ComSignalInitValue=0, ComSignalType=UINT8, ComHandleId=6583, ComSystemTemplateSystemSignalRef=DET_MTD_314
            DET_BELOW_RAIN_THOLD_313_oRDR_DETECTION_313_316_oPCAN_RADAR_5902705f_Tx: ComBitPosition=39, ComBitSize=1, ComSignalInitValue=0, ComSignalType=UINT8, ComHandleId=6543, ComSystemTemplateSystemSignalRef=DET_BELOW_RAIN_THOLD_313
            DET_BELOW_RAIN_THOLD_314_oRDR_DETECTION_313_316_oPCAN_RADAR_05b25336_Tx: ComBitPosition=151, ComBitSize=1, ComSignalInitValue=0, ComSignalType=UINT8, ComHandleId=6544, ComSystemTemplateSystemSignalRef=DET_BELOW_RAIN_THOLD_314
            DET_MTD_315_oRDR_DETECTION_313_316_oPCAN_RADAR_cd436c63_Tx: ComBitPosition=271, ComBitSize=1, ComSignalInitValue=0, ComSignalType=UINT8, ComHandleId=6584, ComSystemTemplateSystemSignalRef=DET_MTD_315
            DET_PROB_1STAZHYPO_313_oRDR_DETECTION_313_316_oPCAN_RADAR_97377352_Tx: ComBitPosition=103, ComBitSize=1, ComSignalInitValue=0, ComSignalType=BOOLEAN, ComHandleId=6586, ComSystemTemplateSystemSignalRef=DET_PROB_1STAZHYPO_313
            DET_PROB_1STAZHYPO_315_oRDR_DETECTION_313_316_oPCAN_RADAR_5ef784ae_Tx: ComBitPosition=327, ComBitSize=1, ComSignalInitValue=0, ComSignalType=BOOLEAN, ComHandleId=6588, ComSystemTemplateSystemSignalRef=DET_PROB_1STAZHYPO_315
            DET_IDM_313_oRDR_DETECTION_313_316_oPCAN_RADAR_6230a944_Tx: ComBitPosition=63, ComBitSize=1, ComSignalInitValue=0, ComSignalType=UINT8, ComHandleId=6575, ComSystemTemplateSystemSignalRef=DET_IDM_313
            DET_PROB_1STAZHYPO_316_oRDR_DETECTION_313_316_oPCAN_RADAR_3a17ff50_Tx: ComBitPosition=439, ComBitSize=1, ComSignalInitValue=0, ComSignalType=BOOLEAN, ComHandleId=6589, ComSystemTemplateSystemSignalRef=DET_PROB_1STAZHYPO_316
        SG_Detections_049_052_oRDR_DETECTION_049_052_oPCAN_RADAR_5d1ac528_Tx: ComTransferProperty=TRIGGERED, ComHandleId=14, ComSystemTemplateSignalGroupRef=SG_Detections_049_052
          83 x ComGroupSignal, all with ComSignalEndianness=LITTLE_ENDIAN, ComTransferProperty=PENDING, ComSignalAccess=ACCESS_NEEDED_BY_SWC_OR_COM:
            DET_RCS_052_oRDR_DETECTION_049_052_oPCAN_RADAR_659d50f5_Tx: ComBitPosition=464, ComBitSize=8, ComSignalInitValue=128, ComSignalType=UINT8, ComHandleId=1131, ComSystemTemplateSystemSignalRef=DET_RCS_052
            DET_SNR_052_oRDR_DETECTION_049_052_oPCAN_RADAR_b83304f7_Tx: ComBitPosition=456, ComBitSize=8, ComSignalInitValue=0, ComSignalType=UINT8, ComHandleId=1135, ComSystemTemplateSystemSignalRef=DET_SNR_052
            DET_ELEVATION_049_oRDR_DETECTION_049_052_oPCAN_RADAR_c223d4f2_Tx: ComBitPosition=72, ComBitSize=8, ComSignalInitValue=0, ComSignalType=UINT8, ComHandleId=1081, ComSystemTemplateSystemSignalRef=DET_ELEVATION_049
            DET_CONFD_AZIMUTH_051_oRDR_DETECTION_049_052_oPCAN_RADAR_e126a705_Tx: ComBitPosition=342, ComBitSize=2, ComSignalInitValue=0, ComSignalType=UINT8, ComHandleId=1075, ComSystemTemplateSystemSignalRef=DET_CONFD_AZIMUTH_051
            DET_SNR_050_oRDR_DETECTION_049_052_oPCAN_RADAR_49a3ab9c_Tx: ComBitPosition=232, ComBitSize=8, ComSignalInitValue=0, ComSignalType=UINT8, ComHandleId=1133, ComSystemTemplateSystemSignalRef=DET_SNR_050
            DET_BI_STATIC_FLAG_052_oRDR_DETECTION_049_052_oPCAN_RADAR_d10c96b4_Tx: ComBitPosition=440, ComBitSize=1, ComSignalInitValue=0, ComSignalType=BOOLEAN, ComHandleId=1072, ComSystemTemplateSystemSignalRef=DET_BI_STATIC_FLAG_052
            DET_RCS_051_oRDR_DETECTION_049_052_oPCAN_RADAR_017d2b0b_Tx: ComBitPosition=352, ComBitSize=8, ComSignalInitValue=128, ComSignalType=UINT8, ComHandleId=1130, ComSystemTemplateSystemSignalRef=DET_RCS_051
            DET_ELEVATION_051_oRDR_DETECTION_049_052_oPCAN_RADAR_327372c3_Tx: ComBitPosition=296, ComBitSize=8, ComSignalInitValue=0, ComSignalType=UINT8, ComHandleId=1083, ComSystemTemplateSystemSignalRef=DET_ELEVATION_051
            DET_BI_STATIC_FLAG_049_oRDR_DETECTION_049_052_oPCAN_RADAR_45bc4b7b_Tx: ComBitPosition=104, ComBitSize=1, ComSignalInitValue=0, ComSignalType=BOOLEAN, ComHandleId=1069, ComSystemTemplateSystemSignalRef=DET_BI_STATIC_FLAG_049
            DET_BI_STATIC_FLAG_050_oRDR_DETECTION_049_052_oPCAN_RADAR_209c39df_Tx: ComBitPosition=216, ComBitSize=1, ComSignalInitValue=0, ComSignalType=BOOLEAN, ComHandleId=1070, ComSystemTemplateSystemSignalRef=DET_BI_STATIC_FLAG_050
            DET_SUPER_RES_TARGET_052_oRDR_DETECTION_049_052_oPCAN_RADAR_89aa2c92_Tx: ComBitPosition=423, ComBitSize=1, ComSignalInitValue=0, ComSignalType=BOOLEAN, ComHandleId=1139, ComSystemTemplateSystemSignalRef=DET_SUPER_RES_TARGET_052
            DET_ELEVATION_052_oRDR_DETECTION_049_052_oPCAN_RADAR_5693093d_Tx: ComBitPosition=408, ComBitSize=8, ComSignalInitValue=0, ComSignalType=UINT8, ComHandleId=1084, ComSystemTemplateSystemSignalRef=DET_ELEVATION_052
            DET_RANGE_ERR_052_oRDR_DETECTION_049_052_oPCAN_RADAR_30531fe3_Tx: ComBitPosition=376, ComBitSize=7, ComSignalInitValue=0, ComSignalType=UINT8, ComHandleId=1119, ComSystemTemplateSystemSignalRef=DET_RANGE_ERR_052
            DET_ELEVATION_ERR_050_oRDR_DETECTION_049_052_oPCAN_RADAR_203a3e23_Tx: ComBitPosition=192, ComBitSize=6, ComSignalInitValue=0, ComSignalType=UINT8, ComHandleId=1086, ComSystemTemplateSystemSignalRef=DET_ELEVATION_ERR_050
            DET_HVC_FLAG_052_oRDR_DETECTION_049_052_oPCAN_RADAR_e241a757_Tx: ComBitPosition=422, ComBitSize=1, ComSignalInitValue=0, ComSignalType=BOOLEAN, ComHandleId=1096, ComSystemTemplateSystemSignalRef=DET_HVC_FLAG_052
            DET_RANGE_052_oRDR_DETECTION_049_052_oPCAN_RADAR_97bba58a_Tx: ComBitPosition=360, ComBitSize=15, ComSignalInitValue=0, ComSignalType=UINT16, ComHandleId=1115, ComSystemTemplateSystemSignalRef=DET_RANGE_052
            DET_SUPER_RES_TARGET_051_oRDR_DETECTION_049_052_oPCAN_RADAR_ed4a576c_Tx: ComBitPosition=311, ComBitSize=1, ComSignalInitValue=0, ComSignalType=BOOLEAN, ComHandleId=1138, ComSystemTemplateSystemSignalRef=DET_SUPER_RES_TARGET_051
            DET_AZIMUTH_052_oRDR_DETECTION_049_052_oPCAN_RADAR_8720d631_Tx: ComBitPosition=424, ComBitSize=13, ComSignalInitValue=0, ComSignalType=UINT16, ComHandleId=1060, ComSystemTemplateSystemSignalRef=DET_AZIMUTH_052
            DET_CONFD_ELEVATION_050_oRDR_DETECTION_049_052_oPCAN_RADAR_76c3726a_Tx: ComBitPosition=213, ComBitSize=2, ComSignalInitValue=0, ComSignalType=UINT8, ComHandleId=1078, ComSystemTemplateSystemSignalRef=DET_CONFD_ELEVATION_050
            DET_CONFD_AZIMUTH_052_oRDR_DETECTION_049_052_oPCAN_RADAR_85c6dcfb_Tx: ComBitPosition=454, ComBitSize=2, ComSignalInitValue=0, ComSignalType=UINT8, ComHandleId=1076, ComSystemTemplateSystemSignalRef=DET_CONFD_AZIMUTH_052
            DET_HVC_FLAG_050_oRDR_DETECTION_049_052_oPCAN_RADAR_13d1083c_Tx: ComBitPosition=198, ComBitSize=1, ComSignalInitValue=0, ComSignalType=BOOLEAN, ComHandleId=1094, ComSystemTemplateSystemSignalRef=DET_HVC_FLAG_050
            DET_AZIMUTH_ERR_051_oRDR_DETECTION_049_052_oPCAN_RADAR_4775383a_Tx: ComBitPosition=329, ComBitSize=7, ComSignalInitValue=0, ComSignalType=UINT8, ComHandleId=1063, ComSystemTemplateSystemSignalRef=DET_AZIMUTH_ERR_051
            DET_RANGE_049_oRDR_DETECTION_049_052_oPCAN_RADAR_030b7845_Tx: ComBitPosition=24, ComBitSize=15, ComSignalInitValue=0, ComSignalType=UINT16, ComHandleId=1112, ComSystemTemplateSystemSignalRef=DET_RANGE_049
            DET_EXISTENCE_PROB_051_oRDR_DETECTION_049_052_oPCAN_RADAR_67d59fd6_Tx: ComBitPosition=336, ComBitSize=6, ComSignalInitValue=0, ComSignalType=UINT8, ComHandleId=1091, ComSystemTemplateSystemSignalRef=DET_EXISTENCE_PROB_051
            DET_RANGE_051_oRDR_DETECTION_049_052_oPCAN_RADAR_f35bde74_Tx: ComBitPosition=248, ComBitSize=15, ComSignalInitValue=0, ComSignalType=UINT16, ComHandleId=1114, ComSystemTemplateSystemSignalRef=DET_RANGE_051
            DET_EXISTENCE_PROB_050_oRDR_DETECTION_049_052_oPCAN_RADAR_f2a54b43_Tx: ComBitPosition=224, ComBitSize=6, ComSignalInitValue=0, ComSignalType=UINT8, ComHandleId=1090, ComSystemTemplateSystemSignalRef=DET_EXISTENCE_PROB_050
            DET_MH_SCAN_INDEX_4LSB_049_052_oRDR_DETECTION_049_052_oPCAN_RADAR_91cd9398_Tx: ComBitPosition=476, ComBitSize=4, ComSignalInitValue=0, ComSignalType=UINT8, ComHandleId=1103, ComSystemTemplateSystemSignalRef=DET_MH_SCAN_INDEX_4LSB_049_052
            DET_EXISTENCE_PROB_052_oRDR_DETECTION_049_052_oPCAN_RADAR_0335e428_Tx: ComBitPosition=448, ComBitSize=6, ComSignalInitValue=0, ComSignalType=UINT8, ComHandleId=1092, ComSystemTemplateSystemSignalRef=DET_EXISTENCE_PROB_052
            DET_AZIMUTH_ERR_049_oRDR_DETECTION_049_052_oPCAN_RADAR_b7259e0b_Tx: ComBitPosition=105, ComBitSize=7, ComSignalInitValue=0, ComSignalType=UINT8, ComHandleId=1061, ComSystemTemplateSystemSignalRef=DET_AZIMUTH_ERR_049
            DET_ELEVATION_050_oRDR_DETECTION_049_052_oPCAN_RADAR_a703a656_Tx: ComBitPosition=184, ComBitSize=8, ComSignalInitValue=0, ComSignalType=UINT8, ComHandleId=1082, ComSystemTemplateSystemSignalRef=DET_ELEVATION_050
            DET_CONFD_ELEVATION_052_oRDR_DETECTION_049_052_oPCAN_RADAR_8753dd01_Tx: ComBitPosition=437, ComBitSize=2, ComSignalInitValue=0, ComSignalType=UINT8, ComHandleId=1080, ComSystemTemplateSystemSignalRef=DET_CONFD_ELEVATION_052
            DET_RANGE_VELOCITY_049_oRDR_DETECTION_049_052_oPCAN_RADAR_76adba60_Tx: ComBitPosition=48, ComBitSize=15, ComSignalInitValue=16384, ComSignalType=UINT16, ComHandleId=1120, ComSystemTemplateSystemSignalRef=DET_RANGE_VELOCITY_049
            DET_EXISTENCE_PROB_049_oRDR_DETECTION_049_052_oPCAN_RADAR_978539e7_Tx: ComBitPosition=112, ComBitSize=6, ComSignalInitValue=0, ComSignalType=UINT8, ComHandleId=1089, ComSystemTemplateSystemSignalRef=DET_EXISTENCE_PROB_049
            DET_RANGE_050_oRDR_DETECTION_049_052_oPCAN_RADAR_662b0ae1_Tx: ComBitPosition=136, ComBitSize=15, ComSignalInitValue=0, ComSignalType=UINT16, ComHandleId=1113, ComSystemTemplateSystemSignalRef=DET_RANGE_050
            DET_HVC_FLAG_049_oRDR_DETECTION_049_052_oPCAN_RADAR_76f17a98_Tx: ComBitPosition=86, ComBitSize=1, ComSignalInitValue=0, ComSignalType=BOOLEAN, ComHandleId=1093, ComSystemTemplateSystemSignalRef=DET_HVC_FLAG_049
            DET_RCS_050_oRDR_DETECTION_049_052_oPCAN_RADAR_940dff9e_Tx: ComBitPosition=240, ComBitSize=8, ComSignalInitValue=128, ComSignalType=UINT8, ComHandleId=1129, ComSystemTemplateSystemSignalRef=DET_RCS_050
            DET_AZIMUTH_ERR_052_oRDR_DETECTION_049_052_oPCAN_RADAR_239543c4_Tx: ComBitPosition=441, ComBitSize=7, ComSignalInitValue=0, ComSignalType=UINT8, ComHandleId=1064, ComSystemTemplateSystemSignalRef=DET_AZIMUTH_ERR_052
            DET_RANGE_VELOCITY_051_oRDR_DETECTION_049_052_oPCAN_RADAR_86fd1c51_Tx: ComBitPosition=272, ComBitSize=15, ComSignalInitValue=16384, ComSignalType=UINT16, ComHandleId=1122, ComSystemTemplateSystemSignalRef=DET_RANGE_VELOCITY_051
            DET_CONFD_ELEVATION_051_oRDR_DETECTION_049_052_oPCAN_RADAR_e3b3a6ff_Tx: ComBitPosition=325, ComBitSize=2, ComSignalInitValue=0, ComSignalType=UINT8, ComHandleId=1079, ComSystemTemplateSystemSignalRef=DET_CONFD_ELEVATION_051
            DET_SUPER_RES_TARGET_050_oRDR_DETECTION_049_052_oPCAN_RADAR_783a83f9_Tx: ComBitPosition=199, ComBitSize=1, ComSignalInitValue=0, ComSignalType=BOOLEAN, ComHandleId=1137, ComSystemTemplateSystemSignalRef=DET_SUPER_RES_TARGET_050
            DET_RANGE_ERR_049_oRDR_DETECTION_049_052_oPCAN_RADAR_a4e3c22c_Tx: ComBitPosition=40, ComBitSize=7, ComSignalInitValue=0, ComSignalType=UINT8, ComHandleId=1116, ComSystemTemplateSystemSignalRef=DET_RANGE_ERR_049
            DET_CONFD_AZIMUTH_049_oRDR_DETECTION_049_052_oPCAN_RADAR_11760134_Tx: ComBitPosition=118, ComBitSize=2, ComSignalInitValue=0, ComSignalType=UINT8, ComHandleId=1073, ComSystemTemplateSystemSignalRef=DET_CONFD_AZIMUTH_049
            DET_ELEVATION_ERR_049_oRDR_DETECTION_049_052_oPCAN_RADAR_451a4c87_Tx: ComBitPosition=80, ComBitSize=6, ComSignalInitValue=0, ComSignalType=UINT8, ComHandleId=1085, ComSystemTemplateSystemSignalRef=DET_ELEVATION_ERR_049
            DET_BI_STATIC_FLAG_051_oRDR_DETECTION_049_052_oPCAN_RADAR_b5eced4a_Tx: ComBitPosition=328, ComBitSize=1, ComSignalInitValue=0, ComSignalType=BOOLEAN, ComHandleId=1071, ComSystemTemplateSystemSignalRef=DET_BI_STATIC_FLAG_051
            DET_CONFD_AZIMUTH_050_oRDR_DETECTION_049_052_oPCAN_RADAR_74567390_Tx: ComBitPosition=230, ComBitSize=2, ComSignalInitValue=0, ComSignalType=UINT8, ComHandleId=1074, ComSystemTemplateSystemSignalRef=DET_CONFD_AZIMUTH_050
            DET_CONFD_ELEVATION_049_oRDR_DETECTION_049_052_oPCAN_RADAR_13e300ce_Tx: ComBitPosition=101, ComBitSize=2, ComSignalInitValue=0, ComSignalType=UINT8, ComHandleId=1077, ComSystemTemplateSystemSignalRef=DET_CONFD_ELEVATION_049
            DET_AZIMUTH_049_oRDR_DETECTION_049_052_oPCAN_RADAR_13900bfe_Tx: ComBitPosition=88, ComBitSize=13, ComSignalInitValue=0, ComSignalType=UINT16, ComHandleId=1057, ComSystemTemplateSystemSignalRef=DET_AZIMUTH_049
            DET_RANGE_VELOCITY_ERR_050_oRDR_DETECTION_049_052_oPCAN_RADAR_1c363376_Tx: ComBitPosition=176, ComBitSize=8, ComSignalInitValue=0, ComSignalType=UINT8, ComHandleId=1125, ComSystemTemplateSystemSignalRef=DET_RANGE_VELOCITY_ERR_050
            DET_HVC_FLAG_051_oRDR_DETECTION_049_052_oPCAN_RADAR_86a1dca9_Tx: ComBitPosition=310, ComBitSize=1, ComSignalInitValue=0, ComSignalType=BOOLEAN, ComHandleId=1095, ComSystemTemplateSystemSignalRef=DET_HVC_FLAG_051
            DET_RANGE_VELOCITY_ERR_049_oRDR_DETECTION_049_052_oPCAN_RADAR_791641d2_Tx: ComBitPosition=64, ComBitSize=8, ComSignalInitValue=0, ComSignalType=UINT8, ComHandleId=1124, ComSystemTemplateSystemSignalRef=DET_RANGE_VELOCITY_ERR_049
            DET_RCS_049_oRDR_DETECTION_049_052_oPCAN_RADAR_f12d8d3a_Tx: ComBitPosition=128, ComBitSize=8, ComSignalInitValue=128, ComSignalType=UINT8, ComHandleId=1128, ComSystemTemplateSystemSignalRef=DET_RCS_049
            DET_MH_CRC16_049_052_oRDR_DETECTION_049_052_oPCAN_RADAR_d9921723_Tx: ComBitPosition=0, ComBitSize=16, ComSignalInitValue=0, ComSignalType=UINT16, ComHandleId=1101, ComSystemTemplateSystemSignalRef=DET_MH_CRC16_049_052
            DET_AZIMUTH_050_oRDR_DETECTION_049_052_oPCAN_RADAR_76b0795a_Tx: ComBitPosition=200, ComBitSize=13, ComSignalInitValue=0, ComSignalType=UINT16, ComHandleId=1058, ComSystemTemplateSystemSignalRef=DET_AZIMUTH_050
            DET_ELEVATION_ERR_052_oRDR_DETECTION_049_052_oPCAN_RADAR_d1aa9148_Tx: ComBitPosition=416, ComBitSize=6, ComSignalInitValue=0, ComSignalType=UINT8, ComHandleId=1088, ComSystemTemplateSystemSignalRef=DET_ELEVATION_ERR_052
            DET_RANGE_ERR_050_oRDR_DETECTION_049_052_oPCAN_RADAR_c1c3b088_Tx: ComBitPosition=152, ComBitSize=7, ComSignalInitValue=0, ComSignalType=UINT8, ComHandleId=1117, ComSystemTemplateSystemSignalRef=DET_RANGE_ERR_050
            DET_RANGE_ERR_051_oRDR_DETECTION_049_052_oPCAN_RADAR_54b3641d_Tx: ComBitPosition=264, ComBitSize=7, ComSignalInitValue=0, ComSignalType=UINT8, ComHandleId=1118, ComSystemTemplateSystemSignalRef=DET_RANGE_ERR_051
            DET_SUPER_RES_TARGET_049_oRDR_DETECTION_049_052_oPCAN_RADAR_1d1af15d_Tx: ComBitPosition=87, ComBitSize=1, ComSignalInitValue=0, ComSignalType=BOOLEAN, ComHandleId=1136, ComSystemTemplateSystemSignalRef=DET_SUPER_RES_TARGET_049
            DET_RANGE_VELOCITY_052_oRDR_DETECTION_049_052_oPCAN_RADAR_e21d67af_Tx: ComBitPosition=384, ComBitSize=15, ComSignalInitValue=16384, ComSignalType=UINT16, ComHandleId=1123, ComSystemTemplateSystemSignalRef=DET_RANGE_VELOCITY_052
            DET_RANGE_VELOCITY_ERR_052_oRDR_DETECTION_049_052_oPCAN_RADAR_eda69c1d_Tx: ComBitPosition=400, ComBitSize=8, ComSignalInitValue=0, ComSignalType=UINT8, ComHandleId=1127, ComSystemTemplateSystemSignalRef=DET_RANGE_VELOCITY_ERR_052
            DET_SNR_049_oRDR_DETECTION_049_052_oPCAN_RADAR_2c83d938_Tx: ComBitPosition=120, ComBitSize=8, ComSignalInitValue=0, ComSignalType=UINT8, ComHandleId=1132, ComSystemTemplateSystemSignalRef=DET_SNR_049
            DET_RANGE_VELOCITY_050_oRDR_DETECTION_049_052_oPCAN_RADAR_138dc8c4_Tx: ComBitPosition=160, ComBitSize=15, ComSignalInitValue=16384, ComSignalType=UINT16, ComHandleId=1121, ComSystemTemplateSystemSignalRef=DET_RANGE_VELOCITY_050
            DET_ELEVATION_ERR_051_oRDR_DETECTION_049_052_oPCAN_RADAR_b54aeab6_Tx: ComBitPosition=304, ComBitSize=6, ComSignalInitValue=0, ComSignalType=UINT8, ComHandleId=1087, ComSystemTemplateSystemSignalRef=DET_ELEVATION_ERR_051
            DET_RANGE_VELOCITY_ERR_051_oRDR_DETECTION_049_052_oPCAN_RADAR_8946e7e3_Tx: ComBitPosition=288, ComBitSize=8, ComSignalInitValue=0, ComSignalType=UINT8, ComHandleId=1126, ComSystemTemplateSystemSignalRef=DET_RANGE_VELOCITY_ERR_051
            DET_SNR_051_oRDR_DETECTION_049_052_oPCAN_RADAR_dcd37f09_Tx: ComBitPosition=344, ComBitSize=8, ComSignalInitValue=0, ComSignalType=UINT8, ComHandleId=1134, ComSystemTemplateSystemSignalRef=DET_SNR_051
            DET_MH_CYCLE_COUNTER_049_052_oRDR_DETECTION_049_052_oPCAN_RADAR_5de7b614_Tx: ComBitPosition=16, ComBitSize=8, ComSignalInitValue=0, ComSignalType=UINT8, ComHandleId=1102, ComSystemTemplateSystemSignalRef=DET_MH_CYCLE_COUNTER_049_052
            DET_AZIMUTH_051_oRDR_DETECTION_049_052_oPCAN_RADAR_e3c0adcf_Tx: ComBitPosition=312, ComBitSize=13, ComSignalInitValue=0, ComSignalType=UINT16, ComHandleId=1059, ComSystemTemplateSystemSignalRef=DET_AZIMUTH_051
            DET_AZIMUTH_ERR_050_oRDR_DETECTION_049_052_oPCAN_RADAR_d205ecaf_Tx: ComBitPosition=217, ComBitSize=7, ComSignalInitValue=0, ComSignalType=UINT8, ComHandleId=1062, ComSystemTemplateSystemSignalRef=DET_AZIMUTH_ERR_050
            DET_IDM_050_oRDR_DETECTION_049_052_oPCAN_RADAR_98833381_Tx: ComBitPosition=175, ComBitSize=1, ComSignalInitValue=0, ComSignalType=UINT8, ComHandleId=1098, ComSystemTemplateSystemSignalRef=DET_IDM_050
            DET_PROB_1STAZHYPO_051_oRDR_DETECTION_049_052_oPCAN_RADAR_f8f43d02_Tx: ComBitPosition=327, ComBitSize=1, ComSignalInitValue=0, ComSignalType=BOOLEAN, ComHandleId=1110, ComSystemTemplateSystemSignalRef=DET_PROB_1STAZHYPO_051
            DET_PROB_1STAZHYPO_049_oRDR_DETECTION_049_052_oPCAN_RADAR_08a49b33_Tx: ComBitPosition=103, ComBitSize=1, ComSignalInitValue=0, ComSignalType=BOOLEAN, ComHandleId=1108, ComSystemTemplateSystemSignalRef=DET_PROB_1STAZHYPO_049
            DET_MTD_050_oRDR_DETECTION_049_052_oPCAN_RADAR_fe30015a_Tx: ComBitPosition=159, ComBitSize=1, ComSignalInitValue=0, ComSignalType=UINT8, ComHandleId=1105, ComSystemTemplateSystemSignalRef=DET_MTD_050
            DET_MTD_051_oRDR_DETECTION_049_052_oPCAN_RADAR_6b40d5cf_Tx: ComBitPosition=271, ComBitSize=1, ComSignalInitValue=0, ComSignalType=UINT8, ComHandleId=1106, ComSystemTemplateSystemSignalRef=DET_MTD_051
            DET_IDM_049_oRDR_DETECTION_049_052_oPCAN_RADAR_fda34125_Tx: ComBitPosition=63, ComBitSize=1, ComSignalInitValue=0, ComSignalType=UINT8, ComHandleId=1097, ComSystemTemplateSystemSignalRef=DET_IDM_049
            DET_PROB_1STAZHYPO_050_oRDR_DETECTION_049_052_oPCAN_RADAR_6d84e997_Tx: ComBitPosition=215, ComBitSize=1, ComSignalInitValue=0, ComSignalType=BOOLEAN, ComHandleId=1109, ComSystemTemplateSystemSignalRef=DET_PROB_1STAZHYPO_050
            DET_PROB_1STAZHYPO_052_oRDR_DETECTION_049_052_oPCAN_RADAR_9c1446fc_Tx: ComBitPosition=439, ComBitSize=1, ComSignalInitValue=0, ComSignalType=BOOLEAN, ComHandleId=1111, ComSystemTemplateSystemSignalRef=DET_PROB_1STAZHYPO_052
            DET_BELOW_RAIN_THOLD_050_oRDR_DETECTION_049_052_oPCAN_RADAR_a3b1ea9a_Tx: ComBitPosition=151, ComBitSize=1, ComSignalInitValue=0, ComSignalType=UINT8, ComHandleId=1066, ComSystemTemplateSystemSignalRef=DET_BELOW_RAIN_THOLD_050
            DET_MTD_049_oRDR_DETECTION_049_052_oPCAN_RADAR_9b1073fe_Tx: ComBitPosition=47, ComBitSize=1, ComSignalInitValue=0, ComSignalType=UINT8, ComHandleId=1104, ComSystemTemplateSystemSignalRef=DET_MTD_049
            DET_IDM_052_oRDR_DETECTION_049_052_oPCAN_RADAR_69139cea_Tx: ComBitPosition=399, ComBitSize=1, ComSignalInitValue=0, ComSignalType=UINT8, ComHandleId=1100, ComSystemTemplateSystemSignalRef=DET_IDM_052
            DET_BELOW_RAIN_THOLD_049_oRDR_DETECTION_049_052_oPCAN_RADAR_c691983e_Tx: ComBitPosition=39, ComBitSize=1, ComSignalInitValue=0, ComSignalType=UINT8, ComHandleId=1065, ComSystemTemplateSystemSignalRef=DET_BELOW_RAIN_THOLD_049
            DET_BELOW_RAIN_THOLD_051_oRDR_DETECTION_049_052_oPCAN_RADAR_36c13e0f_Tx: ComBitPosition=263, ComBitSize=1, ComSignalInitValue=0, ComSignalType=UINT8, ComHandleId=1067, ComSystemTemplateSystemSignalRef=DET_BELOW_RAIN_THOLD_051
            DET_BELOW_RAIN_THOLD_052_oRDR_DETECTION_049_052_oPCAN_RADAR_522145f1_Tx: ComBitPosition=375, ComBitSize=1, ComSignalInitValue=0, ComSignalType=UINT8, ComHandleId=1068, ComSystemTemplateSystemSignalRef=DET_BELOW_RAIN_THOLD_052
            DET_MTD_052_oRDR_DETECTION_049_052_oPCAN_RADAR_0fa0ae31_Tx: ComBitPosition=383, ComBitSize=1, ComSignalInitValue=0, ComSignalType=UINT8, ComHandleId=1107, ComSystemTemplateSystemSignalRef=DET_MTD_052
            DET_IDM_051_oRDR_DETECTION_049_052_oPCAN_RADAR_0df3e714_Tx: ComBitPosition=287, ComBitSize=1, ComSignalInitValue=0, ComSignalType=UINT8, ComHandleId=1099, ComSystemTemplateSystemSignalRef=DET_IDM_051
        SG_Detections_033_036_oRDR_DETECTION_033_036_oPCAN_RADAR_308f4df6_Tx: ComTransferProperty=TRIGGERED, ComHandleId=10, ComSystemTemplateSignalGroupRef=SG_Detections_033_036
          83 x ComGroupSignal, all with ComSignalEndianness=LITTLE_ENDIAN, ComTransferProperty=PENDING, ComSignalAccess=ACCESS_NEEDED_BY_SWC_OR_COM:
            DET_RANGE_ERR_033_oRDR_DETECTION_033_036_oPCAN_RADAR_fa9841ab_Tx: ComBitPosition=40, ComBitSize=7, ComSignalInitValue=0, ComSignalType=UINT8, ComHandleId=784, ComSystemTemplateSystemSignalRef=DET_RANGE_ERR_033
            DET_EXISTENCE_PROB_034_oRDR_DETECTION_033_036_oPCAN_RADAR_954e9909_Tx: ComBitPosition=224, ComBitSize=6, ComSignalInitValue=0, ComSignalType=UINT8, ComHandleId=758, ComSystemTemplateSystemSignalRef=DET_EXISTENCE_PROB_034
            DET_AZIMUTH_ERR_035_oRDR_DETECTION_033_036_oPCAN_RADAR_209eea70_Tx: ComBitPosition=329, ComBitSize=7, ComSignalInitValue=0, ComSignalType=UINT8, ComHandleId=731, ComSystemTemplateSystemSignalRef=DET_AZIMUTH_ERR_035
            DET_MH_CYCLE_COUNTER_033_036_oRDR_DETECTION_033_036_oPCAN_RADAR_30723eca_Tx: ComBitPosition=16, ComBitSize=8, ComSignalInitValue=0, ComSignalType=UINT8, ComHandleId=770, ComSystemTemplateSystemSignalRef=DET_MH_CYCLE_COUNTER_033_036
            DET_HVC_FLAG_036_oRDR_DETECTION_033_036_oPCAN_RADAR_85aa751d_Tx: ComBitPosition=422, ComBitSize=1, ComSignalInitValue=0, ComSignalType=BOOLEAN, ComHandleId=764, ComSystemTemplateSystemSignalRef=DET_HVC_FLAG_036
            DET_BI_STATIC_FLAG_033_oRDR_DETECTION_033_036_oPCAN_RADAR_1bc7c8fc_Tx: ComBitPosition=104, ComBitSize=1, ComSignalInitValue=0, ComSignalType=BOOLEAN, ComHandleId=737, ComSystemTemplateSystemSignalRef=DET_BI_STATIC_FLAG_033
            DET_HVC_FLAG_033_oRDR_DETECTION_033_036_oPCAN_RADAR_288af91f_Tx: ComBitPosition=86, ComBitSize=1, ComSignalInitValue=0, ComSignalType=BOOLEAN, ComHandleId=761, ComSystemTemplateSystemSignalRef=DET_HVC_FLAG_033
            DET_RANGE_ERR_034_oRDR_DETECTION_033_036_oPCAN_RADAR_a62862c2_Tx: ComBitPosition=152, ComBitSize=7, ComSignalInitValue=0, ComSignalType=UINT8, ComHandleId=785, ComSystemTemplateSystemSignalRef=DET_RANGE_ERR_034
            DET_RCS_036_oRDR_DETECTION_033_036_oPCAN_RADAR_027682bf_Tx: ComBitPosition=464, ComBitSize=8, ComSignalInitValue=128, ComSignalType=UINT8, ComHandleId=799, ComSystemTemplateSystemSignalRef=DET_RCS_036
            DET_RANGE_VELOCITY_035_oRDR_DETECTION_033_036_oPCAN_RADAR_e116ce1b_Tx: ComBitPosition=272, ComBitSize=15, ComSignalInitValue=16384, ComSignalType=UINT16, ComHandleId=790, ComSystemTemplateSystemSignalRef=DET_RANGE_VELOCITY_035
            DET_RANGE_VELOCITY_ERR_034_oRDR_DETECTION_033_036_oPCAN_RADAR_7bdde13c_Tx: ComBitPosition=176, ComBitSize=8, ComSignalInitValue=0, ComSignalType=UINT8, ComHandleId=793, ComSystemTemplateSystemSignalRef=DET_RANGE_VELOCITY_ERR_034
            DET_RANGE_VELOCITY_034_oRDR_DETECTION_033_036_oPCAN_RADAR_74661a8e_Tx: ComBitPosition=160, ComBitSize=15, ComSignalInitValue=16384, ComSignalType=UINT16, ComHandleId=789, ComSystemTemplateSystemSignalRef=DET_RANGE_VELOCITY_034
            DET_SUPER_RES_TARGET_035_oRDR_DETECTION_033_036_oPCAN_RADAR_8aa18526_Tx: ComBitPosition=311, ComBitSize=1, ComSignalInitValue=0, ComSignalType=BOOLEAN, ComHandleId=806, ComSystemTemplateSystemSignalRef=DET_SUPER_RES_TARGET_035
            DET_ELEVATION_ERR_035_oRDR_DETECTION_033_036_oPCAN_RADAR_d2a138fc_Tx: ComBitPosition=304, ComBitSize=6, ComSignalInitValue=0, ComSignalType=UINT8, ComHandleId=755, ComSystemTemplateSystemSignalRef=DET_ELEVATION_ERR_035
            DET_CONFD_ELEVATION_034_oRDR_DETECTION_033_036_oPCAN_RADAR_1128a020_Tx: ComBitPosition=213, ComBitSize=2, ComSignalInitValue=0, ComSignalType=UINT8, ComHandleId=746, ComSystemTemplateSystemSignalRef=DET_CONFD_ELEVATION_034
            DET_AZIMUTH_034_oRDR_DETECTION_033_036_oPCAN_RADAR_115bab10_Tx: ComBitPosition=200, ComBitSize=13, ComSignalInitValue=0, ComSignalType=UINT16, ComHandleId=726, ComSystemTemplateSystemSignalRef=DET_AZIMUTH_034
            DET_ELEVATION_035_oRDR_DETECTION_033_036_oPCAN_RADAR_5598a089_Tx: ComBitPosition=296, ComBitSize=8, ComSignalInitValue=0, ComSignalType=UINT8, ComHandleId=751, ComSystemTemplateSystemSignalRef=DET_ELEVATION_035
            DET_CONFD_ELEVATION_035_oRDR_DETECTION_033_036_oPCAN_RADAR_845874b5_Tx: ComBitPosition=325, ComBitSize=2, ComSignalInitValue=0, ComSignalType=UINT8, ComHandleId=747, ComSystemTemplateSystemSignalRef=DET_CONFD_ELEVATION_035
            DET_AZIMUTH_036_oRDR_DETECTION_033_036_oPCAN_RADAR_e0cb047b_Tx: ComBitPosition=424, ComBitSize=13, ComSignalInitValue=0, ComSignalType=UINT16, ComHandleId=728, ComSystemTemplateSystemSignalRef=DET_AZIMUTH_036
            DET_CONFD_ELEVATION_036_oRDR_DETECTION_033_036_oPCAN_RADAR_e0b80f4b_Tx: ComBitPosition=437, ComBitSize=2, ComSignalInitValue=0, ComSignalType=UINT8, ComHandleId=748, ComSystemTemplateSystemSignalRef=DET_CONFD_ELEVATION_036
            DET_RANGE_035_oRDR_DETECTION_033_036_oPCAN_RADAR_94b00c3e_Tx: ComBitPosition=248, ComBitSize=15, ComSignalInitValue=0, ComSignalType=UINT16, ComHandleId=782, ComSystemTemplateSystemSignalRef=DET_RANGE_035
            DET_CONFD_AZIMUTH_034_oRDR_DETECTION_033_036_oPCAN_RADAR_13bda1da_Tx: ComBitPosition=230, ComBitSize=2, ComSignalInitValue=0, ComSignalType=UINT8, ComHandleId=742, ComSystemTemplateSystemSignalRef=DET_CONFD_AZIMUTH_034
            DET_HVC_FLAG_035_oRDR_DETECTION_033_036_oPCAN_RADAR_e14a0ee3_Tx: ComBitPosition=310, ComBitSize=1, ComSignalInitValue=0, ComSignalType=BOOLEAN, ComHandleId=763, ComSystemTemplateSystemSignalRef=DET_HVC_FLAG_035
            DET_AZIMUTH_035_oRDR_DETECTION_033_036_oPCAN_RADAR_842b7f85_Tx: ComBitPosition=312, ComBitSize=13, ComSignalInitValue=0, ComSignalType=UINT16, ComHandleId=727, ComSystemTemplateSystemSignalRef=DET_AZIMUTH_035
            DET_RANGE_ERR_036_oRDR_DETECTION_033_036_oPCAN_RADAR_57b8cda9_Tx: ComBitPosition=376, ComBitSize=7, ComSignalInitValue=0, ComSignalType=UINT8, ComHandleId=787, ComSystemTemplateSystemSignalRef=DET_RANGE_ERR_036
            DET_AZIMUTH_033_oRDR_DETECTION_033_036_oPCAN_RADAR_4deb8879_Tx: ComBitPosition=88, ComBitSize=13, ComSignalInitValue=0, ComSignalType=UINT16, ComHandleId=725, ComSystemTemplateSystemSignalRef=DET_AZIMUTH_033
            DET_RCS_035_oRDR_DETECTION_033_036_oPCAN_RADAR_6696f941_Tx: ComBitPosition=352, ComBitSize=8, ComSignalInitValue=128, ComSignalType=UINT8, ComHandleId=798, ComSystemTemplateSystemSignalRef=DET_RCS_035
            DET_BI_STATIC_FLAG_034_oRDR_DETECTION_033_036_oPCAN_RADAR_4777eb95_Tx: ComBitPosition=216, ComBitSize=1, ComSignalInitValue=0, ComSignalType=BOOLEAN, ComHandleId=738, ComSystemTemplateSystemSignalRef=DET_BI_STATIC_FLAG_034
            DET_RCS_033_oRDR_DETECTION_033_036_oPCAN_RADAR_af560ebd_Tx: ComBitPosition=128, ComBitSize=8, ComSignalInitValue=128, ComSignalType=UINT8, ComHandleId=796, ComSystemTemplateSystemSignalRef=DET_RCS_033
            DET_ELEVATION_ERR_036_oRDR_DETECTION_033_036_oPCAN_RADAR_b6414302_Tx: ComBitPosition=416, ComBitSize=6, ComSignalInitValue=0, ComSignalType=UINT8, ComHandleId=756, ComSystemTemplateSystemSignalRef=DET_ELEVATION_ERR_036
            DET_RANGE_VELOCITY_033_oRDR_DETECTION_033_036_oPCAN_RADAR_28d639e7_Tx: ComBitPosition=48, ComBitSize=15, ComSignalInitValue=16384, ComSignalType=UINT16, ComHandleId=788, ComSystemTemplateSystemSignalRef=DET_RANGE_VELOCITY_033
            DET_BI_STATIC_FLAG_036_oRDR_DETECTION_033_036_oPCAN_RADAR_b6e744fe_Tx: ComBitPosition=440, ComBitSize=1, ComSignalInitValue=0, ComSignalType=BOOLEAN, ComHandleId=740, ComSystemTemplateSystemSignalRef=DET_BI_STATIC_FLAG_036
            DET_CONFD_AZIMUTH_035_oRDR_DETECTION_033_036_oPCAN_RADAR_86cd754f_Tx: ComBitPosition=342, ComBitSize=2, ComSignalInitValue=0, ComSignalType=UINT8, ComHandleId=743, ComSystemTemplateSystemSignalRef=DET_CONFD_AZIMUTH_035
            DET_AZIMUTH_ERR_036_oRDR_DETECTION_033_036_oPCAN_RADAR_447e918e_Tx: ComBitPosition=441, ComBitSize=7, ComSignalInitValue=0, ComSignalType=UINT8, ComHandleId=732, ComSystemTemplateSystemSignalRef=DET_AZIMUTH_ERR_036
            DET_ELEVATION_033_oRDR_DETECTION_033_036_oPCAN_RADAR_9c585775_Tx: ComBitPosition=72, ComBitSize=8, ComSignalInitValue=0, ComSignalType=UINT8, ComHandleId=749, ComSystemTemplateSystemSignalRef=DET_ELEVATION_033
            DET_BI_STATIC_FLAG_035_oRDR_DETECTION_033_036_oPCAN_RADAR_d2073f00_Tx: ComBitPosition=328, ComBitSize=1, ComSignalInitValue=0, ComSignalType=BOOLEAN, ComHandleId=739, ComSystemTemplateSystemSignalRef=DET_BI_STATIC_FLAG_035
            DET_SUPER_RES_TARGET_034_oRDR_DETECTION_033_036_oPCAN_RADAR_1fd151b3_Tx: ComBitPosition=199, ComBitSize=1, ComSignalInitValue=0, ComSignalType=BOOLEAN, ComHandleId=805, ComSystemTemplateSystemSignalRef=DET_SUPER_RES_TARGET_034
            DET_CONFD_AZIMUTH_036_oRDR_DETECTION_033_036_oPCAN_RADAR_e22d0eb1_Tx: ComBitPosition=454, ComBitSize=2, ComSignalInitValue=0, ComSignalType=UINT8, ComHandleId=744, ComSystemTemplateSystemSignalRef=DET_CONFD_AZIMUTH_036
            DET_SUPER_RES_TARGET_036_oRDR_DETECTION_033_036_oPCAN_RADAR_ee41fed8_Tx: ComBitPosition=423, ComBitSize=1, ComSignalInitValue=0, ComSignalType=BOOLEAN, ComHandleId=807, ComSystemTemplateSystemSignalRef=DET_SUPER_RES_TARGET_036
            DET_ELEVATION_ERR_034_oRDR_DETECTION_033_036_oPCAN_RADAR_47d1ec69_Tx: ComBitPosition=192, ComBitSize=6, ComSignalInitValue=0, ComSignalType=UINT8, ComHandleId=754, ComSystemTemplateSystemSignalRef=DET_ELEVATION_ERR_034
            DET_RANGE_VELOCITY_ERR_033_oRDR_DETECTION_033_036_oPCAN_RADAR_276dc255_Tx: ComBitPosition=64, ComBitSize=8, ComSignalInitValue=0, ComSignalType=UINT8, ComHandleId=792, ComSystemTemplateSystemSignalRef=DET_RANGE_VELOCITY_ERR_033
            DET_RANGE_VELOCITY_ERR_035_oRDR_DETECTION_033_036_oPCAN_RADAR_eead35a9_Tx: ComBitPosition=288, ComBitSize=8, ComSignalInitValue=0, ComSignalType=UINT8, ComHandleId=794, ComSystemTemplateSystemSignalRef=DET_RANGE_VELOCITY_ERR_035
            DET_AZIMUTH_ERR_033_oRDR_DETECTION_033_036_oPCAN_RADAR_e95e1d8c_Tx: ComBitPosition=105, ComBitSize=7, ComSignalInitValue=0, ComSignalType=UINT8, ComHandleId=729, ComSystemTemplateSystemSignalRef=DET_AZIMUTH_ERR_033
            DET_EXISTENCE_PROB_035_oRDR_DETECTION_033_036_oPCAN_RADAR_003e4d9c_Tx: ComBitPosition=336, ComBitSize=6, ComSignalInitValue=0, ComSignalType=UINT8, ComHandleId=759, ComSystemTemplateSystemSignalRef=DET_EXISTENCE_PROB_035
            DET_ELEVATION_036_oRDR_DETECTION_033_036_oPCAN_RADAR_3178db77_Tx: ComBitPosition=408, ComBitSize=8, ComSignalInitValue=0, ComSignalType=UINT8, ComHandleId=752, ComSystemTemplateSystemSignalRef=DET_ELEVATION_036
            DET_MH_SCAN_INDEX_4LSB_033_036_oRDR_DETECTION_033_036_oPCAN_RADAR_fc581b46_Tx: ComBitPosition=476, ComBitSize=4, ComSignalInitValue=0, ComSignalType=UINT8, ComHandleId=771, ComSystemTemplateSystemSignalRef=DET_MH_SCAN_INDEX_4LSB_033_036
            DET_RANGE_VELOCITY_036_oRDR_DETECTION_033_036_oPCAN_RADAR_85f6b5e5_Tx: ComBitPosition=384, ComBitSize=15, ComSignalInitValue=16384, ComSignalType=UINT16, ComHandleId=791, ComSystemTemplateSystemSignalRef=DET_RANGE_VELOCITY_036
            DET_ELEVATION_ERR_033_oRDR_DETECTION_033_036_oPCAN_RADAR_1b61cf00_Tx: ComBitPosition=80, ComBitSize=6, ComSignalInitValue=0, ComSignalType=UINT8, ComHandleId=753, ComSystemTemplateSystemSignalRef=DET_ELEVATION_ERR_033
            DET_SNR_035_oRDR_DETECTION_033_036_oPCAN_RADAR_bb38ad43_Tx: ComBitPosition=344, ComBitSize=8, ComSignalInitValue=0, ComSignalType=UINT8, ComHandleId=802, ComSystemTemplateSystemSignalRef=DET_SNR_035
            DET_SNR_036_oRDR_DETECTION_033_036_oPCAN_RADAR_dfd8d6bd_Tx: ComBitPosition=456, ComBitSize=8, ComSignalInitValue=0, ComSignalType=UINT8, ComHandleId=803, ComSystemTemplateSystemSignalRef=DET_SNR_036
            DET_EXISTENCE_PROB_033_oRDR_DETECTION_033_036_oPCAN_RADAR_c9feba60_Tx: ComBitPosition=112, ComBitSize=6, ComSignalInitValue=0, ComSignalType=UINT8, ComHandleId=757, ComSystemTemplateSystemSignalRef=DET_EXISTENCE_PROB_033
            DET_HVC_FLAG_034_oRDR_DETECTION_033_036_oPCAN_RADAR_743ada76_Tx: ComBitPosition=198, ComBitSize=1, ComSignalInitValue=0, ComSignalType=BOOLEAN, ComHandleId=762, ComSystemTemplateSystemSignalRef=DET_HVC_FLAG_034
            DET_RANGE_033_oRDR_DETECTION_033_036_oPCAN_RADAR_5d70fbc2_Tx: ComBitPosition=24, ComBitSize=15, ComSignalInitValue=0, ComSignalType=UINT16, ComHandleId=780, ComSystemTemplateSystemSignalRef=DET_RANGE_033
            DET_RANGE_ERR_035_oRDR_DETECTION_033_036_oPCAN_RADAR_3358b657_Tx: ComBitPosition=264, ComBitSize=7, ComSignalInitValue=0, ComSignalType=UINT8, ComHandleId=786, ComSystemTemplateSystemSignalRef=DET_RANGE_ERR_035
            DET_RANGE_034_oRDR_DETECTION_033_036_oPCAN_RADAR_01c0d8ab_Tx: ComBitPosition=136, ComBitSize=15, ComSignalInitValue=0, ComSignalType=UINT16, ComHandleId=781, ComSystemTemplateSystemSignalRef=DET_RANGE_034
            DET_SNR_033_oRDR_DETECTION_033_036_oPCAN_RADAR_72f85abf_Tx: ComBitPosition=120, ComBitSize=8, ComSignalInitValue=0, ComSignalType=UINT8, ComHandleId=800, ComSystemTemplateSystemSignalRef=DET_SNR_033
            DET_SUPER_RES_TARGET_033_oRDR_DETECTION_033_036_oPCAN_RADAR_436172da_Tx: ComBitPosition=87, ComBitSize=1, ComSignalInitValue=0, ComSignalType=BOOLEAN, ComHandleId=804, ComSystemTemplateSystemSignalRef=DET_SUPER_RES_TARGET_033
            DET_CONFD_AZIMUTH_033_oRDR_DETECTION_033_036_oPCAN_RADAR_4f0d82b3_Tx: ComBitPosition=118, ComBitSize=2, ComSignalInitValue=0, ComSignalType=UINT8, ComHandleId=741, ComSystemTemplateSystemSignalRef=DET_CONFD_AZIMUTH_033
            DET_EXISTENCE_PROB_036_oRDR_DETECTION_033_036_oPCAN_RADAR_64de3662_Tx: ComBitPosition=448, ComBitSize=6, ComSignalInitValue=0, ComSignalType=UINT8, ComHandleId=760, ComSystemTemplateSystemSignalRef=DET_EXISTENCE_PROB_036
            DET_RANGE_VELOCITY_ERR_036_oRDR_DETECTION_033_036_oPCAN_RADAR_8a4d4e57_Tx: ComBitPosition=400, ComBitSize=8, ComSignalInitValue=0, ComSignalType=UINT8, ComHandleId=795, ComSystemTemplateSystemSignalRef=DET_RANGE_VELOCITY_ERR_036
            DET_SNR_034_oRDR_DETECTION_033_036_oPCAN_RADAR_2e4879d6_Tx: ComBitPosition=232, ComBitSize=8, ComSignalInitValue=0, ComSignalType=UINT8, ComHandleId=801, ComSystemTemplateSystemSignalRef=DET_SNR_034
            DET_ELEVATION_034_oRDR_DETECTION_033_036_oPCAN_RADAR_c0e8741c_Tx: ComBitPosition=184, ComBitSize=8, ComSignalInitValue=0, ComSignalType=UINT8, ComHandleId=750, ComSystemTemplateSystemSignalRef=DET_ELEVATION_034
            DET_RANGE_036_oRDR_DETECTION_033_036_oPCAN_RADAR_f05077c0_Tx: ComBitPosition=360, ComBitSize=15, ComSignalInitValue=0, ComSignalType=UINT16, ComHandleId=783, ComSystemTemplateSystemSignalRef=DET_RANGE_036
            DET_MH_CRC16_033_036_oRDR_DETECTION_033_036_oPCAN_RADAR_b4079ffd_Tx: ComBitPosition=0, ComBitSize=16, ComSignalInitValue=0, ComSignalType=UINT16, ComHandleId=769, ComSystemTemplateSystemSignalRef=DET_MH_CRC16_033_036
            DET_CONFD_ELEVATION_033_oRDR_DETECTION_033_036_oPCAN_RADAR_4d988349_Tx: ComBitPosition=101, ComBitSize=2, ComSignalInitValue=0, ComSignalType=UINT8, ComHandleId=745, ComSystemTemplateSystemSignalRef=DET_CONFD_ELEVATION_033
            DET_RCS_034_oRDR_DETECTION_033_036_oPCAN_RADAR_f3e62dd4_Tx: ComBitPosition=240, ComBitSize=8, ComSignalInitValue=128, ComSignalType=UINT8, ComHandleId=797, ComSystemTemplateSystemSignalRef=DET_RCS_034
            DET_AZIMUTH_ERR_034_oRDR_DETECTION_033_036_oPCAN_RADAR_b5ee3ee5_Tx: ComBitPosition=217, ComBitSize=7, ComSignalInitValue=0, ComSignalType=UINT8, ComHandleId=730, ComSystemTemplateSystemSignalRef=DET_AZIMUTH_ERR_034
            DET_BELOW_RAIN_THOLD_036_oRDR_DETECTION_033_036_oPCAN_RADAR_35ca97bb_Tx: ComBitPosition=375, ComBitSize=1, ComSignalInitValue=0, ComSignalType=UINT8, ComHandleId=736, ComSystemTemplateSystemSignalRef=DET_BELOW_RAIN_THOLD_036
            DET_IDM_033_oRDR_DETECTION_033_036_oPCAN_RADAR_a3d8c2a2_Tx: ComBitPosition=63, ComBitSize=1, ComSignalInitValue=0, ComSignalType=UINT8, ComHandleId=765, ComSystemTemplateSystemSignalRef=DET_IDM_033
            DET_IDM_036_oRDR_DETECTION_033_036_oPCAN_RADAR_0ef84ea0_Tx: ComBitPosition=399, ComBitSize=1, ComSignalInitValue=0, ComSignalType=UINT8, ComHandleId=768, ComSystemTemplateSystemSignalRef=DET_IDM_036
            DET_IDM_034_oRDR_DETECTION_033_036_oPCAN_RADAR_ff68e1cb_Tx: ComBitPosition=175, ComBitSize=1, ComSignalInitValue=0, ComSignalType=UINT8, ComHandleId=766, ComSystemTemplateSystemSignalRef=DET_IDM_034
            DET_MTD_034_oRDR_DETECTION_033_036_oPCAN_RADAR_99dbd310_Tx: ComBitPosition=159, ComBitSize=1, ComSignalInitValue=0, ComSignalType=UINT8, ComHandleId=773, ComSystemTemplateSystemSignalRef=DET_MTD_034
            DET_PROB_1STAZHYPO_036_oRDR_DETECTION_033_036_oPCAN_RADAR_fbff94b6_Tx: ComBitPosition=439, ComBitSize=1, ComSignalInitValue=0, ComSignalType=BOOLEAN, ComHandleId=779, ComSystemTemplateSystemSignalRef=DET_PROB_1STAZHYPO_036
            DET_BELOW_RAIN_THOLD_035_oRDR_DETECTION_033_036_oPCAN_RADAR_512aec45_Tx: ComBitPosition=263, ComBitSize=1, ComSignalInitValue=0, ComSignalType=UINT8, ComHandleId=735, ComSystemTemplateSystemSignalRef=DET_BELOW_RAIN_THOLD_035
            DET_BELOW_RAIN_THOLD_033_oRDR_DETECTION_033_036_oPCAN_RADAR_98ea1bb9_Tx: ComBitPosition=39, ComBitSize=1, ComSignalInitValue=0, ComSignalType=UINT8, ComHandleId=733, ComSystemTemplateSystemSignalRef=DET_BELOW_RAIN_THOLD_033
            DET_MTD_033_oRDR_DETECTION_033_036_oPCAN_RADAR_c56bf079_Tx: ComBitPosition=47, ComBitSize=1, ComSignalInitValue=0, ComSignalType=UINT8, ComHandleId=772, ComSystemTemplateSystemSignalRef=DET_MTD_033
            DET_PROB_1STAZHYPO_035_oRDR_DETECTION_033_036_oPCAN_RADAR_9f1fef48_Tx: ComBitPosition=327, ComBitSize=1, ComSignalInitValue=0, ComSignalType=BOOLEAN, ComHandleId=778, ComSystemTemplateSystemSignalRef=DET_PROB_1STAZHYPO_035
            DET_PROB_1STAZHYPO_033_oRDR_DETECTION_033_036_oPCAN_RADAR_56df18b4_Tx: ComBitPosition=103, ComBitSize=1, ComSignalInitValue=0, ComSignalType=BOOLEAN, ComHandleId=776, ComSystemTemplateSystemSignalRef=DET_PROB_1STAZHYPO_033
            DET_IDM_035_oRDR_DETECTION_033_036_oPCAN_RADAR_6a18355e_Tx: ComBitPosition=287, ComBitSize=1, ComSignalInitValue=0, ComSignalType=UINT8, ComHandleId=767, ComSystemTemplateSystemSignalRef=DET_IDM_035
            DET_BELOW_RAIN_THOLD_034_oRDR_DETECTION_033_036_oPCAN_RADAR_c45a38d0_Tx: ComBitPosition=151, ComBitSize=1, ComSignalInitValue=0, ComSignalType=UINT8, ComHandleId=734, ComSystemTemplateSystemSignalRef=DET_BELOW_RAIN_THOLD_034
            DET_PROB_1STAZHYPO_034_oRDR_DETECTION_033_036_oPCAN_RADAR_0a6f3bdd_Tx: ComBitPosition=215, ComBitSize=1, ComSignalInitValue=0, ComSignalType=BOOLEAN, ComHandleId=777, ComSystemTemplateSystemSignalRef=DET_PROB_1STAZHYPO_034
            DET_MTD_036_oRDR_DETECTION_033_036_oPCAN_RADAR_684b7c7b_Tx: ComBitPosition=383, ComBitSize=1, ComSignalInitValue=0, ComSignalType=UINT8, ComHandleId=775, ComSystemTemplateSystemSignalRef=DET_MTD_036
            DET_MTD_035_oRDR_DETECTION_033_036_oPCAN_RADAR_0cab0785_Tx: ComBitPosition=271, ComBitSize=1, ComSignalInitValue=0, ComSignalType=UINT8, ComHandleId=774, ComSystemTemplateSystemSignalRef=DET_MTD_035
