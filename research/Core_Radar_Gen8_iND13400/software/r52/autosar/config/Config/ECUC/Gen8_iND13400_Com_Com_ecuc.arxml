[part 15 of 20: package /ActiveEcuC]
AUTOSAR XML (schema 00053)
package /ActiveEcuC  (continued)
  module config Com: implementation-config-variant=VARIANT-PRE-COMPILE, module-description=Com_Impl  (continued)
    ComConfig: ComConfigurationId=0, ComRxImmediateNotificationCacheSize=0, ComRxDeferredNotificationCacheSize=1  (continued)
      109 x ComSignalGroup, all with ComSignalGroupAccess=ACCESS_NEEDED_BY_SWC_OR_COM, ComSignalGroupArrayAccess=true:  (continued)
        SG_Detections_117_120_oRDR_DETECTION_117_120_oPCAN_RADAR_abfe9992_Tx: ComTransferProperty=TRIGGERED, ComHandleId=31, ComSystemTemplateSignalGroupRef=SG_Detections_117_120
          83 x ComGroupSignal, all with ComSignalEndianness=LITTLE_ENDIAN, ComTransferProperty=PENDING, ComSignalAccess=ACCESS_NEEDED_BY_SWC_OR_COM:
            DET_AZIMUTH_ERR_120_oRDR_DETECTION_117_120_oPCAN_RADAR_a5e9a5d8_Tx: ComBitPosition=441, ComBitSize=7, ComSignalInitValue=0, ComSignalType=UINT8, ComHandleId=2475, ComSystemTemplateSystemSignalRef=DET_AZIMUTH_ERR_120
            DET_AZIMUTH_ERR_117_oRDR_DETECTION_117_120_oPCAN_RADAR_a338b9d1_Tx: ComBitPosition=105, ComBitSize=7, ComSignalInitValue=0, ComSignalType=UINT8, ComHandleId=2472, ComSystemTemplateSystemSignalRef=DET_AZIMUTH_ERR_117
            DET_HVC_FLAG_117_oRDR_DETECTION_117_120_oPCAN_RADAR_62ec5d42_Tx: ComBitPosition=86, ComBitSize=1, ComSignalInitValue=0, ComSignalType=BOOLEAN, ComHandleId=2504, ComSystemTemplateSystemSignalRef=DET_HVC_FLAG_117
            DET_RANGE_VELOCITY_ERR_117_oRDR_DETECTION_117_120_oPCAN_RADAR_6d0b6608_Tx: ComBitPosition=64, ComBitSize=8, ComSignalInitValue=0, ComSignalType=UINT8, ComHandleId=2535, ComSystemTemplateSystemSignalRef=DET_RANGE_VELOCITY_ERR_117
            DET_RANGE_ERR_119_oRDR_DETECTION_117_120_oPCAN_RADAR_099ea324_Tx: ComBitPosition=264, ComBitSize=7, ComSignalInitValue=0, ComSignalType=UINT8, ComHandleId=2529, ComSystemTemplateSystemSignalRef=DET_RANGE_ERR_119
            DET_SUPER_RES_TARGET_118_oRDR_DETECTION_117_120_oPCAN_RADAR_251744c0_Tx: ComBitPosition=199, ComBitSize=1, ComSignalInitValue=0, ComSignalType=BOOLEAN, ComHandleId=2548, ComSystemTemplateSystemSignalRef=DET_SUPER_RES_TARGET_118
            DET_SNR_118_oRDR_DETECTION_117_120_oPCAN_RADAR_148e6ca5_Tx: ComBitPosition=232, ComBitSize=8, ComSignalInitValue=0, ComSignalType=UINT8, ComHandleId=2544, ComSystemTemplateSystemSignalRef=DET_SNR_118
            DET_ELEVATION_ERR_120_oRDR_DETECTION_117_120_oPCAN_RADAR_57d67754_Tx: ComBitPosition=416, ComBitSize=6, ComSignalInitValue=0, ComSignalType=UINT8, ComHandleId=2499, ComSystemTemplateSystemSignalRef=DET_ELEVATION_ERR_120
            DET_HVC_FLAG_118_oRDR_DETECTION_117_120_oPCAN_RADAR_4efccf05_Tx: ComBitPosition=198, ComBitSize=1, ComSignalInitValue=0, ComSignalType=BOOLEAN, ComHandleId=2505, ComSystemTemplateSystemSignalRef=DET_HVC_FLAG_118
            DET_MH_CRC16_117_120_oRDR_DETECTION_117_120_oPCAN_RADAR_2f764b99_Tx: ComBitPosition=0, ComBitSize=16, ComSignalInitValue=0, ComSignalType=UINT16, ComHandleId=2512, ComSystemTemplateSystemSignalRef=DET_MH_CRC16_117_120
            DET_AZIMUTH_119_oRDR_DETECTION_117_120_oPCAN_RADAR_beed6af6_Tx: ComBitPosition=312, ComBitSize=13, ComSignalInitValue=0, ComSignalType=UINT16, ComHandleId=2470, ComSystemTemplateSystemSignalRef=DET_AZIMUTH_119
            DET_CONFD_AZIMUTH_117_oRDR_DETECTION_117_120_oPCAN_RADAR_056b26ee_Tx: ComBitPosition=118, ComBitSize=2, ComSignalInitValue=0, ComSignalType=UINT8, ComHandleId=2484, ComSystemTemplateSystemSignalRef=DET_CONFD_AZIMUTH_117
            DET_RANGE_VELOCITY_ERR_118_oRDR_DETECTION_117_120_oPCAN_RADAR_411bf44f_Tx: ComBitPosition=176, ComBitSize=8, ComSignalInitValue=0, ComSignalType=UINT8, ComHandleId=2536, ComSystemTemplateSystemSignalRef=DET_RANGE_VELOCITY_ERR_118
            DET_RANGE_118_oRDR_DETECTION_117_120_oPCAN_RADAR_3b06cdd8_Tx: ComBitPosition=136, ComBitSize=15, ComSignalInitValue=0, ComSignalType=UINT16, ComHandleId=2524, ComSystemTemplateSystemSignalRef=DET_RANGE_118
            DET_HVC_FLAG_119_oRDR_DETECTION_117_120_oPCAN_RADAR_db8c1b90_Tx: ComBitPosition=310, ComBitSize=1, ComSignalInitValue=0, ComSignalType=BOOLEAN, ComHandleId=2506, ComSystemTemplateSystemSignalRef=DET_HVC_FLAG_119
            DET_RANGE_VELOCITY_119_oRDR_DETECTION_117_120_oPCAN_RADAR_dbd0db68_Tx: ComBitPosition=272, ComBitSize=15, ComSignalInitValue=16384, ComSignalType=UINT16, ComHandleId=2533, ComSystemTemplateSystemSignalRef=DET_RANGE_VELOCITY_119
            DET_RCS_120_oRDR_DETECTION_117_120_oPCAN_RADAR_e3e1b6e9_Tx: ComBitPosition=464, ComBitSize=8, ComSignalInitValue=128, ComSignalType=UINT8, ComHandleId=2542, ComSystemTemplateSystemSignalRef=DET_RCS_120
            DET_AZIMUTH_118_oRDR_DETECTION_117_120_oPCAN_RADAR_2b9dbe63_Tx: ComBitPosition=200, ComBitSize=13, ComSignalInitValue=0, ComSignalType=UINT16, ComHandleId=2469, ComSystemTemplateSystemSignalRef=DET_AZIMUTH_118
            DET_EXISTENCE_PROB_117_oRDR_DETECTION_117_120_oPCAN_RADAR_83981e3d_Tx: ComBitPosition=112, ComBitSize=6, ComSignalInitValue=0, ComSignalType=UINT8, ComHandleId=2500, ComSystemTemplateSystemSignalRef=DET_EXISTENCE_PROB_117
            DET_ELEVATION_118_oRDR_DETECTION_117_120_oPCAN_RADAR_fa2e616f_Tx: ComBitPosition=184, ComBitSize=8, ComSignalInitValue=0, ComSignalType=UINT8, ComHandleId=2493, ComSystemTemplateSystemSignalRef=DET_ELEVATION_118
            DET_ELEVATION_119_oRDR_DETECTION_117_120_oPCAN_RADAR_6f5eb5fa_Tx: ComBitPosition=296, ComBitSize=8, ComSignalInitValue=0, ComSignalType=UINT8, ComHandleId=2494, ComSystemTemplateSystemSignalRef=DET_ELEVATION_119
            DET_RANGE_119_oRDR_DETECTION_117_120_oPCAN_RADAR_ae76194d_Tx: ComBitPosition=248, ComBitSize=15, ComSignalInitValue=0, ComSignalType=UINT16, ComHandleId=2525, ComSystemTemplateSystemSignalRef=DET_RANGE_119
            DET_CONFD_AZIMUTH_118_oRDR_DETECTION_117_120_oPCAN_RADAR_297bb4a9_Tx: ComBitPosition=230, ComBitSize=2, ComSignalInitValue=0, ComSignalType=UINT8, ComHandleId=2485, ComSystemTemplateSystemSignalRef=DET_CONFD_AZIMUTH_118
            DET_BI_STATIC_FLAG_117_oRDR_DETECTION_117_120_oPCAN_RADAR_51a16ca1_Tx: ComBitPosition=104, ComBitSize=1, ComSignalInitValue=0, ComSignalType=BOOLEAN, ComHandleId=2480, ComSystemTemplateSystemSignalRef=DET_BI_STATIC_FLAG_117
            DET_ELEVATION_ERR_117_oRDR_DETECTION_117_120_oPCAN_RADAR_51076b5d_Tx: ComBitPosition=80, ComBitSize=6, ComSignalInitValue=0, ComSignalType=UINT8, ComHandleId=2496, ComSystemTemplateSystemSignalRef=DET_ELEVATION_ERR_117
            DET_MH_CYCLE_COUNTER_117_120_oRDR_DETECTION_117_120_oPCAN_RADAR_ab03eaae_Tx: ComBitPosition=16, ComBitSize=8, ComSignalInitValue=0, ComSignalType=UINT8, ComHandleId=2513, ComSystemTemplateSystemSignalRef=DET_MH_CYCLE_COUNTER_117_120
            DET_SNR_120_oRDR_DETECTION_117_120_oPCAN_RADAR_3e4fe2eb_Tx: ComBitPosition=456, ComBitSize=8, ComSignalInitValue=0, ComSignalType=UINT8, ComHandleId=2546, ComSystemTemplateSystemSignalRef=DET_SNR_120
            DET_CONFD_ELEVATION_120_oRDR_DETECTION_117_120_oPCAN_RADAR_012f3b1d_Tx: ComBitPosition=437, ComBitSize=2, ComSignalInitValue=0, ComSignalType=UINT8, ComHandleId=2491, ComSystemTemplateSystemSignalRef=DET_CONFD_ELEVATION_120
            DET_RANGE_ERR_118_oRDR_DETECTION_117_120_oPCAN_RADAR_9cee77b1_Tx: ComBitPosition=152, ComBitSize=7, ComSignalInitValue=0, ComSignalType=UINT8, ComHandleId=2528, ComSystemTemplateSystemSignalRef=DET_RANGE_ERR_118
            DET_ELEVATION_ERR_119_oRDR_DETECTION_117_120_oPCAN_RADAR_e8672d8f_Tx: ComBitPosition=304, ComBitSize=6, ComSignalInitValue=0, ComSignalType=UINT8, ComHandleId=2498, ComSystemTemplateSystemSignalRef=DET_ELEVATION_ERR_119
            DET_EXISTENCE_PROB_119_oRDR_DETECTION_117_120_oPCAN_RADAR_3af858ef_Tx: ComBitPosition=336, ComBitSize=6, ComSignalInitValue=0, ComSignalType=UINT8, ComHandleId=2502, ComSystemTemplateSystemSignalRef=DET_EXISTENCE_PROB_119
            DET_BI_STATIC_FLAG_118_oRDR_DETECTION_117_120_oPCAN_RADAR_7db1fee6_Tx: ComBitPosition=216, ComBitSize=1, ComSignalInitValue=0, ComSignalType=BOOLEAN, ComHandleId=2481, ComSystemTemplateSystemSignalRef=DET_BI_STATIC_FLAG_118
            DET_CONFD_AZIMUTH_120_oRDR_DETECTION_117_120_oPCAN_RADAR_03ba3ae7_Tx: ComBitPosition=454, ComBitSize=2, ComSignalInitValue=0, ComSignalType=UINT8, ComHandleId=2487, ComSystemTemplateSystemSignalRef=DET_CONFD_AZIMUTH_120
            DET_RANGE_VELOCITY_120_oRDR_DETECTION_117_120_oPCAN_RADAR_646181b3_Tx: ComBitPosition=384, ComBitSize=15, ComSignalInitValue=16384, ComSignalType=UINT16, ComHandleId=2534, ComSystemTemplateSystemSignalRef=DET_RANGE_VELOCITY_120
            DET_ELEVATION_ERR_118_oRDR_DETECTION_117_120_oPCAN_RADAR_7d17f91a_Tx: ComBitPosition=192, ComBitSize=6, ComSignalInitValue=0, ComSignalType=UINT8, ComHandleId=2497, ComSystemTemplateSystemSignalRef=DET_ELEVATION_ERR_118
            DET_AZIMUTH_117_oRDR_DETECTION_117_120_oPCAN_RADAR_078d2c24_Tx: ComBitPosition=88, ComBitSize=13, ComSignalInitValue=0, ComSignalType=UINT16, ComHandleId=2468, ComSystemTemplateSystemSignalRef=DET_AZIMUTH_117
            DET_RANGE_VELOCITY_118_oRDR_DETECTION_117_120_oPCAN_RADAR_4ea00ffd_Tx: ComBitPosition=160, ComBitSize=15, ComSignalInitValue=16384, ComSignalType=UINT16, ComHandleId=2532, ComSystemTemplateSystemSignalRef=DET_RANGE_VELOCITY_118
            DET_CONFD_ELEVATION_118_oRDR_DETECTION_117_120_oPCAN_RADAR_2beeb553_Tx: ComBitPosition=213, ComBitSize=2, ComSignalInitValue=0, ComSignalType=UINT8, ComHandleId=2489, ComSystemTemplateSystemSignalRef=DET_CONFD_ELEVATION_118
            DET_RANGE_ERR_117_oRDR_DETECTION_117_120_oPCAN_RADAR_b0fee5f6_Tx: ComBitPosition=40, ComBitSize=7, ComSignalInitValue=0, ComSignalType=UINT8, ComHandleId=2527, ComSystemTemplateSystemSignalRef=DET_RANGE_ERR_117
            DET_CONFD_ELEVATION_119_oRDR_DETECTION_117_120_oPCAN_RADAR_be9e61c6_Tx: ComBitPosition=325, ComBitSize=2, ComSignalInitValue=0, ComSignalType=UINT8, ComHandleId=2490, ComSystemTemplateSystemSignalRef=DET_CONFD_ELEVATION_119
            DET_SNR_119_oRDR_DETECTION_117_120_oPCAN_RADAR_81feb830_Tx: ComBitPosition=344, ComBitSize=8, ComSignalInitValue=0, ComSignalType=UINT8, ComHandleId=2545, ComSystemTemplateSystemSignalRef=DET_SNR_119
            DET_ELEVATION_117_oRDR_DETECTION_117_120_oPCAN_RADAR_d63ef328_Tx: ComBitPosition=72, ComBitSize=8, ComSignalInitValue=0, ComSignalType=UINT8, ComHandleId=2492, ComSystemTemplateSystemSignalRef=DET_ELEVATION_117
            DET_SUPER_RES_TARGET_119_oRDR_DETECTION_117_120_oPCAN_RADAR_b0679055_Tx: ComBitPosition=311, ComBitSize=1, ComSignalInitValue=0, ComSignalType=BOOLEAN, ComHandleId=2549, ComSystemTemplateSystemSignalRef=DET_SUPER_RES_TARGET_119
            DET_RANGE_120_oRDR_DETECTION_117_120_oPCAN_RADAR_11c74396_Tx: ComBitPosition=360, ComBitSize=15, ComSignalInitValue=0, ComSignalType=UINT16, ComHandleId=2526, ComSystemTemplateSystemSignalRef=DET_RANGE_120
            DET_RANGE_VELOCITY_ERR_119_oRDR_DETECTION_117_120_oPCAN_RADAR_d46b20da_Tx: ComBitPosition=288, ComBitSize=8, ComSignalInitValue=0, ComSignalType=UINT8, ComHandleId=2537, ComSystemTemplateSystemSignalRef=DET_RANGE_VELOCITY_ERR_119
            DET_CONFD_AZIMUTH_119_oRDR_DETECTION_117_120_oPCAN_RADAR_bc0b603c_Tx: ComBitPosition=342, ComBitSize=2, ComSignalInitValue=0, ComSignalType=UINT8, ComHandleId=2486, ComSystemTemplateSystemSignalRef=DET_CONFD_AZIMUTH_119
            DET_ELEVATION_120_oRDR_DETECTION_117_120_oPCAN_RADAR_d0efef21_Tx: ComBitPosition=408, ComBitSize=8, ComSignalInitValue=0, ComSignalType=UINT8, ComHandleId=2495, ComSystemTemplateSystemSignalRef=DET_ELEVATION_120
            DET_RANGE_117_oRDR_DETECTION_117_120_oPCAN_RADAR_17165f9f_Tx: ComBitPosition=24, ComBitSize=15, ComSignalInitValue=0, ComSignalType=UINT16, ComHandleId=2523, ComSystemTemplateSystemSignalRef=DET_RANGE_117
            DET_RCS_117_oRDR_DETECTION_117_120_oPCAN_RADAR_e530aae0_Tx: ComBitPosition=128, ComBitSize=8, ComSignalInitValue=128, ComSignalType=UINT8, ComHandleId=2539, ComSystemTemplateSystemSignalRef=DET_RCS_117
            DET_SUPER_RES_TARGET_120_oRDR_DETECTION_117_120_oPCAN_RADAR_0fd6ca8e_Tx: ComBitPosition=423, ComBitSize=1, ComSignalInitValue=0, ComSignalType=BOOLEAN, ComHandleId=2550, ComSystemTemplateSystemSignalRef=DET_SUPER_RES_TARGET_120
            DET_MH_SCAN_INDEX_4LSB_117_120_oRDR_DETECTION_117_120_oPCAN_RADAR_6729cf22_Tx: ComBitPosition=476, ComBitSize=4, ComSignalInitValue=0, ComSignalType=UINT8, ComHandleId=2514, ComSystemTemplateSystemSignalRef=DET_MH_SCAN_INDEX_4LSB_117_120
            DET_AZIMUTH_ERR_118_oRDR_DETECTION_117_120_oPCAN_RADAR_8f282b96_Tx: ComBitPosition=217, ComBitSize=7, ComSignalInitValue=0, ComSignalType=UINT8, ComHandleId=2473, ComSystemTemplateSystemSignalRef=DET_AZIMUTH_ERR_118
            DET_AZIMUTH_120_oRDR_DETECTION_117_120_oPCAN_RADAR_015c302d_Tx: ComBitPosition=424, ComBitSize=13, ComSignalInitValue=0, ComSignalType=UINT16, ComHandleId=2471, ComSystemTemplateSystemSignalRef=DET_AZIMUTH_120
            DET_EXISTENCE_PROB_120_oRDR_DETECTION_117_120_oPCAN_RADAR_85490234_Tx: ComBitPosition=448, ComBitSize=6, ComSignalInitValue=0, ComSignalType=UINT8, ComHandleId=2503, ComSystemTemplateSystemSignalRef=DET_EXISTENCE_PROB_120
            DET_RANGE_ERR_120_oRDR_DETECTION_117_120_oPCAN_RADAR_b62ff9ff_Tx: ComBitPosition=376, ComBitSize=7, ComSignalInitValue=0, ComSignalType=UINT8, ComHandleId=2530, ComSystemTemplateSystemSignalRef=DET_RANGE_ERR_120
            DET_SUPER_RES_TARGET_117_oRDR_DETECTION_117_120_oPCAN_RADAR_0907d687_Tx: ComBitPosition=87, ComBitSize=1, ComSignalInitValue=0, ComSignalType=BOOLEAN, ComHandleId=2547, ComSystemTemplateSystemSignalRef=DET_SUPER_RES_TARGET_117
            DET_RCS_119_oRDR_DETECTION_117_120_oPCAN_RADAR_5c50ec32_Tx: ComBitPosition=352, ComBitSize=8, ComSignalInitValue=128, ComSignalType=UINT8, ComHandleId=2541, ComSystemTemplateSystemSignalRef=DET_RCS_119
            DET_EXISTENCE_PROB_118_oRDR_DETECTION_117_120_oPCAN_RADAR_af888c7a_Tx: ComBitPosition=224, ComBitSize=6, ComSignalInitValue=0, ComSignalType=UINT8, ComHandleId=2501, ComSystemTemplateSystemSignalRef=DET_EXISTENCE_PROB_118
            DET_SNR_117_oRDR_DETECTION_117_120_oPCAN_RADAR_389efee2_Tx: ComBitPosition=120, ComBitSize=8, ComSignalInitValue=0, ComSignalType=UINT8, ComHandleId=2543, ComSystemTemplateSystemSignalRef=DET_SNR_117
            DET_BI_STATIC_FLAG_119_oRDR_DETECTION_117_120_oPCAN_RADAR_e8c12a73_Tx: ComBitPosition=328, ComBitSize=1, ComSignalInitValue=0, ComSignalType=BOOLEAN, ComHandleId=2482, ComSystemTemplateSystemSignalRef=DET_BI_STATIC_FLAG_119
            DET_CONFD_ELEVATION_117_oRDR_DETECTION_117_120_oPCAN_RADAR_07fe2714_Tx: ComBitPosition=101, ComBitSize=2, ComSignalInitValue=0, ComSignalType=UINT8, ComHandleId=2488, ComSystemTemplateSystemSignalRef=DET_CONFD_ELEVATION_117
            DET_RANGE_VELOCITY_117_oRDR_DETECTION_117_120_oPCAN_RADAR_62b09dba_Tx: ComBitPosition=48, ComBitSize=15, ComSignalInitValue=16384, ComSignalType=UINT16, ComHandleId=2531, ComSystemTemplateSystemSignalRef=DET_RANGE_VELOCITY_117
            DET_BI_STATIC_FLAG_120_oRDR_DETECTION_117_120_oPCAN_RADAR_577070a8_Tx: ComBitPosition=440, ComBitSize=1, ComSignalInitValue=0, ComSignalType=BOOLEAN, ComHandleId=2483, ComSystemTemplateSystemSignalRef=DET_BI_STATIC_FLAG_120
            DET_RANGE_VELOCITY_ERR_120_oRDR_DETECTION_117_120_oPCAN_RADAR_6bda7a01_Tx: ComBitPosition=400, ComBitSize=8, ComSignalInitValue=0, ComSignalType=UINT8, ComHandleId=2538, ComSystemTemplateSystemSignalRef=DET_RANGE_VELOCITY_ERR_120
            DET_HVC_FLAG_120_oRDR_DETECTION_117_120_oPCAN_RADAR_643d414b_Tx: ComBitPosition=422, ComBitSize=1, ComSignalInitValue=0, ComSignalType=BOOLEAN, ComHandleId=2507, ComSystemTemplateSystemSignalRef=DET_HVC_FLAG_120
            DET_AZIMUTH_ERR_119_oRDR_DETECTION_117_120_oPCAN_RADAR_1a58ff03_Tx: ComBitPosition=329, ComBitSize=7, ComSignalInitValue=0, ComSignalType=UINT8, ComHandleId=2474, ComSystemTemplateSystemSignalRef=DET_AZIMUTH_ERR_119
            DET_RCS_118_oRDR_DETECTION_117_120_oPCAN_RADAR_c92038a7_Tx: ComBitPosition=240, ComBitSize=8, ComSignalInitValue=128, ComSignalType=UINT8, ComHandleId=2540, ComSystemTemplateSystemSignalRef=DET_RCS_118
            DET_IDM_120_oRDR_DETECTION_117_120_oPCAN_RADAR_ef6f7af6_Tx: ComBitPosition=399, ComBitSize=1, ComSignalInitValue=0, ComSignalType=UINT8, ComHandleId=2511, ComSystemTemplateSystemSignalRef=DET_IDM_120
            DET_IDM_117_oRDR_DETECTION_117_120_oPCAN_RADAR_e9be66ff_Tx: ComBitPosition=63, ComBitSize=1, ComSignalInitValue=0, ComSignalType=UINT8, ComHandleId=2508, ComSystemTemplateSystemSignalRef=DET_IDM_117
            DET_BELOW_RAIN_THOLD_118_oRDR_DETECTION_117_120_oPCAN_RADAR_fe9c2da3_Tx: ComBitPosition=151, ComBitSize=1, ComSignalInitValue=0, ComSignalType=UINT8, ComHandleId=2477, ComSystemTemplateSystemSignalRef=DET_BELOW_RAIN_THOLD_118
            DET_PROB_1STAZHYPO_117_oRDR_DETECTION_117_120_oPCAN_RADAR_1cb9bce9_Tx: ComBitPosition=103, ComBitSize=1, ComSignalInitValue=0, ComSignalType=BOOLEAN, ComHandleId=2519, ComSystemTemplateSystemSignalRef=DET_PROB_1STAZHYPO_117
            DET_IDM_119_oRDR_DETECTION_117_120_oPCAN_RADAR_50de202d_Tx: ComBitPosition=287, ComBitSize=1, ComSignalInitValue=0, ComSignalType=UINT8, ComHandleId=2510, ComSystemTemplateSystemSignalRef=DET_IDM_119
            DET_MTD_119_oRDR_DETECTION_117_120_oPCAN_RADAR_366d12f6_Tx: ComBitPosition=271, ComBitSize=1, ComSignalInitValue=0, ComSignalType=UINT8, ComHandleId=2517, ComSystemTemplateSystemSignalRef=DET_MTD_119
            DET_PROB_1STAZHYPO_120_oRDR_DETECTION_117_120_oPCAN_RADAR_1a68a0e0_Tx: ComBitPosition=439, ComBitSize=1, ComSignalInitValue=0, ComSignalType=BOOLEAN, ComHandleId=2522, ComSystemTemplateSystemSignalRef=DET_PROB_1STAZHYPO_120
            DET_IDM_118_oRDR_DETECTION_117_120_oPCAN_RADAR_c5aef4b8_Tx: ComBitPosition=175, ComBitSize=1, ComSignalInitValue=0, ComSignalType=UINT8, ComHandleId=2509, ComSystemTemplateSystemSignalRef=DET_IDM_118
            DET_BELOW_RAIN_THOLD_120_oRDR_DETECTION_117_120_oPCAN_RADAR_d45da3ed_Tx: ComBitPosition=375, ComBitSize=1, ComSignalInitValue=0, ComSignalType=UINT8, ComHandleId=2479, ComSystemTemplateSystemSignalRef=DET_BELOW_RAIN_THOLD_120
            DET_MTD_118_oRDR_DETECTION_117_120_oPCAN_RADAR_a31dc663_Tx: ComBitPosition=159, ComBitSize=1, ComSignalInitValue=0, ComSignalType=UINT8, ComHandleId=2516, ComSystemTemplateSystemSignalRef=DET_MTD_118
            DET_MTD_117_oRDR_DETECTION_117_120_oPCAN_RADAR_8f0d5424_Tx: ComBitPosition=47, ComBitSize=1, ComSignalInitValue=0, ComSignalType=UINT8, ComHandleId=2515, ComSystemTemplateSystemSignalRef=DET_MTD_117
            DET_BELOW_RAIN_THOLD_119_oRDR_DETECTION_117_120_oPCAN_RADAR_6becf936_Tx: ComBitPosition=263, ComBitSize=1, ComSignalInitValue=0, ComSignalType=UINT8, ComHandleId=2478, ComSystemTemplateSystemSignalRef=DET_BELOW_RAIN_THOLD_119
            DET_PROB_1STAZHYPO_118_oRDR_DETECTION_117_120_oPCAN_RADAR_30a92eae_Tx: ComBitPosition=215, ComBitSize=1, ComSignalInitValue=0, ComSignalType=BOOLEAN, ComHandleId=2520, ComSystemTemplateSystemSignalRef=DET_PROB_1STAZHYPO_118
            DET_PROB_1STAZHYPO_119_oRDR_DETECTION_117_120_oPCAN_RADAR_a5d9fa3b_Tx: ComBitPosition=327, ComBitSize=1, ComSignalInitValue=0, ComSignalType=BOOLEAN, ComHandleId=2521, ComSystemTemplateSystemSignalRef=DET_PROB_1STAZHYPO_119
            DET_MTD_120_oRDR_DETECTION_117_120_oPCAN_RADAR_89dc482d_Tx: ComBitPosition=383, ComBitSize=1, ComSignalInitValue=0, ComSignalType=UINT8, ComHandleId=2518, ComSystemTemplateSystemSignalRef=DET_MTD_120
            DET_BELOW_RAIN_THOLD_117_oRDR_DETECTION_117_120_oPCAN_RADAR_d28cbfe4_Tx: ComBitPosition=39, ComBitSize=1, ComSignalInitValue=0, ComSignalType=UINT8, ComHandleId=2476, ComSystemTemplateSystemSignalRef=DET_BELOW_RAIN_THOLD_117
        SG_RadarCapability_oRDR_CAPABILITY_oPCAN_RADAR_be2920f1_Tx: ComTransferProperty=TRIGGERED, ComHandleId=105, ComSystemTemplateSignalGroupRef=SG_RadarCapability
          31 x ComGroupSignal, all with ComSignalEndianness=LITTLE_ENDIAN, ComTransferProperty=PENDING, ComSignalAccess=ACCESS_NEEDED_BY_SWC_OR_COM:
            CAP_BlockageProbability_oRDR_CAPABILITY_oPCAN_RADAR_75a4bbd9_Tx: ComBitPosition=208, ComBitSize=7, ComSignalInitValue=0, ComSignalType=UINT8, ComHandleId=8370, ComSystemTemplateSystemSignalRef=CAP_BlockageProbability
            CAP_BlockageStatus_oRDR_CAPABILITY_oPCAN_RADAR_03af1b08_Tx: ComBitPosition=163, ComBitSize=3, ComSignalInitValue=3, ComSignalType=UINT8, ComHandleId=8372, ComSystemTemplateSystemSignalRef=CAP_BlockageStatus
            CAP_BlockageValue_oRDR_CAPABILITY_oPCAN_RADAR_006198cd_Tx: ComBitPosition=184, ComBitSize=3, ComSignalInitValue=5, ComSignalType=UINT8, ComHandleId=8373, ComSystemTemplateSystemSignalRef=CAP_BlockageValue
            CAP_SLLMonitoringStatus_oRDR_CAPABILITY_oPCAN_RADAR_098959a8_Tx: ComBitPosition=60, ComBitSize=3, ComSignalInitValue=3, ComSignalType=UINT8, ComHandleId=8396, ComSystemTemplateSystemSignalRef=CAP_SLLMonitoringStatus
            CAP_DampingStandardDeviation_oRDR_CAPABILITY_oPCAN_RADAR_e78ef0d8_Tx: ComBitPosition=48, ComBitSize=8, ComSignalInitValue=0, ComSignalType=UINT8, ComHandleId=8377, ComSystemTemplateSystemSignalRef=CAP_DampingStandardDeviation
            CAP_FreeSightCheckStatus_oRDR_CAPABILITY_oPCAN_RADAR_27a3e5b3_Tx: ComBitPosition=192, ComBitSize=8, ComSignalInitValue=255, ComSignalType=UINT8, ComHandleId=8380, ComSystemTemplateSystemSignalRef=CAP_FreeSightCheckStatus
            CAP_BlockageActive_oRDR_CAPABILITY_oPCAN_RADAR_5433d84c_Tx: ComBitPosition=162, ComBitSize=1, ComSignalInitValue=1, ComSignalType=UINT8, ComHandleId=8369, ComSystemTemplateSystemSignalRef=CAP_BlockageActive
            CAP_DampingActive_oRDR_CAPABILITY_oPCAN_RADAR_e25d461d_Tx: ComBitPosition=215, ComBitSize=1, ComSignalInitValue=0, ComSignalType=UINT8, ComHandleId=8375, ComSystemTemplateSystemSignalRef=CAP_DampingActive
            CAP_AngleAzimuthRangeStart_oRDR_CAPABILITY_oPCAN_RADAR_2a8ffbb4_Tx: ComBitPosition=90, ComBitSize=9, ComSignalInitValue=0, ComSignalType=SINT16, ComHandleId=8368, ComSystemTemplateSystemSignalRef=CAP_AngleAzimuthRangeStart
            CAP_CYCLE_COUNTER_oRDR_CAPABILITY_oPCAN_RADAR_4f1d1582_Tx: ComBitPosition=16, ComBitSize=8, ComSignalInitValue=0, ComSignalType=UINT8, ComHandleId=8374, ComSystemTemplateSystemSignalRef=CAP_CYCLE_COUNTER
            CAP_SLBlockageFlag_oRDR_CAPABILITY_oPCAN_RADAR_01507d8d_Tx: ComBitPosition=24, ComBitSize=1, ComSignalInitValue=0, ComSignalType=UINT8, ComHandleId=8394, ComSystemTemplateSystemSignalRef=CAP_SLBlockageFlag
            CAP_FreeSightCheckActive_oRDR_CAPABILITY_oPCAN_RADAR_703f26f7_Tx: ComBitPosition=176, ComBitSize=8, ComSignalInitValue=1, ComSignalType=UINT8, ComHandleId=8379, ComSystemTemplateSystemSignalRef=CAP_FreeSightCheckActive
            CAP_RangeEstimationStatus_oRDR_CAPABILITY_oPCAN_RADAR_bfc526eb_Tx: ComBitPosition=56, ComBitSize=3, ComSignalInitValue=3, ComSignalType=UINT8, ComHandleId=8392, ComSystemTemplateSystemSignalRef=CAP_RangeEstimationStatus
            CAP_AngleAzimuthRangeEnd_oRDR_CAPABILITY_oPCAN_RADAR_a9c23dc6_Tx: ComBitPosition=99, ComBitSize=9, ComSignalInitValue=0, ComSignalType=SINT16, ComHandleId=8367, ComSystemTemplateSystemSignalRef=CAP_AngleAzimuthRangeEnd
            CAP_SLBlockageFilterValue_oRDR_CAPABILITY_oPCAN_RADAR_f709e9f9_Tx: ComBitPosition=25, ComBitSize=6, ComSignalInitValue=0, ComSignalType=UINT8, ComHandleId=8393, ComSystemTemplateSystemSignalRef=CAP_SLBlockageFilterValue
            CAP_MH_CRC16_oRDR_CAPABILITY_oPCAN_RADAR_8ad8d6d0_Tx: ComBitPosition=0, ComBitSize=16, ComSignalInitValue=0, ComSignalType=UINT16, ComHandleId=8381, ComSystemTemplateSystemSignalRef=CAP_MH_CRC16
            CAP_SLLMonitoringActive_oRDR_CAPABILITY_oPCAN_RADAR_5e159aec_Tx: ComBitPosition=59, ComBitSize=1, ComSignalInitValue=1, ComSignalType=UINT8, ComHandleId=8395, ComSystemTemplateSystemSignalRef=CAP_SLLMonitoringActive
            CAP_RangeEstimationActive_oRDR_CAPABILITY_oPCAN_RADAR_e859e5af_Tx: ComBitPosition=31, ComBitSize=1, ComSignalInitValue=1, ComSignalType=UINT8, ComHandleId=8391, ComSystemTemplateSystemSignalRef=CAP_RangeEstimationActive
            CAP_DampingCurrent_oRDR_CAPABILITY_oPCAN_RADAR_52c5af4f_Tx: ComBitPosition=32, ComBitSize=16, ComSignalInitValue=25500, ComSignalType=UINT16, ComHandleId=8376, ComSystemTemplateSystemSignalRef=CAP_DampingCurrent
            CAP_BlockageSensitivity_oRDR_CAPABILITY_oPCAN_RADAR_0362010f_Tx: ComBitPosition=200, ComBitSize=8, ComSignalInitValue=2, ComSignalType=UINT8, ComHandleId=8371, ComSystemTemplateSystemSignalRef=CAP_BlockageSensitivity
            CAP_SideLobeLevelBeamformer_oRDR_CAPABILITY_oPCAN_RADAR_df16d7f9_Tx: ComBitPosition=168, ComBitSize=8, ComSignalInitValue=0, ComSignalType=UINT8, ComHandleId=8397, ComSystemTemplateSystemSignalRef=CAP_SideLobeLevelBeamformer
            CAP_DampingStatus_oRDR_CAPABILITY_oPCAN_RADAR_b5c18559_Tx: ComBitPosition=187, ComBitSize=3, ComSignalInitValue=3, ComSignalType=UINT8, ComHandleId=8378, ComSystemTemplateSystemSignalRef=CAP_DampingStatus
            CAP_MaxDetRangeMotorbike_0_oRDR_CAPABILITY_oPCAN_RADAR_5af73033_Tx: ComBitPosition=126, ComBitSize=9, ComSignalInitValue=0, ComSignalType=UINT16, ComHandleId=8382, ComSystemTemplateSystemSignalRef=CAP_MaxDetRangeMotorbike_0
            CAP_MaxDetRangePedestrian_0_oRDR_CAPABILITY_oPCAN_RADAR_fd5aacf5_Tx: ComBitPosition=81, ComBitSize=9, ComSignalInitValue=0, ComSignalType=UINT16, ComHandleId=8385, ComSystemTemplateSystemSignalRef=CAP_MaxDetRangePedestrian_0
            CAP_MaxDetRangePedestrian_2_oRDR_CAPABILITY_oPCAN_RADAR_3b551ebd_Tx: ComBitPosition=153, ComBitSize=9, ComSignalInitValue=0, ComSignalType=UINT16, ComHandleId=8387, ComSystemTemplateSystemSignalRef=CAP_MaxDetRangePedestrian_2
            CAP_MaxDetectionRangeCar_2_oRDR_CAPABILITY_oPCAN_RADAR_48910bf3_Tx: ComBitPosition=117, ComBitSize=9, ComSignalInitValue=0, ComSignalType=UINT16, ComHandleId=8390, ComSystemTemplateSystemSignalRef=CAP_MaxDetectionRangeCar_2
            CAP_MaxDetectionRangeCar_0_oRDR_CAPABILITY_oPCAN_RADAR_8e9eb9bb_Tx: ComBitPosition=63, ComBitSize=9, ComSignalInitValue=0, ComSignalType=UINT16, ComHandleId=8388, ComSystemTemplateSystemSignalRef=CAP_MaxDetectionRangeCar_0
            CAP_MaxDetRangeMotorbike_2_oRDR_CAPABILITY_oPCAN_RADAR_9cf8827b_Tx: ComBitPosition=144, ComBitSize=9, ComSignalInitValue=0, ComSignalType=UINT16, ComHandleId=8384, ComSystemTemplateSystemSignalRef=CAP_MaxDetRangeMotorbike_2
            CAP_MaxDetectionRangeCar_1_oRDR_CAPABILITY_oPCAN_RADAR_ed99609f_Tx: ComBitPosition=108, ComBitSize=9, ComSignalInitValue=0, ComSignalType=UINT16, ComHandleId=8389, ComSystemTemplateSystemSignalRef=CAP_MaxDetectionRangeCar_1
            CAP_MaxDetRangeMotorbike_1_oRDR_CAPABILITY_oPCAN_RADAR_39f0e917_Tx: ComBitPosition=72, ComBitSize=9, ComSignalInitValue=0, ComSignalType=UINT16, ComHandleId=8383, ComSystemTemplateSystemSignalRef=CAP_MaxDetRangeMotorbike_1
            CAP_MaxDetRangePedestrian_1_oRDR_CAPABILITY_oPCAN_RADAR_9e5d75d1_Tx: ComBitPosition=135, ComBitSize=9, ComSignalInitValue=0, ComSignalType=UINT16, ComHandleId=8386, ComSystemTemplateSystemSignalRef=CAP_MaxDetRangePedestrian_1
        SG_Detections_149_152_oRDR_DETECTION_149_152_oPCAN_RADAR_1fb2e794_Tx: ComTransferProperty=TRIGGERED, ComHandleId=39, ComSystemTemplateSignalGroupRef=SG_Detections_149_152
          83 x ComGroupSignal, all with ComSignalEndianness=LITTLE_ENDIAN, ComTransferProperty=PENDING, ComSignalAccess=ACCESS_NEEDED_BY_SWC_OR_COM:
            DET_SNR_152_oRDR_DETECTION_149_152_oPCAN_RADAR_5ba2a2a5_Tx: ComBitPosition=456, ComBitSize=8, ComSignalInitValue=0, ComSignalType=UINT8, ComHandleId=3210, ComSystemTemplateSystemSignalRef=DET_SNR_152
            DET_SUPER_RES_TARGET_151_oRDR_DETECTION_149_152_oPCAN_RADAR_0edbf13e_Tx: ComBitPosition=311, ComBitSize=1, ComSignalInitValue=0, ComSignalType=BOOLEAN, ComHandleId=3213, ComSystemTemplateSystemSignalRef=DET_SUPER_RES_TARGET_151
            DET_RCS_150_oRDR_DETECTION_149_152_oPCAN_RADAR_779c59cc_Tx: ComBitPosition=240, ComBitSize=8, ComSignalInitValue=128, ComSignalType=UINT8, ComHandleId=3204, ComSystemTemplateSystemSignalRef=DET_RCS_150
            DET_CONFD_ELEVATION_149_oRDR_DETECTION_149_152_oPCAN_RADAR_f072a69c_Tx: ComBitPosition=101, ComBitSize=2, ComSignalInitValue=0, ComSignalType=UINT8, ComHandleId=3152, ComSystemTemplateSystemSignalRef=DET_CONFD_ELEVATION_149
            DET_BI_STATIC_FLAG_151_oRDR_DETECTION_149_152_oPCAN_RADAR_567d4b18_Tx: ComBitPosition=328, ComBitSize=1, ComSignalInitValue=0, ComSignalType=BOOLEAN, ComHandleId=3146, ComSystemTemplateSystemSignalRef=DET_BI_STATIC_FLAG_151
            DET_AZIMUTH_ERR_151_oRDR_DETECTION_149_152_oPCAN_RADAR_a4e49e68_Tx: ComBitPosition=329, ComBitSize=7, ComSignalInitValue=0, ComSignalType=UINT8, ComHandleId=3138, ComSystemTemplateSystemSignalRef=DET_AZIMUTH_ERR_151
            DET_RANGE_152_oRDR_DETECTION_149_152_oPCAN_RADAR_742a03d8_Tx: ComBitPosition=360, ComBitSize=15, ComSignalInitValue=0, ComSignalType=UINT16, ComHandleId=3190, ComSystemTemplateSystemSignalRef=DET_RANGE_152
            DET_RCS_152_oRDR_DETECTION_149_152_oPCAN_RADAR_860cf6a7_Tx: ComBitPosition=464, ComBitSize=8, ComSignalInitValue=128, ComSignalType=UINT8, ComHandleId=3206, ComSystemTemplateSystemSignalRef=DET_RCS_152
            DET_AZIMUTH_151_oRDR_DETECTION_149_152_oPCAN_RADAR_00510b9d_Tx: ComBitPosition=312, ComBitSize=13, ComSignalInitValue=0, ComSignalType=UINT16, ComHandleId=3134, ComSystemTemplateSystemSignalRef=DET_AZIMUTH_151
            DET_CONFD_AZIMUTH_151_oRDR_DETECTION_149_152_oPCAN_RADAR_02b70157_Tx: ComBitPosition=342, ComBitSize=2, ComSignalInitValue=0, ComSignalType=UINT8, ComHandleId=3150, ComSystemTemplateSystemSignalRef=DET_CONFD_AZIMUTH_151
            DET_BI_STATIC_FLAG_152_oRDR_DETECTION_149_152_oPCAN_RADAR_329d30e6_Tx: ComBitPosition=440, ComBitSize=1, ComSignalInitValue=0, ComSignalType=BOOLEAN, ComHandleId=3147, ComSystemTemplateSystemSignalRef=DET_BI_STATIC_FLAG_152
            DET_RANGE_ERR_150_oRDR_DETECTION_149_152_oPCAN_RADAR_225216da_Tx: ComBitPosition=152, ComBitSize=7, ComSignalInitValue=0, ComSignalType=UINT8, ComHandleId=3192, ComSystemTemplateSystemSignalRef=DET_RANGE_ERR_150
            DET_RANGE_VELOCITY_152_oRDR_DETECTION_149_152_oPCAN_RADAR_018cc1fd_Tx: ComBitPosition=384, ComBitSize=15, ComSignalInitValue=16384, ComSignalType=UINT16, ComHandleId=3198, ComSystemTemplateSystemSignalRef=DET_RANGE_VELOCITY_152
            DET_RCS_149_oRDR_DETECTION_149_152_oPCAN_RADAR_12bc2b68_Tx: ComBitPosition=128, ComBitSize=8, ComSignalInitValue=128, ComSignalType=UINT8, ComHandleId=3203, ComSystemTemplateSystemSignalRef=DET_RCS_149
            DET_MH_CRC16_149_152_oRDR_DETECTION_149_152_oPCAN_RADAR_9b3a359f_Tx: ComBitPosition=0, ComBitSize=16, ComSignalInitValue=0, ComSignalType=UINT16, ComHandleId=3176, ComSystemTemplateSystemSignalRef=DET_MH_CRC16_149_152
            DET_MH_CYCLE_COUNTER_149_152_oRDR_DETECTION_149_152_oPCAN_RADAR_1f4f94a8_Tx: ComBitPosition=16, ComBitSize=8, ComSignalInitValue=0, ComSignalType=UINT8, ComHandleId=3177, ComSystemTemplateSystemSignalRef=DET_MH_CYCLE_COUNTER_149_152
            DET_ELEVATION_151_oRDR_DETECTION_149_152_oPCAN_RADAR_d1e2d491_Tx: ComBitPosition=296, ComBitSize=8, ComSignalInitValue=0, ComSignalType=UINT8, ComHandleId=3158, ComSystemTemplateSystemSignalRef=DET_ELEVATION_151
            DET_SUPER_RES_TARGET_149_oRDR_DETECTION_149_152_oPCAN_RADAR_fe8b570f_Tx: ComBitPosition=87, ComBitSize=1, ComSignalInitValue=0, ComSignalType=BOOLEAN, ComHandleId=3211, ComSystemTemplateSystemSignalRef=DET_SUPER_RES_TARGET_149
            DET_RCS_151_oRDR_DETECTION_149_152_oPCAN_RADAR_e2ec8d59_Tx: ComBitPosition=352, ComBitSize=8, ComSignalInitValue=128, ComSignalType=UINT8, ComHandleId=3205, ComSystemTemplateSystemSignalRef=DET_RCS_151
            DET_SUPER_RES_TARGET_152_oRDR_DETECTION_149_152_oPCAN_RADAR_6a3b8ac0_Tx: ComBitPosition=423, ComBitSize=1, ComSignalInitValue=0, ComSignalType=BOOLEAN, ComHandleId=3214, ComSystemTemplateSystemSignalRef=DET_SUPER_RES_TARGET_152
            DET_AZIMUTH_ERR_152_oRDR_DETECTION_149_152_oPCAN_RADAR_c004e596_Tx: ComBitPosition=441, ComBitSize=7, ComSignalInitValue=0, ComSignalType=UINT8, ComHandleId=3139, ComSystemTemplateSystemSignalRef=DET_AZIMUTH_ERR_152
            DET_RANGE_VELOCITY_151_oRDR_DETECTION_149_152_oPCAN_RADAR_656cba03_Tx: ComBitPosition=272, ComBitSize=15, ComSignalInitValue=16384, ComSignalType=UINT16, ComHandleId=3197, ComSystemTemplateSystemSignalRef=DET_RANGE_VELOCITY_151
            DET_RANGE_VELOCITY_ERR_152_oRDR_DETECTION_149_152_oPCAN_RADAR_0e373a4f_Tx: ComBitPosition=400, ComBitSize=8, ComSignalInitValue=0, ComSignalType=UINT8, ComHandleId=3202, ComSystemTemplateSystemSignalRef=DET_RANGE_VELOCITY_ERR_152
            DET_BI_STATIC_FLAG_150_oRDR_DETECTION_149_152_oPCAN_RADAR_c30d9f8d_Tx: ComBitPosition=216, ComBitSize=1, ComSignalInitValue=0, ComSignalType=BOOLEAN, ComHandleId=3145, ComSystemTemplateSystemSignalRef=DET_BI_STATIC_FLAG_150
            DET_HVC_FLAG_150_oRDR_DETECTION_149_152_oPCAN_RADAR_f040ae6e_Tx: ComBitPosition=198, ComBitSize=1, ComSignalInitValue=0, ComSignalType=BOOLEAN, ComHandleId=3169, ComSystemTemplateSystemSignalRef=DET_HVC_FLAG_150
            DET_RANGE_149_oRDR_DETECTION_149_152_oPCAN_RADAR_e09ade17_Tx: ComBitPosition=24, ComBitSize=15, ComSignalInitValue=0, ComSignalType=UINT16, ComHandleId=3187, ComSystemTemplateSystemSignalRef=DET_RANGE_149
            DET_ELEVATION_ERR_152_oRDR_DETECTION_149_152_oPCAN_RADAR_323b371a_Tx: ComBitPosition=416, ComBitSize=6, ComSignalInitValue=0, ComSignalType=UINT8, ComHandleId=3163, ComSystemTemplateSystemSignalRef=DET_ELEVATION_ERR_152
            DET_RANGE_151_oRDR_DETECTION_149_152_oPCAN_RADAR_10ca7826_Tx: ComBitPosition=248, ComBitSize=15, ComSignalInitValue=0, ComSignalType=UINT16, ComHandleId=3189, ComSystemTemplateSystemSignalRef=DET_RANGE_151
            DET_HVC_FLAG_152_oRDR_DETECTION_149_152_oPCAN_RADAR_01d00105_Tx: ComBitPosition=422, ComBitSize=1, ComSignalInitValue=0, ComSignalType=BOOLEAN, ComHandleId=3171, ComSystemTemplateSystemSignalRef=DET_HVC_FLAG_152
            DET_BI_STATIC_FLAG_149_oRDR_DETECTION_149_152_oPCAN_RADAR_a62ded29_Tx: ComBitPosition=104, ComBitSize=1, ComSignalInitValue=0, ComSignalType=BOOLEAN, ComHandleId=3144, ComSystemTemplateSystemSignalRef=DET_BI_STATIC_FLAG_149
            DET_RANGE_ERR_151_oRDR_DETECTION_149_152_oPCAN_RADAR_b722c24f_Tx: ComBitPosition=264, ComBitSize=7, ComSignalInitValue=0, ComSignalType=UINT8, ComHandleId=3193, ComSystemTemplateSystemSignalRef=DET_RANGE_ERR_151
            DET_ELEVATION_149_oRDR_DETECTION_149_152_oPCAN_RADAR_21b272a0_Tx: ComBitPosition=72, ComBitSize=8, ComSignalInitValue=0, ComSignalType=UINT8, ComHandleId=3156, ComSystemTemplateSystemSignalRef=DET_ELEVATION_149
            DET_SNR_150_oRDR_DETECTION_149_152_oPCAN_RADAR_aa320dce_Tx: ComBitPosition=232, ComBitSize=8, ComSignalInitValue=0, ComSignalType=UINT8, ComHandleId=3208, ComSystemTemplateSystemSignalRef=DET_SNR_150
            DET_RANGE_VELOCITY_150_oRDR_DETECTION_149_152_oPCAN_RADAR_f01c6e96_Tx: ComBitPosition=160, ComBitSize=15, ComSignalInitValue=16384, ComSignalType=UINT16, ComHandleId=3196, ComSystemTemplateSystemSignalRef=DET_RANGE_VELOCITY_150
            DET_RANGE_VELOCITY_ERR_151_oRDR_DETECTION_149_152_oPCAN_RADAR_6ad741b1_Tx: ComBitPosition=288, ComBitSize=8, ComSignalInitValue=0, ComSignalType=UINT8, ComHandleId=3201, ComSystemTemplateSystemSignalRef=DET_RANGE_VELOCITY_ERR_151
            DET_EXISTENCE_PROB_149_oRDR_DETECTION_149_152_oPCAN_RADAR_74149fb5_Tx: ComBitPosition=112, ComBitSize=6, ComSignalInitValue=0, ComSignalType=UINT8, ComHandleId=3164, ComSystemTemplateSystemSignalRef=DET_EXISTENCE_PROB_149
            DET_RANGE_VELOCITY_ERR_149_oRDR_DETECTION_149_152_oPCAN_RADAR_9a87e780_Tx: ComBitPosition=64, ComBitSize=8, ComSignalInitValue=0, ComSignalType=UINT8, ComHandleId=3199, ComSystemTemplateSystemSignalRef=DET_RANGE_VELOCITY_ERR_149
            DET_CONFD_AZIMUTH_152_oRDR_DETECTION_149_152_oPCAN_RADAR_66577aa9_Tx: ComBitPosition=454, ComBitSize=2, ComSignalInitValue=0, ComSignalType=UINT8, ComHandleId=3151, ComSystemTemplateSystemSignalRef=DET_CONFD_AZIMUTH_152
            DET_SNR_151_oRDR_DETECTION_149_152_oPCAN_RADAR_3f42d95b_Tx: ComBitPosition=344, ComBitSize=8, ComSignalInitValue=0, ComSignalType=UINT8, ComHandleId=3209, ComSystemTemplateSystemSignalRef=DET_SNR_151
            DET_SNR_149_oRDR_DETECTION_149_152_oPCAN_RADAR_cf127f6a_Tx: ComBitPosition=120, ComBitSize=8, ComSignalInitValue=0, ComSignalType=UINT8, ComHandleId=3207, ComSystemTemplateSystemSignalRef=DET_SNR_149
            DET_CONFD_AZIMUTH_149_oRDR_DETECTION_149_152_oPCAN_RADAR_f2e7a766_Tx: ComBitPosition=118, ComBitSize=2, ComSignalInitValue=0, ComSignalType=UINT8, ComHandleId=3148, ComSystemTemplateSystemSignalRef=DET_CONFD_AZIMUTH_149
            DET_CONFD_ELEVATION_152_oRDR_DETECTION_149_152_oPCAN_RADAR_64c27b53_Tx: ComBitPosition=437, ComBitSize=2, ComSignalInitValue=0, ComSignalType=UINT8, ComHandleId=3155, ComSystemTemplateSystemSignalRef=DET_CONFD_ELEVATION_152
            DET_HVC_FLAG_149_oRDR_DETECTION_149_152_oPCAN_RADAR_9560dcca_Tx: ComBitPosition=86, ComBitSize=1, ComSignalInitValue=0, ComSignalType=BOOLEAN, ComHandleId=3168, ComSystemTemplateSystemSignalRef=DET_HVC_FLAG_149
            DET_ELEVATION_ERR_149_oRDR_DETECTION_149_152_oPCAN_RADAR_a68bead5_Tx: ComBitPosition=80, ComBitSize=6, ComSignalInitValue=0, ComSignalType=UINT8, ComHandleId=3160, ComSystemTemplateSystemSignalRef=DET_ELEVATION_ERR_149
            DET_SUPER_RES_TARGET_150_oRDR_DETECTION_149_152_oPCAN_RADAR_9bab25ab_Tx: ComBitPosition=199, ComBitSize=1, ComSignalInitValue=0, ComSignalType=BOOLEAN, ComHandleId=3212, ComSystemTemplateSystemSignalRef=DET_SUPER_RES_TARGET_150
            DET_ELEVATION_150_oRDR_DETECTION_149_152_oPCAN_RADAR_44920004_Tx: ComBitPosition=184, ComBitSize=8, ComSignalInitValue=0, ComSignalType=UINT8, ComHandleId=3157, ComSystemTemplateSystemSignalRef=DET_ELEVATION_150
            DET_CONFD_ELEVATION_151_oRDR_DETECTION_149_152_oPCAN_RADAR_002200ad_Tx: ComBitPosition=325, ComBitSize=2, ComSignalInitValue=0, ComSignalType=UINT8, ComHandleId=3154, ComSystemTemplateSystemSignalRef=DET_CONFD_ELEVATION_151
            DET_HVC_FLAG_151_oRDR_DETECTION_149_152_oPCAN_RADAR_65307afb_Tx: ComBitPosition=310, ComBitSize=1, ComSignalInitValue=0, ComSignalType=BOOLEAN, ComHandleId=3170, ComSystemTemplateSystemSignalRef=DET_HVC_FLAG_151
            DET_RANGE_150_oRDR_DETECTION_149_152_oPCAN_RADAR_85baacb3_Tx: ComBitPosition=136, ComBitSize=15, ComSignalInitValue=0, ComSignalType=UINT16, ComHandleId=3188, ComSystemTemplateSystemSignalRef=DET_RANGE_150
            DET_ELEVATION_ERR_151_oRDR_DETECTION_149_152_oPCAN_RADAR_56db4ce4_Tx: ComBitPosition=304, ComBitSize=6, ComSignalInitValue=0, ComSignalType=UINT8, ComHandleId=3162, ComSystemTemplateSystemSignalRef=DET_ELEVATION_ERR_151
            DET_ELEVATION_152_oRDR_DETECTION_149_152_oPCAN_RADAR_b502af6f_Tx: ComBitPosition=408, ComBitSize=8, ComSignalInitValue=0, ComSignalType=UINT8, ComHandleId=3159, ComSystemTemplateSystemSignalRef=DET_ELEVATION_152
            DET_MH_SCAN_INDEX_4LSB_149_152_oRDR_DETECTION_149_152_oPCAN_RADAR_d365b124_Tx: ComBitPosition=476, ComBitSize=4, ComSignalInitValue=0, ComSignalType=UINT8, ComHandleId=3178, ComSystemTemplateSystemSignalRef=DET_MH_SCAN_INDEX_4LSB_149_152
            DET_RANGE_VELOCITY_149_oRDR_DETECTION_149_152_oPCAN_RADAR_953c1c32_Tx: ComBitPosition=48, ComBitSize=15, ComSignalInitValue=16384, ComSignalType=UINT16, ComHandleId=3195, ComSystemTemplateSystemSignalRef=DET_RANGE_VELOCITY_149
            DET_RANGE_ERR_149_oRDR_DETECTION_149_152_oPCAN_RADAR_4772647e_Tx: ComBitPosition=40, ComBitSize=7, ComSignalInitValue=0, ComSignalType=UINT8, ComHandleId=3191, ComSystemTemplateSystemSignalRef=DET_RANGE_ERR_149
            DET_AZIMUTH_150_oRDR_DETECTION_149_152_oPCAN_RADAR_9521df08_Tx: ComBitPosition=200, ComBitSize=13, ComSignalInitValue=0, ComSignalType=UINT16, ComHandleId=3133, ComSystemTemplateSystemSignalRef=DET_AZIMUTH_150
            DET_EXISTENCE_PROB_150_oRDR_DETECTION_149_152_oPCAN_RADAR_1134ed11_Tx: ComBitPosition=224, ComBitSize=6, ComSignalInitValue=0, ComSignalType=UINT8, ComHandleId=3165, ComSystemTemplateSystemSignalRef=DET_EXISTENCE_PROB_150
            DET_CONFD_AZIMUTH_150_oRDR_DETECTION_149_152_oPCAN_RADAR_97c7d5c2_Tx: ComBitPosition=230, ComBitSize=2, ComSignalInitValue=0, ComSignalType=UINT8, ComHandleId=3149, ComSystemTemplateSystemSignalRef=DET_CONFD_AZIMUTH_150
            DET_AZIMUTH_149_oRDR_DETECTION_149_152_oPCAN_RADAR_f001adac_Tx: ComBitPosition=88, ComBitSize=13, ComSignalInitValue=0, ComSignalType=UINT16, ComHandleId=3132, ComSystemTemplateSystemSignalRef=DET_AZIMUTH_149
            DET_EXISTENCE_PROB_152_oRDR_DETECTION_149_152_oPCAN_RADAR_e0a4427a_Tx: ComBitPosition=448, ComBitSize=6, ComSignalInitValue=0, ComSignalType=UINT8, ComHandleId=3167, ComSystemTemplateSystemSignalRef=DET_EXISTENCE_PROB_152
            DET_CONFD_ELEVATION_150_oRDR_DETECTION_149_152_oPCAN_RADAR_9552d438_Tx: ComBitPosition=213, ComBitSize=2, ComSignalInitValue=0, ComSignalType=UINT8, ComHandleId=3153, ComSystemTemplateSystemSignalRef=DET_CONFD_ELEVATION_150
            DET_RANGE_ERR_152_oRDR_DETECTION_149_152_oPCAN_RADAR_d3c2b9b1_Tx: ComBitPosition=376, ComBitSize=7, ComSignalInitValue=0, ComSignalType=UINT8, ComHandleId=3194, ComSystemTemplateSystemSignalRef=DET_RANGE_ERR_152
            DET_RANGE_VELOCITY_ERR_150_oRDR_DETECTION_149_152_oPCAN_RADAR_ffa79524_Tx: ComBitPosition=176, ComBitSize=8, ComSignalInitValue=0, ComSignalType=UINT8, ComHandleId=3200, ComSystemTemplateSystemSignalRef=DET_RANGE_VELOCITY_ERR_150
            DET_AZIMUTH_152_oRDR_DETECTION_149_152_oPCAN_RADAR_64b17063_Tx: ComBitPosition=424, ComBitSize=13, ComSignalInitValue=0, ComSignalType=UINT16, ComHandleId=3135, ComSystemTemplateSystemSignalRef=DET_AZIMUTH_152
            DET_AZIMUTH_ERR_150_oRDR_DETECTION_149_152_oPCAN_RADAR_31944afd_Tx: ComBitPosition=217, ComBitSize=7, ComSignalInitValue=0, ComSignalType=UINT8, ComHandleId=3137, ComSystemTemplateSystemSignalRef=DET_AZIMUTH_ERR_150
            DET_ELEVATION_ERR_150_oRDR_DETECTION_149_152_oPCAN_RADAR_c3ab9871_Tx: ComBitPosition=192, ComBitSize=6, ComSignalInitValue=0, ComSignalType=UINT8, ComHandleId=3161, ComSystemTemplateSystemSignalRef=DET_ELEVATION_ERR_150
            DET_EXISTENCE_PROB_151_oRDR_DETECTION_149_152_oPCAN_RADAR_84443984_Tx: ComBitPosition=336, ComBitSize=6, ComSignalInitValue=0, ComSignalType=UINT8, ComHandleId=3166, ComSystemTemplateSystemSignalRef=DET_EXISTENCE_PROB_151
            DET_AZIMUTH_ERR_149_oRDR_DETECTION_149_152_oPCAN_RADAR_54b43859_Tx: ComBitPosition=105, ComBitSize=7, ComSignalInitValue=0, ComSignalType=UINT8, ComHandleId=3136, ComSystemTemplateSystemSignalRef=DET_AZIMUTH_ERR_149
            DET_BELOW_RAIN_THOLD_150_oRDR_DETECTION_149_152_oPCAN_RADAR_40204cc8_Tx: ComBitPosition=151, ComBitSize=1, ComSignalInitValue=0, ComSignalType=UINT8, ComHandleId=3141, ComSystemTemplateSystemSignalRef=DET_BELOW_RAIN_THOLD_150
            DET_MTD_150_oRDR_DETECTION_149_152_oPCAN_RADAR_1da1a708_Tx: ComBitPosition=159, ComBitSize=1, ComSignalInitValue=0, ComSignalType=UINT8, ComHandleId=3180, ComSystemTemplateSystemSignalRef=DET_MTD_150
            DET_IDM_150_oRDR_DETECTION_149_152_oPCAN_RADAR_7b1295d3_Tx: ComBitPosition=175, ComBitSize=1, ComSignalInitValue=0, ComSignalType=UINT8, ComHandleId=3173, ComSystemTemplateSystemSignalRef=DET_IDM_150
            DET_IDM_149_oRDR_DETECTION_149_152_oPCAN_RADAR_1e32e777_Tx: ComBitPosition=63, ComBitSize=1, ComSignalInitValue=0, ComSignalType=UINT8, ComHandleId=3172, ComSystemTemplateSystemSignalRef=DET_IDM_149
            DET_PROB_1STAZHYPO_149_oRDR_DETECTION_149_152_oPCAN_RADAR_eb353d61_Tx: ComBitPosition=103, ComBitSize=1, ComSignalInitValue=0, ComSignalType=BOOLEAN, ComHandleId=3183, ComSystemTemplateSystemSignalRef=DET_PROB_1STAZHYPO_149
            DET_BELOW_RAIN_THOLD_152_oRDR_DETECTION_149_152_oPCAN_RADAR_b1b0e3a3_Tx: ComBitPosition=375, ComBitSize=1, ComSignalInitValue=0, ComSignalType=UINT8, ComHandleId=3143, ComSystemTemplateSystemSignalRef=DET_BELOW_RAIN_THOLD_152
            DET_PROB_1STAZHYPO_150_oRDR_DETECTION_149_152_oPCAN_RADAR_8e154fc5_Tx: ComBitPosition=215, ComBitSize=1, ComSignalInitValue=0, ComSignalType=BOOLEAN, ComHandleId=3184, ComSystemTemplateSystemSignalRef=DET_PROB_1STAZHYPO_150
            DET_IDM_152_oRDR_DETECTION_149_152_oPCAN_RADAR_8a823ab8_Tx: ComBitPosition=399, ComBitSize=1, ComSignalInitValue=0, ComSignalType=UINT8, ComHandleId=3175, ComSystemTemplateSystemSignalRef=DET_IDM_152
            DET_MTD_151_oRDR_DETECTION_149_152_oPCAN_RADAR_88d1739d_Tx: ComBitPosition=271, ComBitSize=1, ComSignalInitValue=0, ComSignalType=UINT8, ComHandleId=3181, ComSystemTemplateSystemSignalRef=DET_MTD_151
            DET_PROB_1STAZHYPO_152_oRDR_DETECTION_149_152_oPCAN_RADAR_7f85e0ae_Tx: ComBitPosition=439, ComBitSize=1, ComSignalInitValue=0, ComSignalType=BOOLEAN, ComHandleId=3186, ComSystemTemplateSystemSignalRef=DET_PROB_1STAZHYPO_152
            DET_BELOW_RAIN_THOLD_151_oRDR_DETECTION_149_152_oPCAN_RADAR_d550985d_Tx: ComBitPosition=263, ComBitSize=1, ComSignalInitValue=0, ComSignalType=UINT8, ComHandleId=3142, ComSystemTemplateSystemSignalRef=DET_BELOW_RAIN_THOLD_151
            DET_IDM_151_oRDR_DETECTION_149_152_oPCAN_RADAR_ee624146_Tx: ComBitPosition=287, ComBitSize=1, ComSignalInitValue=0, ComSignalType=UINT8, ComHandleId=3174, ComSystemTemplateSystemSignalRef=DET_IDM_151
            DET_BELOW_RAIN_THOLD_149_oRDR_DETECTION_149_152_oPCAN_RADAR_25003e6c_Tx: ComBitPosition=39, ComBitSize=1, ComSignalInitValue=0, ComSignalType=UINT8, ComHandleId=3140, ComSystemTemplateSystemSignalRef=DET_BELOW_RAIN_THOLD_149
            DET_MTD_149_oRDR_DETECTION_149_152_oPCAN_RADAR_7881d5ac_Tx: ComBitPosition=47, ComBitSize=1, ComSignalInitValue=0, ComSignalType=UINT8, ComHandleId=3179, ComSystemTemplateSystemSignalRef=DET_MTD_149
            DET_PROB_1STAZHYPO_151_oRDR_DETECTION_149_152_oPCAN_RADAR_1b659b50_Tx: ComBitPosition=327, ComBitSize=1, ComSignalInitValue=0, ComSignalType=BOOLEAN, ComHandleId=3185, ComSystemTemplateSystemSignalRef=DET_PROB_1STAZHYPO_151
            DET_MTD_152_oRDR_DETECTION_149_152_oPCAN_RADAR_ec310863_Tx: ComBitPosition=383, ComBitSize=1, ComSignalInitValue=0, ComSignalType=UINT8, ComHandleId=3182, ComSystemTemplateSystemSignalRef=DET_MTD_152
        SG_Detections_113_116_oRDR_DETECTION_113_116_oPCAN_RADAR_4752cf18_Tx: ComTransferProperty=TRIGGERED, ComHandleId=30, ComSystemTemplateSignalGroupRef=SG_Detections_113_116
          83 x ComGroupSignal, all with ComSignalEndianness=LITTLE_ENDIAN, ComTransferProperty=PENDING, ComSignalAccess=ACCESS_NEEDED_BY_SWC_OR_COM:
            DET_ELEVATION_116_oRDR_DETECTION_113_116_oPCAN_RADAR_ecc2fa74_Tx: ComBitPosition=408, ComBitSize=8, ComSignalInitValue=0, ComSignalType=UINT8, ComHandleId=2412, ComSystemTemplateSystemSignalRef=DET_ELEVATION_116
            DET_AZIMUTH_113_oRDR_DETECTION_113_116_oPCAN_RADAR_9051a97a_Tx: ComBitPosition=88, ComBitSize=13, ComSignalInitValue=0, ComSignalType=UINT16, ComHandleId=2385, ComSystemTemplateSystemSignalRef=DET_AZIMUTH_113
            DET_RCS_115_oRDR_DETECTION_113_116_oPCAN_RADAR_bb2cd842_Tx: ComBitPosition=352, ComBitSize=8, ComSignalInitValue=128, ComSignalType=UINT8, ComHandleId=2458, ComSystemTemplateSystemSignalRef=DET_RCS_115
            DET_RANGE_ERR_115_oRDR_DETECTION_113_116_oPCAN_RADAR_eee29754_Tx: ComBitPosition=264, ComBitSize=7, ComSignalInitValue=0, ComSignalType=UINT8, ComHandleId=2446, ComSystemTemplateSystemSignalRef=DET_RANGE_ERR_115
            DET_CONFD_AZIMUTH_115_oRDR_DETECTION_113_116_oPCAN_RADAR_5b77544c_Tx: ComBitPosition=342, ComBitSize=2, ComSignalInitValue=0, ComSignalType=UINT8, ComHandleId=2403, ComSystemTemplateSystemSignalRef=DET_CONFD_AZIMUTH_115
            DET_ELEVATION_ERR_115_oRDR_DETECTION_113_116_oPCAN_RADAR_0f1b19ff_Tx: ComBitPosition=304, ComBitSize=6, ComSignalInitValue=0, ComSignalType=UINT8, ComHandleId=2415, ComSystemTemplateSystemSignalRef=DET_ELEVATION_ERR_115
            DET_CONFD_ELEVATION_115_oRDR_DETECTION_113_116_oPCAN_RADAR_59e255b6_Tx: ComBitPosition=325, ComBitSize=2, ComSignalInitValue=0, ComSignalType=UINT8, ComHandleId=2407, ComSystemTemplateSystemSignalRef=DET_CONFD_ELEVATION_115
            DET_SUPER_RES_TARGET_114_oRDR_DETECTION_113_116_oPCAN_RADAR_c26b70b0_Tx: ComBitPosition=199, ComBitSize=1, ComSignalInitValue=0, ComSignalType=BOOLEAN, ComHandleId=2465, ComSystemTemplateSystemSignalRef=DET_SUPER_RES_TARGET_114
            DET_AZIMUTH_114_oRDR_DETECTION_113_116_oPCAN_RADAR_cce18a13_Tx: ComBitPosition=200, ComBitSize=13, ComSignalInitValue=0, ComSignalType=UINT16, ComHandleId=2386, ComSystemTemplateSystemSignalRef=DET_AZIMUTH_114
            DET_EXISTENCE_PROB_115_oRDR_DETECTION_113_116_oPCAN_RADAR_dd846c9f_Tx: ComBitPosition=336, ComBitSize=6, ComSignalInitValue=0, ComSignalType=UINT8, ComHandleId=2419, ComSystemTemplateSystemSignalRef=DET_EXISTENCE_PROB_115
            DET_CONFD_AZIMUTH_116_oRDR_DETECTION_113_116_oPCAN_RADAR_3f972fb2_Tx: ComBitPosition=454, ComBitSize=2, ComSignalInitValue=0, ComSignalType=UINT8, ComHandleId=2404, ComSystemTemplateSystemSignalRef=DET_CONFD_AZIMUTH_116
            DET_AZIMUTH_116_oRDR_DETECTION_113_116_oPCAN_RADAR_3d712578_Tx: ComBitPosition=424, ComBitSize=13, ComSignalInitValue=0, ComSignalType=UINT16, ComHandleId=2388, ComSystemTemplateSystemSignalRef=DET_AZIMUTH_116
            DET_CONFD_AZIMUTH_113_oRDR_DETECTION_113_116_oPCAN_RADAR_92b7a3b0_Tx: ComBitPosition=118, ComBitSize=2, ComSignalInitValue=0, ComSignalType=UINT8, ComHandleId=2401, ComSystemTemplateSystemSignalRef=DET_CONFD_AZIMUTH_113
            DET_RCS_114_oRDR_DETECTION_113_116_oPCAN_RADAR_2e5c0cd7_Tx: ComBitPosition=240, ComBitSize=8, ComSignalInitValue=128, ComSignalType=UINT8, ComHandleId=2457, ComSystemTemplateSystemSignalRef=DET_RCS_114
            DET_HVC_FLAG_113_oRDR_DETECTION_113_116_oPCAN_RADAR_f530d81c_Tx: ComBitPosition=86, ComBitSize=1, ComSignalInitValue=0, ComSignalType=BOOLEAN, ComHandleId=2421, ComSystemTemplateSystemSignalRef=DET_HVC_FLAG_113
            DET_RANGE_ERR_114_oRDR_DETECTION_113_116_oPCAN_RADAR_7b9243c1_Tx: ComBitPosition=152, ComBitSize=7, ComSignalInitValue=0, ComSignalType=UINT8, ComHandleId=2445, ComSystemTemplateSystemSignalRef=DET_RANGE_ERR_114
            DET_CONFD_ELEVATION_116_oRDR_DETECTION_113_116_oPCAN_RADAR_3d022e48_Tx: ComBitPosition=437, ComBitSize=2, ComSignalInitValue=0, ComSignalType=UINT8, ComHandleId=2408, ComSystemTemplateSystemSignalRef=DET_CONFD_ELEVATION_116
            DET_AZIMUTH_ERR_115_oRDR_DETECTION_113_116_oPCAN_RADAR_fd24cb73_Tx: ComBitPosition=329, ComBitSize=7, ComSignalInitValue=0, ComSignalType=UINT8, ComHandleId=2391, ComSystemTemplateSystemSignalRef=DET_AZIMUTH_ERR_115
            DET_EXISTENCE_PROB_113_oRDR_DETECTION_113_116_oPCAN_RADAR_14449b63_Tx: ComBitPosition=112, ComBitSize=6, ComSignalInitValue=0, ComSignalType=UINT8, ComHandleId=2417, ComSystemTemplateSystemSignalRef=DET_EXISTENCE_PROB_113
            DET_SNR_113_oRDR_DETECTION_113_116_oPCAN_RADAR_af427bbc_Tx: ComBitPosition=120, ComBitSize=8, ComSignalInitValue=0, ComSignalType=UINT8, ComHandleId=2460, ComSystemTemplateSystemSignalRef=DET_SNR_113
            DET_AZIMUTH_ERR_116_oRDR_DETECTION_113_116_oPCAN_RADAR_99c4b08d_Tx: ComBitPosition=441, ComBitSize=7, ComSignalInitValue=0, ComSignalType=UINT8, ComHandleId=2392, ComSystemTemplateSystemSignalRef=DET_AZIMUTH_ERR_116
            DET_EXISTENCE_PROB_116_oRDR_DETECTION_113_116_oPCAN_RADAR_b9641761_Tx: ComBitPosition=448, ComBitSize=6, ComSignalInitValue=0, ComSignalType=UINT8, ComHandleId=2420, ComSystemTemplateSystemSignalRef=DET_EXISTENCE_PROB_116
            DET_HVC_FLAG_116_oRDR_DETECTION_113_116_oPCAN_RADAR_5810541e_Tx: ComBitPosition=422, ComBitSize=1, ComSignalInitValue=0, ComSignalType=BOOLEAN, ComHandleId=2424, ComSystemTemplateSystemSignalRef=DET_HVC_FLAG_116
            DET_AZIMUTH_ERR_114_oRDR_DETECTION_113_116_oPCAN_RADAR_68541fe6_Tx: ComBitPosition=217, ComBitSize=7, ComSignalInitValue=0, ComSignalType=UINT8, ComHandleId=2390, ComSystemTemplateSystemSignalRef=DET_AZIMUTH_ERR_114
            DET_RANGE_VELOCITY_ERR_113_oRDR_DETECTION_113_116_oPCAN_RADAR_fad7e356_Tx: ComBitPosition=64, ComBitSize=8, ComSignalInitValue=0, ComSignalType=UINT8, ComHandleId=2452, ComSystemTemplateSystemSignalRef=DET_RANGE_VELOCITY_ERR_113
            DET_BI_STATIC_FLAG_116_oRDR_DETECTION_113_116_oPCAN_RADAR_6b5d65fd_Tx: ComBitPosition=440, ComBitSize=1, ComSignalInitValue=0, ComSignalType=BOOLEAN, ComHandleId=2400, ComSystemTemplateSystemSignalRef=DET_BI_STATIC_FLAG_116
            DET_BI_STATIC_FLAG_113_oRDR_DETECTION_113_116_oPCAN_RADAR_c67de9ff_Tx: ComBitPosition=104, ComBitSize=1, ComSignalInitValue=0, ComSignalType=BOOLEAN, ComHandleId=2397, ComSystemTemplateSystemSignalRef=DET_BI_STATIC_FLAG_113
            DET_ELEVATION_ERR_113_oRDR_DETECTION_113_116_oPCAN_RADAR_c6dbee03_Tx: ComBitPosition=80, ComBitSize=6, ComSignalInitValue=0, ComSignalType=UINT8, ComHandleId=2413, ComSystemTemplateSystemSignalRef=DET_ELEVATION_ERR_113
            DET_SNR_114_oRDR_DETECTION_113_116_oPCAN_RADAR_f3f258d5_Tx: ComBitPosition=232, ComBitSize=8, ComSignalInitValue=0, ComSignalType=UINT8, ComHandleId=2461, ComSystemTemplateSystemSignalRef=DET_SNR_114
            DET_ELEVATION_ERR_114_oRDR_DETECTION_113_116_oPCAN_RADAR_9a6bcd6a_Tx: ComBitPosition=192, ComBitSize=6, ComSignalInitValue=0, ComSignalType=UINT8, ComHandleId=2414, ComSystemTemplateSystemSignalRef=DET_ELEVATION_ERR_114
            DET_MH_CRC16_113_116_oRDR_DETECTION_113_116_oPCAN_RADAR_c3da1d13_Tx: ComBitPosition=0, ComBitSize=16, ComSignalInitValue=0, ComSignalType=UINT16, ComHandleId=2429, ComSystemTemplateSystemSignalRef=DET_MH_CRC16_113_116
            DET_SUPER_RES_TARGET_115_oRDR_DETECTION_113_116_oPCAN_RADAR_571ba425_Tx: ComBitPosition=311, ComBitSize=1, ComSignalInitValue=0, ComSignalType=BOOLEAN, ComHandleId=2466, ComSystemTemplateSystemSignalRef=DET_SUPER_RES_TARGET_115
            DET_EXISTENCE_PROB_114_oRDR_DETECTION_113_116_oPCAN_RADAR_48f4b80a_Tx: ComBitPosition=224, ComBitSize=6, ComSignalInitValue=0, ComSignalType=UINT8, ComHandleId=2418, ComSystemTemplateSystemSignalRef=DET_EXISTENCE_PROB_114
            DET_RANGE_116_oRDR_DETECTION_113_116_oPCAN_RADAR_2dea56c3_Tx: ComBitPosition=360, ComBitSize=15, ComSignalInitValue=0, ComSignalType=UINT16, ComHandleId=2443, ComSystemTemplateSystemSignalRef=DET_RANGE_116
            DET_RANGE_VELOCITY_116_oRDR_DETECTION_113_116_oPCAN_RADAR_584c94e6_Tx: ComBitPosition=384, ComBitSize=15, ComSignalInitValue=16384, ComSignalType=UINT16, ComHandleId=2451, ComSystemTemplateSystemSignalRef=DET_RANGE_VELOCITY_116
            DET_SNR_115_oRDR_DETECTION_113_116_oPCAN_RADAR_66828c40_Tx: ComBitPosition=344, ComBitSize=8, ComSignalInitValue=0, ComSignalType=UINT8, ComHandleId=2462, ComSystemTemplateSystemSignalRef=DET_SNR_115
            DET_MH_CYCLE_COUNTER_113_116_oRDR_DETECTION_113_116_oPCAN_RADAR_47afbc24_Tx: ComBitPosition=16, ComBitSize=8, ComSignalInitValue=0, ComSignalType=UINT8, ComHandleId=2430, ComSystemTemplateSystemSignalRef=DET_MH_CYCLE_COUNTER_113_116
            DET_AZIMUTH_ERR_113_oRDR_DETECTION_113_116_oPCAN_RADAR_34e43c8f_Tx: ComBitPosition=105, ComBitSize=7, ComSignalInitValue=0, ComSignalType=UINT8, ComHandleId=2389, ComSystemTemplateSystemSignalRef=DET_AZIMUTH_ERR_113
            DET_RANGE_VELOCITY_ERR_114_oRDR_DETECTION_113_116_oPCAN_RADAR_a667c03f_Tx: ComBitPosition=176, ComBitSize=8, ComSignalInitValue=0, ComSignalType=UINT8, ComHandleId=2453, ComSystemTemplateSystemSignalRef=DET_RANGE_VELOCITY_ERR_114
            DET_HVC_FLAG_114_oRDR_DETECTION_113_116_oPCAN_RADAR_a980fb75_Tx: ComBitPosition=198, ComBitSize=1, ComSignalInitValue=0, ComSignalType=BOOLEAN, ComHandleId=2422, ComSystemTemplateSystemSignalRef=DET_HVC_FLAG_114
            DET_SUPER_RES_TARGET_116_oRDR_DETECTION_113_116_oPCAN_RADAR_33fbdfdb_Tx: ComBitPosition=423, ComBitSize=1, ComSignalInitValue=0, ComSignalType=BOOLEAN, ComHandleId=2467, ComSystemTemplateSystemSignalRef=DET_SUPER_RES_TARGET_116
            DET_RANGE_VELOCITY_113_oRDR_DETECTION_113_116_oPCAN_RADAR_f56c18e4_Tx: ComBitPosition=48, ComBitSize=15, ComSignalInitValue=16384, ComSignalType=UINT16, ComHandleId=2448, ComSystemTemplateSystemSignalRef=DET_RANGE_VELOCITY_113
            DET_MH_SCAN_INDEX_4LSB_113_116_oRDR_DETECTION_113_116_oPCAN_RADAR_8b8599a8_Tx: ComBitPosition=476, ComBitSize=4, ComSignalInitValue=0, ComSignalType=UINT8, ComHandleId=2431, ComSystemTemplateSystemSignalRef=DET_MH_SCAN_INDEX_4LSB_113_116
            DET_RANGE_VELOCITY_ERR_115_oRDR_DETECTION_113_116_oPCAN_RADAR_331714aa_Tx: ComBitPosition=288, ComBitSize=8, ComSignalInitValue=0, ComSignalType=UINT8, ComHandleId=2454, ComSystemTemplateSystemSignalRef=DET_RANGE_VELOCITY_ERR_115
            DET_BI_STATIC_FLAG_114_oRDR_DETECTION_113_116_oPCAN_RADAR_9acdca96_Tx: ComBitPosition=216, ComBitSize=1, ComSignalInitValue=0, ComSignalType=BOOLEAN, ComHandleId=2398, ComSystemTemplateSystemSignalRef=DET_BI_STATIC_FLAG_114
            DET_ELEVATION_114_oRDR_DETECTION_113_116_oPCAN_RADAR_1d52551f_Tx: ComBitPosition=184, ComBitSize=8, ComSignalInitValue=0, ComSignalType=UINT8, ComHandleId=2410, ComSystemTemplateSystemSignalRef=DET_ELEVATION_114
            DET_RANGE_114_oRDR_DETECTION_113_116_oPCAN_RADAR_dc7af9a8_Tx: ComBitPosition=136, ComBitSize=15, ComSignalInitValue=0, ComSignalType=UINT16, ComHandleId=2441, ComSystemTemplateSystemSignalRef=DET_RANGE_114
            DET_RANGE_VELOCITY_115_oRDR_DETECTION_113_116_oPCAN_RADAR_3cacef18_Tx: ComBitPosition=272, ComBitSize=15, ComSignalInitValue=16384, ComSignalType=UINT16, ComHandleId=2450, ComSystemTemplateSystemSignalRef=DET_RANGE_VELOCITY_115
            DET_CONFD_ELEVATION_113_oRDR_DETECTION_113_116_oPCAN_RADAR_9022a24a_Tx: ComBitPosition=101, ComBitSize=2, ComSignalInitValue=0, ComSignalType=UINT8, ComHandleId=2405, ComSystemTemplateSystemSignalRef=DET_CONFD_ELEVATION_113
            DET_RANGE_ERR_113_oRDR_DETECTION_113_116_oPCAN_RADAR_272260a8_Tx: ComBitPosition=40, ComBitSize=7, ComSignalInitValue=0, ComSignalType=UINT8, ComHandleId=2444, ComSystemTemplateSystemSignalRef=DET_RANGE_ERR_113
            DET_RANGE_115_oRDR_DETECTION_113_116_oPCAN_RADAR_490a2d3d_Tx: ComBitPosition=248, ComBitSize=15, ComSignalInitValue=0, ComSignalType=UINT16, ComHandleId=2442, ComSystemTemplateSystemSignalRef=DET_RANGE_115
            DET_AZIMUTH_115_oRDR_DETECTION_113_116_oPCAN_RADAR_59915e86_Tx: ComBitPosition=312, ComBitSize=13, ComSignalInitValue=0, ComSignalType=UINT16, ComHandleId=2387, ComSystemTemplateSystemSignalRef=DET_AZIMUTH_115
            DET_RANGE_VELOCITY_ERR_116_oRDR_DETECTION_113_116_oPCAN_RADAR_57f76f54_Tx: ComBitPosition=400, ComBitSize=8, ComSignalInitValue=0, ComSignalType=UINT8, ComHandleId=2455, ComSystemTemplateSystemSignalRef=DET_RANGE_VELOCITY_ERR_116
            DET_SNR_116_oRDR_DETECTION_113_116_oPCAN_RADAR_0262f7be_Tx: ComBitPosition=456, ComBitSize=8, ComSignalInitValue=0, ComSignalType=UINT8, ComHandleId=2463, ComSystemTemplateSystemSignalRef=DET_SNR_116
            DET_RANGE_VELOCITY_114_oRDR_DETECTION_113_116_oPCAN_RADAR_a9dc3b8d_Tx: ComBitPosition=160, ComBitSize=15, ComSignalInitValue=16384, ComSignalType=UINT16, ComHandleId=2449, ComSystemTemplateSystemSignalRef=DET_RANGE_VELOCITY_114
            DET_CONFD_AZIMUTH_114_oRDR_DETECTION_113_116_oPCAN_RADAR_ce0780d9_Tx: ComBitPosition=230, ComBitSize=2, ComSignalInitValue=0, ComSignalType=UINT8, ComHandleId=2402, ComSystemTemplateSystemSignalRef=DET_CONFD_AZIMUTH_114
            DET_ELEVATION_113_oRDR_DETECTION_113_116_oPCAN_RADAR_41e27676_Tx: ComBitPosition=72, ComBitSize=8, ComSignalInitValue=0, ComSignalType=UINT8, ComHandleId=2409, ComSystemTemplateSystemSignalRef=DET_ELEVATION_113
            DET_CONFD_ELEVATION_114_oRDR_DETECTION_113_116_oPCAN_RADAR_cc928123_Tx: ComBitPosition=213, ComBitSize=2, ComSignalInitValue=0, ComSignalType=UINT8, ComHandleId=2406, ComSystemTemplateSystemSignalRef=DET_CONFD_ELEVATION_114
            DET_RANGE_113_oRDR_DETECTION_113_116_oPCAN_RADAR_80cadac1_Tx: ComBitPosition=24, ComBitSize=15, ComSignalInitValue=0, ComSignalType=UINT16, ComHandleId=2440, ComSystemTemplateSystemSignalRef=DET_RANGE_113
            DET_RANGE_ERR_116_oRDR_DETECTION_113_116_oPCAN_RADAR_8a02ecaa_Tx: ComBitPosition=376, ComBitSize=7, ComSignalInitValue=0, ComSignalType=UINT8, ComHandleId=2447, ComSystemTemplateSystemSignalRef=DET_RANGE_ERR_116
            DET_RCS_116_oRDR_DETECTION_113_116_oPCAN_RADAR_dfcca3bc_Tx: ComBitPosition=464, ComBitSize=8, ComSignalInitValue=128, ComSignalType=UINT8, ComHandleId=2459, ComSystemTemplateSystemSignalRef=DET_RCS_116
            DET_ELEVATION_ERR_116_oRDR_DETECTION_113_116_oPCAN_RADAR_6bfb6201_Tx: ComBitPosition=416, ComBitSize=6, ComSignalInitValue=0, ComSignalType=UINT8, ComHandleId=2416, ComSystemTemplateSystemSignalRef=DET_ELEVATION_ERR_116
            DET_ELEVATION_115_oRDR_DETECTION_113_116_oPCAN_RADAR_8822818a_Tx: ComBitPosition=296, ComBitSize=8, ComSignalInitValue=0, ComSignalType=UINT8, ComHandleId=2411, ComSystemTemplateSystemSignalRef=DET_ELEVATION_115
            DET_SUPER_RES_TARGET_113_oRDR_DETECTION_113_116_oPCAN_RADAR_9edb53d9_Tx: ComBitPosition=87, ComBitSize=1, ComSignalInitValue=0, ComSignalType=BOOLEAN, ComHandleId=2464, ComSystemTemplateSystemSignalRef=DET_SUPER_RES_TARGET_113
            DET_HVC_FLAG_115_oRDR_DETECTION_113_116_oPCAN_RADAR_3cf02fe0_Tx: ComBitPosition=310, ComBitSize=1, ComSignalInitValue=0, ComSignalType=BOOLEAN, ComHandleId=2423, ComSystemTemplateSystemSignalRef=DET_HVC_FLAG_115
            DET_RCS_113_oRDR_DETECTION_113_116_oPCAN_RADAR_72ec2fbe_Tx: ComBitPosition=128, ComBitSize=8, ComSignalInitValue=128, ComSignalType=UINT8, ComHandleId=2456, ComSystemTemplateSystemSignalRef=DET_RCS_113
            DET_BI_STATIC_FLAG_115_oRDR_DETECTION_113_116_oPCAN_RADAR_0fbd1e03_Tx: ComBitPosition=328, ComBitSize=1, ComSignalInitValue=0, ComSignalType=BOOLEAN, ComHandleId=2399, ComSystemTemplateSystemSignalRef=DET_BI_STATIC_FLAG_115
            DET_BELOW_RAIN_THOLD_116_oRDR_DETECTION_113_116_oPCAN_RADAR_e870b6b8_Tx: ComBitPosition=375, ComBitSize=1, ComSignalInitValue=0, ComSignalType=UINT8, ComHandleId=2396, ComSystemTemplateSystemSignalRef=DET_BELOW_RAIN_THOLD_116
            DET_PROB_1STAZHYPO_114_oRDR_DETECTION_113_116_oPCAN_RADAR_d7d51ade_Tx: ComBitPosition=215, ComBitSize=1, ComSignalInitValue=0, ComSignalType=BOOLEAN, ComHandleId=2437, ComSystemTemplateSystemSignalRef=DET_PROB_1STAZHYPO_114
            DET_IDM_114_oRDR_DETECTION_113_116_oPCAN_RADAR_22d2c0c8_Tx: ComBitPosition=175, ComBitSize=1, ComSignalInitValue=0, ComSignalType=UINT8, ComHandleId=2426, ComSystemTemplateSystemSignalRef=DET_IDM_114
            DET_MTD_113_oRDR_DETECTION_113_116_oPCAN_RADAR_18d1d17a_Tx: ComBitPosition=47, ComBitSize=1, ComSignalInitValue=0, ComSignalType=UINT8, ComHandleId=2432, ComSystemTemplateSystemSignalRef=DET_MTD_113
            DET_BELOW_RAIN_THOLD_113_oRDR_DETECTION_113_116_oPCAN_RADAR_45503aba_Tx: ComBitPosition=39, ComBitSize=1, ComSignalInitValue=0, ComSignalType=UINT8, ComHandleId=2393, ComSystemTemplateSystemSignalRef=DET_BELOW_RAIN_THOLD_113
            DET_MTD_116_oRDR_DETECTION_113_116_oPCAN_RADAR_b5f15d78_Tx: ComBitPosition=383, ComBitSize=1, ComSignalInitValue=0, ComSignalType=UINT8, ComHandleId=2435, ComSystemTemplateSystemSignalRef=DET_MTD_116
            DET_MTD_114_oRDR_DETECTION_113_116_oPCAN_RADAR_4461f213_Tx: ComBitPosition=159, ComBitSize=1, ComSignalInitValue=0, ComSignalType=UINT8, ComHandleId=2433, ComSystemTemplateSystemSignalRef=DET_MTD_114
            DET_IDM_116_oRDR_DETECTION_113_116_oPCAN_RADAR_d3426fa3_Tx: ComBitPosition=399, ComBitSize=1, ComSignalInitValue=0, ComSignalType=UINT8, ComHandleId=2428, ComSystemTemplateSystemSignalRef=DET_IDM_116
            DET_MTD_115_oRDR_DETECTION_113_116_oPCAN_RADAR_d1112686_Tx: ComBitPosition=271, ComBitSize=1, ComSignalInitValue=0, ComSignalType=UINT8, ComHandleId=2434, ComSystemTemplateSystemSignalRef=DET_MTD_115
            DET_BELOW_RAIN_THOLD_114_oRDR_DETECTION_113_116_oPCAN_RADAR_19e019d3_Tx: ComBitPosition=151, ComBitSize=1, ComSignalInitValue=0, ComSignalType=UINT8, ComHandleId=2394, ComSystemTemplateSystemSignalRef=DET_BELOW_RAIN_THOLD_114
            DET_PROB_1STAZHYPO_113_oRDR_DETECTION_113_116_oPCAN_RADAR_8b6539b7_Tx: ComBitPosition=103, ComBitSize=1, ComSignalInitValue=0, ComSignalType=BOOLEAN, ComHandleId=2436, ComSystemTemplateSystemSignalRef=DET_PROB_1STAZHYPO_113
            DET_IDM_113_oRDR_DETECTION_113_116_oPCAN_RADAR_7e62e3a1_Tx: ComBitPosition=63, ComBitSize=1, ComSignalInitValue=0, ComSignalType=UINT8, ComHandleId=2425, ComSystemTemplateSystemSignalRef=DET_IDM_113
            DET_IDM_115_oRDR_DETECTION_113_116_oPCAN_RADAR_b7a2145d_Tx: ComBitPosition=287, ComBitSize=1, ComSignalInitValue=0, ComSignalType=UINT8, ComHandleId=2427, ComSystemTemplateSystemSignalRef=DET_IDM_115
            DET_BELOW_RAIN_THOLD_115_oRDR_DETECTION_113_116_oPCAN_RADAR_8c90cd46_Tx: ComBitPosition=263, ComBitSize=1, ComSignalInitValue=0, ComSignalType=UINT8, ComHandleId=2395, ComSystemTemplateSystemSignalRef=DET_BELOW_RAIN_THOLD_115
            DET_PROB_1STAZHYPO_116_oRDR_DETECTION_113_116_oPCAN_RADAR_2645b5b5_Tx: ComBitPosition=439, ComBitSize=1, ComSignalInitValue=0, ComSignalType=BOOLEAN, ComHandleId=2439, ComSystemTemplateSystemSignalRef=DET_PROB_1STAZHYPO_116
            DET_PROB_1STAZHYPO_115_oRDR_DETECTION_113_116_oPCAN_RADAR_42a5ce4b_Tx: ComBitPosition=327, ComBitSize=1, ComSignalInitValue=0, ComSignalType=BOOLEAN, ComHandleId=2438, ComSystemTemplateSystemSignalRef=DET_PROB_1STAZHYPO_115
        SG_Detections_245_248_oRDR_DETECTION_245_248_oPCAN_RADAR_4130a42b_Tx: ComTransferProperty=TRIGGERED, ComHandleId=63, ComSystemTemplateSignalGroupRef=SG_Detections_245_248
          83 x ComGroupSignal, all with ComSignalEndianness=LITTLE_ENDIAN, ComTransferProperty=PENDING, ComSignalAccess=ACCESS_NEEDED_BY_SWC_OR_COM:
            DET_SUPER_RES_TARGET_248_oRDR_DETECTION_245_248_oPCAN_RADAR_a670802c_Tx: ComBitPosition=423, ComBitSize=1, ComSignalInitValue=0, ComSignalType=BOOLEAN, ComHandleId=5206, ComSystemTemplateSystemSignalRef=DET_SUPER_RES_TARGET_248
            DET_AZIMUTH_248_oRDR_DETECTION_245_248_oPCAN_RADAR_a8fa7a8f_Tx: ComBitPosition=424, ComBitSize=13, ComSignalInitValue=0, ComSignalType=UINT16, ComHandleId=5127, ComSystemTemplateSystemSignalRef=DET_AZIMUTH_248
            DET_MH_CRC16_245_248_oRDR_DETECTION_245_248_oPCAN_RADAR_c5b87620_Tx: ComBitPosition=0, ComBitSize=16, ComSignalInitValue=0, ComSignalType=UINT16, ComHandleId=5168, ComSystemTemplateSystemSignalRef=DET_MH_CRC16_245_248
            DET_CONFD_AZIMUTH_246_oRDR_DETECTION_245_248_oPCAN_RADAR_137c3697_Tx: ComBitPosition=230, ComBitSize=2, ComSignalInitValue=0, ComSignalType=UINT8, ComHandleId=5141, ComSystemTemplateSystemSignalRef=DET_CONFD_AZIMUTH_246
            DET_RANGE_ERR_248_oRDR_DETECTION_245_248_oPCAN_RADAR_1f89b35d_Tx: ComBitPosition=376, ComBitSize=7, ComSignalInitValue=0, ComSignalType=UINT8, ComHandleId=5186, ComSystemTemplateSystemSignalRef=DET_RANGE_ERR_248
            DET_RANGE_VELOCITY_246_oRDR_DETECTION_245_248_oPCAN_RADAR_74a78dc3_Tx: ComBitPosition=160, ComBitSize=15, ComSignalInitValue=16384, ComSignalType=UINT16, ComHandleId=5188, ComSystemTemplateSystemSignalRef=DET_RANGE_VELOCITY_246
            DET_RANGE_ERR_245_oRDR_DETECTION_245_248_oPCAN_RADAR_c2098e71_Tx: ComBitPosition=40, ComBitSize=7, ComSignalInitValue=0, ComSignalType=UINT8, ComHandleId=5183, ComSystemTemplateSystemSignalRef=DET_RANGE_ERR_245
            DET_RANGE_VELOCITY_247_oRDR_DETECTION_245_248_oPCAN_RADAR_e1d75956_Tx: ComBitPosition=272, ComBitSize=15, ComSignalInitValue=16384, ComSignalType=UINT16, ComHandleId=5189, ComSystemTemplateSystemSignalRef=DET_RANGE_VELOCITY_247
            DET_MH_SCAN_INDEX_4LSB_245_248_oRDR_DETECTION_245_248_oPCAN_RADAR_8de7f29b_Tx: ComBitPosition=476, ComBitSize=4, ComSignalInitValue=0, ComSignalType=UINT8, ComHandleId=5170, ComSystemTemplateSystemSignalRef=DET_MH_SCAN_INDEX_4LSB_245_248
            DET_ELEVATION_246_oRDR_DETECTION_245_248_oPCAN_RADAR_c029e351_Tx: ComBitPosition=184, ComBitSize=8, ComSignalInitValue=0, ComSignalType=UINT8, ComHandleId=5149, ComSystemTemplateSystemSignalRef=DET_ELEVATION_246
            DET_ELEVATION_ERR_245_oRDR_DETECTION_245_248_oPCAN_RADAR_23f000da_Tx: ComBitPosition=80, ComBitSize=6, ComSignalInitValue=0, ComSignalType=UINT8, ComHandleId=5152, ComSystemTemplateSystemSignalRef=DET_ELEVATION_ERR_245
            DET_BI_STATIC_FLAG_248_oRDR_DETECTION_245_248_oPCAN_RADAR_fed63a0a_Tx: ComBitPosition=440, ComBitSize=1, ComSignalInitValue=0, ComSignalType=BOOLEAN, ComHandleId=5139, ComSystemTemplateSystemSignalRef=DET_BI_STATIC_FLAG_248
            DET_RANGE_ERR_246_oRDR_DETECTION_245_248_oPCAN_RADAR_a6e9f58f_Tx: ComBitPosition=152, ComBitSize=7, ComSignalInitValue=0, ComSignalType=UINT8, ComHandleId=5184, ComSystemTemplateSystemSignalRef=DET_RANGE_ERR_246
            DET_ELEVATION_247_oRDR_DETECTION_245_248_oPCAN_RADAR_555937c4_Tx: ComBitPosition=296, ComBitSize=8, ComSignalInitValue=0, ComSignalType=UINT8, ComHandleId=5150, ComSystemTemplateSystemSignalRef=DET_ELEVATION_247
            DET_AZIMUTH_ERR_246_oRDR_DETECTION_245_248_oPCAN_RADAR_b52fa9a8_Tx: ComBitPosition=217, ComBitSize=7, ComSignalInitValue=0, ComSignalType=UINT8, ComHandleId=5129, ComSystemTemplateSystemSignalRef=DET_AZIMUTH_ERR_246
            DET_SUPER_RES_TARGET_246_oRDR_DETECTION_245_248_oPCAN_RADAR_1f10c6fe_Tx: ComBitPosition=199, ComBitSize=1, ComSignalInitValue=0, ComSignalType=BOOLEAN, ComHandleId=5204, ComSystemTemplateSystemSignalRef=DET_SUPER_RES_TARGET_246
            DET_BI_STATIC_FLAG_246_oRDR_DETECTION_245_248_oPCAN_RADAR_47b67cd8_Tx: ComBitPosition=216, ComBitSize=1, ComSignalInitValue=0, ComSignalType=BOOLEAN, ComHandleId=5137, ComSystemTemplateSystemSignalRef=DET_BI_STATIC_FLAG_246
            DET_CONFD_ELEVATION_247_oRDR_DETECTION_245_248_oPCAN_RADAR_8499e3f8_Tx: ComBitPosition=325, ComBitSize=2, ComSignalInitValue=0, ComSignalType=UINT8, ComHandleId=5146, ComSystemTemplateSystemSignalRef=DET_CONFD_ELEVATION_247
            DET_HVC_FLAG_245_oRDR_DETECTION_245_248_oPCAN_RADAR_101b36c5_Tx: ComBitPosition=86, ComBitSize=1, ComSignalInitValue=0, ComSignalType=BOOLEAN, ComHandleId=5160, ComSystemTemplateSystemSignalRef=DET_HVC_FLAG_245
            DET_RCS_247_oRDR_DETECTION_245_248_oPCAN_RADAR_66576e0c_Tx: ComBitPosition=352, ComBitSize=8, ComSignalInitValue=128, ComSignalType=UINT8, ComHandleId=5197, ComSystemTemplateSystemSignalRef=DET_RCS_247
            DET_CONFD_AZIMUTH_247_oRDR_DETECTION_245_248_oPCAN_RADAR_860ce202_Tx: ComBitPosition=342, ComBitSize=2, ComSignalInitValue=0, ComSignalType=UINT8, ComHandleId=5142, ComSystemTemplateSystemSignalRef=DET_CONFD_AZIMUTH_247
            DET_SNR_246_oRDR_DETECTION_245_248_oPCAN_RADAR_2e89ee9b_Tx: ComBitPosition=232, ComBitSize=8, ComSignalInitValue=0, ComSignalType=UINT8, ComHandleId=5200, ComSystemTemplateSystemSignalRef=DET_SNR_246
            DET_AZIMUTH_246_oRDR_DETECTION_245_248_oPCAN_RADAR_119a3c5d_Tx: ComBitPosition=200, ComBitSize=13, ComSignalInitValue=0, ComSignalType=UINT16, ComHandleId=5125, ComSystemTemplateSystemSignalRef=DET_AZIMUTH_246
            DET_SNR_248_oRDR_DETECTION_245_248_oPCAN_RADAR_97e9a849_Tx: ComBitPosition=456, ComBitSize=8, ComSignalInitValue=0, ComSignalType=UINT8, ComHandleId=5202, ComSystemTemplateSystemSignalRef=DET_SNR_248
            DET_RCS_246_oRDR_DETECTION_245_248_oPCAN_RADAR_f327ba99_Tx: ComBitPosition=240, ComBitSize=8, ComSignalInitValue=128, ComSignalType=UINT8, ComHandleId=5196, ComSystemTemplateSystemSignalRef=DET_RCS_246
            DET_SUPER_RES_TARGET_245_oRDR_DETECTION_245_248_oPCAN_RADAR_7bf0bd00_Tx: ComBitPosition=87, ComBitSize=1, ComSignalInitValue=0, ComSignalType=BOOLEAN, ComHandleId=5203, ComSystemTemplateSystemSignalRef=DET_SUPER_RES_TARGET_245
            DET_EXISTENCE_PROB_248_oRDR_DETECTION_245_248_oPCAN_RADAR_2cef4896_Tx: ComBitPosition=448, ComBitSize=6, ComSignalInitValue=0, ComSignalType=UINT8, ComHandleId=5159, ComSystemTemplateSystemSignalRef=DET_EXISTENCE_PROB_248
            DET_RANGE_ERR_247_oRDR_DETECTION_245_248_oPCAN_RADAR_3399211a_Tx: ComBitPosition=264, ComBitSize=7, ComSignalInitValue=0, ComSignalType=UINT8, ComHandleId=5185, ComSystemTemplateSystemSignalRef=DET_RANGE_ERR_247
            DET_BI_STATIC_FLAG_245_oRDR_DETECTION_245_248_oPCAN_RADAR_23560726_Tx: ComBitPosition=104, ComBitSize=1, ComSignalInitValue=0, ComSignalType=BOOLEAN, ComHandleId=5136, ComSystemTemplateSystemSignalRef=DET_BI_STATIC_FLAG_245
            DET_AZIMUTH_245_oRDR_DETECTION_245_248_oPCAN_RADAR_757a47a3_Tx: ComBitPosition=88, ComBitSize=13, ComSignalInitValue=0, ComSignalType=UINT16, ComHandleId=5124, ComSystemTemplateSystemSignalRef=DET_AZIMUTH_245
            DET_EXISTENCE_PROB_247_oRDR_DETECTION_245_248_oPCAN_RADAR_00ffdad1_Tx: ComBitPosition=336, ComBitSize=6, ComSignalInitValue=0, ComSignalType=UINT8, ComHandleId=5158, ComSystemTemplateSystemSignalRef=DET_EXISTENCE_PROB_247
            DET_ELEVATION_ERR_248_oRDR_DETECTION_245_248_oPCAN_RADAR_fe703df6_Tx: ComBitPosition=416, ComBitSize=6, ComSignalInitValue=0, ComSignalType=UINT8, ComHandleId=5155, ComSystemTemplateSystemSignalRef=DET_ELEVATION_ERR_248
            DET_EXISTENCE_PROB_245_oRDR_DETECTION_245_248_oPCAN_RADAR_f16f75ba_Tx: ComBitPosition=112, ComBitSize=6, ComSignalInitValue=0, ComSignalType=UINT8, ComHandleId=5156, ComSystemTemplateSystemSignalRef=DET_EXISTENCE_PROB_245
            DET_AZIMUTH_ERR_245_oRDR_DETECTION_245_248_oPCAN_RADAR_d1cfd256_Tx: ComBitPosition=105, ComBitSize=7, ComSignalInitValue=0, ComSignalType=UINT8, ComHandleId=5128, ComSystemTemplateSystemSignalRef=DET_AZIMUTH_ERR_245
            DET_RANGE_247_oRDR_DETECTION_245_248_oPCAN_RADAR_94719b73_Tx: ComBitPosition=248, ComBitSize=15, ComSignalInitValue=0, ComSignalType=UINT16, ComHandleId=5181, ComSystemTemplateSystemSignalRef=DET_RANGE_247
            DET_RANGE_VELOCITY_ERR_245_oRDR_DETECTION_245_248_oPCAN_RADAR_1ffc0d8f_Tx: ComBitPosition=64, ComBitSize=8, ComSignalInitValue=0, ComSignalType=UINT8, ComHandleId=5191, ComSystemTemplateSystemSignalRef=DET_RANGE_VELOCITY_ERR_245
            DET_AZIMUTH_ERR_247_oRDR_DETECTION_245_248_oPCAN_RADAR_205f7d3d_Tx: ComBitPosition=329, ComBitSize=7, ComSignalInitValue=0, ComSignalType=UINT8, ComHandleId=5130, ComSystemTemplateSystemSignalRef=DET_AZIMUTH_ERR_247
            DET_CONFD_ELEVATION_245_oRDR_DETECTION_245_248_oPCAN_RADAR_75094c93_Tx: ComBitPosition=101, ComBitSize=2, ComSignalInitValue=0, ComSignalType=UINT8, ComHandleId=5144, ComSystemTemplateSystemSignalRef=DET_CONFD_ELEVATION_245
            DET_ELEVATION_248_oRDR_DETECTION_245_248_oPCAN_RADAR_7949a583_Tx: ComBitPosition=408, ComBitSize=8, ComSignalInitValue=0, ComSignalType=UINT8, ComHandleId=5151, ComSystemTemplateSystemSignalRef=DET_ELEVATION_248
            DET_SNR_247_oRDR_DETECTION_245_248_oPCAN_RADAR_bbf93a0e_Tx: ComBitPosition=344, ComBitSize=8, ComSignalInitValue=0, ComSignalType=UINT8, ComHandleId=5201, ComSystemTemplateSystemSignalRef=DET_SNR_247
            DET_AZIMUTH_ERR_248_oRDR_DETECTION_245_248_oPCAN_RADAR_0c4fef7a_Tx: ComBitPosition=441, ComBitSize=7, ComSignalInitValue=0, ComSignalType=UINT8, ComHandleId=5131, ComSystemTemplateSystemSignalRef=DET_AZIMUTH_ERR_248
            DET_HVC_FLAG_246_oRDR_DETECTION_245_248_oPCAN_RADAR_74fb4d3b_Tx: ComBitPosition=198, ComBitSize=1, ComSignalInitValue=0, ComSignalType=BOOLEAN, ComHandleId=5161, ComSystemTemplateSystemSignalRef=DET_HVC_FLAG_246
            DET_HVC_FLAG_247_oRDR_DETECTION_245_248_oPCAN_RADAR_e18b99ae_Tx: ComBitPosition=310, ComBitSize=1, ComSignalInitValue=0, ComSignalType=BOOLEAN, ComHandleId=5162, ComSystemTemplateSystemSignalRef=DET_HVC_FLAG_247
            DET_RANGE_VELOCITY_ERR_247_oRDR_DETECTION_245_248_oPCAN_RADAR_ee6ca2e4_Tx: ComBitPosition=288, ComBitSize=8, ComSignalInitValue=0, ComSignalType=UINT8, ComHandleId=5193, ComSystemTemplateSystemSignalRef=DET_RANGE_VELOCITY_ERR_247
            DET_RANGE_245_oRDR_DETECTION_245_248_oPCAN_RADAR_65e13418_Tx: ComBitPosition=24, ComBitSize=15, ComSignalInitValue=0, ComSignalType=UINT16, ComHandleId=5179, ComSystemTemplateSystemSignalRef=DET_RANGE_245
            DET_SNR_245_oRDR_DETECTION_245_248_oPCAN_RADAR_4a699565_Tx: ComBitPosition=120, ComBitSize=8, ComSignalInitValue=0, ComSignalType=UINT8, ComHandleId=5199, ComSystemTemplateSystemSignalRef=DET_SNR_245
            DET_ELEVATION_ERR_246_oRDR_DETECTION_245_248_oPCAN_RADAR_47107b24_Tx: ComBitPosition=192, ComBitSize=6, ComSignalInitValue=0, ComSignalType=UINT8, ComHandleId=5153, ComSystemTemplateSystemSignalRef=DET_ELEVATION_ERR_246
            DET_ELEVATION_ERR_247_oRDR_DETECTION_245_248_oPCAN_RADAR_d260afb1_Tx: ComBitPosition=304, ComBitSize=6, ComSignalInitValue=0, ComSignalType=UINT8, ComHandleId=5154, ComSystemTemplateSystemSignalRef=DET_ELEVATION_ERR_247
            DET_RANGE_VELOCITY_248_oRDR_DETECTION_245_248_oPCAN_RADAR_cdc7cb11_Tx: ComBitPosition=384, ComBitSize=15, ComSignalInitValue=16384, ComSignalType=UINT16, ComHandleId=5190, ComSystemTemplateSystemSignalRef=DET_RANGE_VELOCITY_248
            DET_EXISTENCE_PROB_246_oRDR_DETECTION_245_248_oPCAN_RADAR_958f0e44_Tx: ComBitPosition=224, ComBitSize=6, ComSignalInitValue=0, ComSignalType=UINT8, ComHandleId=5157, ComSystemTemplateSystemSignalRef=DET_EXISTENCE_PROB_246
            DET_RCS_248_oRDR_DETECTION_245_248_oPCAN_RADAR_4a47fc4b_Tx: ComBitPosition=464, ComBitSize=8, ComSignalInitValue=128, ComSignalType=UINT8, ComHandleId=5198, ComSystemTemplateSystemSignalRef=DET_RCS_248
            DET_RANGE_248_oRDR_DETECTION_245_248_oPCAN_RADAR_b8610934_Tx: ComBitPosition=360, ComBitSize=15, ComSignalInitValue=0, ComSignalType=UINT16, ComHandleId=5182, ComSystemTemplateSystemSignalRef=DET_RANGE_248
            DET_ELEVATION_245_oRDR_DETECTION_245_248_oPCAN_RADAR_a4c998af_Tx: ComBitPosition=72, ComBitSize=8, ComSignalInitValue=0, ComSignalType=UINT8, ComHandleId=5148, ComSystemTemplateSystemSignalRef=DET_ELEVATION_245
            DET_CONFD_AZIMUTH_248_oRDR_DETECTION_245_248_oPCAN_RADAR_aa1c7045_Tx: ComBitPosition=454, ComBitSize=2, ComSignalInitValue=0, ComSignalType=UINT8, ComHandleId=5143, ComSystemTemplateSystemSignalRef=DET_CONFD_AZIMUTH_248
            DET_BI_STATIC_FLAG_247_oRDR_DETECTION_245_248_oPCAN_RADAR_d2c6a84d_Tx: ComBitPosition=328, ComBitSize=1, ComSignalInitValue=0, ComSignalType=BOOLEAN, ComHandleId=5138, ComSystemTemplateSystemSignalRef=DET_BI_STATIC_FLAG_247
            DET_RANGE_VELOCITY_ERR_246_oRDR_DETECTION_245_248_oPCAN_RADAR_7b1c7671_Tx: ComBitPosition=176, ComBitSize=8, ComSignalInitValue=0, ComSignalType=UINT8, ComHandleId=5192, ComSystemTemplateSystemSignalRef=DET_RANGE_VELOCITY_ERR_246
            DET_RCS_245_oRDR_DETECTION_245_248_oPCAN_RADAR_97c7c167_Tx: ComBitPosition=128, ComBitSize=8, ComSignalInitValue=128, ComSignalType=UINT8, ComHandleId=5195, ComSystemTemplateSystemSignalRef=DET_RCS_245
            DET_AZIMUTH_247_oRDR_DETECTION_245_248_oPCAN_RADAR_84eae8c8_Tx: ComBitPosition=312, ComBitSize=13, ComSignalInitValue=0, ComSignalType=UINT16, ComHandleId=5126, ComSystemTemplateSystemSignalRef=DET_AZIMUTH_247
            DET_CONFD_ELEVATION_246_oRDR_DETECTION_245_248_oPCAN_RADAR_11e9376d_Tx: ComBitPosition=213, ComBitSize=2, ComSignalInitValue=0, ComSignalType=UINT8, ComHandleId=5145, ComSystemTemplateSystemSignalRef=DET_CONFD_ELEVATION_246
            DET_RANGE_VELOCITY_ERR_248_oRDR_DETECTION_245_248_oPCAN_RADAR_c27c30a3_Tx: ComBitPosition=400, ComBitSize=8, ComSignalInitValue=0, ComSignalType=UINT8, ComHandleId=5194, ComSystemTemplateSystemSignalRef=DET_RANGE_VELOCITY_ERR_248
            DET_SUPER_RES_TARGET_247_oRDR_DETECTION_245_248_oPCAN_RADAR_8a60126b_Tx: ComBitPosition=311, ComBitSize=1, ComSignalInitValue=0, ComSignalType=BOOLEAN, ComHandleId=5205, ComSystemTemplateSystemSignalRef=DET_SUPER_RES_TARGET_247
            DET_RANGE_VELOCITY_245_oRDR_DETECTION_245_248_oPCAN_RADAR_1047f63d_Tx: ComBitPosition=48, ComBitSize=15, ComSignalInitValue=16384, ComSignalType=UINT16, ComHandleId=5187, ComSystemTemplateSystemSignalRef=DET_RANGE_VELOCITY_245
            DET_HVC_FLAG_248_oRDR_DETECTION_245_248_oPCAN_RADAR_cd9b0be9_Tx: ComBitPosition=422, ComBitSize=1, ComSignalInitValue=0, ComSignalType=BOOLEAN, ComHandleId=5163, ComSystemTemplateSystemSignalRef=DET_HVC_FLAG_248
            DET_CONFD_AZIMUTH_245_oRDR_DETECTION_245_248_oPCAN_RADAR_779c4d69_Tx: ComBitPosition=118, ComBitSize=2, ComSignalInitValue=0, ComSignalType=UINT8, ComHandleId=5140, ComSystemTemplateSystemSignalRef=DET_CONFD_AZIMUTH_245
            DET_CONFD_ELEVATION_248_oRDR_DETECTION_245_248_oPCAN_RADAR_a88971bf_Tx: ComBitPosition=437, ComBitSize=2, ComSignalInitValue=0, ComSignalType=UINT8, ComHandleId=5147, ComSystemTemplateSystemSignalRef=DET_CONFD_ELEVATION_248
            DET_RANGE_246_oRDR_DETECTION_245_248_oPCAN_RADAR_01014fe6_Tx: ComBitPosition=136, ComBitSize=15, ComSignalInitValue=0, ComSignalType=UINT16, ComHandleId=5180, ComSystemTemplateSystemSignalRef=DET_RANGE_246
            DET_MH_CYCLE_COUNTER_245_248_oRDR_DETECTION_245_248_oPCAN_RADAR_41cdd717_Tx: ComBitPosition=16, ComBitSize=8, ComSignalInitValue=0, ComSignalType=UINT8, ComHandleId=5169, ComSystemTemplateSystemSignalRef=DET_MH_CYCLE_COUNTER_245_248
            DET_BELOW_RAIN_THOLD_245_oRDR_DETECTION_245_248_oPCAN_RADAR_a07bd463_Tx: ComBitPosition=39, ComBitSize=1, ComSignalInitValue=0, ComSignalType=UINT8, ComHandleId=5132, ComSystemTemplateSystemSignalRef=DET_BELOW_RAIN_THOLD_245
            DET_PROB_1STAZHYPO_248_oRDR_DETECTION_245_248_oPCAN_RADAR_b3ceea42_Tx: ComBitPosition=439, ComBitSize=1, ComSignalInitValue=0, ComSignalType=BOOLEAN, ComHandleId=5178, ComSystemTemplateSystemSignalRef=DET_PROB_1STAZHYPO_248
            DET_IDM_247_oRDR_DETECTION_245_248_oPCAN_RADAR_6ad9a213_Tx: ComBitPosition=287, ComBitSize=1, ComSignalInitValue=0, ComSignalType=UINT8, ComHandleId=5166, ComSystemTemplateSystemSignalRef=DET_IDM_247
            DET_MTD_248_oRDR_DETECTION_245_248_oPCAN_RADAR_207a028f_Tx: ComBitPosition=383, ComBitSize=1, ComSignalInitValue=0, ComSignalType=UINT8, ComHandleId=5174, ComSystemTemplateSystemSignalRef=DET_MTD_248
            DET_PROB_1STAZHYPO_247_oRDR_DETECTION_245_248_oPCAN_RADAR_9fde7805_Tx: ComBitPosition=327, ComBitSize=1, ComSignalInitValue=0, ComSignalType=BOOLEAN, ComHandleId=5177, ComSystemTemplateSystemSignalRef=DET_PROB_1STAZHYPO_247
            DET_PROB_1STAZHYPO_245_oRDR_DETECTION_245_248_oPCAN_RADAR_6e4ed76e_Tx: ComBitPosition=103, ComBitSize=1, ComSignalInitValue=0, ComSignalType=BOOLEAN, ComHandleId=5175, ComSystemTemplateSystemSignalRef=DET_PROB_1STAZHYPO_245
            DET_IDM_245_oRDR_DETECTION_245_248_oPCAN_RADAR_9b490d78_Tx: ComBitPosition=63, ComBitSize=1, ComSignalInitValue=0, ComSignalType=UINT8, ComHandleId=5164, ComSystemTemplateSystemSignalRef=DET_IDM_245
            DET_BELOW_RAIN_THOLD_246_oRDR_DETECTION_245_248_oPCAN_RADAR_c49baf9d_Tx: ComBitPosition=151, ComBitSize=1, ComSignalInitValue=0, ComSignalType=UINT8, ComHandleId=5133, ComSystemTemplateSystemSignalRef=DET_BELOW_RAIN_THOLD_246
            DET_MTD_247_oRDR_DETECTION_245_248_oPCAN_RADAR_0c6a90c8_Tx: ComBitPosition=271, ComBitSize=1, ComSignalInitValue=0, ComSignalType=UINT8, ComHandleId=5173, ComSystemTemplateSystemSignalRef=DET_MTD_247
            DET_IDM_248_oRDR_DETECTION_245_248_oPCAN_RADAR_46c93054_Tx: ComBitPosition=399, ComBitSize=1, ComSignalInitValue=0, ComSignalType=UINT8, ComHandleId=5167, ComSystemTemplateSystemSignalRef=DET_IDM_248
            DET_MTD_245_oRDR_DETECTION_245_248_oPCAN_RADAR_fdfa3fa3_Tx: ComBitPosition=47, ComBitSize=1, ComSignalInitValue=0, ComSignalType=UINT8, ComHandleId=5171, ComSystemTemplateSystemSignalRef=DET_MTD_245
            DET_IDM_246_oRDR_DETECTION_245_248_oPCAN_RADAR_ffa97686_Tx: ComBitPosition=175, ComBitSize=1, ComSignalInitValue=0, ComSignalType=UINT8, ComHandleId=5165, ComSystemTemplateSystemSignalRef=DET_IDM_246
            DET_MTD_246_oRDR_DETECTION_245_248_oPCAN_RADAR_991a445d_Tx: ComBitPosition=159, ComBitSize=1, ComSignalInitValue=0, ComSignalType=UINT8, ComHandleId=5172, ComSystemTemplateSystemSignalRef=DET_MTD_246
            DET_PROB_1STAZHYPO_246_oRDR_DETECTION_245_248_oPCAN_RADAR_0aaeac90_Tx: ComBitPosition=215, ComBitSize=1, ComSignalInitValue=0, ComSignalType=BOOLEAN, ComHandleId=5176, ComSystemTemplateSystemSignalRef=DET_PROB_1STAZHYPO_246
            DET_BELOW_RAIN_THOLD_248_oRDR_DETECTION_245_248_oPCAN_RADAR_7dfbe94f_Tx: ComBitPosition=375, ComBitSize=1, ComSignalInitValue=0, ComSignalType=UINT8, ComHandleId=5135, ComSystemTemplateSystemSignalRef=DET_BELOW_RAIN_THOLD_248
            DET_BELOW_RAIN_THOLD_247_oRDR_DETECTION_245_248_oPCAN_RADAR_51eb7b08_Tx: ComBitPosition=263, ComBitSize=1, ComSignalInitValue=0, ComSignalType=UINT8, ComHandleId=5134, ComSystemTemplateSystemSignalRef=DET_BELOW_RAIN_THOLD_247
        SG_Detections_397_400_oRDR_DETECTION_397_400_oPCAN_RADAR_a221f00e_Tx: ComTransferProperty=TRIGGERED, ComHandleId=101, ComSystemTemplateSignalGroupRef=SG_Detections_397_400
          83 x ComGroupSignal, all with ComSignalEndianness=LITTLE_ENDIAN, ComTransferProperty=PENDING, ComSignalAccess=ACCESS_NEEDED_BY_SWC_OR_COM:
            DET_MH_CRC16_397_400_oRDR_DETECTION_397_400_oPCAN_RADAR_26a92205_Tx: ComBitPosition=0, ComBitSize=16, ComSignalInitValue=0, ComSignalType=UINT16, ComHandleId=8322, ComSystemTemplateSystemSignalRef=DET_MH_CRC16_397_400
            DET_RANGE_VELOCITY_400_oRDR_DETECTION_397_400_oPCAN_RADAR_d9c47bbe_Tx: ComBitPosition=384, ComBitSize=15, ComSignalInitValue=16384, ComSignalType=UINT16, ComHandleId=8344, ComSystemTemplateSystemSignalRef=DET_RANGE_VELOCITY_400
            DET_RANGE_VELOCITY_398_oRDR_DETECTION_397_400_oPCAN_RADAR_e36a8ddd_Tx: ComBitPosition=160, ComBitSize=15, ComSignalInitValue=16384, ComSignalType=UINT16, ComHandleId=8342, ComSystemTemplateSystemSignalRef=DET_RANGE_VELOCITY_398
            DET_EXISTENCE_PROB_400_oRDR_DETECTION_397_400_oPCAN_RADAR_38ecf839_Tx: ComBitPosition=448, ComBitSize=6, ComSignalInitValue=0, ComSignalType=UINT8, ComHandleId=8313, ComSystemTemplateSystemSignalRef=DET_EXISTENCE_PROB_400
            DET_CONFD_AZIMUTH_398_oRDR_DETECTION_397_400_oPCAN_RADAR_84b13689_Tx: ComBitPosition=230, ComBitSize=2, ComSignalInitValue=0, ComSignalType=UINT8, ComHandleId=8295, ComSystemTemplateSystemSignalRef=DET_CONFD_AZIMUTH_398
            DET_ELEVATION_397_oRDR_DETECTION_397_400_oPCAN_RADAR_7bf47108_Tx: ComBitPosition=72, ComBitSize=8, ComSignalInitValue=0, ComSignalType=UINT8, ComHandleId=8302, ComSystemTemplateSystemSignalRef=DET_ELEVATION_397
            DET_HVC_FLAG_398_oRDR_DETECTION_397_400_oPCAN_RADAR_e3364d25_Tx: ComBitPosition=198, ComBitSize=1, ComSignalInitValue=0, ComSignalType=BOOLEAN, ComHandleId=8315, ComSystemTemplateSystemSignalRef=DET_HVC_FLAG_398
            DET_AZIMUTH_399_oRDR_DETECTION_397_400_oPCAN_RADAR_1327e8d6_Tx: ComBitPosition=312, ComBitSize=13, ComSignalInitValue=0, ComSignalType=UINT16, ComHandleId=8280, ComSystemTemplateSystemSignalRef=DET_AZIMUTH_399
            DET_AZIMUTH_ERR_397_oRDR_DETECTION_397_400_oPCAN_RADAR_0ef23bf1_Tx: ComBitPosition=105, ComBitSize=7, ComSignalInitValue=0, ComSignalType=UINT8, ComHandleId=8282, ComSystemTemplateSystemSignalRef=DET_AZIMUTH_ERR_397
            DET_RANGE_398_oRDR_DETECTION_397_400_oPCAN_RADAR_96cc4ff8_Tx: ComBitPosition=136, ComBitSize=15, ComSignalInitValue=0, ComSignalType=UINT16, ComHandleId=8334, ComSystemTemplateSystemSignalRef=DET_RANGE_398
            DET_HVC_FLAG_397_oRDR_DETECTION_397_400_oPCAN_RADAR_cf26df62_Tx: ComBitPosition=86, ComBitSize=1, ComSignalInitValue=0, ComSignalType=BOOLEAN, ComHandleId=8314, ComSystemTemplateSystemSignalRef=DET_HVC_FLAG_397
            DET_CONFD_AZIMUTH_400_oRDR_DETECTION_397_400_oPCAN_RADAR_be1fc0ea_Tx: ComBitPosition=454, ComBitSize=2, ComSignalInitValue=0, ComSignalType=UINT8, ComHandleId=8297, ComSystemTemplateSystemSignalRef=DET_CONFD_AZIMUTH_400
            DET_ELEVATION_400_oRDR_DETECTION_397_400_oPCAN_RADAR_6d4a152c_Tx: ComBitPosition=408, ComBitSize=8, ComSignalInitValue=0, ComSignalType=UINT8, ComHandleId=8305, ComSystemTemplateSystemSignalRef=DET_ELEVATION_400
            DET_AZIMUTH_397_oRDR_DETECTION_397_400_oPCAN_RADAR_aa47ae04_Tx: ComBitPosition=88, ComBitSize=13, ComSignalInitValue=0, ComSignalType=UINT16, ComHandleId=8278, ComSystemTemplateSystemSignalRef=DET_AZIMUTH_397
            DET_RANGE_399_oRDR_DETECTION_397_400_oPCAN_RADAR_03bc9b6d_Tx: ComBitPosition=248, ComBitSize=15, ComSignalInitValue=0, ComSignalType=UINT16, ComHandleId=8335, ComSystemTemplateSystemSignalRef=DET_RANGE_399
            DET_MH_CYCLE_COUNTER_397_400_oRDR_DETECTION_397_400_oPCAN_RADAR_a2dc8332_Tx: ComBitPosition=16, ComBitSize=8, ComSignalInitValue=0, ComSignalType=UINT8, ComHandleId=8323, ComSystemTemplateSystemSignalRef=DET_MH_CYCLE_COUNTER_397_400
            DET_RANGE_VELOCITY_397_oRDR_DETECTION_397_400_oPCAN_RADAR_cf7a1f9a_Tx: ComBitPosition=48, ComBitSize=15, ComSignalInitValue=16384, ComSignalType=UINT16, ComHandleId=8341, ComSystemTemplateSystemSignalRef=DET_RANGE_VELOCITY_397
            DET_ELEVATION_ERR_400_oRDR_DETECTION_397_400_oPCAN_RADAR_ea738d59_Tx: ComBitPosition=416, ComBitSize=6, ComSignalInitValue=0, ComSignalType=UINT8, ComHandleId=8309, ComSystemTemplateSystemSignalRef=DET_ELEVATION_ERR_400
            DET_AZIMUTH_ERR_399_oRDR_DETECTION_397_400_oPCAN_RADAR_b7927d23_Tx: ComBitPosition=329, ComBitSize=7, ComSignalInitValue=0, ComSignalType=UINT8, ComHandleId=8284, ComSystemTemplateSystemSignalRef=DET_AZIMUTH_ERR_399
            DET_CONFD_ELEVATION_397_oRDR_DETECTION_397_400_oPCAN_RADAR_aa34a534_Tx: ComBitPosition=101, ComBitSize=2, ComSignalInitValue=0, ComSignalType=UINT8, ComHandleId=8298, ComSystemTemplateSystemSignalRef=DET_CONFD_ELEVATION_397
            DET_RANGE_ERR_398_oRDR_DETECTION_397_400_oPCAN_RADAR_3124f591_Tx: ComBitPosition=152, ComBitSize=7, ComSignalInitValue=0, ComSignalType=UINT8, ComHandleId=8338, ComSystemTemplateSystemSignalRef=DET_RANGE_ERR_398
            DET_RANGE_397_oRDR_DETECTION_397_400_oPCAN_RADAR_badcddbf_Tx: ComBitPosition=24, ComBitSize=15, ComSignalInitValue=0, ComSignalType=UINT16, ComHandleId=8333, ComSystemTemplateSystemSignalRef=DET_RANGE_397
            DET_HVC_FLAG_400_oRDR_DETECTION_397_400_oPCAN_RADAR_d998bb46_Tx: ComBitPosition=422, ComBitSize=1, ComSignalInitValue=0, ComSignalType=BOOLEAN, ComHandleId=8317, ComSystemTemplateSystemSignalRef=DET_HVC_FLAG_400
            DET_AZIMUTH_400_oRDR_DETECTION_397_400_oPCAN_RADAR_bcf9ca20_Tx: ComBitPosition=424, ComBitSize=13, ComSignalInitValue=0, ComSignalType=UINT16, ComHandleId=8281, ComSystemTemplateSystemSignalRef=DET_AZIMUTH_400
            DET_AZIMUTH_398_oRDR_DETECTION_397_400_oPCAN_RADAR_86573c43_Tx: ComBitPosition=200, ComBitSize=13, ComSignalInitValue=0, ComSignalType=UINT16, ComHandleId=8279, ComSystemTemplateSystemSignalRef=DET_AZIMUTH_398
            DET_ELEVATION_ERR_397_oRDR_DETECTION_397_400_oPCAN_RADAR_fccde97d_Tx: ComBitPosition=80, ComBitSize=6, ComSignalInitValue=0, ComSignalType=UINT8, ComHandleId=8306, ComSystemTemplateSystemSignalRef=DET_ELEVATION_ERR_397
            DET_BI_STATIC_FLAG_398_oRDR_DETECTION_397_400_oPCAN_RADAR_d07b7cc6_Tx: ComBitPosition=216, ComBitSize=1, ComSignalInitValue=0, ComSignalType=BOOLEAN, ComHandleId=8291, ComSystemTemplateSystemSignalRef=DET_BI_STATIC_FLAG_398
            DET_ELEVATION_ERR_399_oRDR_DETECTION_397_400_oPCAN_RADAR_45adafaf_Tx: ComBitPosition=304, ComBitSize=6, ComSignalInitValue=0, ComSignalType=UINT8, ComHandleId=8308, ComSystemTemplateSystemSignalRef=DET_ELEVATION_ERR_399
            DET_RANGE_VELOCITY_399_oRDR_DETECTION_397_400_oPCAN_RADAR_761a5948_Tx: ComBitPosition=272, ComBitSize=15, ComSignalInitValue=16384, ComSignalType=UINT16, ComHandleId=8343, ComSystemTemplateSystemSignalRef=DET_RANGE_VELOCITY_399
            DET_SNR_399_oRDR_DETECTION_397_400_oPCAN_RADAR_2c343a10_Tx: ComBitPosition=344, ComBitSize=8, ComSignalInitValue=0, ComSignalType=UINT8, ComHandleId=8355, ComSystemTemplateSystemSignalRef=DET_SNR_399
            DET_AZIMUTH_ERR_398_oRDR_DETECTION_397_400_oPCAN_RADAR_22e2a9b6_Tx: ComBitPosition=217, ComBitSize=7, ComSignalInitValue=0, ComSignalType=UINT8, ComHandleId=8283, ComSystemTemplateSystemSignalRef=DET_AZIMUTH_ERR_398
            DET_BI_STATIC_FLAG_397_oRDR_DETECTION_397_400_oPCAN_RADAR_fc6bee81_Tx: ComBitPosition=104, ComBitSize=1, ComSignalInitValue=0, ComSignalType=BOOLEAN, ComHandleId=8290, ComSystemTemplateSystemSignalRef=DET_BI_STATIC_FLAG_397
            DET_SNR_397_oRDR_DETECTION_397_400_oPCAN_RADAR_95547cc2_Tx: ComBitPosition=120, ComBitSize=8, ComSignalInitValue=0, ComSignalType=UINT8, ComHandleId=8353, ComSystemTemplateSystemSignalRef=DET_SNR_397
            DET_RANGE_400_oRDR_DETECTION_397_400_oPCAN_RADAR_ac62b99b_Tx: ComBitPosition=360, ComBitSize=15, ComSignalInitValue=0, ComSignalType=UINT16, ComHandleId=8336, ComSystemTemplateSystemSignalRef=DET_RANGE_400
            DET_CONFD_AZIMUTH_397_oRDR_DETECTION_397_400_oPCAN_RADAR_a8a1a4ce_Tx: ComBitPosition=118, ComBitSize=2, ComSignalInitValue=0, ComSignalType=UINT8, ComHandleId=8294, ComSystemTemplateSystemSignalRef=DET_CONFD_AZIMUTH_397
            DET_SUPER_RES_TARGET_399_oRDR_DETECTION_397_400_oPCAN_RADAR_1dad1275_Tx: ComBitPosition=311, ComBitSize=1, ComSignalInitValue=0, ComSignalType=BOOLEAN, ComHandleId=8359, ComSystemTemplateSystemSignalRef=DET_SUPER_RES_TARGET_399
            DET_CONFD_ELEVATION_398_oRDR_DETECTION_397_400_oPCAN_RADAR_86243773_Tx: ComBitPosition=213, ComBitSize=2, ComSignalInitValue=0, ComSignalType=UINT8, ComHandleId=8299, ComSystemTemplateSystemSignalRef=DET_CONFD_ELEVATION_398
            DET_HVC_FLAG_399_oRDR_DETECTION_397_400_oPCAN_RADAR_764699b0_Tx: ComBitPosition=310, ComBitSize=1, ComSignalInitValue=0, ComSignalType=BOOLEAN, ComHandleId=8316, ComSystemTemplateSystemSignalRef=DET_HVC_FLAG_399
            DET_RANGE_VELOCITY_ERR_397_oRDR_DETECTION_397_400_oPCAN_RADAR_c0c1e428_Tx: ComBitPosition=64, ComBitSize=8, ComSignalInitValue=0, ComSignalType=UINT8, ComHandleId=8345, ComSystemTemplateSystemSignalRef=DET_RANGE_VELOCITY_ERR_397
            DET_SNR_400_oRDR_DETECTION_397_400_oPCAN_RADAR_83ea18e6_Tx: ComBitPosition=456, ComBitSize=8, ComSignalInitValue=0, ComSignalType=UINT8, ComHandleId=8356, ComSystemTemplateSystemSignalRef=DET_SNR_400
            DET_EXISTENCE_PROB_399_oRDR_DETECTION_397_400_oPCAN_RADAR_9732dacf_Tx: ComBitPosition=336, ComBitSize=6, ComSignalInitValue=0, ComSignalType=UINT8, ComHandleId=8312, ComSystemTemplateSystemSignalRef=DET_EXISTENCE_PROB_399
            DET_RANGE_ERR_397_oRDR_DETECTION_397_400_oPCAN_RADAR_1d3467d6_Tx: ComBitPosition=40, ComBitSize=7, ComSignalInitValue=0, ComSignalType=UINT8, ComHandleId=8337, ComSystemTemplateSystemSignalRef=DET_RANGE_ERR_397
            DET_SUPER_RES_TARGET_397_oRDR_DETECTION_397_400_oPCAN_RADAR_a4cd54a7_Tx: ComBitPosition=87, ComBitSize=1, ComSignalInitValue=0, ComSignalType=BOOLEAN, ComHandleId=8357, ComSystemTemplateSystemSignalRef=DET_SUPER_RES_TARGET_397
            DET_AZIMUTH_ERR_400_oRDR_DETECTION_397_400_oPCAN_RADAR_184c5fd5_Tx: ComBitPosition=441, ComBitSize=7, ComSignalInitValue=0, ComSignalType=UINT8, ComHandleId=8285, ComSystemTemplateSystemSignalRef=DET_AZIMUTH_ERR_400
            DET_CONFD_AZIMUTH_399_oRDR_DETECTION_397_400_oPCAN_RADAR_11c1e21c_Tx: ComBitPosition=342, ComBitSize=2, ComSignalInitValue=0, ComSignalType=UINT8, ComHandleId=8296, ComSystemTemplateSystemSignalRef=DET_CONFD_AZIMUTH_399
            DET_ELEVATION_399_oRDR_DETECTION_397_400_oPCAN_RADAR_c29437da_Tx: ComBitPosition=296, ComBitSize=8, ComSignalInitValue=0, ComSignalType=UINT8, ComHandleId=8304, ComSystemTemplateSystemSignalRef=DET_ELEVATION_399
            DET_RANGE_VELOCITY_ERR_400_oRDR_DETECTION_397_400_oPCAN_RADAR_d67f800c_Tx: ComBitPosition=400, ComBitSize=8, ComSignalInitValue=0, ComSignalType=UINT8, ComHandleId=8348, ComSystemTemplateSystemSignalRef=DET_RANGE_VELOCITY_ERR_400
            DET_EXISTENCE_PROB_398_oRDR_DETECTION_397_400_oPCAN_RADAR_02420e5a_Tx: ComBitPosition=224, ComBitSize=6, ComSignalInitValue=0, ComSignalType=UINT8, ComHandleId=8311, ComSystemTemplateSystemSignalRef=DET_EXISTENCE_PROB_398
            DET_RCS_397_oRDR_DETECTION_397_400_oPCAN_RADAR_48fa28c0_Tx: ComBitPosition=128, ComBitSize=8, ComSignalInitValue=128, ComSignalType=UINT8, ComHandleId=8349, ComSystemTemplateSystemSignalRef=DET_RCS_397
            DET_RANGE_ERR_399_oRDR_DETECTION_397_400_oPCAN_RADAR_a4542104_Tx: ComBitPosition=264, ComBitSize=7, ComSignalInitValue=0, ComSignalType=UINT8, ComHandleId=8339, ComSystemTemplateSystemSignalRef=DET_RANGE_ERR_399
            DET_EXISTENCE_PROB_397_oRDR_DETECTION_397_400_oPCAN_RADAR_2e529c1d_Tx: ComBitPosition=112, ComBitSize=6, ComSignalInitValue=0, ComSignalType=UINT8, ComHandleId=8310, ComSystemTemplateSystemSignalRef=DET_EXISTENCE_PROB_397
            DET_ELEVATION_398_oRDR_DETECTION_397_400_oPCAN_RADAR_57e4e34f_Tx: ComBitPosition=184, ComBitSize=8, ComSignalInitValue=0, ComSignalType=UINT8, ComHandleId=8303, ComSystemTemplateSystemSignalRef=DET_ELEVATION_398
            DET_BI_STATIC_FLAG_399_oRDR_DETECTION_397_400_oPCAN_RADAR_450ba853_Tx: ComBitPosition=328, ComBitSize=1, ComSignalInitValue=0, ComSignalType=BOOLEAN, ComHandleId=8292, ComSystemTemplateSystemSignalRef=DET_BI_STATIC_FLAG_399
            DET_RCS_399_oRDR_DETECTION_397_400_oPCAN_RADAR_f19a6e12_Tx: ComBitPosition=352, ComBitSize=8, ComSignalInitValue=128, ComSignalType=UINT8, ComHandleId=8351, ComSystemTemplateSystemSignalRef=DET_RCS_399
            DET_RCS_400_oRDR_DETECTION_397_400_oPCAN_RADAR_5e444ce4_Tx: ComBitPosition=464, ComBitSize=8, ComSignalInitValue=128, ComSignalType=UINT8, ComHandleId=8352, ComSystemTemplateSystemSignalRef=DET_RCS_400
            DET_CONFD_ELEVATION_399_oRDR_DETECTION_397_400_oPCAN_RADAR_1354e3e6_Tx: ComBitPosition=325, ComBitSize=2, ComSignalInitValue=0, ComSignalType=UINT8, ComHandleId=8300, ComSystemTemplateSystemSignalRef=DET_CONFD_ELEVATION_399
            DET_ELEVATION_ERR_398_oRDR_DETECTION_397_400_oPCAN_RADAR_d0dd7b3a_Tx: ComBitPosition=192, ComBitSize=6, ComSignalInitValue=0, ComSignalType=UINT8, ComHandleId=8307, ComSystemTemplateSystemSignalRef=DET_ELEVATION_ERR_398
            DET_SNR_398_oRDR_DETECTION_397_400_oPCAN_RADAR_b944ee85_Tx: ComBitPosition=232, ComBitSize=8, ComSignalInitValue=0, ComSignalType=UINT8, ComHandleId=8354, ComSystemTemplateSystemSignalRef=DET_SNR_398
            DET_BI_STATIC_FLAG_400_oRDR_DETECTION_397_400_oPCAN_RADAR_ead58aa5_Tx: ComBitPosition=440, ComBitSize=1, ComSignalInitValue=0, ComSignalType=BOOLEAN, ComHandleId=8293, ComSystemTemplateSystemSignalRef=DET_BI_STATIC_FLAG_400
            DET_RANGE_VELOCITY_ERR_398_oRDR_DETECTION_397_400_oPCAN_RADAR_ecd1766f_Tx: ComBitPosition=176, ComBitSize=8, ComSignalInitValue=0, ComSignalType=UINT8, ComHandleId=8346, ComSystemTemplateSystemSignalRef=DET_RANGE_VELOCITY_ERR_398
            DET_CONFD_ELEVATION_400_oRDR_DETECTION_397_400_oPCAN_RADAR_bc8ac110_Tx: ComBitPosition=437, ComBitSize=2, ComSignalInitValue=0, ComSignalType=UINT8, ComHandleId=8301, ComSystemTemplateSystemSignalRef=DET_CONFD_ELEVATION_400
            DET_RCS_398_oRDR_DETECTION_397_400_oPCAN_RADAR_64eaba87_Tx: ComBitPosition=240, ComBitSize=8, ComSignalInitValue=128, ComSignalType=UINT8, ComHandleId=8350, ComSystemTemplateSystemSignalRef=DET_RCS_398
            DET_MH_SCAN_INDEX_4LSB_397_400_oRDR_DETECTION_397_400_oPCAN_RADAR_6ef6a6be_Tx: ComBitPosition=476, ComBitSize=4, ComSignalInitValue=0, ComSignalType=UINT8, ComHandleId=8324, ComSystemTemplateSystemSignalRef=DET_MH_SCAN_INDEX_4LSB_397_400
            DET_RANGE_ERR_400_oRDR_DETECTION_397_400_oPCAN_RADAR_0b8a03f2_Tx: ComBitPosition=376, ComBitSize=7, ComSignalInitValue=0, ComSignalType=UINT8, ComHandleId=8340, ComSystemTemplateSystemSignalRef=DET_RANGE_ERR_400
            DET_RANGE_VELOCITY_ERR_399_oRDR_DETECTION_397_400_oPCAN_RADAR_79a1a2fa_Tx: ComBitPosition=288, ComBitSize=8, ComSignalInitValue=0, ComSignalType=UINT8, ComHandleId=8347, ComSystemTemplateSystemSignalRef=DET_RANGE_VELOCITY_ERR_399
            DET_SUPER_RES_TARGET_398_oRDR_DETECTION_397_400_oPCAN_RADAR_88ddc6e0_Tx: ComBitPosition=199, ComBitSize=1, ComSignalInitValue=0, ComSignalType=BOOLEAN, ComHandleId=8358, ComSystemTemplateSystemSignalRef=DET_SUPER_RES_TARGET_398
            DET_SUPER_RES_TARGET_400_oRDR_DETECTION_397_400_oPCAN_RADAR_b2733083_Tx: ComBitPosition=423, ComBitSize=1, ComSignalInitValue=0, ComSignalType=BOOLEAN, ComHandleId=8360, ComSystemTemplateSystemSignalRef=DET_SUPER_RES_TARGET_400
            DET_PROB_1STAZHYPO_400_oRDR_DETECTION_397_400_oPCAN_RADAR_a7cd5aed_Tx: ComBitPosition=439, ComBitSize=1, ComSignalInitValue=0, ComSignalType=BOOLEAN, ComHandleId=8332, ComSystemTemplateSystemSignalRef=DET_PROB_1STAZHYPO_400
            DET_IDM_399_oRDR_DETECTION_397_400_oPCAN_RADAR_fd14a20d_Tx: ComBitPosition=287, ComBitSize=1, ComSignalInitValue=0, ComSignalType=UINT8, ComHandleId=8320, ComSystemTemplateSystemSignalRef=DET_IDM_399
            DET_MTD_397_oRDR_DETECTION_397_400_oPCAN_RADAR_22c7d604_Tx: ComBitPosition=47, ComBitSize=1, ComSignalInitValue=0, ComSignalType=UINT8, ComHandleId=8325, ComSystemTemplateSystemSignalRef=DET_MTD_397
            DET_PROB_1STAZHYPO_398_oRDR_DETECTION_397_400_oPCAN_RADAR_9d63ac8e_Tx: ComBitPosition=215, ComBitSize=1, ComSignalInitValue=0, ComSignalType=BOOLEAN, ComHandleId=8330, ComSystemTemplateSystemSignalRef=DET_PROB_1STAZHYPO_398
            DET_PROB_1STAZHYPO_399_oRDR_DETECTION_397_400_oPCAN_RADAR_0813781b_Tx: ComBitPosition=327, ComBitSize=1, ComSignalInitValue=0, ComSignalType=BOOLEAN, ComHandleId=8331, ComSystemTemplateSystemSignalRef=DET_PROB_1STAZHYPO_399
            DET_MTD_399_oRDR_DETECTION_397_400_oPCAN_RADAR_9ba790d6_Tx: ComBitPosition=271, ComBitSize=1, ComSignalInitValue=0, ComSignalType=UINT8, ComHandleId=8327, ComSystemTemplateSystemSignalRef=DET_MTD_399
            DET_BELOW_RAIN_THOLD_398_oRDR_DETECTION_397_400_oPCAN_RADAR_5356af83_Tx: ComBitPosition=151, ComBitSize=1, ComSignalInitValue=0, ComSignalType=UINT8, ComHandleId=8287, ComSystemTemplateSystemSignalRef=DET_BELOW_RAIN_THOLD_398
            DET_IDM_400_oRDR_DETECTION_397_400_oPCAN_RADAR_52ca80fb_Tx: ComBitPosition=399, ComBitSize=1, ComSignalInitValue=0, ComSignalType=UINT8, ComHandleId=8321, ComSystemTemplateSystemSignalRef=DET_IDM_400
            DET_IDM_398_oRDR_DETECTION_397_400_oPCAN_RADAR_68647698_Tx: ComBitPosition=175, ComBitSize=1, ComSignalInitValue=0, ComSignalType=UINT8, ComHandleId=8319, ComSystemTemplateSystemSignalRef=DET_IDM_398
            DET_BELOW_RAIN_THOLD_399_oRDR_DETECTION_397_400_oPCAN_RADAR_c6267b16_Tx: ComBitPosition=263, ComBitSize=1, ComSignalInitValue=0, ComSignalType=UINT8, ComHandleId=8288, ComSystemTemplateSystemSignalRef=DET_BELOW_RAIN_THOLD_399
            DET_BELOW_RAIN_THOLD_400_oRDR_DETECTION_397_400_oPCAN_RADAR_69f859e0_Tx: ComBitPosition=375, ComBitSize=1, ComSignalInitValue=0, ComSignalType=UINT8, ComHandleId=8289, ComSystemTemplateSystemSignalRef=DET_BELOW_RAIN_THOLD_400
            DET_BELOW_RAIN_THOLD_397_oRDR_DETECTION_397_400_oPCAN_RADAR_7f463dc4_Tx: ComBitPosition=39, ComBitSize=1, ComSignalInitValue=0, ComSignalType=UINT8, ComHandleId=8286, ComSystemTemplateSystemSignalRef=DET_BELOW_RAIN_THOLD_397
            DET_MTD_400_oRDR_DETECTION_397_400_oPCAN_RADAR_3479b220_Tx: ComBitPosition=383, ComBitSize=1, ComSignalInitValue=0, ComSignalType=UINT8, ComHandleId=8328, ComSystemTemplateSystemSignalRef=DET_MTD_400
            DET_MTD_398_oRDR_DETECTION_397_400_oPCAN_RADAR_0ed74443_Tx: ComBitPosition=159, ComBitSize=1, ComSignalInitValue=0, ComSignalType=UINT8, ComHandleId=8326, ComSystemTemplateSystemSignalRef=DET_MTD_398
            DET_PROB_1STAZHYPO_397_oRDR_DETECTION_397_400_oPCAN_RADAR_b1733ec9_Tx: ComBitPosition=103, ComBitSize=1, ComSignalInitValue=0, ComSignalType=BOOLEAN, ComHandleId=8329, ComSystemTemplateSystemSignalRef=DET_PROB_1STAZHYPO_397
            DET_IDM_397_oRDR_DETECTION_397_400_oPCAN_RADAR_4474e4df_Tx: ComBitPosition=63, ComBitSize=1, ComSignalInitValue=0, ComSignalType=UINT8, ComHandleId=8318, ComSystemTemplateSystemSignalRef=DET_IDM_397
        SG_Detections_185_188_oRDR_DETECTION_185_188_oPCAN_RADAR_39f50203_Tx: ComTransferProperty=TRIGGERED, ComHandleId=48, ComSystemTemplateSignalGroupRef=SG_Detections_185_188
          83 x ComGroupSignal, all with ComSignalEndianness=LITTLE_ENDIAN, ComTransferProperty=PENDING, ComSignalAccess=ACCESS_NEEDED_BY_SWC_OR_COM:
            DET_RCS_186_oRDR_DETECTION_185_188_oPCAN_RADAR_881d45c8_Tx: ComBitPosition=240, ComBitSize=8, ComSignalInitValue=128, ComSignalType=UINT8, ComHandleId=3951, ComSystemTemplateSystemSignalRef=DET_RCS_186
            DET_SUPER_RES_TARGET_188_oRDR_DETECTION_185_188_oPCAN_RADAR_dd4a7f7d_Tx: ComBitPosition=423, ComBitSize=1, ComSignalInitValue=0, ComSignalType=BOOLEAN, ComHandleId=3961, ComSystemTemplateSystemSignalRef=DET_SUPER_RES_TARGET_188
            DET_CONFD_ELEVATION_187_oRDR_DETECTION_185_188_oPCAN_RADAR_ffa31ca9_Tx: ComBitPosition=325, ComBitSize=2, ComSignalInitValue=0, ComSignalType=UINT8, ComHandleId=3901, ComSystemTemplateSystemSignalRef=DET_CONFD_ELEVATION_187
            DET_ELEVATION_186_oRDR_DETECTION_185_188_oPCAN_RADAR_bb131c00_Tx: ComBitPosition=184, ComBitSize=8, ComSignalInitValue=0, ComSignalType=UINT8, ComHandleId=3904, ComSystemTemplateSystemSignalRef=DET_ELEVATION_186
            DET_AZIMUTH_ERR_188_oRDR_DETECTION_185_188_oPCAN_RADAR_7775102b_Tx: ComBitPosition=441, ComBitSize=7, ComSignalInitValue=0, ComSignalType=UINT8, ComHandleId=3886, ComSystemTemplateSystemSignalRef=DET_AZIMUTH_ERR_188
            DET_BI_STATIC_FLAG_187_oRDR_DETECTION_185_188_oPCAN_RADAR_a9fc571c_Tx: ComBitPosition=328, ComBitSize=1, ComSignalInitValue=0, ComSignalType=BOOLEAN, ComHandleId=3893, ComSystemTemplateSystemSignalRef=DET_BI_STATIC_FLAG_187
            DET_RANGE_VELOCITY_185_oRDR_DETECTION_185_188_oPCAN_RADAR_6b7d096c_Tx: ComBitPosition=48, ComBitSize=15, ComSignalInitValue=16384, ComSignalType=UINT16, ComHandleId=3942, ComSystemTemplateSystemSignalRef=DET_RANGE_VELOCITY_185
            DET_SNR_188_oRDR_DETECTION_185_188_oPCAN_RADAR_ecd35718_Tx: ComBitPosition=456, ComBitSize=8, ComSignalInitValue=0, ComSignalType=UINT8, ComHandleId=3957, ComSystemTemplateSystemSignalRef=DET_SNR_188
            DET_CONFD_ELEVATION_185_oRDR_DETECTION_185_188_oPCAN_RADAR_0e33b3c2_Tx: ComBitPosition=101, ComBitSize=2, ComSignalInitValue=0, ComSignalType=UINT8, ComHandleId=3899, ComSystemTemplateSystemSignalRef=DET_CONFD_ELEVATION_185
            DET_RANGE_VELOCITY_186_oRDR_DETECTION_185_188_oPCAN_RADAR_0f9d7292_Tx: ComBitPosition=160, ComBitSize=15, ComSignalInitValue=16384, ComSignalType=UINT16, ComHandleId=3943, ComSystemTemplateSystemSignalRef=DET_RANGE_VELOCITY_186
            DET_BI_STATIC_FLAG_186_oRDR_DETECTION_185_188_oPCAN_RADAR_3c8c8389_Tx: ComBitPosition=216, ComBitSize=1, ComSignalInitValue=0, ComSignalType=BOOLEAN, ComHandleId=3892, ComSystemTemplateSystemSignalRef=DET_BI_STATIC_FLAG_186
            DET_CONFD_ELEVATION_186_oRDR_DETECTION_185_188_oPCAN_RADAR_6ad3c83c_Tx: ComBitPosition=213, ComBitSize=2, ComSignalInitValue=0, ComSignalType=UINT8, ComHandleId=3900, ComSystemTemplateSystemSignalRef=DET_CONFD_ELEVATION_186
            DET_AZIMUTH_186_oRDR_DETECTION_185_188_oPCAN_RADAR_6aa0c30c_Tx: ComBitPosition=200, ComBitSize=13, ComSignalInitValue=0, ComSignalType=UINT16, ComHandleId=3880, ComSystemTemplateSystemSignalRef=DET_AZIMUTH_186
            DET_AZIMUTH_188_oRDR_DETECTION_185_188_oPCAN_RADAR_d3c085de_Tx: ComBitPosition=424, ComBitSize=13, ComSignalInitValue=0, ComSignalType=UINT16, ComHandleId=3882, ComSystemTemplateSystemSignalRef=DET_AZIMUTH_188
            DET_CONFD_AZIMUTH_186_oRDR_DETECTION_185_188_oPCAN_RADAR_6846c9c6_Tx: ComBitPosition=230, ComBitSize=2, ComSignalInitValue=0, ComSignalType=UINT8, ComHandleId=3896, ComSystemTemplateSystemSignalRef=DET_CONFD_AZIMUTH_186
            DET_ELEVATION_ERR_188_oRDR_DETECTION_185_188_oPCAN_RADAR_854ac2a7_Tx: ComBitPosition=416, ComBitSize=6, ComSignalInitValue=0, ComSignalType=UINT8, ComHandleId=3910, ComSystemTemplateSystemSignalRef=DET_ELEVATION_ERR_188
            DET_EXISTENCE_PROB_185_oRDR_DETECTION_185_188_oPCAN_RADAR_8a558aeb_Tx: ComBitPosition=112, ComBitSize=6, ComSignalInitValue=0, ComSignalType=UINT8, ComHandleId=3911, ComSystemTemplateSystemSignalRef=DET_EXISTENCE_PROB_185
            DET_RANGE_187_oRDR_DETECTION_185_188_oPCAN_RADAR_ef4b6422_Tx: ComBitPosition=248, ComBitSize=15, ComSignalInitValue=0, ComSignalType=UINT16, ComHandleId=3936, ComSystemTemplateSystemSignalRef=DET_RANGE_187
            DET_RANGE_VELOCITY_ERR_187_oRDR_DETECTION_185_188_oPCAN_RADAR_95565db5_Tx: ComBitPosition=288, ComBitSize=8, ComSignalInitValue=0, ComSignalType=UINT8, ComHandleId=3948, ComSystemTemplateSystemSignalRef=DET_RANGE_VELOCITY_ERR_187
            DET_RCS_188_oRDR_DETECTION_185_188_oPCAN_RADAR_317d031a_Tx: ComBitPosition=464, ComBitSize=8, ComSignalInitValue=128, ComSignalType=UINT8, ComHandleId=3953, ComSystemTemplateSystemSignalRef=DET_RCS_188
            DET_AZIMUTH_185_oRDR_DETECTION_185_188_oPCAN_RADAR_0e40b8f2_Tx: ComBitPosition=88, ComBitSize=13, ComSignalInitValue=0, ComSignalType=UINT16, ComHandleId=3879, ComSystemTemplateSystemSignalRef=DET_AZIMUTH_185
            DET_CONFD_AZIMUTH_185_oRDR_DETECTION_185_188_oPCAN_RADAR_0ca6b238_Tx: ComBitPosition=118, ComBitSize=2, ComSignalInitValue=0, ComSignalType=UINT8, ComHandleId=3895, ComSystemTemplateSystemSignalRef=DET_CONFD_AZIMUTH_185
            DET_SUPER_RES_TARGET_185_oRDR_DETECTION_185_188_oPCAN_RADAR_00ca4251_Tx: ComBitPosition=87, ComBitSize=1, ComSignalInitValue=0, ComSignalType=BOOLEAN, ComHandleId=3958, ComSystemTemplateSystemSignalRef=DET_SUPER_RES_TARGET_185
            DET_MH_CRC16_185_188_oRDR_DETECTION_185_188_oPCAN_RADAR_bd7dd008_Tx: ComBitPosition=0, ComBitSize=16, ComSignalInitValue=0, ComSignalType=UINT16, ComHandleId=3923, ComSystemTemplateSystemSignalRef=DET_MH_CRC16_185_188
            DET_MH_SCAN_INDEX_4LSB_185_188_oRDR_DETECTION_185_188_oPCAN_RADAR_f52254b3_Tx: ComBitPosition=476, ComBitSize=4, ComSignalInitValue=0, ComSignalType=UINT8, ComHandleId=3925, ComSystemTemplateSystemSignalRef=DET_MH_SCAN_INDEX_4LSB_185_188
            DET_ELEVATION_ERR_186_oRDR_DETECTION_185_188_oPCAN_RADAR_3c2a8475_Tx: ComBitPosition=192, ComBitSize=6, ComSignalInitValue=0, ComSignalType=UINT8, ComHandleId=3908, ComSystemTemplateSystemSignalRef=DET_ELEVATION_ERR_186
            DET_CONFD_AZIMUTH_187_oRDR_DETECTION_185_188_oPCAN_RADAR_fd361d53_Tx: ComBitPosition=342, ComBitSize=2, ComSignalInitValue=0, ComSignalType=UINT8, ComHandleId=3897, ComSystemTemplateSystemSignalRef=DET_CONFD_AZIMUTH_187
            DET_EXISTENCE_PROB_187_oRDR_DETECTION_185_188_oPCAN_RADAR_7bc52580_Tx: ComBitPosition=336, ComBitSize=6, ComSignalInitValue=0, ComSignalType=UINT8, ComHandleId=3913, ComSystemTemplateSystemSignalRef=DET_EXISTENCE_PROB_187
            DET_RANGE_ERR_187_oRDR_DETECTION_185_188_oPCAN_RADAR_48a3de4b_Tx: ComBitPosition=264, ComBitSize=7, ComSignalInitValue=0, ComSignalType=UINT8, ComHandleId=3940, ComSystemTemplateSystemSignalRef=DET_RANGE_ERR_187
            DET_BI_STATIC_FLAG_188_oRDR_DETECTION_185_188_oPCAN_RADAR_85ecc55b_Tx: ComBitPosition=440, ComBitSize=1, ComSignalInitValue=0, ComSignalType=BOOLEAN, ComHandleId=3894, ComSystemTemplateSystemSignalRef=DET_BI_STATIC_FLAG_188
            DET_SNR_187_oRDR_DETECTION_185_188_oPCAN_RADAR_c0c3c55f_Tx: ComBitPosition=344, ComBitSize=8, ComSignalInitValue=0, ComSignalType=UINT8, ComHandleId=3956, ComSystemTemplateSystemSignalRef=DET_SNR_187
            DET_CONFD_AZIMUTH_188_oRDR_DETECTION_185_188_oPCAN_RADAR_d1268f14_Tx: ComBitPosition=454, ComBitSize=2, ComSignalInitValue=0, ComSignalType=UINT8, ComHandleId=3898, ComSystemTemplateSystemSignalRef=DET_CONFD_AZIMUTH_188
            DET_HVC_FLAG_187_oRDR_DETECTION_185_188_oPCAN_RADAR_9ab166ff_Tx: ComBitPosition=310, ComBitSize=1, ComSignalInitValue=0, ComSignalType=BOOLEAN, ComHandleId=3917, ComSystemTemplateSystemSignalRef=DET_HVC_FLAG_187
            DET_SUPER_RES_TARGET_187_oRDR_DETECTION_185_188_oPCAN_RADAR_f15aed3a_Tx: ComBitPosition=311, ComBitSize=1, ComSignalInitValue=0, ComSignalType=BOOLEAN, ComHandleId=3960, ComSystemTemplateSystemSignalRef=DET_SUPER_RES_TARGET_187
            DET_RANGE_VELOCITY_ERR_185_oRDR_DETECTION_185_188_oPCAN_RADAR_64c6f2de_Tx: ComBitPosition=64, ComBitSize=8, ComSignalInitValue=0, ComSignalType=UINT8, ComHandleId=3946, ComSystemTemplateSystemSignalRef=DET_RANGE_VELOCITY_ERR_185
            DET_ELEVATION_ERR_185_oRDR_DETECTION_185_188_oPCAN_RADAR_58caff8b_Tx: ComBitPosition=80, ComBitSize=6, ComSignalInitValue=0, ComSignalType=UINT8, ComHandleId=3907, ComSystemTemplateSystemSignalRef=DET_ELEVATION_ERR_185
            DET_RANGE_188_oRDR_DETECTION_185_188_oPCAN_RADAR_c35bf665_Tx: ComBitPosition=360, ComBitSize=15, ComSignalInitValue=0, ComSignalType=UINT16, ComHandleId=3937, ComSystemTemplateSystemSignalRef=DET_RANGE_188
            DET_BI_STATIC_FLAG_185_oRDR_DETECTION_185_188_oPCAN_RADAR_586cf877_Tx: ComBitPosition=104, ComBitSize=1, ComSignalInitValue=0, ComSignalType=BOOLEAN, ComHandleId=3891, ComSystemTemplateSystemSignalRef=DET_BI_STATIC_FLAG_185
            DET_RANGE_VELOCITY_ERR_188_oRDR_DETECTION_185_188_oPCAN_RADAR_b946cff2_Tx: ComBitPosition=400, ComBitSize=8, ComSignalInitValue=0, ComSignalType=UINT8, ComHandleId=3949, ComSystemTemplateSystemSignalRef=DET_RANGE_VELOCITY_ERR_188
            DET_HVC_FLAG_188_oRDR_DETECTION_185_188_oPCAN_RADAR_b6a1f4b8_Tx: ComBitPosition=422, ComBitSize=1, ComSignalInitValue=0, ComSignalType=BOOLEAN, ComHandleId=3918, ComSystemTemplateSystemSignalRef=DET_HVC_FLAG_188
            DET_RANGE_VELOCITY_ERR_186_oRDR_DETECTION_185_188_oPCAN_RADAR_00268920_Tx: ComBitPosition=176, ComBitSize=8, ComSignalInitValue=0, ComSignalType=UINT8, ComHandleId=3947, ComSystemTemplateSystemSignalRef=DET_RANGE_VELOCITY_ERR_186
            DET_AZIMUTH_ERR_187_oRDR_DETECTION_185_188_oPCAN_RADAR_5b65826c_Tx: ComBitPosition=329, ComBitSize=7, ComSignalInitValue=0, ComSignalType=UINT8, ComHandleId=3885, ComSystemTemplateSystemSignalRef=DET_AZIMUTH_ERR_187
            DET_ELEVATION_187_oRDR_DETECTION_185_188_oPCAN_RADAR_2e63c895_Tx: ComBitPosition=296, ComBitSize=8, ComSignalInitValue=0, ComSignalType=UINT8, ComHandleId=3905, ComSystemTemplateSystemSignalRef=DET_ELEVATION_187
            DET_AZIMUTH_ERR_186_oRDR_DETECTION_185_188_oPCAN_RADAR_ce1556f9_Tx: ComBitPosition=217, ComBitSize=7, ComSignalInitValue=0, ComSignalType=UINT8, ComHandleId=3884, ComSystemTemplateSystemSignalRef=DET_AZIMUTH_ERR_186
            DET_SUPER_RES_TARGET_186_oRDR_DETECTION_185_188_oPCAN_RADAR_642a39af_Tx: ComBitPosition=199, ComBitSize=1, ComSignalInitValue=0, ComSignalType=BOOLEAN, ComHandleId=3959, ComSystemTemplateSystemSignalRef=DET_SUPER_RES_TARGET_186
            DET_MH_CYCLE_COUNTER_185_188_oRDR_DETECTION_185_188_oPCAN_RADAR_3908713f_Tx: ComBitPosition=16, ComBitSize=8, ComSignalInitValue=0, ComSignalType=UINT8, ComHandleId=3924, ComSystemTemplateSystemSignalRef=DET_MH_CYCLE_COUNTER_185_188
            DET_RANGE_185_oRDR_DETECTION_185_188_oPCAN_RADAR_1edbcb49_Tx: ComBitPosition=24, ComBitSize=15, ComSignalInitValue=0, ComSignalType=UINT16, ComHandleId=3934, ComSystemTemplateSystemSignalRef=DET_RANGE_185
            DET_RCS_185_oRDR_DETECTION_185_188_oPCAN_RADAR_ecfd3e36_Tx: ComBitPosition=128, ComBitSize=8, ComSignalInitValue=128, ComSignalType=UINT8, ComHandleId=3950, ComSystemTemplateSystemSignalRef=DET_RCS_185
            DET_ELEVATION_ERR_187_oRDR_DETECTION_185_188_oPCAN_RADAR_a95a50e0_Tx: ComBitPosition=304, ComBitSize=6, ComSignalInitValue=0, ComSignalType=UINT8, ComHandleId=3909, ComSystemTemplateSystemSignalRef=DET_ELEVATION_ERR_187
            DET_AZIMUTH_ERR_185_oRDR_DETECTION_185_188_oPCAN_RADAR_aaf52d07_Tx: ComBitPosition=105, ComBitSize=7, ComSignalInitValue=0, ComSignalType=UINT8, ComHandleId=3883, ComSystemTemplateSystemSignalRef=DET_AZIMUTH_ERR_185
            DET_SNR_186_oRDR_DETECTION_185_188_oPCAN_RADAR_55b311ca_Tx: ComBitPosition=232, ComBitSize=8, ComSignalInitValue=0, ComSignalType=UINT8, ComHandleId=3955, ComSystemTemplateSystemSignalRef=DET_SNR_186
            DET_HVC_FLAG_186_oRDR_DETECTION_185_188_oPCAN_RADAR_0fc1b26a_Tx: ComBitPosition=198, ComBitSize=1, ComSignalInitValue=0, ComSignalType=BOOLEAN, ComHandleId=3916, ComSystemTemplateSystemSignalRef=DET_HVC_FLAG_186
            DET_ELEVATION_185_oRDR_DETECTION_185_188_oPCAN_RADAR_dff367fe_Tx: ComBitPosition=72, ComBitSize=8, ComSignalInitValue=0, ComSignalType=UINT8, ComHandleId=3903, ComSystemTemplateSystemSignalRef=DET_ELEVATION_185
            DET_RANGE_ERR_186_oRDR_DETECTION_185_188_oPCAN_RADAR_ddd30ade_Tx: ComBitPosition=152, ComBitSize=7, ComSignalInitValue=0, ComSignalType=UINT8, ComHandleId=3939, ComSystemTemplateSystemSignalRef=DET_RANGE_ERR_186
            DET_RANGE_VELOCITY_188_oRDR_DETECTION_185_188_oPCAN_RADAR_b6fd3440_Tx: ComBitPosition=384, ComBitSize=15, ComSignalInitValue=16384, ComSignalType=UINT16, ComHandleId=3945, ComSystemTemplateSystemSignalRef=DET_RANGE_VELOCITY_188
            DET_EXISTENCE_PROB_188_oRDR_DETECTION_185_188_oPCAN_RADAR_57d5b7c7_Tx: ComBitPosition=448, ComBitSize=6, ComSignalInitValue=0, ComSignalType=UINT8, ComHandleId=3914, ComSystemTemplateSystemSignalRef=DET_EXISTENCE_PROB_188
            DET_HVC_FLAG_185_oRDR_DETECTION_185_188_oPCAN_RADAR_6b21c994_Tx: ComBitPosition=86, ComBitSize=1, ComSignalInitValue=0, ComSignalType=BOOLEAN, ComHandleId=3915, ComSystemTemplateSystemSignalRef=DET_HVC_FLAG_185
            DET_RCS_187_oRDR_DETECTION_185_188_oPCAN_RADAR_1d6d915d_Tx: ComBitPosition=352, ComBitSize=8, ComSignalInitValue=128, ComSignalType=UINT8, ComHandleId=3952, ComSystemTemplateSystemSignalRef=DET_RCS_187
            DET_ELEVATION_188_oRDR_DETECTION_185_188_oPCAN_RADAR_02735ad2_Tx: ComBitPosition=408, ComBitSize=8, ComSignalInitValue=0, ComSignalType=UINT8, ComHandleId=3906, ComSystemTemplateSystemSignalRef=DET_ELEVATION_188
            DET_EXISTENCE_PROB_186_oRDR_DETECTION_185_188_oPCAN_RADAR_eeb5f115_Tx: ComBitPosition=224, ComBitSize=6, ComSignalInitValue=0, ComSignalType=UINT8, ComHandleId=3912, ComSystemTemplateSystemSignalRef=DET_EXISTENCE_PROB_186
            DET_SNR_185_oRDR_DETECTION_185_188_oPCAN_RADAR_31536a34_Tx: ComBitPosition=120, ComBitSize=8, ComSignalInitValue=0, ComSignalType=UINT8, ComHandleId=3954, ComSystemTemplateSystemSignalRef=DET_SNR_185
            DET_RANGE_ERR_188_oRDR_DETECTION_185_188_oPCAN_RADAR_64b34c0c_Tx: ComBitPosition=376, ComBitSize=7, ComSignalInitValue=0, ComSignalType=UINT8, ComHandleId=3941, ComSystemTemplateSystemSignalRef=DET_RANGE_ERR_188
            DET_RANGE_VELOCITY_187_oRDR_DETECTION_185_188_oPCAN_RADAR_9aeda607_Tx: ComBitPosition=272, ComBitSize=15, ComSignalInitValue=16384, ComSignalType=UINT16, ComHandleId=3944, ComSystemTemplateSystemSignalRef=DET_RANGE_VELOCITY_187
            DET_RANGE_186_oRDR_DETECTION_185_188_oPCAN_RADAR_7a3bb0b7_Tx: ComBitPosition=136, ComBitSize=15, ComSignalInitValue=0, ComSignalType=UINT16, ComHandleId=3935, ComSystemTemplateSystemSignalRef=DET_RANGE_186
            DET_RANGE_ERR_185_oRDR_DETECTION_185_188_oPCAN_RADAR_b9337120_Tx: ComBitPosition=40, ComBitSize=7, ComSignalInitValue=0, ComSignalType=UINT8, ComHandleId=3938, ComSystemTemplateSystemSignalRef=DET_RANGE_ERR_185
            DET_AZIMUTH_187_oRDR_DETECTION_185_188_oPCAN_RADAR_ffd01799_Tx: ComBitPosition=312, ComBitSize=13, ComSignalInitValue=0, ComSignalType=UINT16, ComHandleId=3881, ComSystemTemplateSystemSignalRef=DET_AZIMUTH_187
            DET_CONFD_ELEVATION_188_oRDR_DETECTION_185_188_oPCAN_RADAR_d3b38eee_Tx: ComBitPosition=437, ComBitSize=2, ComSignalInitValue=0, ComSignalType=UINT8, ComHandleId=3902, ComSystemTemplateSystemSignalRef=DET_CONFD_ELEVATION_188
            DET_IDM_188_oRDR_DETECTION_185_188_oPCAN_RADAR_3df3cf05_Tx: ComBitPosition=399, ComBitSize=1, ComSignalInitValue=0, ComSignalType=UINT8, ComHandleId=3922, ComSystemTemplateSystemSignalRef=DET_IDM_188
            DET_PROB_1STAZHYPO_187_oRDR_DETECTION_185_188_oPCAN_RADAR_e4e48754_Tx: ComBitPosition=327, ComBitSize=1, ComSignalInitValue=0, ComSignalType=BOOLEAN, ComHandleId=3932, ComSystemTemplateSystemSignalRef=DET_PROB_1STAZHYPO_187
            DET_MTD_187_oRDR_DETECTION_185_188_oPCAN_RADAR_77506f99_Tx: ComBitPosition=271, ComBitSize=1, ComSignalInitValue=0, ComSignalType=UINT8, ComHandleId=3928, ComSystemTemplateSystemSignalRef=DET_MTD_187
            DET_IDM_187_oRDR_DETECTION_185_188_oPCAN_RADAR_11e35d42_Tx: ComBitPosition=287, ComBitSize=1, ComSignalInitValue=0, ComSignalType=UINT8, ComHandleId=3921, ComSystemTemplateSystemSignalRef=DET_IDM_187
            DET_MTD_185_oRDR_DETECTION_185_188_oPCAN_RADAR_86c0c0f2_Tx: ComBitPosition=47, ComBitSize=1, ComSignalInitValue=0, ComSignalType=UINT8, ComHandleId=3926, ComSystemTemplateSystemSignalRef=DET_MTD_185
            DET_PROB_1STAZHYPO_188_oRDR_DETECTION_185_188_oPCAN_RADAR_c8f41513_Tx: ComBitPosition=439, ComBitSize=1, ComSignalInitValue=0, ComSignalType=BOOLEAN, ComHandleId=3933, ComSystemTemplateSystemSignalRef=DET_PROB_1STAZHYPO_188
            DET_IDM_186_oRDR_DETECTION_185_188_oPCAN_RADAR_849389d7_Tx: ComBitPosition=175, ComBitSize=1, ComSignalInitValue=0, ComSignalType=UINT8, ComHandleId=3920, ComSystemTemplateSystemSignalRef=DET_IDM_186
            DET_BELOW_RAIN_THOLD_188_oRDR_DETECTION_185_188_oPCAN_RADAR_06c1161e_Tx: ComBitPosition=375, ComBitSize=1, ComSignalInitValue=0, ComSignalType=UINT8, ComHandleId=3890, ComSystemTemplateSystemSignalRef=DET_BELOW_RAIN_THOLD_188
            DET_BELOW_RAIN_THOLD_186_oRDR_DETECTION_185_188_oPCAN_RADAR_bfa150cc_Tx: ComBitPosition=151, ComBitSize=1, ComSignalInitValue=0, ComSignalType=UINT8, ComHandleId=3888, ComSystemTemplateSystemSignalRef=DET_BELOW_RAIN_THOLD_186
            DET_MTD_186_oRDR_DETECTION_185_188_oPCAN_RADAR_e220bb0c_Tx: ComBitPosition=159, ComBitSize=1, ComSignalInitValue=0, ComSignalType=UINT8, ComHandleId=3927, ComSystemTemplateSystemSignalRef=DET_MTD_186
            DET_MTD_188_oRDR_DETECTION_185_188_oPCAN_RADAR_5b40fdde_Tx: ComBitPosition=383, ComBitSize=1, ComSignalInitValue=0, ComSignalType=UINT8, ComHandleId=3929, ComSystemTemplateSystemSignalRef=DET_MTD_188
            DET_PROB_1STAZHYPO_186_oRDR_DETECTION_185_188_oPCAN_RADAR_719453c1_Tx: ComBitPosition=215, ComBitSize=1, ComSignalInitValue=0, ComSignalType=BOOLEAN, ComHandleId=3931, ComSystemTemplateSystemSignalRef=DET_PROB_1STAZHYPO_186
            DET_BELOW_RAIN_THOLD_185_oRDR_DETECTION_185_188_oPCAN_RADAR_db412b32_Tx: ComBitPosition=39, ComBitSize=1, ComSignalInitValue=0, ComSignalType=UINT8, ComHandleId=3887, ComSystemTemplateSystemSignalRef=DET_BELOW_RAIN_THOLD_185
            DET_PROB_1STAZHYPO_185_oRDR_DETECTION_185_188_oPCAN_RADAR_1574283f_Tx: ComBitPosition=103, ComBitSize=1, ComSignalInitValue=0, ComSignalType=BOOLEAN, ComHandleId=3930, ComSystemTemplateSystemSignalRef=DET_PROB_1STAZHYPO_185
            DET_BELOW_RAIN_THOLD_187_oRDR_DETECTION_185_188_oPCAN_RADAR_2ad18459_Tx: ComBitPosition=263, ComBitSize=1, ComSignalInitValue=0, ComSignalType=UINT8, ComHandleId=3889, ComSystemTemplateSystemSignalRef=DET_BELOW_RAIN_THOLD_187
            DET_IDM_185_oRDR_DETECTION_185_188_oPCAN_RADAR_e073f229_Tx: ComBitPosition=63, ComBitSize=1, ComSignalInitValue=0, ComSignalType=UINT8, ComHandleId=3919, ComSystemTemplateSystemSignalRef=DET_IDM_185
        SG_Detections_101_104_oRDR_DETECTION_101_104_oPCAN_RADAR_9de0b719_Tx: ComTransferProperty=TRIGGERED, ComHandleId=27, ComSystemTemplateSignalGroupRef=SG_Detections_101_104
          83 x ComGroupSignal, all with ComSignalEndianness=LITTLE_ENDIAN, ComTransferProperty=PENDING, ComSignalAccess=ACCESS_NEEDED_BY_SWC_OR_COM:
            DET_MH_SCAN_INDEX_4LSB_101_104_oRDR_DETECTION_101_104_oPCAN_RADAR_5137e1a9_Tx: ComBitPosition=476, ComBitSize=4, ComSignalInitValue=0, ComSignalType=UINT8, ComHandleId=2182, ComSystemTemplateSystemSignalRef=DET_MH_SCAN_INDEX_4LSB_101_104
            DET_RANGE_VELOCITY_102_oRDR_DETECTION_101_104_oPCAN_RADAR_26d1a975_Tx: ComBitPosition=160, ComBitSize=15, ComSignalInitValue=16384, ComSignalType=UINT16, ComHandleId=2200, ComSystemTemplateSystemSignalRef=DET_RANGE_VELOCITY_102
            DET_CONFD_AZIMUTH_101_oRDR_DETECTION_101_104_oPCAN_RADAR_25ea69df_Tx: ComBitPosition=118, ComBitSize=2, ComSignalInitValue=0, ComSignalType=UINT8, ComHandleId=2152, ComSystemTemplateSystemSignalRef=DET_CONFD_AZIMUTH_101
            DET_CONFD_ELEVATION_103_oRDR_DETECTION_101_104_oPCAN_RADAR_d6efc74e_Tx: ComBitPosition=325, ComBitSize=2, ComSignalInitValue=0, ComSignalType=UINT8, ComHandleId=2158, ComSystemTemplateSystemSignalRef=DET_CONFD_ELEVATION_103
            DET_BI_STATIC_FLAG_102_oRDR_DETECTION_101_104_oPCAN_RADAR_15c0586e_Tx: ComBitPosition=216, ComBitSize=1, ComSignalInitValue=0, ComSignalType=BOOLEAN, ComHandleId=2149, ComSystemTemplateSystemSignalRef=DET_BI_STATIC_FLAG_102
            DET_RANGE_ERR_103_oRDR_DETECTION_101_104_oPCAN_RADAR_61ef05ac_Tx: ComBitPosition=264, ComBitSize=7, ComSignalInitValue=0, ComSignalType=UINT8, ComHandleId=2197, ComSystemTemplateSystemSignalRef=DET_RANGE_ERR_103
            DET_EXISTENCE_PROB_104_oRDR_DETECTION_101_104_oPCAN_RADAR_0e39dd0e_Tx: ComBitPosition=448, ComBitSize=6, ComSignalInitValue=0, ComSignalType=UINT8, ComHandleId=2171, ComSystemTemplateSystemSignalRef=DET_EXISTENCE_PROB_104
            DET_HVC_FLAG_103_oRDR_DETECTION_101_104_oPCAN_RADAR_b3fdbd18_Tx: ComBitPosition=310, ComBitSize=1, ComSignalInitValue=0, ComSignalType=BOOLEAN, ComHandleId=2174, ComSystemTemplateSystemSignalRef=DET_HVC_FLAG_103
            DET_RANGE_ERR_101_oRDR_DETECTION_101_104_oPCAN_RADAR_907faac7_Tx: ComBitPosition=40, ComBitSize=7, ComSignalInitValue=0, ComSignalType=UINT8, ComHandleId=2195, ComSystemTemplateSystemSignalRef=DET_RANGE_ERR_101
            DET_SNR_104_oRDR_DETECTION_101_104_oPCAN_RADAR_b53f3dd1_Tx: ComBitPosition=456, ComBitSize=8, ComSignalInitValue=0, ComSignalType=UINT8, ComHandleId=2214, ComSystemTemplateSystemSignalRef=DET_SNR_104
            DET_BI_STATIC_FLAG_103_oRDR_DETECTION_101_104_oPCAN_RADAR_80b08cfb_Tx: ComBitPosition=328, ComBitSize=1, ComSignalInitValue=0, ComSignalType=BOOLEAN, ComHandleId=2150, ComSystemTemplateSystemSignalRef=DET_BI_STATIC_FLAG_103
            DET_RANGE_101_oRDR_DETECTION_101_104_oPCAN_RADAR_379710ae_Tx: ComBitPosition=24, ComBitSize=15, ComSignalInitValue=0, ComSignalType=UINT16, ComHandleId=2191, ComSystemTemplateSystemSignalRef=DET_RANGE_101
            DET_SNR_102_oRDR_DETECTION_101_104_oPCAN_RADAR_7cffca2d_Tx: ComBitPosition=232, ComBitSize=8, ComSignalInitValue=0, ComSignalType=UINT8, ComHandleId=2212, ComSystemTemplateSystemSignalRef=DET_SNR_102
            DET_ELEVATION_103_oRDR_DETECTION_101_104_oPCAN_RADAR_072f1372_Tx: ComBitPosition=296, ComBitSize=8, ComSignalInitValue=0, ComSignalType=UINT8, ComHandleId=2162, ComSystemTemplateSystemSignalRef=DET_ELEVATION_103
            DET_RANGE_ERR_102_oRDR_DETECTION_101_104_oPCAN_RADAR_f49fd139_Tx: ComBitPosition=152, ComBitSize=7, ComSignalInitValue=0, ComSignalType=UINT8, ComHandleId=2196, ComSystemTemplateSystemSignalRef=DET_RANGE_ERR_102
            DET_RCS_101_oRDR_DETECTION_101_104_oPCAN_RADAR_c5b1e5d1_Tx: ComBitPosition=128, ComBitSize=8, ComSignalInitValue=128, ComSignalType=UINT8, ComHandleId=2207, ComSystemTemplateSystemSignalRef=DET_RCS_101
            DET_EXISTENCE_PROB_103_oRDR_DETECTION_101_104_oPCAN_RADAR_5289fe67_Tx: ComBitPosition=336, ComBitSize=6, ComSignalInitValue=0, ComSignalType=UINT8, ComHandleId=2170, ComSystemTemplateSystemSignalRef=DET_EXISTENCE_PROB_103
            DET_MH_CRC16_101_104_oRDR_DETECTION_101_104_oPCAN_RADAR_19686512_Tx: ComBitPosition=0, ComBitSize=16, ComSignalInitValue=0, ComSignalType=UINT16, ComHandleId=2180, ComSystemTemplateSystemSignalRef=DET_MH_CRC16_101_104
            DET_SNR_103_oRDR_DETECTION_101_104_oPCAN_RADAR_e98f1eb8_Tx: ComBitPosition=344, ComBitSize=8, ComSignalInitValue=0, ComSignalType=UINT8, ComHandleId=2213, ComSystemTemplateSystemSignalRef=DET_SNR_103
            DET_CONFD_ELEVATION_101_oRDR_DETECTION_101_104_oPCAN_RADAR_277f6825_Tx: ComBitPosition=101, ComBitSize=2, ComSignalInitValue=0, ComSignalType=UINT8, ComHandleId=2156, ComSystemTemplateSystemSignalRef=DET_CONFD_ELEVATION_101
            DET_BI_STATIC_FLAG_104_oRDR_DETECTION_101_104_oPCAN_RADAR_dc00af92_Tx: ComBitPosition=440, ComBitSize=1, ComSignalInitValue=0, ComSignalType=BOOLEAN, ComHandleId=2151, ComSystemTemplateSystemSignalRef=DET_BI_STATIC_FLAG_104
            DET_SUPER_RES_TARGET_101_oRDR_DETECTION_101_104_oPCAN_RADAR_298699b6_Tx: ComBitPosition=87, ComBitSize=1, ComSignalInitValue=0, ComSignalType=BOOLEAN, ComHandleId=2215, ComSystemTemplateSystemSignalRef=DET_SUPER_RES_TARGET_101
            DET_ELEVATION_102_oRDR_DETECTION_101_104_oPCAN_RADAR_925fc7e7_Tx: ComBitPosition=184, ComBitSize=8, ComSignalInitValue=0, ComSignalType=UINT8, ComHandleId=2161, ComSystemTemplateSystemSignalRef=DET_ELEVATION_102
            DET_SUPER_RES_TARGET_102_oRDR_DETECTION_101_104_oPCAN_RADAR_4d66e248_Tx: ComBitPosition=199, ComBitSize=1, ComSignalInitValue=0, ComSignalType=BOOLEAN, ComHandleId=2216, ComSystemTemplateSystemSignalRef=DET_SUPER_RES_TARGET_102
            DET_AZIMUTH_102_oRDR_DETECTION_101_104_oPCAN_RADAR_43ec18eb_Tx: ComBitPosition=200, ComBitSize=13, ComSignalInitValue=0, ComSignalType=UINT16, ComHandleId=2137, ComSystemTemplateSystemSignalRef=DET_AZIMUTH_102
            DET_RCS_103_oRDR_DETECTION_101_104_oPCAN_RADAR_34214aba_Tx: ComBitPosition=352, ComBitSize=8, ComSignalInitValue=128, ComSignalType=UINT8, ComHandleId=2209, ComSystemTemplateSystemSignalRef=DET_RCS_103
            DET_CONFD_AZIMUTH_102_oRDR_DETECTION_101_104_oPCAN_RADAR_410a1221_Tx: ComBitPosition=230, ComBitSize=2, ComSignalInitValue=0, ComSignalType=UINT8, ComHandleId=2153, ComSystemTemplateSystemSignalRef=DET_CONFD_AZIMUTH_102
            DET_AZIMUTH_ERR_102_oRDR_DETECTION_101_104_oPCAN_RADAR_e7598d1e_Tx: ComBitPosition=217, ComBitSize=7, ComSignalInitValue=0, ComSignalType=UINT8, ComHandleId=2141, ComSystemTemplateSystemSignalRef=DET_AZIMUTH_ERR_102
            DET_RANGE_VELOCITY_ERR_104_oRDR_DETECTION_101_104_oPCAN_RADAR_e0aaa53b_Tx: ComBitPosition=400, ComBitSize=8, ComSignalInitValue=0, ComSignalType=UINT8, ComHandleId=2206, ComSystemTemplateSystemSignalRef=DET_RANGE_VELOCITY_ERR_104
            DET_AZIMUTH_ERR_101_oRDR_DETECTION_101_104_oPCAN_RADAR_83b9f6e0_Tx: ComBitPosition=105, ComBitSize=7, ComSignalInitValue=0, ComSignalType=UINT8, ComHandleId=2140, ComSystemTemplateSystemSignalRef=DET_AZIMUTH_ERR_101
            DET_RANGE_104_oRDR_DETECTION_101_104_oPCAN_RADAR_9ab79cac_Tx: ComBitPosition=360, ComBitSize=15, ComSignalInitValue=0, ComSignalType=UINT16, ComHandleId=2194, ComSystemTemplateSystemSignalRef=DET_RANGE_104
            DET_AZIMUTH_ERR_104_oRDR_DETECTION_101_104_oPCAN_RADAR_2e997ae2_Tx: ComBitPosition=441, ComBitSize=7, ComSignalInitValue=0, ComSignalType=UINT8, ComHandleId=2143, ComSystemTemplateSystemSignalRef=DET_AZIMUTH_ERR_104
            DET_MH_CYCLE_COUNTER_101_104_oRDR_DETECTION_101_104_oPCAN_RADAR_9d1dc425_Tx: ComBitPosition=16, ComBitSize=8, ComSignalInitValue=0, ComSignalType=UINT8, ComHandleId=2181, ComSystemTemplateSystemSignalRef=DET_MH_CYCLE_COUNTER_101_104
            DET_ELEVATION_ERR_102_oRDR_DETECTION_101_104_oPCAN_RADAR_15665f92_Tx: ComBitPosition=192, ComBitSize=6, ComSignalInitValue=0, ComSignalType=UINT8, ComHandleId=2165, ComSystemTemplateSystemSignalRef=DET_ELEVATION_ERR_102
            DET_BI_STATIC_FLAG_101_oRDR_DETECTION_101_104_oPCAN_RADAR_71202390_Tx: ComBitPosition=104, ComBitSize=1, ComSignalInitValue=0, ComSignalType=BOOLEAN, ComHandleId=2148, ComSystemTemplateSystemSignalRef=DET_BI_STATIC_FLAG_101
            DET_RANGE_ERR_104_oRDR_DETECTION_101_104_oPCAN_RADAR_3d5f26c5_Tx: ComBitPosition=376, ComBitSize=7, ComSignalInitValue=0, ComSignalType=UINT8, ComHandleId=2198, ComSystemTemplateSystemSignalRef=DET_RANGE_ERR_104
            DET_RANGE_VELOCITY_ERR_103_oRDR_DETECTION_101_104_oPCAN_RADAR_bc1a8652_Tx: ComBitPosition=288, ComBitSize=8, ComSignalInitValue=0, ComSignalType=UINT8, ComHandleId=2205, ComSystemTemplateSystemSignalRef=DET_RANGE_VELOCITY_ERR_103
            DET_CONFD_ELEVATION_104_oRDR_DETECTION_101_104_oPCAN_RADAR_8a5fe427_Tx: ComBitPosition=437, ComBitSize=2, ComSignalInitValue=0, ComSignalType=UINT8, ComHandleId=2159, ComSystemTemplateSystemSignalRef=DET_CONFD_ELEVATION_104
            DET_EXISTENCE_PROB_102_oRDR_DETECTION_101_104_oPCAN_RADAR_c7f92af2_Tx: ComBitPosition=224, ComBitSize=6, ComSignalInitValue=0, ComSignalType=UINT8, ComHandleId=2169, ComSystemTemplateSystemSignalRef=DET_EXISTENCE_PROB_102
            DET_AZIMUTH_101_oRDR_DETECTION_101_104_oPCAN_RADAR_270c6315_Tx: ComBitPosition=88, ComBitSize=13, ComSignalInitValue=0, ComSignalType=UINT16, ComHandleId=2136, ComSystemTemplateSystemSignalRef=DET_AZIMUTH_101
            DET_RANGE_103_oRDR_DETECTION_101_104_oPCAN_RADAR_c607bfc5_Tx: ComBitPosition=248, ComBitSize=15, ComSignalInitValue=0, ComSignalType=UINT16, ComHandleId=2193, ComSystemTemplateSystemSignalRef=DET_RANGE_103
            DET_RANGE_VELOCITY_ERR_101_oRDR_DETECTION_101_104_oPCAN_RADAR_4d8a2939_Tx: ComBitPosition=64, ComBitSize=8, ComSignalInitValue=0, ComSignalType=UINT8, ComHandleId=2203, ComSystemTemplateSystemSignalRef=DET_RANGE_VELOCITY_ERR_101
            DET_RANGE_VELOCITY_ERR_102_oRDR_DETECTION_101_104_oPCAN_RADAR_296a52c7_Tx: ComBitPosition=176, ComBitSize=8, ComSignalInitValue=0, ComSignalType=UINT8, ComHandleId=2204, ComSystemTemplateSystemSignalRef=DET_RANGE_VELOCITY_ERR_102
            DET_CONFD_AZIMUTH_103_oRDR_DETECTION_101_104_oPCAN_RADAR_d47ac6b4_Tx: ComBitPosition=342, ComBitSize=2, ComSignalInitValue=0, ComSignalType=UINT8, ComHandleId=2154, ComSystemTemplateSystemSignalRef=DET_CONFD_AZIMUTH_103
            DET_HVC_FLAG_102_oRDR_DETECTION_101_104_oPCAN_RADAR_268d698d_Tx: ComBitPosition=198, ComBitSize=1, ComSignalInitValue=0, ComSignalType=BOOLEAN, ComHandleId=2173, ComSystemTemplateSystemSignalRef=DET_HVC_FLAG_102
            DET_CONFD_AZIMUTH_104_oRDR_DETECTION_101_104_oPCAN_RADAR_88cae5dd_Tx: ComBitPosition=454, ComBitSize=2, ComSignalInitValue=0, ComSignalType=UINT8, ComHandleId=2155, ComSystemTemplateSystemSignalRef=DET_CONFD_AZIMUTH_104
            DET_SNR_101_oRDR_DETECTION_101_104_oPCAN_RADAR_181fb1d3_Tx: ComBitPosition=120, ComBitSize=8, ComSignalInitValue=0, ComSignalType=UINT8, ComHandleId=2211, ComSystemTemplateSystemSignalRef=DET_SNR_101
            DET_HVC_FLAG_101_oRDR_DETECTION_101_104_oPCAN_RADAR_426d1273_Tx: ComBitPosition=86, ComBitSize=1, ComSignalInitValue=0, ComSignalType=BOOLEAN, ComHandleId=2172, ComSystemTemplateSystemSignalRef=DET_HVC_FLAG_101
            DET_AZIMUTH_104_oRDR_DETECTION_101_104_oPCAN_RADAR_8a2cef17_Tx: ComBitPosition=424, ComBitSize=13, ComSignalInitValue=0, ComSignalType=UINT16, ComHandleId=2139, ComSystemTemplateSystemSignalRef=DET_AZIMUTH_104
            DET_EXISTENCE_PROB_101_oRDR_DETECTION_101_104_oPCAN_RADAR_a319510c_Tx: ComBitPosition=112, ComBitSize=6, ComSignalInitValue=0, ComSignalType=UINT8, ComHandleId=2168, ComSystemTemplateSystemSignalRef=DET_EXISTENCE_PROB_101
            DET_ELEVATION_ERR_104_oRDR_DETECTION_101_104_oPCAN_RADAR_dca6a86e_Tx: ComBitPosition=416, ComBitSize=6, ComSignalInitValue=0, ComSignalType=UINT8, ComHandleId=2167, ComSystemTemplateSystemSignalRef=DET_ELEVATION_ERR_104
            DET_RCS_104_oRDR_DETECTION_101_104_oPCAN_RADAR_689169d3_Tx: ComBitPosition=464, ComBitSize=8, ComSignalInitValue=128, ComSignalType=UINT8, ComHandleId=2210, ComSystemTemplateSystemSignalRef=DET_RCS_104
            DET_RCS_102_oRDR_DETECTION_101_104_oPCAN_RADAR_a1519e2f_Tx: ComBitPosition=240, ComBitSize=8, ComSignalInitValue=128, ComSignalType=UINT8, ComHandleId=2208, ComSystemTemplateSystemSignalRef=DET_RCS_102
            DET_ELEVATION_ERR_101_oRDR_DETECTION_101_104_oPCAN_RADAR_7186246c_Tx: ComBitPosition=80, ComBitSize=6, ComSignalInitValue=0, ComSignalType=UINT8, ComHandleId=2164, ComSystemTemplateSystemSignalRef=DET_ELEVATION_ERR_101
            DET_RANGE_VELOCITY_104_oRDR_DETECTION_101_104_oPCAN_RADAR_ef115e89_Tx: ComBitPosition=384, ComBitSize=15, ComSignalInitValue=16384, ComSignalType=UINT16, ComHandleId=2202, ComSystemTemplateSystemSignalRef=DET_RANGE_VELOCITY_104
            DET_SUPER_RES_TARGET_104_oRDR_DETECTION_101_104_oPCAN_RADAR_84a615b4_Tx: ComBitPosition=423, ComBitSize=1, ComSignalInitValue=0, ComSignalType=BOOLEAN, ComHandleId=2218, ComSystemTemplateSystemSignalRef=DET_SUPER_RES_TARGET_104
            DET_RANGE_VELOCITY_103_oRDR_DETECTION_101_104_oPCAN_RADAR_b3a17de0_Tx: ComBitPosition=272, ComBitSize=15, ComSignalInitValue=16384, ComSignalType=UINT16, ComHandleId=2201, ComSystemTemplateSystemSignalRef=DET_RANGE_VELOCITY_103
            DET_RANGE_VELOCITY_101_oRDR_DETECTION_101_104_oPCAN_RADAR_4231d28b_Tx: ComBitPosition=48, ComBitSize=15, ComSignalInitValue=16384, ComSignalType=UINT16, ComHandleId=2199, ComSystemTemplateSystemSignalRef=DET_RANGE_VELOCITY_101
            DET_AZIMUTH_103_oRDR_DETECTION_101_104_oPCAN_RADAR_d69ccc7e_Tx: ComBitPosition=312, ComBitSize=13, ComSignalInitValue=0, ComSignalType=UINT16, ComHandleId=2138, ComSystemTemplateSystemSignalRef=DET_AZIMUTH_103
            DET_ELEVATION_ERR_103_oRDR_DETECTION_101_104_oPCAN_RADAR_80168b07_Tx: ComBitPosition=304, ComBitSize=6, ComSignalInitValue=0, ComSignalType=UINT8, ComHandleId=2166, ComSystemTemplateSystemSignalRef=DET_ELEVATION_ERR_103
            DET_RANGE_102_oRDR_DETECTION_101_104_oPCAN_RADAR_53776b50_Tx: ComBitPosition=136, ComBitSize=15, ComSignalInitValue=0, ComSignalType=UINT16, ComHandleId=2192, ComSystemTemplateSystemSignalRef=DET_RANGE_102
            DET_SUPER_RES_TARGET_103_oRDR_DETECTION_101_104_oPCAN_RADAR_d81636dd_Tx: ComBitPosition=311, ComBitSize=1, ComSignalInitValue=0, ComSignalType=BOOLEAN, ComHandleId=2217, ComSystemTemplateSystemSignalRef=DET_SUPER_RES_TARGET_103
            DET_AZIMUTH_ERR_103_oRDR_DETECTION_101_104_oPCAN_RADAR_7229598b_Tx: ComBitPosition=329, ComBitSize=7, ComSignalInitValue=0, ComSignalType=UINT8, ComHandleId=2142, ComSystemTemplateSystemSignalRef=DET_AZIMUTH_ERR_103
            DET_ELEVATION_104_oRDR_DETECTION_101_104_oPCAN_RADAR_5b9f301b_Tx: ComBitPosition=408, ComBitSize=8, ComSignalInitValue=0, ComSignalType=UINT8, ComHandleId=2163, ComSystemTemplateSystemSignalRef=DET_ELEVATION_104
            DET_HVC_FLAG_104_oRDR_DETECTION_101_104_oPCAN_RADAR_ef4d9e71_Tx: ComBitPosition=422, ComBitSize=1, ComSignalInitValue=0, ComSignalType=BOOLEAN, ComHandleId=2175, ComSystemTemplateSystemSignalRef=DET_HVC_FLAG_104
            DET_CONFD_ELEVATION_102_oRDR_DETECTION_101_104_oPCAN_RADAR_439f13db_Tx: ComBitPosition=213, ComBitSize=2, ComSignalInitValue=0, ComSignalType=UINT8, ComHandleId=2157, ComSystemTemplateSystemSignalRef=DET_CONFD_ELEVATION_102
            DET_ELEVATION_101_oRDR_DETECTION_101_104_oPCAN_RADAR_f6bfbc19_Tx: ComBitPosition=72, ComBitSize=8, ComSignalInitValue=0, ComSignalType=UINT8, ComHandleId=2160, ComSystemTemplateSystemSignalRef=DET_ELEVATION_101
            DET_PROB_1STAZHYPO_103_oRDR_DETECTION_101_104_oPCAN_RADAR_cda85cb3_Tx: ComBitPosition=327, ComBitSize=1, ComSignalInitValue=0, ComSignalType=BOOLEAN, ComHandleId=2189, ComSystemTemplateSystemSignalRef=DET_PROB_1STAZHYPO_103
            DET_PROB_1STAZHYPO_101_oRDR_DETECTION_101_104_oPCAN_RADAR_3c38f3d8_Tx: ComBitPosition=103, ComBitSize=1, ComSignalInitValue=0, ComSignalType=BOOLEAN, ComHandleId=2187, ComSystemTemplateSystemSignalRef=DET_PROB_1STAZHYPO_101
            DET_IDM_101_oRDR_DETECTION_101_104_oPCAN_RADAR_c93f29ce_Tx: ComBitPosition=63, ComBitSize=1, ComSignalInitValue=0, ComSignalType=UINT8, ComHandleId=2176, ComSystemTemplateSystemSignalRef=DET_IDM_101
            DET_IDM_103_oRDR_DETECTION_101_104_oPCAN_RADAR_38af86a5_Tx: ComBitPosition=287, ComBitSize=1, ComSignalInitValue=0, ComSignalType=UINT8, ComHandleId=2178, ComSystemTemplateSystemSignalRef=DET_IDM_103
            DET_PROB_1STAZHYPO_104_oRDR_DETECTION_101_104_oPCAN_RADAR_91187fda_Tx: ComBitPosition=439, ComBitSize=1, ComSignalInitValue=0, ComSignalType=BOOLEAN, ComHandleId=2190, ComSystemTemplateSystemSignalRef=DET_PROB_1STAZHYPO_104
            DET_BELOW_RAIN_THOLD_101_oRDR_DETECTION_101_104_oPCAN_RADAR_f20df0d5_Tx: ComBitPosition=39, ComBitSize=1, ComSignalInitValue=0, ComSignalType=UINT8, ComHandleId=2144, ComSystemTemplateSystemSignalRef=DET_BELOW_RAIN_THOLD_101
            DET_BELOW_RAIN_THOLD_102_oRDR_DETECTION_101_104_oPCAN_RADAR_96ed8b2b_Tx: ComBitPosition=151, ComBitSize=1, ComSignalInitValue=0, ComSignalType=UINT8, ComHandleId=2145, ComSystemTemplateSystemSignalRef=DET_BELOW_RAIN_THOLD_102
            DET_IDM_102_oRDR_DETECTION_101_104_oPCAN_RADAR_addf5230_Tx: ComBitPosition=175, ComBitSize=1, ComSignalInitValue=0, ComSignalType=UINT8, ComHandleId=2177, ComSystemTemplateSystemSignalRef=DET_IDM_102
            DET_MTD_103_oRDR_DETECTION_101_104_oPCAN_RADAR_5e1cb47e_Tx: ComBitPosition=271, ComBitSize=1, ComSignalInitValue=0, ComSignalType=UINT8, ComHandleId=2185, ComSystemTemplateSystemSignalRef=DET_MTD_103
            DET_MTD_102_oRDR_DETECTION_101_104_oPCAN_RADAR_cb6c60eb_Tx: ComBitPosition=159, ComBitSize=1, ComSignalInitValue=0, ComSignalType=UINT8, ComHandleId=2184, ComSystemTemplateSystemSignalRef=DET_MTD_102
            DET_MTD_101_oRDR_DETECTION_101_104_oPCAN_RADAR_af8c1b15_Tx: ComBitPosition=47, ComBitSize=1, ComSignalInitValue=0, ComSignalType=UINT8, ComHandleId=2183, ComSystemTemplateSystemSignalRef=DET_MTD_101
            DET_PROB_1STAZHYPO_102_oRDR_DETECTION_101_104_oPCAN_RADAR_58d88826_Tx: ComBitPosition=215, ComBitSize=1, ComSignalInitValue=0, ComSignalType=BOOLEAN, ComHandleId=2188, ComSystemTemplateSystemSignalRef=DET_PROB_1STAZHYPO_102
            DET_BELOW_RAIN_THOLD_103_oRDR_DETECTION_101_104_oPCAN_RADAR_039d5fbe_Tx: ComBitPosition=263, ComBitSize=1, ComSignalInitValue=0, ComSignalType=UINT8, ComHandleId=2146, ComSystemTemplateSystemSignalRef=DET_BELOW_RAIN_THOLD_103
            DET_MTD_104_oRDR_DETECTION_101_104_oPCAN_RADAR_02ac9717_Tx: ComBitPosition=383, ComBitSize=1, ComSignalInitValue=0, ComSignalType=UINT8, ComHandleId=2186, ComSystemTemplateSystemSignalRef=DET_MTD_104
            DET_BELOW_RAIN_THOLD_104_oRDR_DETECTION_101_104_oPCAN_RADAR_5f2d7cd7_Tx: ComBitPosition=375, ComBitSize=1, ComSignalInitValue=0, ComSignalType=UINT8, ComHandleId=2147, ComSystemTemplateSystemSignalRef=DET_BELOW_RAIN_THOLD_104
            DET_IDM_104_oRDR_DETECTION_101_104_oPCAN_RADAR_641fa5cc_Tx: ComBitPosition=399, ComBitSize=1, ComSignalInitValue=0, ComSignalType=UINT8, ComHandleId=2179, ComSystemTemplateSystemSignalRef=DET_IDM_104
        SG_Detections_309_312_oRDR_DETECTION_309_312_oPCAN_RADAR_f009e248_Tx: ComTransferProperty=TRIGGERED, ComHandleId=79, ComSystemTemplateSignalGroupRef=SG_Detections_309_312
          83 x ComGroupSignal, all with ComSignalEndianness=LITTLE_ENDIAN, ComTransferProperty=PENDING, ComSignalAccess=ACCESS_NEEDED_BY_SWC_OR_COM:
            DET_RANGE_VELOCITY_ERR_310_oRDR_DETECTION_309_312_oPCAN_RADAR_9fa2d163_Tx: ComBitPosition=176, ComBitSize=8, ComSignalInitValue=0, ComSignalType=UINT8, ComHandleId=6520, ComSystemTemplateSystemSignalRef=DET_RANGE_VELOCITY_ERR_310
            DET_SNR_309_oRDR_DETECTION_309_312_oPCAN_RADAR_af173b2d_Tx: ComBitPosition=120, ComBitSize=8, ComSignalInitValue=0, ComSignalType=UINT8, ComHandleId=6527, ComSystemTemplateSystemSignalRef=DET_SNR_309
            DET_EXISTENCE_PROB_312_oRDR_DETECTION_309_312_oPCAN_RADAR_80a1063d_Tx: ComBitPosition=448, ComBitSize=6, ComSignalInitValue=0, ComSignalType=UINT8, ComHandleId=6487, ComSystemTemplateSystemSignalRef=DET_EXISTENCE_PROB_312
            DET_RANGE_310_oRDR_DETECTION_309_312_oPCAN_RADAR_e5bfe8f4_Tx: ComBitPosition=136, ComBitSize=15, ComSignalInitValue=0, ComSignalType=UINT16, ComHandleId=6508, ComSystemTemplateSystemSignalRef=DET_RANGE_310
            DET_RANGE_VELOCITY_310_oRDR_DETECTION_309_312_oPCAN_RADAR_90192ad1_Tx: ComBitPosition=160, ComBitSize=15, ComSignalInitValue=16384, ComSignalType=UINT16, ComHandleId=6516, ComSystemTemplateSystemSignalRef=DET_RANGE_VELOCITY_310
            DET_RCS_312_oRDR_DETECTION_309_312_oPCAN_RADAR_e609b2e0_Tx: ComBitPosition=464, ComBitSize=8, ComSignalInitValue=128, ComSignalType=UINT8, ComHandleId=6526, ComSystemTemplateSystemSignalRef=DET_RCS_312
            DET_AZIMUTH_ERR_310_oRDR_DETECTION_309_312_oPCAN_RADAR_51910eba_Tx: ComBitPosition=217, ComBitSize=7, ComSignalInitValue=0, ComSignalType=UINT8, ComHandleId=6457, ComSystemTemplateSystemSignalRef=DET_AZIMUTH_ERR_310
            DET_HVC_FLAG_309_oRDR_DETECTION_309_312_oPCAN_RADAR_f565988d_Tx: ComBitPosition=86, ComBitSize=1, ComSignalInitValue=0, ComSignalType=BOOLEAN, ComHandleId=6488, ComSystemTemplateSystemSignalRef=DET_HVC_FLAG_309
            DET_RANGE_311_oRDR_DETECTION_309_312_oPCAN_RADAR_70cf3c61_Tx: ComBitPosition=248, ComBitSize=15, ComSignalInitValue=0, ComSignalType=UINT16, ComHandleId=6509, ComSystemTemplateSystemSignalRef=DET_RANGE_311
            DET_BI_STATIC_FLAG_309_oRDR_DETECTION_309_312_oPCAN_RADAR_c628a96e_Tx: ComBitPosition=104, ComBitSize=1, ComSignalInitValue=0, ComSignalType=BOOLEAN, ComHandleId=6464, ComSystemTemplateSystemSignalRef=DET_BI_STATIC_FLAG_309
            DET_AZIMUTH_311_oRDR_DETECTION_309_312_oPCAN_RADAR_60544fda_Tx: ComBitPosition=312, ComBitSize=13, ComSignalInitValue=0, ComSignalType=UINT16, ComHandleId=6454, ComSystemTemplateSystemSignalRef=DET_AZIMUTH_311
            DET_RANGE_VELOCITY_309_oRDR_DETECTION_309_312_oPCAN_RADAR_f5395875_Tx: ComBitPosition=48, ComBitSize=15, ComSignalInitValue=16384, ComSignalType=UINT16, ComHandleId=6515, ComSystemTemplateSystemSignalRef=DET_RANGE_VELOCITY_309
            DET_CONFD_AZIMUTH_311_oRDR_DETECTION_309_312_oPCAN_RADAR_62b24510_Tx: ComBitPosition=342, ComBitSize=2, ComSignalInitValue=0, ComSignalType=UINT8, ComHandleId=6470, ComSystemTemplateSystemSignalRef=DET_CONFD_AZIMUTH_311
            DET_RANGE_ERR_310_oRDR_DETECTION_309_312_oPCAN_RADAR_4257529d_Tx: ComBitPosition=152, ComBitSize=7, ComSignalInitValue=0, ComSignalType=UINT8, ComHandleId=6512, ComSystemTemplateSystemSignalRef=DET_RANGE_ERR_310
            DET_MH_SCAN_INDEX_4LSB_309_312_oRDR_DETECTION_309_312_oPCAN_RADAR_3cdeb4f8_Tx: ComBitPosition=476, ComBitSize=4, ComSignalInitValue=0, ComSignalType=UINT8, ComHandleId=6498, ComSystemTemplateSystemSignalRef=DET_MH_SCAN_INDEX_4LSB_309_312
            DET_EXISTENCE_PROB_310_oRDR_DETECTION_309_312_oPCAN_RADAR_7131a956_Tx: ComBitPosition=224, ComBitSize=6, ComSignalInitValue=0, ComSignalType=UINT8, ComHandleId=6485, ComSystemTemplateSystemSignalRef=DET_EXISTENCE_PROB_310
            DET_ELEVATION_312_oRDR_DETECTION_309_312_oPCAN_RADAR_d507eb28_Tx: ComBitPosition=408, ComBitSize=8, ComSignalInitValue=0, ComSignalType=UINT8, ComHandleId=6479, ComSystemTemplateSystemSignalRef=DET_ELEVATION_312
            DET_RCS_309_oRDR_DETECTION_309_312_oPCAN_RADAR_72b96f2f_Tx: ComBitPosition=128, ComBitSize=8, ComSignalInitValue=128, ComSignalType=UINT8, ComHandleId=6523, ComSystemTemplateSystemSignalRef=DET_RCS_309
            DET_HVC_FLAG_310_oRDR_DETECTION_309_312_oPCAN_RADAR_9045ea29_Tx: ComBitPosition=198, ComBitSize=1, ComSignalInitValue=0, ComSignalType=BOOLEAN, ComHandleId=6489, ComSystemTemplateSystemSignalRef=DET_HVC_FLAG_310
            DET_ELEVATION_309_oRDR_DETECTION_309_312_oPCAN_RADAR_41b736e7_Tx: ComBitPosition=72, ComBitSize=8, ComSignalInitValue=0, ComSignalType=UINT8, ComHandleId=6476, ComSystemTemplateSystemSignalRef=DET_ELEVATION_309
            DET_CONFD_AZIMUTH_309_oRDR_DETECTION_309_312_oPCAN_RADAR_92e2e321_Tx: ComBitPosition=118, ComBitSize=2, ComSignalInitValue=0, ComSignalType=UINT8, ComHandleId=6468, ComSystemTemplateSystemSignalRef=DET_CONFD_AZIMUTH_309
            DET_AZIMUTH_ERR_309_oRDR_DETECTION_309_312_oPCAN_RADAR_34b17c1e_Tx: ComBitPosition=105, ComBitSize=7, ComSignalInitValue=0, ComSignalType=UINT8, ComHandleId=6456, ComSystemTemplateSystemSignalRef=DET_AZIMUTH_ERR_309
            DET_AZIMUTH_309_oRDR_DETECTION_309_312_oPCAN_RADAR_9004e9eb_Tx: ComBitPosition=88, ComBitSize=13, ComSignalInitValue=0, ComSignalType=UINT16, ComHandleId=6452, ComSystemTemplateSystemSignalRef=DET_AZIMUTH_309
            DET_RANGE_VELOCITY_ERR_312_oRDR_DETECTION_309_312_oPCAN_RADAR_6e327e08_Tx: ComBitPosition=400, ComBitSize=8, ComSignalInitValue=0, ComSignalType=UINT8, ComHandleId=6522, ComSystemTemplateSystemSignalRef=DET_RANGE_VELOCITY_ERR_312
            DET_AZIMUTH_310_oRDR_DETECTION_309_312_oPCAN_RADAR_f5249b4f_Tx: ComBitPosition=200, ComBitSize=13, ComSignalInitValue=0, ComSignalType=UINT16, ComHandleId=6453, ComSystemTemplateSystemSignalRef=DET_AZIMUTH_310
            DET_RANGE_ERR_309_oRDR_DETECTION_309_312_oPCAN_RADAR_27772039_Tx: ComBitPosition=40, ComBitSize=7, ComSignalInitValue=0, ComSignalType=UINT8, ComHandleId=6511, ComSystemTemplateSystemSignalRef=DET_RANGE_ERR_309
            DET_SUPER_RES_TARGET_309_oRDR_DETECTION_309_312_oPCAN_RADAR_9e8e1348_Tx: ComBitPosition=87, ComBitSize=1, ComSignalInitValue=0, ComSignalType=BOOLEAN, ComHandleId=6531, ComSystemTemplateSystemSignalRef=DET_SUPER_RES_TARGET_309
            DET_RCS_310_oRDR_DETECTION_309_312_oPCAN_RADAR_17991d8b_Tx: ComBitPosition=240, ComBitSize=8, ComSignalInitValue=128, ComSignalType=UINT8, ComHandleId=6524, ComSystemTemplateSystemSignalRef=DET_RCS_310
            DET_SUPER_RES_TARGET_312_oRDR_DETECTION_309_312_oPCAN_RADAR_0a3ece87_Tx: ComBitPosition=423, ComBitSize=1, ComSignalInitValue=0, ComSignalType=BOOLEAN, ComHandleId=6534, ComSystemTemplateSystemSignalRef=DET_SUPER_RES_TARGET_312
            DET_AZIMUTH_ERR_312_oRDR_DETECTION_309_312_oPCAN_RADAR_a001a1d1_Tx: ComBitPosition=441, ComBitSize=7, ComSignalInitValue=0, ComSignalType=UINT8, ComHandleId=6459, ComSystemTemplateSystemSignalRef=DET_AZIMUTH_ERR_312
            DET_RANGE_VELOCITY_ERR_309_oRDR_DETECTION_309_312_oPCAN_RADAR_fa82a3c7_Tx: ComBitPosition=64, ComBitSize=8, ComSignalInitValue=0, ComSignalType=UINT8, ComHandleId=6519, ComSystemTemplateSystemSignalRef=DET_RANGE_VELOCITY_ERR_309
            DET_SNR_310_oRDR_DETECTION_309_312_oPCAN_RADAR_ca374989_Tx: ComBitPosition=232, ComBitSize=8, ComSignalInitValue=0, ComSignalType=UINT8, ComHandleId=6528, ComSystemTemplateSystemSignalRef=DET_SNR_310
            DET_ELEVATION_ERR_312_oRDR_DETECTION_309_312_oPCAN_RADAR_523e735d_Tx: ComBitPosition=416, ComBitSize=6, ComSignalInitValue=0, ComSignalType=UINT8, ComHandleId=6483, ComSystemTemplateSystemSignalRef=DET_ELEVATION_ERR_312
            DET_RANGE_VELOCITY_311_oRDR_DETECTION_309_312_oPCAN_RADAR_0569fe44_Tx: ComBitPosition=272, ComBitSize=15, ComSignalInitValue=16384, ComSignalType=UINT16, ComHandleId=6517, ComSystemTemplateSystemSignalRef=DET_RANGE_VELOCITY_311
            DET_SUPER_RES_TARGET_311_oRDR_DETECTION_309_312_oPCAN_RADAR_6edeb579_Tx: ComBitPosition=311, ComBitSize=1, ComSignalInitValue=0, ComSignalType=BOOLEAN, ComHandleId=6533, ComSystemTemplateSystemSignalRef=DET_SUPER_RES_TARGET_311
            DET_CONFD_ELEVATION_310_oRDR_DETECTION_309_312_oPCAN_RADAR_f557907f_Tx: ComBitPosition=213, ComBitSize=2, ComSignalInitValue=0, ComSignalType=UINT8, ComHandleId=6473, ComSystemTemplateSystemSignalRef=DET_CONFD_ELEVATION_310
            DET_HVC_FLAG_312_oRDR_DETECTION_309_312_oPCAN_RADAR_61d54542_Tx: ComBitPosition=422, ComBitSize=1, ComSignalInitValue=0, ComSignalType=BOOLEAN, ComHandleId=6491, ComSystemTemplateSystemSignalRef=DET_HVC_FLAG_312
            DET_BI_STATIC_FLAG_312_oRDR_DETECTION_309_312_oPCAN_RADAR_529874a1_Tx: ComBitPosition=440, ComBitSize=1, ComSignalInitValue=0, ComSignalType=BOOLEAN, ComHandleId=6467, ComSystemTemplateSystemSignalRef=DET_BI_STATIC_FLAG_312
            DET_SNR_312_oRDR_DETECTION_309_312_oPCAN_RADAR_3ba7e6e2_Tx: ComBitPosition=456, ComBitSize=8, ComSignalInitValue=0, ComSignalType=UINT8, ComHandleId=6530, ComSystemTemplateSystemSignalRef=DET_SNR_312
            DET_ELEVATION_310_oRDR_DETECTION_309_312_oPCAN_RADAR_24974443_Tx: ComBitPosition=184, ComBitSize=8, ComSignalInitValue=0, ComSignalType=UINT8, ComHandleId=6477, ComSystemTemplateSystemSignalRef=DET_ELEVATION_310
            DET_RANGE_VELOCITY_312_oRDR_DETECTION_309_312_oPCAN_RADAR_618985ba_Tx: ComBitPosition=384, ComBitSize=15, ComSignalInitValue=16384, ComSignalType=UINT16, ComHandleId=6518, ComSystemTemplateSystemSignalRef=DET_RANGE_VELOCITY_312
            DET_RANGE_VELOCITY_ERR_311_oRDR_DETECTION_309_312_oPCAN_RADAR_0ad205f6_Tx: ComBitPosition=288, ComBitSize=8, ComSignalInitValue=0, ComSignalType=UINT8, ComHandleId=6521, ComSystemTemplateSystemSignalRef=DET_RANGE_VELOCITY_ERR_311
            DET_CONFD_AZIMUTH_310_oRDR_DETECTION_309_312_oPCAN_RADAR_f7c29185_Tx: ComBitPosition=230, ComBitSize=2, ComSignalInitValue=0, ComSignalType=UINT8, ComHandleId=6469, ComSystemTemplateSystemSignalRef=DET_CONFD_AZIMUTH_310
            DET_ELEVATION_ERR_311_oRDR_DETECTION_309_312_oPCAN_RADAR_36de08a3_Tx: ComBitPosition=304, ComBitSize=6, ComSignalInitValue=0, ComSignalType=UINT8, ComHandleId=6482, ComSystemTemplateSystemSignalRef=DET_ELEVATION_ERR_311
            DET_CONFD_ELEVATION_309_oRDR_DETECTION_309_312_oPCAN_RADAR_9077e2db_Tx: ComBitPosition=101, ComBitSize=2, ComSignalInitValue=0, ComSignalType=UINT8, ComHandleId=6472, ComSystemTemplateSystemSignalRef=DET_CONFD_ELEVATION_309
            DET_ELEVATION_ERR_310_oRDR_DETECTION_309_312_oPCAN_RADAR_a3aedc36_Tx: ComBitPosition=192, ComBitSize=6, ComSignalInitValue=0, ComSignalType=UINT8, ComHandleId=6481, ComSystemTemplateSystemSignalRef=DET_ELEVATION_ERR_310
            DET_RANGE_ERR_311_oRDR_DETECTION_309_312_oPCAN_RADAR_d7278608_Tx: ComBitPosition=264, ComBitSize=7, ComSignalInitValue=0, ComSignalType=UINT8, ComHandleId=6513, ComSystemTemplateSystemSignalRef=DET_RANGE_ERR_311
            DET_CONFD_ELEVATION_311_oRDR_DETECTION_309_312_oPCAN_RADAR_602744ea_Tx: ComBitPosition=325, ComBitSize=2, ComSignalInitValue=0, ComSignalType=UINT8, ComHandleId=6474, ComSystemTemplateSystemSignalRef=DET_CONFD_ELEVATION_311
            DET_BI_STATIC_FLAG_310_oRDR_DETECTION_309_312_oPCAN_RADAR_a308dbca_Tx: ComBitPosition=216, ComBitSize=1, ComSignalInitValue=0, ComSignalType=BOOLEAN, ComHandleId=6465, ComSystemTemplateSystemSignalRef=DET_BI_STATIC_FLAG_310
            DET_BI_STATIC_FLAG_311_oRDR_DETECTION_309_312_oPCAN_RADAR_36780f5f_Tx: ComBitPosition=328, ComBitSize=1, ComSignalInitValue=0, ComSignalType=BOOLEAN, ComHandleId=6466, ComSystemTemplateSystemSignalRef=DET_BI_STATIC_FLAG_311
            DET_RANGE_312_oRDR_DETECTION_309_312_oPCAN_RADAR_142f479f_Tx: ComBitPosition=360, ComBitSize=15, ComSignalInitValue=0, ComSignalType=UINT16, ComHandleId=6510, ComSystemTemplateSystemSignalRef=DET_RANGE_312
            DET_RCS_311_oRDR_DETECTION_309_312_oPCAN_RADAR_82e9c91e_Tx: ComBitPosition=352, ComBitSize=8, ComSignalInitValue=128, ComSignalType=UINT8, ComHandleId=6525, ComSystemTemplateSystemSignalRef=DET_RCS_311
            DET_HVC_FLAG_311_oRDR_DETECTION_309_312_oPCAN_RADAR_05353ebc_Tx: ComBitPosition=310, ComBitSize=1, ComSignalInitValue=0, ComSignalType=BOOLEAN, ComHandleId=6490, ComSystemTemplateSystemSignalRef=DET_HVC_FLAG_311
            DET_CONFD_AZIMUTH_312_oRDR_DETECTION_309_312_oPCAN_RADAR_06523eee_Tx: ComBitPosition=454, ComBitSize=2, ComSignalInitValue=0, ComSignalType=UINT8, ComHandleId=6471, ComSystemTemplateSystemSignalRef=DET_CONFD_AZIMUTH_312
            DET_EXISTENCE_PROB_309_oRDR_DETECTION_309_312_oPCAN_RADAR_1411dbf2_Tx: ComBitPosition=112, ComBitSize=6, ComSignalInitValue=0, ComSignalType=UINT8, ComHandleId=6484, ComSystemTemplateSystemSignalRef=DET_EXISTENCE_PROB_309
            DET_RANGE_309_oRDR_DETECTION_309_312_oPCAN_RADAR_809f9a50_Tx: ComBitPosition=24, ComBitSize=15, ComSignalInitValue=0, ComSignalType=UINT16, ComHandleId=6507, ComSystemTemplateSystemSignalRef=DET_RANGE_309
            DET_EXISTENCE_PROB_311_oRDR_DETECTION_309_312_oPCAN_RADAR_e4417dc3_Tx: ComBitPosition=336, ComBitSize=6, ComSignalInitValue=0, ComSignalType=UINT8, ComHandleId=6486, ComSystemTemplateSystemSignalRef=DET_EXISTENCE_PROB_311
            DET_MH_CRC16_309_312_oRDR_DETECTION_309_312_oPCAN_RADAR_74813043_Tx: ComBitPosition=0, ComBitSize=16, ComSignalInitValue=0, ComSignalType=UINT16, ComHandleId=6496, ComSystemTemplateSystemSignalRef=DET_MH_CRC16_309_312
            DET_AZIMUTH_ERR_311_oRDR_DETECTION_309_312_oPCAN_RADAR_c4e1da2f_Tx: ComBitPosition=329, ComBitSize=7, ComSignalInitValue=0, ComSignalType=UINT8, ComHandleId=6458, ComSystemTemplateSystemSignalRef=DET_AZIMUTH_ERR_311
            DET_SNR_311_oRDR_DETECTION_309_312_oPCAN_RADAR_5f479d1c_Tx: ComBitPosition=344, ComBitSize=8, ComSignalInitValue=0, ComSignalType=UINT8, ComHandleId=6529, ComSystemTemplateSystemSignalRef=DET_SNR_311
            DET_SUPER_RES_TARGET_310_oRDR_DETECTION_309_312_oPCAN_RADAR_fbae61ec_Tx: ComBitPosition=199, ComBitSize=1, ComSignalInitValue=0, ComSignalType=BOOLEAN, ComHandleId=6532, ComSystemTemplateSystemSignalRef=DET_SUPER_RES_TARGET_310
            DET_AZIMUTH_312_oRDR_DETECTION_309_312_oPCAN_RADAR_04b43424_Tx: ComBitPosition=424, ComBitSize=13, ComSignalInitValue=0, ComSignalType=UINT16, ComHandleId=6455, ComSystemTemplateSystemSignalRef=DET_AZIMUTH_312
            DET_ELEVATION_ERR_309_oRDR_DETECTION_309_312_oPCAN_RADAR_c68eae92_Tx: ComBitPosition=80, ComBitSize=6, ComSignalInitValue=0, ComSignalType=UINT8, ComHandleId=6480, ComSystemTemplateSystemSignalRef=DET_ELEVATION_ERR_309
            DET_CONFD_ELEVATION_312_oRDR_DETECTION_309_312_oPCAN_RADAR_04c73f14_Tx: ComBitPosition=437, ComBitSize=2, ComSignalInitValue=0, ComSignalType=UINT8, ComHandleId=6475, ComSystemTemplateSystemSignalRef=DET_CONFD_ELEVATION_312
            DET_MH_CYCLE_COUNTER_309_312_oRDR_DETECTION_309_312_oPCAN_RADAR_f0f49174_Tx: ComBitPosition=16, ComBitSize=8, ComSignalInitValue=0, ComSignalType=UINT8, ComHandleId=6497, ComSystemTemplateSystemSignalRef=DET_MH_CYCLE_COUNTER_309_312
            DET_RANGE_ERR_312_oRDR_DETECTION_309_312_oPCAN_RADAR_b3c7fdf6_Tx: ComBitPosition=376, ComBitSize=7, ComSignalInitValue=0, ComSignalType=UINT8, ComHandleId=6514, ComSystemTemplateSystemSignalRef=DET_RANGE_ERR_312
            DET_ELEVATION_311_oRDR_DETECTION_309_312_oPCAN_RADAR_b1e790d6_Tx: ComBitPosition=296, ComBitSize=8, ComSignalInitValue=0, ComSignalType=UINT8, ComHandleId=6478, ComSystemTemplateSystemSignalRef=DET_ELEVATION_311
            DET_PROB_1STAZHYPO_309_oRDR_DETECTION_309_312_oPCAN_RADAR_8b307926_Tx: ComBitPosition=103, ComBitSize=1, ComSignalInitValue=0, ComSignalType=BOOLEAN, ComHandleId=6503, ComSystemTemplateSystemSignalRef=DET_PROB_1STAZHYPO_309
            DET_BELOW_RAIN_THOLD_312_oRDR_DETECTION_309_312_oPCAN_RADAR_d1b5a7e4_Tx: ComBitPosition=375, ComBitSize=1, ComSignalInitValue=0, ComSignalType=UINT8, ComHandleId=6463, ComSystemTemplateSystemSignalRef=DET_BELOW_RAIN_THOLD_312
            DET_BELOW_RAIN_THOLD_311_oRDR_DETECTION_309_312_oPCAN_RADAR_b555dc1a_Tx: ComBitPosition=263, ComBitSize=1, ComSignalInitValue=0, ComSignalType=UINT8, ComHandleId=6462, ComSystemTemplateSystemSignalRef=DET_BELOW_RAIN_THOLD_311
            DET_IDM_312_oRDR_DETECTION_309_312_oPCAN_RADAR_ea877eff_Tx: ComBitPosition=399, ComBitSize=1, ComSignalInitValue=0, ComSignalType=UINT8, ComHandleId=6495, ComSystemTemplateSystemSignalRef=DET_IDM_312
            DET_IDM_311_oRDR_DETECTION_309_312_oPCAN_RADAR_8e670501_Tx: ComBitPosition=287, ComBitSize=1, ComSignalInitValue=0, ComSignalType=UINT8, ComHandleId=6494, ComSystemTemplateSystemSignalRef=DET_IDM_311
            DET_BELOW_RAIN_THOLD_310_oRDR_DETECTION_309_312_oPCAN_RADAR_2025088f_Tx: ComBitPosition=151, ComBitSize=1, ComSignalInitValue=0, ComSignalType=UINT8, ComHandleId=6461, ComSystemTemplateSystemSignalRef=DET_BELOW_RAIN_THOLD_310
            DET_IDM_309_oRDR_DETECTION_309_312_oPCAN_RADAR_7e37a330_Tx: ComBitPosition=63, ComBitSize=1, ComSignalInitValue=0, ComSignalType=UINT8, ComHandleId=6492, ComSystemTemplateSystemSignalRef=DET_IDM_309
            DET_MTD_312_oRDR_DETECTION_309_312_oPCAN_RADAR_8c344c24_Tx: ComBitPosition=383, ComBitSize=1, ComSignalInitValue=0, ComSignalType=UINT8, ComHandleId=6502, ComSystemTemplateSystemSignalRef=DET_MTD_312
            DET_MTD_309_oRDR_DETECTION_309_312_oPCAN_RADAR_188491eb_Tx: ComBitPosition=47, ComBitSize=1, ComSignalInitValue=0, ComSignalType=UINT8, ComHandleId=6499, ComSystemTemplateSystemSignalRef=DET_MTD_309
            DET_MTD_310_oRDR_DETECTION_309_312_oPCAN_RADAR_7da4e34f_Tx: ComBitPosition=159, ComBitSize=1, ComSignalInitValue=0, ComSignalType=UINT8, ComHandleId=6500, ComSystemTemplateSystemSignalRef=DET_MTD_310
            DET_PROB_1STAZHYPO_310_oRDR_DETECTION_309_312_oPCAN_RADAR_ee100b82_Tx: ComBitPosition=215, ComBitSize=1, ComSignalInitValue=0, ComSignalType=BOOLEAN, ComHandleId=6504, ComSystemTemplateSystemSignalRef=DET_PROB_1STAZHYPO_310
            DET_PROB_1STAZHYPO_312_oRDR_DETECTION_309_312_oPCAN_RADAR_1f80a4e9_Tx: ComBitPosition=439, ComBitSize=1, ComSignalInitValue=0, ComSignalType=BOOLEAN, ComHandleId=6506, ComSystemTemplateSystemSignalRef=DET_PROB_1STAZHYPO_312
            DET_PROB_1STAZHYPO_311_oRDR_DETECTION_309_312_oPCAN_RADAR_7b60df17_Tx: ComBitPosition=327, ComBitSize=1, ComSignalInitValue=0, ComSignalType=BOOLEAN, ComHandleId=6505, ComSystemTemplateSystemSignalRef=DET_PROB_1STAZHYPO_311
            DET_MTD_311_oRDR_DETECTION_309_312_oPCAN_RADAR_e8d437da_Tx: ComBitPosition=271, ComBitSize=1, ComSignalInitValue=0, ComSignalType=UINT8, ComHandleId=6501, ComSystemTemplateSystemSignalRef=DET_MTD_311
            DET_BELOW_RAIN_THOLD_309_oRDR_DETECTION_309_312_oPCAN_RADAR_45057a2b_Tx: ComBitPosition=39, ComBitSize=1, ComSignalInitValue=0, ComSignalType=UINT8, ComHandleId=6460, ComSystemTemplateSystemSignalRef=DET_BELOW_RAIN_THOLD_309
            DET_IDM_310_oRDR_DETECTION_309_312_oPCAN_RADAR_1b17d194_Tx: ComBitPosition=175, ComBitSize=1, ComSignalInitValue=0, ComSignalType=UINT8, ComHandleId=6493, ComSystemTemplateSystemSignalRef=DET_IDM_310
        SG_Detections_065_068_oRDR_DETECTION_065_068_oPCAN_RADAR_f1154101_Tx: ComTransferProperty=TRIGGERED, ComHandleId=18, ComSystemTemplateSignalGroupRef=SG_Detections_065_068
          83 x ComGroupSignal, all with ComSignalEndianness=LITTLE_ENDIAN, ComTransferProperty=PENDING, ComSignalAccess=ACCESS_NEEDED_BY_SWC_OR_COM:
            DET_HVC_FLAG_068_oRDR_DETECTION_065_068_oPCAN_RADAR_efe2c65d_Tx: ComBitPosition=422, ComBitSize=1, ComSignalInitValue=0, ComSignalType=BOOLEAN, ComHandleId=1428, ComSystemTemplateSystemSignalRef=DET_HVC_FLAG_068
            DET_SNR_065_oRDR_DETECTION_065_068_oPCAN_RADAR_681058d1_Tx: ComBitPosition=120, ComBitSize=8, ComSignalInitValue=0, ComSignalType=UINT8, ComHandleId=1464, ComSystemTemplateSystemSignalRef=DET_SNR_065
            DET_SNR_067_oRDR_DETECTION_065_068_oPCAN_RADAR_9980f7ba_Tx: ComBitPosition=344, ComBitSize=8, ComSignalInitValue=0, ComSignalType=UINT8, ComHandleId=1466, ComSystemTemplateSystemSignalRef=DET_SNR_067
            DET_RCS_066_oRDR_DETECTION_065_068_oPCAN_RADAR_d15e772d_Tx: ComBitPosition=240, ComBitSize=8, ComSignalInitValue=128, ComSignalType=UINT8, ComHandleId=1461, ComSystemTemplateSystemSignalRef=DET_RCS_066
            DET_SUPER_RES_TARGET_067_oRDR_DETECTION_065_068_oPCAN_RADAR_a819dfdf_Tx: ComBitPosition=311, ComBitSize=1, ComSignalInitValue=0, ComSignalType=BOOLEAN, ComHandleId=1470, ComSystemTemplateSystemSignalRef=DET_SUPER_RES_TARGET_067
            DET_AZIMUTH_ERR_065_oRDR_DETECTION_065_068_oPCAN_RADAR_f3b61fe2_Tx: ComBitPosition=105, ComBitSize=7, ComSignalInitValue=0, ComSignalType=UINT8, ComHandleId=1393, ComSystemTemplateSystemSignalRef=DET_AZIMUTH_ERR_065
            DET_BI_STATIC_FLAG_068_oRDR_DETECTION_065_068_oPCAN_RADAR_dcaff7be_Tx: ComBitPosition=440, ComBitSize=1, ComSignalInitValue=0, ComSignalType=BOOLEAN, ComHandleId=1404, ComSystemTemplateSystemSignalRef=DET_BI_STATIC_FLAG_068
            DET_EXISTENCE_PROB_068_oRDR_DETECTION_065_068_oPCAN_RADAR_0e968522_Tx: ComBitPosition=448, ComBitSize=6, ComSignalInitValue=0, ComSignalType=UINT8, ComHandleId=1424, ComSystemTemplateSystemSignalRef=DET_EXISTENCE_PROB_068
            DET_EXISTENCE_PROB_065_oRDR_DETECTION_065_068_oPCAN_RADAR_d316b80e_Tx: ComBitPosition=112, ComBitSize=6, ComSignalInitValue=0, ComSignalType=UINT8, ComHandleId=1421, ComSystemTemplateSystemSignalRef=DET_EXISTENCE_PROB_065
            DET_AZIMUTH_066_oRDR_DETECTION_065_068_oPCAN_RADAR_33e3f1e9_Tx: ComBitPosition=200, ComBitSize=13, ComSignalInitValue=0, ComSignalType=UINT16, ComHandleId=1390, ComSystemTemplateSystemSignalRef=DET_AZIMUTH_066
            DET_RANGE_067_oRDR_DETECTION_065_068_oPCAN_RADAR_b60856c7_Tx: ComBitPosition=248, ComBitSize=15, ComSignalInitValue=0, ComSignalType=UINT16, ComHandleId=1446, ComSystemTemplateSystemSignalRef=DET_RANGE_067
            DET_RANGE_VELOCITY_066_oRDR_DETECTION_065_068_oPCAN_RADAR_56de4077_Tx: ComBitPosition=160, ComBitSize=15, ComSignalInitValue=16384, ComSignalType=UINT16, ComHandleId=1453, ComSystemTemplateSystemSignalRef=DET_RANGE_VELOCITY_066
            DET_CONFD_AZIMUTH_067_oRDR_DETECTION_065_068_oPCAN_RADAR_a4752fb6_Tx: ComBitPosition=342, ComBitSize=2, ComSignalInitValue=0, ComSignalType=UINT8, ComHandleId=1407, ComSystemTemplateSystemSignalRef=DET_CONFD_AZIMUTH_067
            DET_ELEVATION_ERR_066_oRDR_DETECTION_065_068_oPCAN_RADAR_6569b690_Tx: ComBitPosition=192, ComBitSize=6, ComSignalInitValue=0, ComSignalType=UINT8, ComHandleId=1418, ComSystemTemplateSystemSignalRef=DET_ELEVATION_ERR_066
            DET_ELEVATION_ERR_067_oRDR_DETECTION_065_068_oPCAN_RADAR_f0196205_Tx: ComBitPosition=304, ComBitSize=6, ComSignalInitValue=0, ComSignalType=UINT8, ComHandleId=1419, ComSystemTemplateSystemSignalRef=DET_ELEVATION_ERR_067
            DET_RANGE_VELOCITY_068_oRDR_DETECTION_065_068_oPCAN_RADAR_efbe06a5_Tx: ComBitPosition=384, ComBitSize=15, ComSignalInitValue=16384, ComSignalType=UINT16, ComHandleId=1455, ComSystemTemplateSystemSignalRef=DET_RANGE_VELOCITY_068
            DET_RANGE_VELOCITY_ERR_065_oRDR_DETECTION_065_068_oPCAN_RADAR_3d85c03b_Tx: ComBitPosition=64, ComBitSize=8, ComSignalInitValue=0, ComSignalType=UINT8, ComHandleId=1456, ComSystemTemplateSystemSignalRef=DET_RANGE_VELOCITY_ERR_065
            DET_HVC_FLAG_065_oRDR_DETECTION_065_068_oPCAN_RADAR_3262fb71_Tx: ComBitPosition=86, ComBitSize=1, ComSignalInitValue=0, ComSignalType=BOOLEAN, ComHandleId=1425, ComSystemTemplateSystemSignalRef=DET_HVC_FLAG_065
            DET_SUPER_RES_TARGET_068_oRDR_DETECTION_065_068_oPCAN_RADAR_84094d98_Tx: ComBitPosition=423, ComBitSize=1, ComSignalInitValue=0, ComSignalType=BOOLEAN, ComHandleId=1471, ComSystemTemplateSystemSignalRef=DET_SUPER_RES_TARGET_068
            DET_HVC_FLAG_067_oRDR_DETECTION_065_068_oPCAN_RADAR_c3f2541a_Tx: ComBitPosition=310, ComBitSize=1, ComSignalInitValue=0, ComSignalType=BOOLEAN, ComHandleId=1427, ComSystemTemplateSystemSignalRef=DET_HVC_FLAG_067
            DET_ELEVATION_ERR_065_oRDR_DETECTION_065_068_oPCAN_RADAR_0189cd6e_Tx: ComBitPosition=80, ComBitSize=6, ComSignalInitValue=0, ComSignalType=UINT8, ComHandleId=1417, ComSystemTemplateSystemSignalRef=DET_ELEVATION_ERR_065
            DET_MH_CRC16_065_068_oRDR_DETECTION_065_068_oPCAN_RADAR_759d930a_Tx: ComBitPosition=0, ComBitSize=16, ComSignalInitValue=0, ComSignalType=UINT16, ComHandleId=1433, ComSystemTemplateSystemSignalRef=DET_MH_CRC16_065_068
            DET_SNR_068_oRDR_DETECTION_065_068_oPCAN_RADAR_b59065fd_Tx: ComBitPosition=456, ComBitSize=8, ComSignalInitValue=0, ComSignalType=UINT8, ComHandleId=1467, ComSystemTemplateSystemSignalRef=DET_SNR_068
            DET_CONFD_AZIMUTH_068_oRDR_DETECTION_065_068_oPCAN_RADAR_8865bdf1_Tx: ComBitPosition=454, ComBitSize=2, ComSignalInitValue=0, ComSignalType=UINT8, ComHandleId=1408, ComSystemTemplateSystemSignalRef=DET_CONFD_AZIMUTH_068
            DET_ELEVATION_067_oRDR_DETECTION_065_068_oPCAN_RADAR_7720fa70_Tx: ComBitPosition=296, ComBitSize=8, ComSignalInitValue=0, ComSignalType=UINT8, ComHandleId=1415, ComSystemTemplateSystemSignalRef=DET_ELEVATION_067
            DET_MH_CYCLE_COUNTER_065_068_oRDR_DETECTION_065_068_oPCAN_RADAR_f1e8323d_Tx: ComBitPosition=16, ComBitSize=8, ComSignalInitValue=0, ComSignalType=UINT8, ComHandleId=1434, ComSystemTemplateSystemSignalRef=DET_MH_CYCLE_COUNTER_065_068
            DET_CONFD_AZIMUTH_065_oRDR_DETECTION_065_068_oPCAN_RADAR_55e580dd_Tx: ComBitPosition=118, ComBitSize=2, ComSignalInitValue=0, ComSignalType=UINT8, ComHandleId=1405, ComSystemTemplateSystemSignalRef=DET_CONFD_AZIMUTH_065
            DET_RANGE_068_oRDR_DETECTION_065_068_oPCAN_RADAR_9a18c480_Tx: ComBitPosition=360, ComBitSize=15, ComSignalInitValue=0, ComSignalType=UINT16, ComHandleId=1447, ComSystemTemplateSystemSignalRef=DET_RANGE_068
            DET_BI_STATIC_FLAG_067_oRDR_DETECTION_065_068_oPCAN_RADAR_f0bf65f9_Tx: ComBitPosition=328, ComBitSize=1, ComSignalInitValue=0, ComSignalType=BOOLEAN, ComHandleId=1403, ComSystemTemplateSystemSignalRef=DET_BI_STATIC_FLAG_067
            DET_CONFD_AZIMUTH_066_oRDR_DETECTION_065_068_oPCAN_RADAR_3105fb23_Tx: ComBitPosition=230, ComBitSize=2, ComSignalInitValue=0, ComSignalType=UINT8, ComHandleId=1406, ComSystemTemplateSystemSignalRef=DET_CONFD_AZIMUTH_066
            DET_AZIMUTH_ERR_066_oRDR_DETECTION_065_068_oPCAN_RADAR_9756641c_Tx: ComBitPosition=217, ComBitSize=7, ComSignalInitValue=0, ComSignalType=UINT8, ComHandleId=1394, ComSystemTemplateSystemSignalRef=DET_AZIMUTH_ERR_066
            DET_RANGE_066_oRDR_DETECTION_065_068_oPCAN_RADAR_23788252_Tx: ComBitPosition=136, ComBitSize=15, ComSignalInitValue=0, ComSignalType=UINT16, ComHandleId=1445, ComSystemTemplateSystemSignalRef=DET_RANGE_066
            DET_SUPER_RES_TARGET_066_oRDR_DETECTION_065_068_oPCAN_RADAR_3d690b4a_Tx: ComBitPosition=199, ComBitSize=1, ComSignalInitValue=0, ComSignalType=BOOLEAN, ComHandleId=1469, ComSystemTemplateSystemSignalRef=DET_SUPER_RES_TARGET_066
            DET_BI_STATIC_FLAG_065_oRDR_DETECTION_065_068_oPCAN_RADAR_012fca92_Tx: ComBitPosition=104, ComBitSize=1, ComSignalInitValue=0, ComSignalType=BOOLEAN, ComHandleId=1401, ComSystemTemplateSystemSignalRef=DET_BI_STATIC_FLAG_065
            DET_EXISTENCE_PROB_066_oRDR_DETECTION_065_068_oPCAN_RADAR_b7f6c3f0_Tx: ComBitPosition=224, ComBitSize=6, ComSignalInitValue=0, ComSignalType=UINT8, ComHandleId=1422, ComSystemTemplateSystemSignalRef=DET_EXISTENCE_PROB_066
            DET_CONFD_ELEVATION_066_oRDR_DETECTION_065_068_oPCAN_RADAR_3390fad9_Tx: ComBitPosition=213, ComBitSize=2, ComSignalInitValue=0, ComSignalType=UINT8, ComHandleId=1410, ComSystemTemplateSystemSignalRef=DET_CONFD_ELEVATION_066
            DET_RANGE_VELOCITY_065_oRDR_DETECTION_065_068_oPCAN_RADAR_323e3b89_Tx: ComBitPosition=48, ComBitSize=15, ComSignalInitValue=16384, ComSignalType=UINT16, ComHandleId=1452, ComSystemTemplateSystemSignalRef=DET_RANGE_VELOCITY_065
            DET_SUPER_RES_TARGET_065_oRDR_DETECTION_065_068_oPCAN_RADAR_598970b4_Tx: ComBitPosition=87, ComBitSize=1, ComSignalInitValue=0, ComSignalType=BOOLEAN, ComHandleId=1468, ComSystemTemplateSystemSignalRef=DET_SUPER_RES_TARGET_065
            DET_RCS_065_oRDR_DETECTION_065_068_oPCAN_RADAR_b5be0cd3_Tx: ComBitPosition=128, ComBitSize=8, ComSignalInitValue=128, ComSignalType=UINT8, ComHandleId=1460, ComSystemTemplateSystemSignalRef=DET_RCS_065
            DET_AZIMUTH_067_oRDR_DETECTION_065_068_oPCAN_RADAR_a693257c_Tx: ComBitPosition=312, ComBitSize=13, ComSignalInitValue=0, ComSignalType=UINT16, ComHandleId=1391, ComSystemTemplateSystemSignalRef=DET_AZIMUTH_067
            DET_AZIMUTH_ERR_068_oRDR_DETECTION_065_068_oPCAN_RADAR_2e3622ce_Tx: ComBitPosition=441, ComBitSize=7, ComSignalInitValue=0, ComSignalType=UINT8, ComHandleId=1396, ComSystemTemplateSystemSignalRef=DET_AZIMUTH_ERR_068
            DET_EXISTENCE_PROB_067_oRDR_DETECTION_065_068_oPCAN_RADAR_22861765_Tx: ComBitPosition=336, ComBitSize=6, ComSignalInitValue=0, ComSignalType=UINT8, ComHandleId=1423, ComSystemTemplateSystemSignalRef=DET_EXISTENCE_PROB_067
            DET_SNR_066_oRDR_DETECTION_065_068_oPCAN_RADAR_0cf0232f_Tx: ComBitPosition=232, ComBitSize=8, ComSignalInitValue=0, ComSignalType=UINT8, ComHandleId=1465, ComSystemTemplateSystemSignalRef=DET_SNR_066
            DET_AZIMUTH_ERR_067_oRDR_DETECTION_065_068_oPCAN_RADAR_0226b089_Tx: ComBitPosition=329, ComBitSize=7, ComSignalInitValue=0, ComSignalType=UINT8, ComHandleId=1395, ComSystemTemplateSystemSignalRef=DET_AZIMUTH_ERR_067
            DET_RANGE_ERR_065_oRDR_DETECTION_065_068_oPCAN_RADAR_e07043c5_Tx: ComBitPosition=40, ComBitSize=7, ComSignalInitValue=0, ComSignalType=UINT8, ComHandleId=1448, ComSystemTemplateSystemSignalRef=DET_RANGE_ERR_065
            DET_RANGE_VELOCITY_ERR_068_oRDR_DETECTION_065_068_oPCAN_RADAR_e005fd17_Tx: ComBitPosition=400, ComBitSize=8, ComSignalInitValue=0, ComSignalType=UINT8, ComHandleId=1459, ComSystemTemplateSystemSignalRef=DET_RANGE_VELOCITY_ERR_068
            DET_RANGE_VELOCITY_ERR_067_oRDR_DETECTION_065_068_oPCAN_RADAR_cc156f50_Tx: ComBitPosition=288, ComBitSize=8, ComSignalInitValue=0, ComSignalType=UINT8, ComHandleId=1458, ComSystemTemplateSystemSignalRef=DET_RANGE_VELOCITY_ERR_067
            DET_MH_SCAN_INDEX_4LSB_065_068_oRDR_DETECTION_065_068_oPCAN_RADAR_3dc217b1_Tx: ComBitPosition=476, ComBitSize=4, ComSignalInitValue=0, ComSignalType=UINT8, ComHandleId=1435, ComSystemTemplateSystemSignalRef=DET_MH_SCAN_INDEX_4LSB_065_068
            DET_HVC_FLAG_066_oRDR_DETECTION_065_068_oPCAN_RADAR_5682808f_Tx: ComBitPosition=198, ComBitSize=1, ComSignalInitValue=0, ComSignalType=BOOLEAN, ComHandleId=1426, ComSystemTemplateSystemSignalRef=DET_HVC_FLAG_066
            DET_RANGE_065_oRDR_DETECTION_065_068_oPCAN_RADAR_4798f9ac_Tx: ComBitPosition=24, ComBitSize=15, ComSignalInitValue=0, ComSignalType=UINT16, ComHandleId=1444, ComSystemTemplateSystemSignalRef=DET_RANGE_065
            DET_CONFD_ELEVATION_065_oRDR_DETECTION_065_068_oPCAN_RADAR_57708127_Tx: ComBitPosition=101, ComBitSize=2, ComSignalInitValue=0, ComSignalType=UINT8, ComHandleId=1409, ComSystemTemplateSystemSignalRef=DET_CONFD_ELEVATION_065
            DET_AZIMUTH_068_oRDR_DETECTION_065_068_oPCAN_RADAR_8a83b73b_Tx: ComBitPosition=424, ComBitSize=13, ComSignalInitValue=0, ComSignalType=UINT16, ComHandleId=1392, ComSystemTemplateSystemSignalRef=DET_AZIMUTH_068
            DET_BI_STATIC_FLAG_066_oRDR_DETECTION_065_068_oPCAN_RADAR_65cfb16c_Tx: ComBitPosition=216, ComBitSize=1, ComSignalInitValue=0, ComSignalType=BOOLEAN, ComHandleId=1402, ComSystemTemplateSystemSignalRef=DET_BI_STATIC_FLAG_066
            DET_AZIMUTH_065_oRDR_DETECTION_065_068_oPCAN_RADAR_57038a17_Tx: ComBitPosition=88, ComBitSize=13, ComSignalInitValue=0, ComSignalType=UINT16, ComHandleId=1389, ComSystemTemplateSystemSignalRef=DET_AZIMUTH_065
            DET_RANGE_ERR_066_oRDR_DETECTION_065_068_oPCAN_RADAR_8490383b_Tx: ComBitPosition=152, ComBitSize=7, ComSignalInitValue=0, ComSignalType=UINT8, ComHandleId=1449, ComSystemTemplateSystemSignalRef=DET_RANGE_ERR_066
            DET_RCS_067_oRDR_DETECTION_065_068_oPCAN_RADAR_442ea3b8_Tx: ComBitPosition=352, ComBitSize=8, ComSignalInitValue=128, ComSignalType=UINT8, ComHandleId=1462, ComSystemTemplateSystemSignalRef=DET_RCS_067
            DET_RANGE_VELOCITY_067_oRDR_DETECTION_065_068_oPCAN_RADAR_c3ae94e2_Tx: ComBitPosition=272, ComBitSize=15, ComSignalInitValue=16384, ComSignalType=UINT16, ComHandleId=1454, ComSystemTemplateSystemSignalRef=DET_RANGE_VELOCITY_067
            DET_ELEVATION_ERR_068_oRDR_DETECTION_065_068_oPCAN_RADAR_dc09f042_Tx: ComBitPosition=416, ComBitSize=6, ComSignalInitValue=0, ComSignalType=UINT8, ComHandleId=1420, ComSystemTemplateSystemSignalRef=DET_ELEVATION_ERR_068
            DET_RANGE_ERR_068_oRDR_DETECTION_065_068_oPCAN_RADAR_3df07ee9_Tx: ComBitPosition=376, ComBitSize=7, ComSignalInitValue=0, ComSignalType=UINT8, ComHandleId=1451, ComSystemTemplateSystemSignalRef=DET_RANGE_ERR_068
            DET_RANGE_VELOCITY_ERR_066_oRDR_DETECTION_065_068_oPCAN_RADAR_5965bbc5_Tx: ComBitPosition=176, ComBitSize=8, ComSignalInitValue=0, ComSignalType=UINT8, ComHandleId=1457, ComSystemTemplateSystemSignalRef=DET_RANGE_VELOCITY_ERR_066
            DET_ELEVATION_065_oRDR_DETECTION_065_068_oPCAN_RADAR_86b0551b_Tx: ComBitPosition=72, ComBitSize=8, ComSignalInitValue=0, ComSignalType=UINT8, ComHandleId=1413, ComSystemTemplateSystemSignalRef=DET_ELEVATION_065
            DET_ELEVATION_066_oRDR_DETECTION_065_068_oPCAN_RADAR_e2502ee5_Tx: ComBitPosition=184, ComBitSize=8, ComSignalInitValue=0, ComSignalType=UINT8, ComHandleId=1414, ComSystemTemplateSystemSignalRef=DET_ELEVATION_066
            DET_RANGE_ERR_067_oRDR_DETECTION_065_068_oPCAN_RADAR_11e0ecae_Tx: ComBitPosition=264, ComBitSize=7, ComSignalInitValue=0, ComSignalType=UINT8, ComHandleId=1450, ComSystemTemplateSystemSignalRef=DET_RANGE_ERR_067
            DET_CONFD_ELEVATION_067_oRDR_DETECTION_065_068_oPCAN_RADAR_a6e02e4c_Tx: ComBitPosition=325, ComBitSize=2, ComSignalInitValue=0, ComSignalType=UINT8, ComHandleId=1411, ComSystemTemplateSystemSignalRef=DET_CONFD_ELEVATION_067
            DET_CONFD_ELEVATION_068_oRDR_DETECTION_065_068_oPCAN_RADAR_8af0bc0b_Tx: ComBitPosition=437, ComBitSize=2, ComSignalInitValue=0, ComSignalType=UINT8, ComHandleId=1412, ComSystemTemplateSystemSignalRef=DET_CONFD_ELEVATION_068
            DET_ELEVATION_068_oRDR_DETECTION_065_068_oPCAN_RADAR_5b306837_Tx: ComBitPosition=408, ComBitSize=8, ComSignalInitValue=0, ComSignalType=UINT8, ComHandleId=1416, ComSystemTemplateSystemSignalRef=DET_ELEVATION_068
            DET_RCS_068_oRDR_DETECTION_065_068_oPCAN_RADAR_683e31ff_Tx: ComBitPosition=464, ComBitSize=8, ComSignalInitValue=128, ComSignalType=UINT8, ComHandleId=1463, ComSystemTemplateSystemSignalRef=DET_RCS_068
            DET_MTD_068_oRDR_DETECTION_065_068_oPCAN_RADAR_0203cf3b_Tx: ComBitPosition=383, ComBitSize=1, ComSignalInitValue=0, ComSignalType=UINT8, ComHandleId=1439, ComSystemTemplateSystemSignalRef=DET_MTD_068
            DET_BELOW_RAIN_THOLD_066_oRDR_DETECTION_065_068_oPCAN_RADAR_e6e26229_Tx: ComBitPosition=151, ComBitSize=1, ComSignalInitValue=0, ComSignalType=UINT8, ComHandleId=1398, ComSystemTemplateSystemSignalRef=DET_BELOW_RAIN_THOLD_066
            DET_PROB_1STAZHYPO_067_oRDR_DETECTION_065_068_oPCAN_RADAR_bda7b5b1_Tx: ComBitPosition=327, ComBitSize=1, ComSignalInitValue=0, ComSignalType=BOOLEAN, ComHandleId=1442, ComSystemTemplateSystemSignalRef=DET_PROB_1STAZHYPO_067
            DET_MTD_065_oRDR_DETECTION_065_068_oPCAN_RADAR_df83f217_Tx: ComBitPosition=47, ComBitSize=1, ComSignalInitValue=0, ComSignalType=UINT8, ComHandleId=1436, ComSystemTemplateSystemSignalRef=DET_MTD_065
            DET_PROB_1STAZHYPO_065_oRDR_DETECTION_065_068_oPCAN_RADAR_4c371ada_Tx: ComBitPosition=103, ComBitSize=1, ComSignalInitValue=0, ComSignalType=BOOLEAN, ComHandleId=1440, ComSystemTemplateSystemSignalRef=DET_PROB_1STAZHYPO_065
            DET_PROB_1STAZHYPO_068_oRDR_DETECTION_065_068_oPCAN_RADAR_91b727f6_Tx: ComBitPosition=439, ComBitSize=1, ComSignalInitValue=0, ComSignalType=BOOLEAN, ComHandleId=1443, ComSystemTemplateSystemSignalRef=DET_PROB_1STAZHYPO_068
            DET_IDM_067_oRDR_DETECTION_065_068_oPCAN_RADAR_48a06fa7_Tx: ComBitPosition=287, ComBitSize=1, ComSignalInitValue=0, ComSignalType=UINT8, ComHandleId=1431, ComSystemTemplateSystemSignalRef=DET_IDM_067
            DET_BELOW_RAIN_THOLD_067_oRDR_DETECTION_065_068_oPCAN_RADAR_7392b6bc_Tx: ComBitPosition=263, ComBitSize=1, ComSignalInitValue=0, ComSignalType=UINT8, ComHandleId=1399, ComSystemTemplateSystemSignalRef=DET_BELOW_RAIN_THOLD_067
            DET_IDM_065_oRDR_DETECTION_065_068_oPCAN_RADAR_b930c0cc_Tx: ComBitPosition=63, ComBitSize=1, ComSignalInitValue=0, ComSignalType=UINT8, ComHandleId=1429, ComSystemTemplateSystemSignalRef=DET_IDM_065
            DET_MTD_067_oRDR_DETECTION_065_068_oPCAN_RADAR_2e135d7c_Tx: ComBitPosition=271, ComBitSize=1, ComSignalInitValue=0, ComSignalType=UINT8, ComHandleId=1438, ComSystemTemplateSystemSignalRef=DET_MTD_067
            DET_MTD_066_oRDR_DETECTION_065_068_oPCAN_RADAR_bb6389e9_Tx: ComBitPosition=159, ComBitSize=1, ComSignalInitValue=0, ComSignalType=UINT8, ComHandleId=1437, ComSystemTemplateSystemSignalRef=DET_MTD_066
            DET_IDM_066_oRDR_DETECTION_065_068_oPCAN_RADAR_ddd0bb32_Tx: ComBitPosition=175, ComBitSize=1, ComSignalInitValue=0, ComSignalType=UINT8, ComHandleId=1430, ComSystemTemplateSystemSignalRef=DET_IDM_066
            DET_BELOW_RAIN_THOLD_068_oRDR_DETECTION_065_068_oPCAN_RADAR_5f8224fb_Tx: ComBitPosition=375, ComBitSize=1, ComSignalInitValue=0, ComSignalType=UINT8, ComHandleId=1400, ComSystemTemplateSystemSignalRef=DET_BELOW_RAIN_THOLD_068
            DET_BELOW_RAIN_THOLD_065_oRDR_DETECTION_065_068_oPCAN_RADAR_820219d7_Tx: ComBitPosition=39, ComBitSize=1, ComSignalInitValue=0, ComSignalType=UINT8, ComHandleId=1397, ComSystemTemplateSystemSignalRef=DET_BELOW_RAIN_THOLD_065
            DET_PROB_1STAZHYPO_066_oRDR_DETECTION_065_068_oPCAN_RADAR_28d76124_Tx: ComBitPosition=215, ComBitSize=1, ComSignalInitValue=0, ComSignalType=BOOLEAN, ComHandleId=1441, ComSystemTemplateSystemSignalRef=DET_PROB_1STAZHYPO_066
            DET_IDM_068_oRDR_DETECTION_065_068_oPCAN_RADAR_64b0fde0_Tx: ComBitPosition=399, ComBitSize=1, ComSignalInitValue=0, ComSignalType=UINT8, ComHandleId=1432, ComSystemTemplateSystemSignalRef=DET_IDM_068
