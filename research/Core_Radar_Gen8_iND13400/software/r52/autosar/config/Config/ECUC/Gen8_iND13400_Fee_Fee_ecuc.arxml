AUTOSAR XML (schema 00053)
package /ActiveEcuC
  module config Fee: implementation-config-variant=VARIANT-PRE-COMPILE, module-description=Fee_Impl
    FeeBlockConfiguration:
      FeeBlockNumber = 16
      FeeBlockSize = 4
      FeeImmediateData = false
      FeeNumberOfWriteCycles = 10000
      FeeBlockId = 3
      FeeIsLookupTableBlock = false
      FeePartition = FeePartitionConfiguration
      FeeDeviceIndex = FlsGeneral
    FeeGeneral:
      FeeDevErrorDetect = true
      FeeMainFunctionPeriod = 0.005
      FeePollingMode = true
      FeeSetModeSupported = false
      FeeVersionInfoApi = false
      FeeVirtualPageSize = 0
      FeeSafeBswChecks = false
      FeeMainFunctionTriggering = FixedCycleTime
      FeeInternalBufferSize = 1024
      FeeBootloaderMode = false
      FeeMinimumReadPageSize = 1
      FeeLookupTableCompatibilityMode = true
      FeeReportExceptions = false
      FeeReportDebugNotifications = false
      FeeFlsApi:
        FeeFlsIncludeFile = Fls.h
        FeeFlsRead = Fls_Read
        FeeFlsWrite = Fls_Write
        FeeFlsCancel = Fls_Cancel
        FeeFlsGetStatus = Fls_GetStatus
        FeeFlsGetJobResult = Fls_GetJobResult
        FeeFlsErase = Fls_Erase
        FeeFlsBlankCheck = Fls_BlankCheck
        FeeFlsAddressType = Fls_AddressType
        FeeFlsLengthType = Fls_LengthType
    FeePublishedInformation: FeeBlockOverhead=0, FeePageOverhead=0
    FeePartitionConfiguration:
      FeePartitionLayout = SecureLayout
      FeePageAlignment = 256
      FeeInterferenceFreeAlignment = 256
      FeeBlankCheckRequired = false
      FeeLookupTableSize = 0
      FeeMaximalEraseCycles = 65536
      FeeReadAlignment = 1
      FeePartitionTarget = FlsConfigSet
      FeeSectorConfiguration: FeeSectorAddress=3932160, FeeSectorSize=131072
      FeeSectorConfiguration_1 (FeeSectorConfiguration): FeeSectorAddress=4063232, FeeSectorSize=131072
    30 x FeeBlockConfiguration, all with FeeImmediateData=false, FeePartition=FeePartitionConfiguration, FeeDeviceIndex=FlsGeneral:
      FeeLookupTableBlock_FeePartitionConfiguration: FeeBlockNumber=224, FeeBlockSize=128, FeeNumberOfWriteCycles=10000, FeeBlockId=1, FeeIsLookupTableBlock=true
      FeeBlockConfiguration_01: FeeBlockNumber=17, FeeBlockSize=4, FeeNumberOfWriteCycles=10000, FeeBlockId=4, FeeIsLookupTableBlock=false
      FeeSWC_PLT_Appl_NvMHandlerAlignment_NvMBlock: FeeBlockNumber=272, FeeBlockSize=66, FeeNumberOfWriteCycles=100000, FeeBlockId=5, FeeIsLookupTableBlock=false
      FeeSWC_PLT_Appl_NvMHandlerRFE_R1R2_Fault_NvM: FeeBlockNumber=320, FeeBlockSize=72, FeeNumberOfWriteCycles=100000, FeeBlockId=6, FeeIsLookupTableBlock=false
      FeeSWC_PLT_Appl_NvMHandlerSWC_PLT_CDD_FailSafe: FeeBlockNumber=368, FeeBlockSize=126, FeeNumberOfWriteCycles=10000, FeeBlockId=7, FeeIsLookupTableBlock=false
      FeeSWC_PLT_Appl_NvMHandlerBringup_NvMBlock: FeeBlockNumber=288, FeeBlockSize=66, FeeNumberOfWriteCycles=100000, FeeBlockId=8, FeeIsLookupTableBlock=false
      FeeSWC_PLT_Appl_NvMHandlerSWC_Appl_Faultmgr: FeeBlockNumber=336, FeeBlockSize=20, FeeNumberOfWriteCycles=100000, FeeBlockId=9, FeeIsLookupTableBlock=false
      FeeSWC_PLT_Appl_NvMHandlerCorrectable_Fault_NvM: FeeBlockNumber=304, FeeBlockSize=26, FeeNumberOfWriteCycles=100000, FeeBlockId=10, FeeIsLookupTableBlock=false
      FeeDemAdminDataBlock: FeeBlockNumber=32, FeeBlockSize=12, FeeNumberOfWriteCycles=10000, FeeBlockId=11, FeeIsLookupTableBlock=false
      FeeDemStatusDataBlock: FeeBlockNumber=208, FeeBlockSize=72, FeeNumberOfWriteCycles=10000, FeeBlockId=12, FeeIsLookupTableBlock=false
      FeeDemPrimaryDataBlock0: FeeBlockNumber=48, FeeBlockSize=28, FeeNumberOfWriteCycles=10000, FeeBlockId=13, FeeIsLookupTableBlock=false
      FeeSWC_CMP_PRJ_UDSHandlerSWC_UDSHandler_VIN: FeeBlockNumber=256, FeeBlockSize=19, FeeNumberOfWriteCycles=100000, FeeBlockId=23, FeeIsLookupTableBlock=false
      FeeSWC_PLT_Appl_NvMHandlerSensorPos_NvM: FeeBlockNumber=416, FeeBlockSize=10, FeeNumberOfWriteCycles=100000, FeeBlockId=24, FeeIsLookupTableBlock=false
      FeeSWC_PLT_Appl_NvMHandlerSensorPos_NvM_01: FeeBlockNumber=417, FeeBlockSize=10, FeeNumberOfWriteCycles=100000, FeeBlockId=2, FeeIsLookupTableBlock=false
      FeeDemPrimaryDataBlock1: FeeBlockNumber=64, FeeBlockSize=28, FeeNumberOfWriteCycles=10000, FeeBlockId=14, FeeIsLookupTableBlock=false
      FeeDemPrimaryDataBlock2: FeeBlockNumber=80, FeeBlockSize=28, FeeNumberOfWriteCycles=10000, FeeBlockId=15, FeeIsLookupTableBlock=false
      FeeDemPrimaryDataBlock3: FeeBlockNumber=96, FeeBlockSize=28, FeeNumberOfWriteCycles=10000, FeeBlockId=16, FeeIsLookupTableBlock=false
      FeeDemPrimaryDataBlock4: FeeBlockNumber=112, FeeBlockSize=28, FeeNumberOfWriteCycles=10000, FeeBlockId=17, FeeIsLookupTableBlock=false
      FeeDemPrimaryDataBlock5: FeeBlockNumber=128, FeeBlockSize=28, FeeNumberOfWriteCycles=10000, FeeBlockId=18, FeeIsLookupTableBlock=false
      FeeDemPrimaryDataBlock6: FeeBlockNumber=144, FeeBlockSize=28, FeeNumberOfWriteCycles=10000, FeeBlockId=19, FeeIsLookupTableBlock=false
      FeeDemPrimaryDataBlock7: FeeBlockNumber=160, FeeBlockSize=28, FeeNumberOfWriteCycles=10000, FeeBlockId=20, FeeIsLookupTableBlock=false
      FeeDemPrimaryDataBlock8: FeeBlockNumber=176, FeeBlockSize=28, FeeNumberOfWriteCycles=10000, FeeBlockId=21, FeeIsLookupTableBlock=false
      FeeDemPrimaryDataBlock9: FeeBlockNumber=192, FeeBlockSize=28, FeeNumberOfWriteCycles=10000, FeeBlockId=22, FeeIsLookupTableBlock=false
      FeeSWC_CMP_PRJ_UDSHandlerSWC_UDSHandler_Attemptcounter: FeeBlockNumber=240, FeeBlockSize=4, FeeNumberOfWriteCycles=100000, FeeBlockId=25, FeeIsLookupTableBlock=false
      FeeSWC_PLT_Appl_NvMHandlerSWC_Manual_alignment_Execution: FeeBlockNumber=352, FeeBlockSize=18, FeeNumberOfWriteCycles=100000, FeeBlockId=26, FeeIsLookupTableBlock=false
      FeeSWC_PLT_Appl_NvMHandlerSWC_Static_Alignment_Write_Parameters: FeeBlockNumber=384, FeeBlockSize=14, FeeNumberOfWriteCycles=100000, FeeBlockId=27, FeeIsLookupTableBlock=false
      FeeSWC_PLT_Appl_NvMHandlerSWC_VSE_NVM_Params: FeeBlockNumber=400, FeeBlockSize=22, FeeNumberOfWriteCycles=100000, FeeBlockId=28, FeeIsLookupTableBlock=false
      FeeSWC_PLT_Appl_NvMHandlerSWC_Manual_alignment_Execution_01: FeeBlockNumber=353, FeeBlockSize=18, FeeNumberOfWriteCycles=100000, FeeBlockId=29, FeeIsLookupTableBlock=false
      FeeSWC_PLT_Appl_NvMHandlerSWC_Static_Alignment_Write_Parameters_01: FeeBlockNumber=385, FeeBlockSize=14, FeeNumberOfWriteCycles=100000, FeeBlockId=30, FeeIsLookupTableBlock=false
      FeeSWC_PLT_Appl_NvMHandlerCorrectable_Fault_NvM_01: FeeBlockNumber=305, FeeBlockSize=26, FeeNumberOfWriteCycles=100000, FeeBlockId=31, FeeIsLookupTableBlock=false
