AUTOSAR XML (schema 00049)
package /MICROSAR/Csm_swc/DataTypes
  12 x impl type:
    Csm_VerifyResultType: compu {0=CRYPTO_E_VER_OK, 1=CRYPTO_E_VER_NOT_OK}, range raw 0..1, implementation-data-type=uint8  # The data type Csm_VerifyResultType indicates the result of a verification operation.
    Csm_ConfigIdType: range raw 0..65535, implementation-data-type=uint16  # The data type Csm_ConfigIdType identifies a configuration data set, which is unique within a service.
    Crypto_OperationModeType: compu {1=CRYPTO_OPERATIONMODE_START, 2=CRYPTO_OPERATIONMODE_UPDATE, 3=CRYPTO_OPERATIONMODE_STREAMSTART, 4=CRYPTO_OPERATIONMODE_FINISH, 7=CRYPTO_OPERATIONMODE_SINGLECALL}, range raw 0..7, implementation-data-type=uint8  # Enum which operation shall be performed. This enum is constructed from a bit mask, where the first bit indicates “Start”, the second “Update” and the third “Finish”.
    Crypto_VerifyResultType: compu {0=CRYPTO_E_VER_OK, 1=CRYPTO_E_VER_NOT_OK}, range raw 0..1, implementation-data-type=uint8  # Enumeration of the result type of verification operations.
    Csm_DataPtr: category=DATA_REFERENCE, sw-pointer-target-props={target-category=TYPE_REFERENCE, implementation-data-type=uint8}
    Csm_const_DataPtr: category=DATA_REFERENCE, sw-pointer-target-props={target-category=TYPE_REFERENCE, implementation-data-type=uint8, sw-impl-policy=CONST}
    Csm_LengthPtr: category=DATA_REFERENCE, sw-pointer-target-props={target-category=TYPE_REFERENCE, implementation-data-type=uint32}
    Csm_VerifyResultPtr: category=DATA_REFERENCE, sw-pointer-target-props={target-category=TYPE_REFERENCE, implementation-data-type=Crypto_VerifyResultType}
    Csm_ResultType: compu {1=E_NOT_OK, 2=E_SMALL_BUFFER, 3=E_ENTROPY_EXHAUSTION, 4=E_KEY_READ_FAIL, 5=E_KEY_NOT_AVAILABLE, 6=E_KEY_NOT_VALID, 7=E_JOB_CANCELED, 8=E_KEY_EMPTY}, range raw 0..8, implementation-data-type=uint8  # Csm module specific return values for use in Std_ReturnType that could occur during asynchronous job processing.
    Crypto_ResultType: compu {1=E_NOT_OK, 2=CRYPTO_E_BUSY, 4=CRYPTO_E_ENTROPY_EXHAUSTED, 6=CRYPTO_E_KEY_READ_FAIL, 7=CRYPTO_E_KEY_WRITE_FAIL, 8=CRYPTO_E_KEY_NOT_AVAILABLE, 9=CRYPTO_E_KEY_NOT_VALID, 10=CRYPTO_E_KEY_SIZE_MISMATCH, 12=CRYPTO_E_JOB_CANCELED, 13=CRYPTO_E_KEY_EMPTY}, range raw 0..13, implementation-data-type=uint8  # Return for Std_ReturnType for Cryptostack.
    Crypto_KeyStatusType: compu {0=CRYPTO_KEYSTATUS_INVALID, 1=CRYPTO_KEYSTATUS_VALID}, range raw 0..1, implementation-data-type=uint8  # Enumeration for key status.
    Csm_KeyElementEnumType:  # Enum which lists the most common Crypto Key Elements IDs
      compu {1=CRYPTO_KE_MAC_KEY, 2=CRYPTO_KE_MAC_PROOF, 1=CRYPTO_KE_SIGNATURE_KEY, 29=CRYPTO_KE_SIGNATURE_CURVETYPE, 3=CRYPTO_KE_RANDOM_SEED_STATE, 4=CRYPTO_KE_RANDOM_ALGORITHM, 1=CRYPTO_KE_CIPHER_KEY, 5=CRYPTO_KE_CIPHER_IV, 6=CRYPTO_KE_CIPHER_PROOF, 7=CRYPTO_KE_CIPHER_2NDKEY, 8=CRYPTO_KE_KEYEXCHANGE_BASE, 9=CRYPTO_KE_KEYEXCHANGE_PRIVKEY, 10=CRYPTO_KE_KEYEXCHANGE_OWNPUBKEY, 1=CRYPTO_KE_KEYEXCHANGE_SHAREDVALUE, 1=CYRPTO_KE_KEYEXCHANGE_SHAREDVALUE, 12=CRYPTO_KE_KEYEXCHANGE_ALGORITHM, 29=CRYPTO_KE_KEYEXCHANGE_CURVETYPE, 1=CRYPTO_KE_KEYDERIVATION_PASSWORD, 13=CRYPTO_KE_KEYDERIVATION_SALT, 14=CRYPTO_KE_KEYDERIVATION_ITERATIONS, 15=CRYPTO_KE_KEYDERIVATION_ALGORITHM, 29=CRYPTO_KE_KEYDERIVATION_CURVETYPE, 1=CRYPTO_KE_KEYGENERATE_KEY, 16=CRYPTO_KE_KEYGENERATE_SEED, 17=CRYPTO_KE_KEYGENERATE_ALGORITHM, 29=CRYPTO_KE_KEYGENERATE_CURVETYPE, 0=CRYPTO_KE_CERTIFICATE_DATA, 18=CRYPTO_KE_CERTIFICATE_PARSING_FORMAT, 19=CRYPTO_KE_CERTIFICATE_CURRENT_TIME, 20=CRYPTO_KE_CERTIFICATE_VERSION, 21=CRYPTO_KE_CERTIFICATE_SERIALNUMBER, 22=CRYPTO_KE_CERTIFICATE_SIGNATURE_ALGORITHM, 23=CRYPTO_KE_CERTIFICATE_ISSUER, 24=CRYPTO_KE_CERTIFICATE_VALIDITY_NOT_BEFORE, 25=CRYPTO_KE_CERTIFICATE_VALIDITY_NOT_AFTER, 26=CRYPTO_KE_CERTIFICATE_SUBJECT, 1=CRYPTO_KE_CERTIFICATE_SUBJECT_PUBLIC_KEY, 27=CRYPTO_KE_CERTIFICATE_EXTENSIONS, 28=CRYPTO_KE_CERTIFICATE_SIGNATURE, 1=CRYPTO_KE_KEYWRAP_KEY, 2=CRYPTO_KE_KEYWRAP_HEADER}
      range raw 0..4294967295
      implementation-data-type=uint32
package /MICROSAR/Csm_swc/ComponentTypes
  service sw component type Csm: category=SERVICE_COMPONENT
    behavior CsmInternalBehavior: handle-termination-and-restart=NO-SUPPORT, included-data-type-set=data-type=[Csm_VerifyResultType, Csm_ConfigIdType, Crypto_OperationModeType, Crypto_VerifyResultType, Csm_KeyElementEnumType, Csm_ResultType, Crypto_ResultType, Crypto_KeyStatusType]
      timing event Timer_Csm_MainFunction: start-on-event=Csm_MainFunction, period=0.01
      runnable Csm_MainFunction
  swc implementation CsmImplementation: programming-language=C, behavior=CsmInternalBehavior
