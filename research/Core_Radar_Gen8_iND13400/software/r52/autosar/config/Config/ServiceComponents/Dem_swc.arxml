[part 3 of 3: package /MICROSAR/Dem_swc/ComponentTypes]
AUTOSAR XML (schema 00053)
package /MICROSAR/Dem_swc/ComponentTypes  (continued)
  service sw component type DemSatellite_Invalid_OsApplication: category=SERVICE_COMPONENT  (continued)
    behavior DemSatellite_Invalid_OsApplicationInternalBehavior: handle-termination-and-restart=NO-SUPPORT, included-data-type-set=data-type=[Dem_EventIdType, Dem_BufferLengthType, Dcm_NegativeResponseCodeType, Dem_RatioIdType, Dem_EventStatusType, Dem_UdsStatusByteType, Dem_DTCFormatType, Dem_InitMonitorReasonType, Dem_OperationCycleStateType, Dem_DTCStatusMaskType, Dem_IndicatorStatusType, Dem_MaxDataValueType, Dem_DTCKindType, Dem_DTCGroupType, Dem_IumprDenomCondIdType, Dem_IumprDenomCondStatusType, Dem_DebounceResetStatusType, Dem_DebouncingStateType, Dem_IumprReadinessGroupType, Dem_DTRControlType, Dem_DTCSeverityType, Dem_MonitorStatusType]  (continued)
      1375 x operation invoked event:  (continued)
        OpEventGetEventExtendedDataRecordEx_GetEventExtendedDataRecordEx_Event_ECU_NVM_Corruption_Program_memory_Failure: start-on-event=DemSatellite_Invalid_OsApplicationInternalBehavior/GetEventExtendedDataRecordEx, operation=Event_ECU_NVM_Corruption_Program_memory_Failure.GetEventExtendedDataRecordEx
        OpEventGetEventExtendedDataRecordEx_GetEventExtendedDataRecordEx_EvtInfo_Cluster_ECU_TD_message_Missing_Message: start-on-event=DemSatellite_Invalid_OsApplicationInternalBehavior/GetEventExtendedDataRecordEx, operation=EvtInfo_Cluster_ECU_TD_message_Missing_Message.GetEventExtendedDataRecordEx
        OpEventGetEventExtendedDataRecordEx_GetEventExtendedDataRecordEx_Event_Cluster_ECU_TD_message_Missing_Message: start-on-event=DemSatellite_Invalid_OsApplicationInternalBehavior/GetEventExtendedDataRecordEx, operation=Event_Cluster_ECU_TD_message_Missing_Message.GetEventExtendedDataRecordEx
        OpEventGetEventExtendedDataRecordEx_GetEventExtendedDataRecordEx_EvtInfo_PCAN_Communication_Bus_Off: start-on-event=DemSatellite_Invalid_OsApplicationInternalBehavior/GetEventExtendedDataRecordEx, operation=EvtInfo_PCAN_Communication_Bus_Off.GetEventExtendedDataRecordEx
        OpEventGetEventExtendedDataRecordEx_GetEventExtendedDataRecordEx_Event_PCAN_Communication_Bus_Off: start-on-event=DemSatellite_Invalid_OsApplicationInternalBehavior/GetEventExtendedDataRecordEx, operation=Event_PCAN_Communication_Bus_Off.GetEventExtendedDataRecordEx
        OpEventGetEventExtendedDataRecordEx_GetEventExtendedDataRecordEx_EvtInfo_Front_Left_Side_Radar_Missing_Message: start-on-event=DemSatellite_Invalid_OsApplicationInternalBehavior/GetEventExtendedDataRecordEx, operation=EvtInfo_Front_Left_Side_Radar_Missing_Message.GetEventExtendedDataRecordEx
        OpEventGetEventExtendedDataRecordEx_GetEventExtendedDataRecordEx_Event_Front_Left_Side_Radar_Missing_Message: start-on-event=DemSatellite_Invalid_OsApplicationInternalBehavior/GetEventExtendedDataRecordEx, operation=Event_Front_Left_Side_Radar_Missing_Message.GetEventExtendedDataRecordEx
        OpEventGetEventExtendedDataRecordEx_GetEventExtendedDataRecordEx_EvtInfo_Manual_ETC2_message_Transcurrent_gear_Invalid_1899adad: start-on-event=DemSatellite_Invalid_OsApplicationInternalBehavior/GetEventExtendedDataRecordEx, operation=EvtInfo_Manual_ETC2_message_Transcurrent_gear_Invalid_Serial_Data_Received.GetEventExtendedDataRecordEx
        OpEventGetEventExtendedDataRecordEx_GetEventExtendedDataRecordEx_Event_Manual_ETC2_message_Transcurrent_gear_Invalid_Se_f9a59ec3: start-on-event=DemSatellite_Invalid_OsApplicationInternalBehavior/GetEventExtendedDataRecordEx, operation=Event_Manual_ETC2_message_Transcurrent_gear_Invalid_Serial_Data_Received.GetEventExtendedDataRecordEx
        OpEventGetEventExtendedDataRecordEx_GetEventExtendedDataRecordEx_EvtInfo_SAS_ECU_erratic_communication_Erratic: start-on-event=DemSatellite_Invalid_OsApplicationInternalBehavior/GetEventExtendedDataRecordEx, operation=EvtInfo_SAS_ECU_erratic_communication_Erratic.GetEventExtendedDataRecordEx
        OpEventGetEventExtendedDataRecordEx_GetEventExtendedDataRecordEx_Event_SAS_ECU_erratic_communication_Erratic: start-on-event=DemSatellite_Invalid_OsApplicationInternalBehavior/GetEventExtendedDataRecordEx, operation=Event_SAS_ECU_erratic_communication_Erratic.GetEventExtendedDataRecordEx
        OpEventGetEventExtendedDataRecordEx_GetEventExtendedDataRecordEx_EvtInfo_VDC2_message_Yaw_rate_Invalid_Serial_Data_Received: start-on-event=DemSatellite_Invalid_OsApplicationInternalBehavior/GetEventExtendedDataRecordEx, operation=EvtInfo_VDC2_message_Yaw_rate_Invalid_Serial_Data_Received.GetEventExtendedDataRecordEx
        OpEventGetEventExtendedDataRecordEx_GetEventExtendedDataRecordEx_Event_VDC2_message_Yaw_rate_Invalid_Serial_Data_Received: start-on-event=DemSatellite_Invalid_OsApplicationInternalBehavior/GetEventExtendedDataRecordEx, operation=Event_VDC2_message_Yaw_rate_Invalid_Serial_Data_Received.GetEventExtendedDataRecordEx
        OpEventGetEventExtendedDataRecordEx_GetEventExtendedDataRecordEx_EvtInfo_Cluster_ECU_TD_erratic_communication_Erratic: start-on-event=DemSatellite_Invalid_OsApplicationInternalBehavior/GetEventExtendedDataRecordEx, operation=EvtInfo_Cluster_ECU_TD_erratic_communication_Erratic.GetEventExtendedDataRecordEx
        OpEventGetEventExtendedDataRecordEx_GetEventExtendedDataRecordEx_Event_Cluster_ECU_TD_erratic_communication_Erratic: start-on-event=DemSatellite_Invalid_OsApplicationInternalBehavior/GetEventExtendedDataRecordEx, operation=Event_Cluster_ECU_TD_erratic_communication_Erratic.GetEventExtendedDataRecordEx
        OpEventGetEventExtendedDataRecordEx_GetEventExtendedDataRecordEx_EvtInfo_EMS_ECU_CCVS1_message_Missing_Message: start-on-event=DemSatellite_Invalid_OsApplicationInternalBehavior/GetEventExtendedDataRecordEx, operation=EvtInfo_EMS_ECU_CCVS1_message_Missing_Message.GetEventExtendedDataRecordEx
        OpEventGetEventExtendedDataRecordEx_GetEventExtendedDataRecordEx_Event_EMS_ECU_CCVS1_message_Missing_Message: start-on-event=DemSatellite_Invalid_OsApplicationInternalBehavior/GetEventExtendedDataRecordEx, operation=Event_EMS_ECU_CCVS1_message_Missing_Message.GetEventExtendedDataRecordEx
        OpEventGetEventExtendedDataRecordEx_GetEventExtendedDataRecordEx_EvtInfo_Radar_Mounting_Orientation_Incorrect_Assembly: start-on-event=DemSatellite_Invalid_OsApplicationInternalBehavior/GetEventExtendedDataRecordEx, operation=EvtInfo_Radar_Mounting_Orientation_Incorrect_Assembly.GetEventExtendedDataRecordEx
        OpEventGetEventExtendedDataRecordEx_GetEventExtendedDataRecordEx_Event_Radar_Mounting_Orientation_Incorrect_Assembly: start-on-event=DemSatellite_Invalid_OsApplicationInternalBehavior/GetEventExtendedDataRecordEx, operation=Event_Radar_Mounting_Orientation_Incorrect_Assembly.GetEventExtendedDataRecordEx
        OpEventGetEventExtendedDataRecordEx_GetEventExtendedDataRecordEx_EvtInfo_EMS_ECU_ETC2_erratic_communication_Erractic: start-on-event=DemSatellite_Invalid_OsApplicationInternalBehavior/GetEventExtendedDataRecordEx, operation=EvtInfo_EMS_ECU_ETC2_erratic_communication_Erractic.GetEventExtendedDataRecordEx
        OpEventGetEventExtendedDataRecordEx_GetEventExtendedDataRecordEx_Event_EMS_ECU_ETC2_erratic_communication_Erractic: start-on-event=DemSatellite_Invalid_OsApplicationInternalBehavior/GetEventExtendedDataRecordEx, operation=Event_EMS_ECU_ETC2_erratic_communication_Erractic.GetEventExtendedDataRecordEx
        OpEventGetEventExtendedDataRecordEx_GetEventExtendedDataRecordEx_EvtInfo_Cluster_ECU_ADAS_FN_STS_erratic_communication_Erratic: start-on-event=DemSatellite_Invalid_OsApplicationInternalBehavior/GetEventExtendedDataRecordEx, operation=EvtInfo_Cluster_ECU_ADAS_FN_STS_erratic_communication_Erratic.GetEventExtendedDataRecordEx
        OpEventGetEventExtendedDataRecordEx_GetEventExtendedDataRecordEx_Event_Cluster_ECU_ADAS_FN_STS_erratic_communication_Erratic: start-on-event=DemSatellite_Invalid_OsApplicationInternalBehavior/GetEventExtendedDataRecordEx, operation=Event_Cluster_ECU_ADAS_FN_STS_erratic_communication_Erratic.GetEventExtendedDataRecordEx
        OpEventGetEventExtendedDataRecordEx_GetEventExtendedDataRecordEx_EvtInfo_ESC_ECU_VDC2_message_Missing_Message: start-on-event=DemSatellite_Invalid_OsApplicationInternalBehavior/GetEventExtendedDataRecordEx, operation=EvtInfo_ESC_ECU_VDC2_message_Missing_Message.GetEventExtendedDataRecordEx
        OpEventGetEventExtendedDataRecordEx_GetEventExtendedDataRecordEx_Event_ESC_ECU_VDC2_message_Missing_Message: start-on-event=DemSatellite_Invalid_OsApplicationInternalBehavior/GetEventExtendedDataRecordEx, operation=Event_ESC_ECU_VDC2_message_Missing_Message.GetEventExtendedDataRecordEx
        OpEventGetEventExtendedDataRecordEx_GetEventExtendedDataRecordEx_EvtInfo_CLS_TX_16_message_Transmission_Type_info_Inval_91a84ba5: start-on-event=DemSatellite_Invalid_OsApplicationInternalBehavior/GetEventExtendedDataRecordEx, operation=EvtInfo_CLS_TX_16_message_Transmission_Type_info_Invalid_Serial_Data_Received.GetEventExtendedDataRecordEx
        OpEventGetEventExtendedDataRecordEx_GetEventExtendedDataRecordEx_Event_CLS_TX_16_message_Transmission_Type_info_Invalid_08e5b4d9: start-on-event=DemSatellite_Invalid_OsApplicationInternalBehavior/GetEventExtendedDataRecordEx, operation=Event_CLS_TX_16_message_Transmission_Type_info_Invalid_Serial_Data_Received.GetEventExtendedDataRecordEx
        OpEventGetEventExtendedDataRecordEx_GetEventExtendedDataRecordEx_EvtInfo_Cluster_ECU_CLS_Tx_4_erratic_communication_Erratic: start-on-event=DemSatellite_Invalid_OsApplicationInternalBehavior/GetEventExtendedDataRecordEx, operation=EvtInfo_Cluster_ECU_CLS_Tx_4_erratic_communication_Erratic.GetEventExtendedDataRecordEx
        OpEventGetEventExtendedDataRecordEx_GetEventExtendedDataRecordEx_Event_Cluster_ECU_CLS_Tx_4_erratic_communication_Erratic: start-on-event=DemSatellite_Invalid_OsApplicationInternalBehavior/GetEventExtendedDataRecordEx, operation=Event_Cluster_ECU_CLS_Tx_4_erratic_communication_Erratic.GetEventExtendedDataRecordEx
        OpEventGetEventExtendedDataRecordEx_GetEventExtendedDataRecordEx_EvtInfo_Cluster_ECU_ADAS_FN_STS_message_Missing_Message: start-on-event=DemSatellite_Invalid_OsApplicationInternalBehavior/GetEventExtendedDataRecordEx, operation=EvtInfo_Cluster_ECU_ADAS_FN_STS_message_Missing_Message.GetEventExtendedDataRecordEx
        OpEventGetEventExtendedDataRecordEx_GetEventExtendedDataRecordEx_Event_Cluster_ECU_ADAS_FN_STS_message_Missing_Message: start-on-event=DemSatellite_Invalid_OsApplicationInternalBehavior/GetEventExtendedDataRecordEx, operation=Event_Cluster_ECU_ADAS_FN_STS_message_Missing_Message.GetEventExtendedDataRecordEx
        OpEventGetEventExtendedDataRecordEx_GetEventExtendedDataRecordEx_EvtInfo_Vehicle_Dataset_value_of_signal_protection_cal_96691b8c: start-on-event=DemSatellite_Invalid_OsApplicationInternalBehavior/GetEventExtendedDataRecordEx, operation=EvtInfo_Vehicle_Dataset_value_of_signal_protection_calculation_Incorrect.GetEventExtendedDataRecordEx
        OpEventGetEventExtendedDataRecordEx_GetEventExtendedDataRecordEx_Event_Vehicle_Dataset_value_of_signal_protection_calcu_e573b3a0: start-on-event=DemSatellite_Invalid_OsApplicationInternalBehavior/GetEventExtendedDataRecordEx, operation=Event_Vehicle_Dataset_value_of_signal_protection_calculation_Incorrect.GetEventExtendedDataRecordEx
        OpEventGetEventExtendedDataRecordEx_GetEventExtendedDataRecordEx_EvtInfo_Cluster_ECU_CLS_Tx_16_erratic_communication_Erratic: start-on-event=DemSatellite_Invalid_OsApplicationInternalBehavior/GetEventExtendedDataRecordEx, operation=EvtInfo_Cluster_ECU_CLS_Tx_16_erratic_communication_Erratic.GetEventExtendedDataRecordEx
        OpEventGetEventExtendedDataRecordEx_GetEventExtendedDataRecordEx_Event_Cluster_ECU_CLS_Tx_16_erratic_communication_Erratic: start-on-event=DemSatellite_Invalid_OsApplicationInternalBehavior/GetEventExtendedDataRecordEx, operation=Event_Cluster_ECU_CLS_Tx_16_erratic_communication_Erratic.GetEventExtendedDataRecordEx
        OpEventGetEventExtendedDataRecordEx_GetEventExtendedDataRecordEx_EvtInfo_Cluster_ECU_OEL_erratic_communication_Erratic: start-on-event=DemSatellite_Invalid_OsApplicationInternalBehavior/GetEventExtendedDataRecordEx, operation=EvtInfo_Cluster_ECU_OEL_erratic_communication_Erratic.GetEventExtendedDataRecordEx
        OpEventGetEventExtendedDataRecordEx_GetEventExtendedDataRecordEx_Event_Cluster_ECU_OEL_erratic_communication_Erratic: start-on-event=DemSatellite_Invalid_OsApplicationInternalBehavior/GetEventExtendedDataRecordEx, operation=Event_Cluster_ECU_OEL_erratic_communication_Erratic.GetEventExtendedDataRecordEx
        OpEventGetEventExtendedDataRecordEx_GetEventExtendedDataRecordEx_EvtInfo_Cluster_ECU_CLS_Tx_4_message_Missing_Message: start-on-event=DemSatellite_Invalid_OsApplicationInternalBehavior/GetEventExtendedDataRecordEx, operation=EvtInfo_Cluster_ECU_CLS_Tx_4_message_Missing_Message.GetEventExtendedDataRecordEx
        OpEventGetEventExtendedDataRecordEx_GetEventExtendedDataRecordEx_Event_Cluster_ECU_CLS_Tx_4_message_Missing_Message: start-on-event=DemSatellite_Invalid_OsApplicationInternalBehavior/GetEventExtendedDataRecordEx, operation=Event_Cluster_ECU_CLS_Tx_4_message_Missing_Message.GetEventExtendedDataRecordEx
        OpEventGetEventExtendedDataRecordEx_GetEventExtendedDataRecordEx_EvtInfo_Radar_Performance_Capability_Algorithm_Based_Failure: start-on-event=DemSatellite_Invalid_OsApplicationInternalBehavior/GetEventExtendedDataRecordEx, operation=EvtInfo_Radar_Performance_Capability_Algorithm_Based_Failure.GetEventExtendedDataRecordEx
        OpEventGetEventExtendedDataRecordEx_GetEventExtendedDataRecordEx_Event_Radar_Performance_Capability_Algorithm_Based_Failure: start-on-event=DemSatellite_Invalid_OsApplicationInternalBehavior/GetEventExtendedDataRecordEx, operation=Event_Radar_Performance_Capability_Algorithm_Based_Failure.GetEventExtendedDataRecordEx
        OpEventGetEventExtendedDataRecordEx_GetEventExtendedDataRecordEx_EvtInfo_Radar_AutoAlignment_Range_Alignment_or_Adjuste_162bbf47: start-on-event=DemSatellite_Invalid_OsApplicationInternalBehavior/GetEventExtendedDataRecordEx, operation=EvtInfo_Radar_AutoAlignment_Range_Alignment_or_Adjustement_Incorrect.GetEventExtendedDataRecordEx
        OpEventGetEventExtendedDataRecordEx_GetEventExtendedDataRecordEx_Event_Radar_AutoAlignment_Range_Alignment_or_Adjusteme_498a8af7: start-on-event=DemSatellite_Invalid_OsApplicationInternalBehavior/GetEventExtendedDataRecordEx, operation=Event_Radar_AutoAlignment_Range_Alignment_or_Adjustement_Incorrect.GetEventExtendedDataRecordEx
        OpEventGetEventExtendedDataRecordEx_GetEventExtendedDataRecordEx_EvtInfo_EMS_ECU_CCVS1_erratic_communication_Erractic: start-on-event=DemSatellite_Invalid_OsApplicationInternalBehavior/GetEventExtendedDataRecordEx, operation=EvtInfo_EMS_ECU_CCVS1_erratic_communication_Erractic.GetEventExtendedDataRecordEx
        OpEventGetEventExtendedDataRecordEx_GetEventExtendedDataRecordEx_Event_EMS_ECU_CCVS1_erratic_communication_Erractic: start-on-event=DemSatellite_Invalid_OsApplicationInternalBehavior/GetEventExtendedDataRecordEx, operation=Event_EMS_ECU_CCVS1_erratic_communication_Erractic.GetEventExtendedDataRecordEx
        OpEventGetEventExtendedDataRecordEx_GetEventExtendedDataRecordEx_EvtInfo_Radar_System_Battery_Low_Voltage_System_Voltage_Low: start-on-event=DemSatellite_Invalid_OsApplicationInternalBehavior/GetEventExtendedDataRecordEx, operation=EvtInfo_Radar_System_Battery_Low_Voltage_System_Voltage_Low.GetEventExtendedDataRecordEx
        OpEventGetEventExtendedDataRecordEx_GetEventExtendedDataRecordEx_Event_Radar_System_Battery_Low_Voltage_System_Voltage_Low: start-on-event=DemSatellite_Invalid_OsApplicationInternalBehavior/GetEventExtendedDataRecordEx, operation=Event_Radar_System_Battery_Low_Voltage_System_Voltage_Low.GetEventExtendedDataRecordEx
        OpEventGetEventExtendedDataRecordEx_GetEventExtendedDataRecordEx_EvtInfo_Radar_SMC_General_Checksum_Failure: start-on-event=DemSatellite_Invalid_OsApplicationInternalBehavior/GetEventExtendedDataRecordEx, operation=EvtInfo_Radar_SMC_General_Checksum_Failure.GetEventExtendedDataRecordEx
        OpEventGetEventExtendedDataRecordEx_GetEventExtendedDataRecordEx_Event_Radar_SMC_General_Checksum_Failure: start-on-event=DemSatellite_Invalid_OsApplicationInternalBehavior/GetEventExtendedDataRecordEx, operation=Event_Radar_SMC_General_Checksum_Failure.GetEventExtendedDataRecordEx
        OpEventGetEventExtendedDataRecordEx_GetEventExtendedDataRecordEx_EvtInfo_Radar_Pin_Position_Wrong_Mounting_Position: start-on-event=DemSatellite_Invalid_OsApplicationInternalBehavior/GetEventExtendedDataRecordEx, operation=EvtInfo_Radar_Pin_Position_Wrong_Mounting_Position.GetEventExtendedDataRecordEx
        OpEventGetEventExtendedDataRecordEx_GetEventExtendedDataRecordEx_Event_Radar_Pin_Position_Wrong_Mounting_Position: start-on-event=DemSatellite_Invalid_OsApplicationInternalBehavior/GetEventExtendedDataRecordEx, operation=Event_Radar_Pin_Position_Wrong_Mounting_Position.GetEventExtendedDataRecordEx
        OpEventGetEventExtendedDataRecordEx_GetEventExtendedDataRecordEx_EvtInfo_VDC2_message_Lateral_Accleration_Invalid_Seria_8bd1d122: start-on-event=DemSatellite_Invalid_OsApplicationInternalBehavior/GetEventExtendedDataRecordEx, operation=EvtInfo_VDC2_message_Lateral_Accleration_Invalid_Serial_Data_Received.GetEventExtendedDataRecordEx
        OpEventGetEventExtendedDataRecordEx_GetEventExtendedDataRecordEx_Event_VDC2_message_Lateral_Accleration_Invalid_Serial_40efc39b: start-on-event=DemSatellite_Invalid_OsApplicationInternalBehavior/GetEventExtendedDataRecordEx, operation=Event_VDC2_message_Lateral_Accleration_Invalid_Serial_Data_Received.GetEventExtendedDataRecordEx
        OpEventGetEventExtendedDataRecordEx_GetEventExtendedDataRecordEx_EvtInfo_ADAS_FN_STS_message_BSIS_FN_Switch_STS_Invalid_0230ac92: start-on-event=DemSatellite_Invalid_OsApplicationInternalBehavior/GetEventExtendedDataRecordEx, operation=EvtInfo_ADAS_FN_STS_message_BSIS_FN_Switch_STS_Invalid_Serial_Data_Received.GetEventExtendedDataRecordEx
        OpEventGetEventExtendedDataRecordEx_GetEventExtendedDataRecordEx_Event_ADAS_FN_STS_message_BSIS_FN_Switch_STS_Invalid_S_a8dbdcfe: start-on-event=DemSatellite_Invalid_OsApplicationInternalBehavior/GetEventExtendedDataRecordEx, operation=Event_ADAS_FN_STS_message_BSIS_FN_Switch_STS_Invalid_Serial_Data_Received.GetEventExtendedDataRecordEx
        OpEventGetEventExtendedDataRecordEx_GetEventExtendedDataRecordEx_EvtInfo_Radar_AutoAlignment_Misalignment_Performance_o_5469043b: start-on-event=DemSatellite_Invalid_OsApplicationInternalBehavior/GetEventExtendedDataRecordEx, operation=EvtInfo_Radar_AutoAlignment_Misalignment_Performance_or_Incorrect_Operation.GetEventExtendedDataRecordEx
        OpEventGetEventExtendedDataRecordEx_GetEventExtendedDataRecordEx_Event_Radar_AutoAlignment_Misalignment_Performance_or_fe827457: start-on-event=DemSatellite_Invalid_OsApplicationInternalBehavior/GetEventExtendedDataRecordEx, operation=Event_Radar_AutoAlignment_Misalignment_Performance_or_Incorrect_Operation.GetEventExtendedDataRecordEx
        OpEventGetEventExtendedDataRecordEx_GetEventExtendedDataRecordEx_EvtInfo_ESC_ECU_VDC2_erratic_communication_Erratic: start-on-event=DemSatellite_Invalid_OsApplicationInternalBehavior/GetEventExtendedDataRecordEx, operation=EvtInfo_ESC_ECU_VDC2_erratic_communication_Erratic.GetEventExtendedDataRecordEx
        OpEventGetEventExtendedDataRecordEx_GetEventExtendedDataRecordEx_Event_ESC_ECU_VDC2_erratic_communication_Erratic: start-on-event=DemSatellite_Invalid_OsApplicationInternalBehavior/GetEventExtendedDataRecordEx, operation=Event_ESC_ECU_VDC2_erratic_communication_Erratic.GetEventExtendedDataRecordEx
        OpEventGetEventExtendedDataRecordEx_GetEventExtendedDataRecordEx_EvtInfo_Application_Interface_Lookup_Performance_or_In_802661e7: start-on-event=DemSatellite_Invalid_OsApplicationInternalBehavior/GetEventExtendedDataRecordEx, operation=EvtInfo_Application_Interface_Lookup_Performance_or_Incorrect_Operation.GetEventExtendedDataRecordEx
        OpEventGetEventExtendedDataRecordEx_GetEventExtendedDataRecordEx_Event_Application_Interface_Lookup_Performance_or_Inco_4698ce60: start-on-event=DemSatellite_Invalid_OsApplicationInternalBehavior/GetEventExtendedDataRecordEx, operation=Event_Application_Interface_Lookup_Performance_or_Incorrect_Operation.GetEventExtendedDataRecordEx
        OpEventGetEventExtendedDataRecordEx_GetEventExtendedDataRecordEx_EvtInfo_EMS_ECU_VD_message_Missing_Message: start-on-event=DemSatellite_Invalid_OsApplicationInternalBehavior/GetEventExtendedDataRecordEx, operation=EvtInfo_EMS_ECU_VD_message_Missing_Message.GetEventExtendedDataRecordEx
        OpEventGetEventExtendedDataRecordEx_GetEventExtendedDataRecordEx_Event_EMS_ECU_VD_message_Missing_Message: start-on-event=DemSatellite_Invalid_OsApplicationInternalBehavior/GetEventExtendedDataRecordEx, operation=Event_EMS_ECU_VD_message_Missing_Message.GetEventExtendedDataRecordEx
        OpEventGetEventExtendedDataRecordEx_GetEventExtendedDataRecordEx_EvtInfo_Radar_Platform_Time_System_Programming_Failure: start-on-event=DemSatellite_Invalid_OsApplicationInternalBehavior/GetEventExtendedDataRecordEx, operation=EvtInfo_Radar_Platform_Time_System_Programming_Failure.GetEventExtendedDataRecordEx
        OpEventGetEventExtendedDataRecordEx_GetEventExtendedDataRecordEx_Event_Radar_Platform_Time_System_Programming_Failure: start-on-event=DemSatellite_Invalid_OsApplicationInternalBehavior/GetEventExtendedDataRecordEx, operation=Event_Radar_Platform_Time_System_Programming_Failure.GetEventExtendedDataRecordEx
        OpEventGetEventExtendedDataRecordEx_GetEventExtendedDataRecordEx_EvtInfo_OEL_message_Turn_Signal_Switch_Invalid_Serial_39dbabbc: start-on-event=DemSatellite_Invalid_OsApplicationInternalBehavior/GetEventExtendedDataRecordEx, operation=EvtInfo_OEL_message_Turn_Signal_Switch_Invalid_Serial_Data_Received.GetEventExtendedDataRecordEx
        OpEventGetEventExtendedDataRecordEx_GetEventExtendedDataRecordEx_Event_OEL_message_Turn_Signal_Switch_Invalid_Serial_Da_9d661385: start-on-event=DemSatellite_Invalid_OsApplicationInternalBehavior/GetEventExtendedDataRecordEx, operation=Event_OEL_message_Turn_Signal_Switch_Invalid_Serial_Data_Received.GetEventExtendedDataRecordEx
        OpEventGetEventExtendedDataRecordEx_GetEventExtendedDataRecordEx_EvtInfo_Radar_calibration_Calibration_or_Paramater_Mem_ab89598b: start-on-event=DemSatellite_Invalid_OsApplicationInternalBehavior/GetEventExtendedDataRecordEx, operation=EvtInfo_Radar_calibration_Calibration_or_Paramater_Memory_Failure.GetEventExtendedDataRecordEx
        OpEventGetEventExtendedDataRecordEx_GetEventExtendedDataRecordEx_Event_Radar_calibration_Calibration_or_Paramater_Memory_Failure: start-on-event=DemSatellite_Invalid_OsApplicationInternalBehavior/GetEventExtendedDataRecordEx, operation=Event_Radar_calibration_Calibration_or_Paramater_Memory_Failure.GetEventExtendedDataRecordEx
        OpEventGetEventExtendedDataRecordEx_GetEventExtendedDataRecordEx_GeneralEvtInfo: start-on-event=DemSatellite_Invalid_OsApplicationInternalBehavior/GetEventExtendedDataRecordEx, operation=GeneralEvtInfo.GetEventExtendedDataRecordEx
        OpEventGetEventEnableCondition_GetEventEnableCondition_EvtInfo_SAS_message_Steering_Wheel_Angle_Invalid_Serial_Data_Received: start-on-event=DemSatellite_Invalid_OsApplicationInternalBehavior/GetEventEnableCondition, operation=EvtInfo_SAS_message_Steering_Wheel_Angle_Invalid_Serial_Data_Received.GetEventEnableCondition
        OpEventGetEventEnableCondition_GetEventEnableCondition_EvtInfo_AT_AMT_ETC2_message_Transcurrent_gear_Invalid_Serial_Dat_98622d12: start-on-event=DemSatellite_Invalid_OsApplicationInternalBehavior/GetEventEnableCondition, operation=EvtInfo_AT_AMT_ETC2_message_Transcurrent_gear_Invalid_Serial_Data_Received.GetEventEnableCondition
        OpEventGetEventEnableCondition_GetEventEnableCondition_EvtInfo_Radar_AutoAlignment_Algorithm_Signal_Calculation_Failure: start-on-event=DemSatellite_Invalid_OsApplicationInternalBehavior/GetEventEnableCondition, operation=EvtInfo_Radar_AutoAlignment_Algorithm_Signal_Calculation_Failure.GetEventEnableCondition
        OpEventGetEventEnableCondition_GetEventEnableCondition_EvtInfo_Vehicle_DataSet_Not_Configured: start-on-event=DemSatellite_Invalid_OsApplicationInternalBehavior/GetEventEnableCondition, operation=EvtInfo_Vehicle_DataSet_Not_Configured.GetEventEnableCondition
        OpEventGetEventEnableCondition_GetEventEnableCondition_EvtInfo_Radar_Module_System_Internal_Failure: start-on-event=DemSatellite_Invalid_OsApplicationInternalBehavior/GetEventEnableCondition, operation=EvtInfo_Radar_Module_System_Internal_Failure.GetEventEnableCondition
        OpEventGetEventEnableCondition_GetEventEnableCondition_EvtInfo_Radar_MMIC_Component_Failure: start-on-event=DemSatellite_Invalid_OsApplicationInternalBehavior/GetEventEnableCondition, operation=EvtInfo_Radar_MMIC_Component_Failure.GetEventEnableCondition
        OpEventGetEventEnableCondition_GetEventEnableCondition_EvtInfo_Radar_Module_General_Memory_Failure: start-on-event=DemSatellite_Invalid_OsApplicationInternalBehavior/GetEventEnableCondition, operation=EvtInfo_Radar_Module_General_Memory_Failure.GetEventEnableCondition
        OpEventGetEventEnableCondition_GetEventEnableCondition_EvtInfo_Radar_System_Battery_High_Voltage_System_Voltage_High: start-on-event=DemSatellite_Invalid_OsApplicationInternalBehavior/GetEventEnableCondition, operation=EvtInfo_Radar_System_Battery_High_Voltage_System_Voltage_High.GetEventEnableCondition
        OpEventGetEventEnableCondition_GetEventEnableCondition_EvtInfo_CCVS1_message_Vehicle_Speed_Invalid_Serial_Data_Received: start-on-event=DemSatellite_Invalid_OsApplicationInternalBehavior/GetEventEnableCondition, operation=EvtInfo_CCVS1_message_Vehicle_Speed_Invalid_Serial_Data_Received.GetEventEnableCondition
        OpEventGetEventEnableCondition_GetEventEnableCondition_EvtInfo_EMS_ECU_VD_erratic_communication_Erratic: start-on-event=DemSatellite_Invalid_OsApplicationInternalBehavior/GetEventEnableCondition, operation=EvtInfo_EMS_ECU_VD_erratic_communication_Erratic.GetEventEnableCondition
        OpEventGetEventEnableCondition_GetEventEnableCondition_EvtInfo_EMS_ECU_ETC2_00_message_Missing_Message: start-on-event=DemSatellite_Invalid_OsApplicationInternalBehavior/GetEventEnableCondition, operation=EvtInfo_EMS_ECU_ETC2_00_message_Missing_Message.GetEventEnableCondition
        OpEventGetEventEnableCondition_GetEventEnableCondition_EvtInfo_Cluster_ECU_CLS_Tx_16_message_Missing_Message: start-on-event=DemSatellite_Invalid_OsApplicationInternalBehavior/GetEventEnableCondition, operation=EvtInfo_Cluster_ECU_CLS_Tx_16_message_Missing_Message.GetEventEnableCondition
        OpEventGetEventEnableCondition_GetEventEnableCondition_EvtInfo_Exceeded_Security_Access_0x27_Attempt_Threshold_Authenti_4fc41757: start-on-event=DemSatellite_Invalid_OsApplicationInternalBehavior/GetEventEnableCondition, operation=EvtInfo_Exceeded_Security_Access_0x27_Attempt_Threshold_Authentication_Failure.GetEventEnableCondition
        OpEventGetEventEnableCondition_GetEventEnableCondition_EvtInfo_Front_Left_Side_Radar_value_of_signal_protection_calcula_055dc31f: start-on-event=DemSatellite_Invalid_OsApplicationInternalBehavior/GetEventEnableCondition, operation=EvtInfo_Front_Left_Side_Radar_value_of_signal_protection_calculation_Incorrect.GetEventEnableCondition
        OpEventGetEventEnableCondition_GetEventEnableCondition_EvtInfo_AT_AMT_ETC2_erratic_communication_Erratic: start-on-event=DemSatellite_Invalid_OsApplicationInternalBehavior/GetEventEnableCondition, operation=EvtInfo_AT_AMT_ETC2_erratic_communication_Erratic.GetEventEnableCondition
        OpEventGetEventEnableCondition_GetEventEnableCondition_EvtInfo_VCAN_Communication_Bus_Off: start-on-event=DemSatellite_Invalid_OsApplicationInternalBehavior/GetEventEnableCondition, operation=EvtInfo_VCAN_Communication_Bus_Off.GetEventEnableCondition
        OpEventGetEventEnableCondition_GetEventEnableCondition_EvtInfo_VDC2_message_LongitudinalAcceleration_Invalid_Serial_Dat_188e77bd: start-on-event=DemSatellite_Invalid_OsApplicationInternalBehavior/GetEventEnableCondition, operation=EvtInfo_VDC2_message_LongitudinalAcceleration_Invalid_Serial_Data_Received.GetEventEnableCondition
        OpEventGetEventEnableCondition_GetEventEnableCondition_EvtInfo_Radar_MMIC_RFBIST_Component_Internal_Failure: start-on-event=DemSatellite_Invalid_OsApplicationInternalBehavior/GetEventEnableCondition, operation=EvtInfo_Radar_MMIC_RFBIST_Component_Internal_Failure.GetEventEnableCondition
        OpEventGetEventEnableCondition_GetEventEnableCondition_EvtInfo_Radar_Initial_Alignment_Missing_Calibration: start-on-event=DemSatellite_Invalid_OsApplicationInternalBehavior/GetEventEnableCondition, operation=EvtInfo_Radar_Initial_Alignment_Missing_Calibration.GetEventEnableCondition
        OpEventGetEventEnableCondition_GetEventEnableCondition_EvtInfo_Cluster_ECU_OEL_message_Missing_Message: start-on-event=DemSatellite_Invalid_OsApplicationInternalBehavior/GetEventEnableCondition, operation=EvtInfo_Cluster_ECU_OEL_message_Missing_Message.GetEventEnableCondition
        OpEventGetEventEnableCondition_GetEventEnableCondition_EvtInfo_AT_AMT_ECU_ETC2_03_message_Missing_Message: start-on-event=DemSatellite_Invalid_OsApplicationInternalBehavior/GetEventEnableCondition, operation=EvtInfo_AT_AMT_ECU_ETC2_03_message_Missing_Message.GetEventEnableCondition
        OpEventGetEventEnableCondition_GetEventEnableCondition_EvtInfo_ADAS_FN_STS_message_MOIS_FN_Switch_STS_Invalid_Serial_Da_c0517e8a: start-on-event=DemSatellite_Invalid_OsApplicationInternalBehavior/GetEventEnableCondition, operation=EvtInfo_ADAS_FN_STS_message_MOIS_FN_Switch_STS_Invalid_Serial_Data_Received.GetEventEnableCondition
        OpEventGetEventEnableCondition_GetEventEnableCondition_EvtInfo_Radar_Module_Over_Temperature: start-on-event=DemSatellite_Invalid_OsApplicationInternalBehavior/GetEventEnableCondition, operation=EvtInfo_Radar_Module_Over_Temperature.GetEventEnableCondition
        OpEventGetEventEnableCondition_GetEventEnableCondition_EvtInfo_PCAN_TimeSync_Missing_Message: start-on-event=DemSatellite_Invalid_OsApplicationInternalBehavior/GetEventEnableCondition, operation=EvtInfo_PCAN_TimeSync_Missing_Message.GetEventEnableCondition
        OpEventGetEventEnableCondition_GetEventEnableCondition_EvtInfo_Radar_Module_Watchdog_Failure: start-on-event=DemSatellite_Invalid_OsApplicationInternalBehavior/GetEventEnableCondition, operation=EvtInfo_Radar_Module_Watchdog_Failure.GetEventEnableCondition
        OpEventGetEventEnableCondition_GetEventEnableCondition_EvtInfo_SAS_ECU_SAS_message_Missing_Message: start-on-event=DemSatellite_Invalid_OsApplicationInternalBehavior/GetEventEnableCondition, operation=EvtInfo_SAS_ECU_SAS_message_Missing_Message.GetEventEnableCondition
        OpEventGetEventEnableCondition_GetEventEnableCondition_EvtInfo_ECU_NVM_Corruption_Program_memory_Failure: start-on-event=DemSatellite_Invalid_OsApplicationInternalBehavior/GetEventEnableCondition, operation=EvtInfo_ECU_NVM_Corruption_Program_memory_Failure.GetEventEnableCondition
        OpEventGetEventEnableCondition_GetEventEnableCondition_EvtInfo_Cluster_ECU_TD_message_Missing_Message: start-on-event=DemSatellite_Invalid_OsApplicationInternalBehavior/GetEventEnableCondition, operation=EvtInfo_Cluster_ECU_TD_message_Missing_Message.GetEventEnableCondition
        OpEventGetEventEnableCondition_GetEventEnableCondition_EvtInfo_PCAN_Communication_Bus_Off: start-on-event=DemSatellite_Invalid_OsApplicationInternalBehavior/GetEventEnableCondition, operation=EvtInfo_PCAN_Communication_Bus_Off.GetEventEnableCondition
        OpEventGetEventEnableCondition_GetEventEnableCondition_EvtInfo_Front_Left_Side_Radar_Missing_Message: start-on-event=DemSatellite_Invalid_OsApplicationInternalBehavior/GetEventEnableCondition, operation=EvtInfo_Front_Left_Side_Radar_Missing_Message.GetEventEnableCondition
        OpEventGetEventEnableCondition_GetEventEnableCondition_EvtInfo_Manual_ETC2_message_Transcurrent_gear_Invalid_Serial_Dat_84f65fa9: start-on-event=DemSatellite_Invalid_OsApplicationInternalBehavior/GetEventEnableCondition, operation=EvtInfo_Manual_ETC2_message_Transcurrent_gear_Invalid_Serial_Data_Received.GetEventEnableCondition
        OpEventGetEventEnableCondition_GetEventEnableCondition_EvtInfo_SAS_ECU_erratic_communication_Erratic: start-on-event=DemSatellite_Invalid_OsApplicationInternalBehavior/GetEventEnableCondition, operation=EvtInfo_SAS_ECU_erratic_communication_Erratic.GetEventEnableCondition
        OpEventGetEventEnableCondition_GetEventEnableCondition_EvtInfo_VDC2_message_Yaw_rate_Invalid_Serial_Data_Received: start-on-event=DemSatellite_Invalid_OsApplicationInternalBehavior/GetEventEnableCondition, operation=EvtInfo_VDC2_message_Yaw_rate_Invalid_Serial_Data_Received.GetEventEnableCondition
        OpEventGetEventEnableCondition_GetEventEnableCondition_EvtInfo_Cluster_ECU_TD_erratic_communication_Erratic: start-on-event=DemSatellite_Invalid_OsApplicationInternalBehavior/GetEventEnableCondition, operation=EvtInfo_Cluster_ECU_TD_erratic_communication_Erratic.GetEventEnableCondition
        OpEventGetEventEnableCondition_GetEventEnableCondition_EvtInfo_EMS_ECU_CCVS1_message_Missing_Message: start-on-event=DemSatellite_Invalid_OsApplicationInternalBehavior/GetEventEnableCondition, operation=EvtInfo_EMS_ECU_CCVS1_message_Missing_Message.GetEventEnableCondition
        OpEventGetEventEnableCondition_GetEventEnableCondition_EvtInfo_Radar_Mounting_Orientation_Incorrect_Assembly: start-on-event=DemSatellite_Invalid_OsApplicationInternalBehavior/GetEventEnableCondition, operation=EvtInfo_Radar_Mounting_Orientation_Incorrect_Assembly.GetEventEnableCondition
        OpEventGetEventEnableCondition_GetEventEnableCondition_EvtInfo_EMS_ECU_ETC2_erratic_communication_Erractic: start-on-event=DemSatellite_Invalid_OsApplicationInternalBehavior/GetEventEnableCondition, operation=EvtInfo_EMS_ECU_ETC2_erratic_communication_Erractic.GetEventEnableCondition
        OpEventGetEventEnableCondition_GetEventEnableCondition_EvtInfo_Cluster_ECU_ADAS_FN_STS_erratic_communication_Erratic: start-on-event=DemSatellite_Invalid_OsApplicationInternalBehavior/GetEventEnableCondition, operation=EvtInfo_Cluster_ECU_ADAS_FN_STS_erratic_communication_Erratic.GetEventEnableCondition
        OpEventGetEventEnableCondition_GetEventEnableCondition_EvtInfo_ESC_ECU_VDC2_message_Missing_Message: start-on-event=DemSatellite_Invalid_OsApplicationInternalBehavior/GetEventEnableCondition, operation=EvtInfo_ESC_ECU_VDC2_message_Missing_Message.GetEventEnableCondition
        OpEventGetEventEnableCondition_GetEventEnableCondition_EvtInfo_CLS_TX_16_message_Transmission_Type_info_Invalid_Serial_6d261c13: start-on-event=DemSatellite_Invalid_OsApplicationInternalBehavior/GetEventEnableCondition, operation=EvtInfo_CLS_TX_16_message_Transmission_Type_info_Invalid_Serial_Data_Received.GetEventEnableCondition
        OpEventGetEventEnableCondition_GetEventEnableCondition_EvtInfo_Cluster_ECU_CLS_Tx_4_erratic_communication_Erratic: start-on-event=DemSatellite_Invalid_OsApplicationInternalBehavior/GetEventEnableCondition, operation=EvtInfo_Cluster_ECU_CLS_Tx_4_erratic_communication_Erratic.GetEventEnableCondition
        OpEventGetEventEnableCondition_GetEventEnableCondition_EvtInfo_Cluster_ECU_ADAS_FN_STS_message_Missing_Message: start-on-event=DemSatellite_Invalid_OsApplicationInternalBehavior/GetEventEnableCondition, operation=EvtInfo_Cluster_ECU_ADAS_FN_STS_message_Missing_Message.GetEventEnableCondition
        OpEventGetEventEnableCondition_GetEventEnableCondition_EvtInfo_Vehicle_Dataset_value_of_signal_protection_calculation_Incorrect: start-on-event=DemSatellite_Invalid_OsApplicationInternalBehavior/GetEventEnableCondition, operation=EvtInfo_Vehicle_Dataset_value_of_signal_protection_calculation_Incorrect.GetEventEnableCondition
        OpEventGetEventEnableCondition_GetEventEnableCondition_EvtInfo_Cluster_ECU_CLS_Tx_16_erratic_communication_Erratic: start-on-event=DemSatellite_Invalid_OsApplicationInternalBehavior/GetEventEnableCondition, operation=EvtInfo_Cluster_ECU_CLS_Tx_16_erratic_communication_Erratic.GetEventEnableCondition
        OpEventGetEventEnableCondition_GetEventEnableCondition_EvtInfo_Cluster_ECU_OEL_erratic_communication_Erratic: start-on-event=DemSatellite_Invalid_OsApplicationInternalBehavior/GetEventEnableCondition, operation=EvtInfo_Cluster_ECU_OEL_erratic_communication_Erratic.GetEventEnableCondition
        OpEventGetEventEnableCondition_GetEventEnableCondition_EvtInfo_Cluster_ECU_CLS_Tx_4_message_Missing_Message: start-on-event=DemSatellite_Invalid_OsApplicationInternalBehavior/GetEventEnableCondition, operation=EvtInfo_Cluster_ECU_CLS_Tx_4_message_Missing_Message.GetEventEnableCondition
        OpEventGetEventEnableCondition_GetEventEnableCondition_EvtInfo_Radar_Performance_Capability_Algorithm_Based_Failure: start-on-event=DemSatellite_Invalid_OsApplicationInternalBehavior/GetEventEnableCondition, operation=EvtInfo_Radar_Performance_Capability_Algorithm_Based_Failure.GetEventEnableCondition
        OpEventGetEventEnableCondition_GetEventEnableCondition_EvtInfo_Radar_AutoAlignment_Range_Alignment_or_Adjustement_Incorrect: start-on-event=DemSatellite_Invalid_OsApplicationInternalBehavior/GetEventEnableCondition, operation=EvtInfo_Radar_AutoAlignment_Range_Alignment_or_Adjustement_Incorrect.GetEventEnableCondition
        OpEventGetEventEnableCondition_GetEventEnableCondition_EvtInfo_EMS_ECU_CCVS1_erratic_communication_Erractic: start-on-event=DemSatellite_Invalid_OsApplicationInternalBehavior/GetEventEnableCondition, operation=EvtInfo_EMS_ECU_CCVS1_erratic_communication_Erractic.GetEventEnableCondition
        OpEventGetEventEnableCondition_GetEventEnableCondition_EvtInfo_Radar_System_Battery_Low_Voltage_System_Voltage_Low: start-on-event=DemSatellite_Invalid_OsApplicationInternalBehavior/GetEventEnableCondition, operation=EvtInfo_Radar_System_Battery_Low_Voltage_System_Voltage_Low.GetEventEnableCondition
        OpEventGetEventEnableCondition_GetEventEnableCondition_EvtInfo_Radar_SMC_General_Checksum_Failure: start-on-event=DemSatellite_Invalid_OsApplicationInternalBehavior/GetEventEnableCondition, operation=EvtInfo_Radar_SMC_General_Checksum_Failure.GetEventEnableCondition
        OpEventGetEventEnableCondition_GetEventEnableCondition_EvtInfo_Radar_Pin_Position_Wrong_Mounting_Position: start-on-event=DemSatellite_Invalid_OsApplicationInternalBehavior/GetEventEnableCondition, operation=EvtInfo_Radar_Pin_Position_Wrong_Mounting_Position.GetEventEnableCondition
        OpEventGetEventEnableCondition_GetEventEnableCondition_EvtInfo_VDC2_message_Lateral_Accleration_Invalid_Serial_Data_Received: start-on-event=DemSatellite_Invalid_OsApplicationInternalBehavior/GetEventEnableCondition, operation=EvtInfo_VDC2_message_Lateral_Accleration_Invalid_Serial_Data_Received.GetEventEnableCondition
        OpEventGetEventEnableCondition_GetEventEnableCondition_EvtInfo_ADAS_FN_STS_message_BSIS_FN_Switch_STS_Invalid_Serial_Da_05c10779: start-on-event=DemSatellite_Invalid_OsApplicationInternalBehavior/GetEventEnableCondition, operation=EvtInfo_ADAS_FN_STS_message_BSIS_FN_Switch_STS_Invalid_Serial_Data_Received.GetEventEnableCondition
        OpEventGetEventEnableCondition_GetEventEnableCondition_EvtInfo_Radar_AutoAlignment_Misalignment_Performance_or_Incorrec_5398afd0: start-on-event=DemSatellite_Invalid_OsApplicationInternalBehavior/GetEventEnableCondition, operation=EvtInfo_Radar_AutoAlignment_Misalignment_Performance_or_Incorrect_Operation.GetEventEnableCondition
        OpEventGetEventEnableCondition_GetEventEnableCondition_EvtInfo_ESC_ECU_VDC2_erratic_communication_Erratic: start-on-event=DemSatellite_Invalid_OsApplicationInternalBehavior/GetEventEnableCondition, operation=EvtInfo_ESC_ECU_VDC2_erratic_communication_Erratic.GetEventEnableCondition
        OpEventGetEventEnableCondition_GetEventEnableCondition_EvtInfo_Application_Interface_Lookup_Performance_or_Incorrect_Operation: start-on-event=DemSatellite_Invalid_OsApplicationInternalBehavior/GetEventEnableCondition, operation=EvtInfo_Application_Interface_Lookup_Performance_or_Incorrect_Operation.GetEventEnableCondition
        OpEventGetEventEnableCondition_GetEventEnableCondition_EvtInfo_EMS_ECU_VD_message_Missing_Message: start-on-event=DemSatellite_Invalid_OsApplicationInternalBehavior/GetEventEnableCondition, operation=EvtInfo_EMS_ECU_VD_message_Missing_Message.GetEventEnableCondition
        OpEventGetEventEnableCondition_GetEventEnableCondition_EvtInfo_Radar_Platform_Time_System_Programming_Failure: start-on-event=DemSatellite_Invalid_OsApplicationInternalBehavior/GetEventEnableCondition, operation=EvtInfo_Radar_Platform_Time_System_Programming_Failure.GetEventEnableCondition
        OpEventGetEventEnableCondition_GetEventEnableCondition_EvtInfo_OEL_message_Turn_Signal_Switch_Invalid_Serial_Data_Received: start-on-event=DemSatellite_Invalid_OsApplicationInternalBehavior/GetEventEnableCondition, operation=EvtInfo_OEL_message_Turn_Signal_Switch_Invalid_Serial_Data_Received.GetEventEnableCondition
        OpEventGetEventEnableCondition_GetEventEnableCondition_EvtInfo_Radar_calibration_Calibration_or_Paramater_Memory_Failure: start-on-event=DemSatellite_Invalid_OsApplicationInternalBehavior/GetEventEnableCondition, operation=EvtInfo_Radar_calibration_Calibration_or_Paramater_Memory_Failure.GetEventEnableCondition
        OpEventGetEventEnableCondition_GetEventEnableCondition_GeneralEvtInfo: start-on-event=DemSatellite_Invalid_OsApplicationInternalBehavior/GetEventEnableCondition, operation=GeneralEvtInfo.GetEventEnableCondition
        OpEventGetDebouncingOfEvent_GetDebouncingOfEvent_EvtInfo_SAS_message_Steering_Wheel_Angle_Invalid_Serial_Data_Received: start-on-event=DemSatellite_Invalid_OsApplicationInternalBehavior/GetDebouncingOfEvent, operation=EvtInfo_SAS_message_Steering_Wheel_Angle_Invalid_Serial_Data_Received.GetDebouncingOfEvent
        OpEventGetDebouncingOfEvent_GetDebouncingOfEvent_EvtInfo_AT_AMT_ETC2_message_Transcurrent_gear_Invalid_Serial_Data_Received: start-on-event=DemSatellite_Invalid_OsApplicationInternalBehavior/GetDebouncingOfEvent, operation=EvtInfo_AT_AMT_ETC2_message_Transcurrent_gear_Invalid_Serial_Data_Received.GetDebouncingOfEvent
        OpEventGetDebouncingOfEvent_GetDebouncingOfEvent_EvtInfo_Radar_AutoAlignment_Algorithm_Signal_Calculation_Failure: start-on-event=DemSatellite_Invalid_OsApplicationInternalBehavior/GetDebouncingOfEvent, operation=EvtInfo_Radar_AutoAlignment_Algorithm_Signal_Calculation_Failure.GetDebouncingOfEvent
        OpEventGetDebouncingOfEvent_GetDebouncingOfEvent_EvtInfo_Vehicle_DataSet_Not_Configured: start-on-event=DemSatellite_Invalid_OsApplicationInternalBehavior/GetDebouncingOfEvent, operation=EvtInfo_Vehicle_DataSet_Not_Configured.GetDebouncingOfEvent
        OpEventGetDebouncingOfEvent_GetDebouncingOfEvent_EvtInfo_Radar_Module_System_Internal_Failure: start-on-event=DemSatellite_Invalid_OsApplicationInternalBehavior/GetDebouncingOfEvent, operation=EvtInfo_Radar_Module_System_Internal_Failure.GetDebouncingOfEvent
        OpEventGetDebouncingOfEvent_GetDebouncingOfEvent_EvtInfo_Radar_MMIC_Component_Failure: start-on-event=DemSatellite_Invalid_OsApplicationInternalBehavior/GetDebouncingOfEvent, operation=EvtInfo_Radar_MMIC_Component_Failure.GetDebouncingOfEvent
        OpEventGetDebouncingOfEvent_GetDebouncingOfEvent_EvtInfo_Radar_Module_General_Memory_Failure: start-on-event=DemSatellite_Invalid_OsApplicationInternalBehavior/GetDebouncingOfEvent, operation=EvtInfo_Radar_Module_General_Memory_Failure.GetDebouncingOfEvent
        OpEventGetDebouncingOfEvent_GetDebouncingOfEvent_EvtInfo_Radar_System_Battery_High_Voltage_System_Voltage_High: start-on-event=DemSatellite_Invalid_OsApplicationInternalBehavior/GetDebouncingOfEvent, operation=EvtInfo_Radar_System_Battery_High_Voltage_System_Voltage_High.GetDebouncingOfEvent
        OpEventGetDebouncingOfEvent_GetDebouncingOfEvent_EvtInfo_CCVS1_message_Vehicle_Speed_Invalid_Serial_Data_Received: start-on-event=DemSatellite_Invalid_OsApplicationInternalBehavior/GetDebouncingOfEvent, operation=EvtInfo_CCVS1_message_Vehicle_Speed_Invalid_Serial_Data_Received.GetDebouncingOfEvent
        OpEventGetDebouncingOfEvent_GetDebouncingOfEvent_EvtInfo_EMS_ECU_VD_erratic_communication_Erratic: start-on-event=DemSatellite_Invalid_OsApplicationInternalBehavior/GetDebouncingOfEvent, operation=EvtInfo_EMS_ECU_VD_erratic_communication_Erratic.GetDebouncingOfEvent
        OpEventGetDebouncingOfEvent_GetDebouncingOfEvent_EvtInfo_EMS_ECU_ETC2_00_message_Missing_Message: start-on-event=DemSatellite_Invalid_OsApplicationInternalBehavior/GetDebouncingOfEvent, operation=EvtInfo_EMS_ECU_ETC2_00_message_Missing_Message.GetDebouncingOfEvent
        OpEventGetDebouncingOfEvent_GetDebouncingOfEvent_EvtInfo_Cluster_ECU_CLS_Tx_16_message_Missing_Message: start-on-event=DemSatellite_Invalid_OsApplicationInternalBehavior/GetDebouncingOfEvent, operation=EvtInfo_Cluster_ECU_CLS_Tx_16_message_Missing_Message.GetDebouncingOfEvent
        OpEventGetDebouncingOfEvent_GetDebouncingOfEvent_EvtInfo_Exceeded_Security_Access_0x27_Attempt_Threshold_Authentication_Failure: start-on-event=DemSatellite_Invalid_OsApplicationInternalBehavior/GetDebouncingOfEvent, operation=EvtInfo_Exceeded_Security_Access_0x27_Attempt_Threshold_Authentication_Failure.GetDebouncingOfEvent
        OpEventGetDebouncingOfEvent_GetDebouncingOfEvent_EvtInfo_Front_Left_Side_Radar_value_of_signal_protection_calculation_Incorrect: start-on-event=DemSatellite_Invalid_OsApplicationInternalBehavior/GetDebouncingOfEvent, operation=EvtInfo_Front_Left_Side_Radar_value_of_signal_protection_calculation_Incorrect.GetDebouncingOfEvent
        OpEventGetDebouncingOfEvent_GetDebouncingOfEvent_EvtInfo_AT_AMT_ETC2_erratic_communication_Erratic: start-on-event=DemSatellite_Invalid_OsApplicationInternalBehavior/GetDebouncingOfEvent, operation=EvtInfo_AT_AMT_ETC2_erratic_communication_Erratic.GetDebouncingOfEvent
        OpEventGetDebouncingOfEvent_GetDebouncingOfEvent_EvtInfo_VCAN_Communication_Bus_Off: start-on-event=DemSatellite_Invalid_OsApplicationInternalBehavior/GetDebouncingOfEvent, operation=EvtInfo_VCAN_Communication_Bus_Off.GetDebouncingOfEvent
        OpEventGetDebouncingOfEvent_GetDebouncingOfEvent_EvtInfo_VDC2_message_LongitudinalAcceleration_Invalid_Serial_Data_Received: start-on-event=DemSatellite_Invalid_OsApplicationInternalBehavior/GetDebouncingOfEvent, operation=EvtInfo_VDC2_message_LongitudinalAcceleration_Invalid_Serial_Data_Received.GetDebouncingOfEvent
        OpEventGetDebouncingOfEvent_GetDebouncingOfEvent_EvtInfo_Radar_MMIC_RFBIST_Component_Internal_Failure: start-on-event=DemSatellite_Invalid_OsApplicationInternalBehavior/GetDebouncingOfEvent, operation=EvtInfo_Radar_MMIC_RFBIST_Component_Internal_Failure.GetDebouncingOfEvent
        OpEventGetDebouncingOfEvent_GetDebouncingOfEvent_EvtInfo_Radar_Initial_Alignment_Missing_Calibration: start-on-event=DemSatellite_Invalid_OsApplicationInternalBehavior/GetDebouncingOfEvent, operation=EvtInfo_Radar_Initial_Alignment_Missing_Calibration.GetDebouncingOfEvent
        OpEventGetDebouncingOfEvent_GetDebouncingOfEvent_EvtInfo_Cluster_ECU_OEL_message_Missing_Message: start-on-event=DemSatellite_Invalid_OsApplicationInternalBehavior/GetDebouncingOfEvent, operation=EvtInfo_Cluster_ECU_OEL_message_Missing_Message.GetDebouncingOfEvent
        OpEventGetDebouncingOfEvent_GetDebouncingOfEvent_EvtInfo_AT_AMT_ECU_ETC2_03_message_Missing_Message: start-on-event=DemSatellite_Invalid_OsApplicationInternalBehavior/GetDebouncingOfEvent, operation=EvtInfo_AT_AMT_ECU_ETC2_03_message_Missing_Message.GetDebouncingOfEvent
        OpEventGetDebouncingOfEvent_GetDebouncingOfEvent_EvtInfo_ADAS_FN_STS_message_MOIS_FN_Switch_STS_Invalid_Serial_Data_Received: start-on-event=DemSatellite_Invalid_OsApplicationInternalBehavior/GetDebouncingOfEvent, operation=EvtInfo_ADAS_FN_STS_message_MOIS_FN_Switch_STS_Invalid_Serial_Data_Received.GetDebouncingOfEvent
        OpEventGetDebouncingOfEvent_GetDebouncingOfEvent_EvtInfo_Radar_Module_Over_Temperature: start-on-event=DemSatellite_Invalid_OsApplicationInternalBehavior/GetDebouncingOfEvent, operation=EvtInfo_Radar_Module_Over_Temperature.GetDebouncingOfEvent
        OpEventGetDebouncingOfEvent_GetDebouncingOfEvent_EvtInfo_PCAN_TimeSync_Missing_Message: start-on-event=DemSatellite_Invalid_OsApplicationInternalBehavior/GetDebouncingOfEvent, operation=EvtInfo_PCAN_TimeSync_Missing_Message.GetDebouncingOfEvent
        OpEventGetDebouncingOfEvent_GetDebouncingOfEvent_EvtInfo_Radar_Module_Watchdog_Failure: start-on-event=DemSatellite_Invalid_OsApplicationInternalBehavior/GetDebouncingOfEvent, operation=EvtInfo_Radar_Module_Watchdog_Failure.GetDebouncingOfEvent
        OpEventGetDebouncingOfEvent_GetDebouncingOfEvent_EvtInfo_SAS_ECU_SAS_message_Missing_Message: start-on-event=DemSatellite_Invalid_OsApplicationInternalBehavior/GetDebouncingOfEvent, operation=EvtInfo_SAS_ECU_SAS_message_Missing_Message.GetDebouncingOfEvent
        OpEventGetDebouncingOfEvent_GetDebouncingOfEvent_EvtInfo_ECU_NVM_Corruption_Program_memory_Failure: start-on-event=DemSatellite_Invalid_OsApplicationInternalBehavior/GetDebouncingOfEvent, operation=EvtInfo_ECU_NVM_Corruption_Program_memory_Failure.GetDebouncingOfEvent
        OpEventGetDebouncingOfEvent_GetDebouncingOfEvent_EvtInfo_Cluster_ECU_TD_message_Missing_Message: start-on-event=DemSatellite_Invalid_OsApplicationInternalBehavior/GetDebouncingOfEvent, operation=EvtInfo_Cluster_ECU_TD_message_Missing_Message.GetDebouncingOfEvent
        OpEventGetDebouncingOfEvent_GetDebouncingOfEvent_EvtInfo_PCAN_Communication_Bus_Off: start-on-event=DemSatellite_Invalid_OsApplicationInternalBehavior/GetDebouncingOfEvent, operation=EvtInfo_PCAN_Communication_Bus_Off.GetDebouncingOfEvent
        OpEventGetDebouncingOfEvent_GetDebouncingOfEvent_EvtInfo_Front_Left_Side_Radar_Missing_Message: start-on-event=DemSatellite_Invalid_OsApplicationInternalBehavior/GetDebouncingOfEvent, operation=EvtInfo_Front_Left_Side_Radar_Missing_Message.GetDebouncingOfEvent
        OpEventGetDebouncingOfEvent_GetDebouncingOfEvent_EvtInfo_Manual_ETC2_message_Transcurrent_gear_Invalid_Serial_Data_Received: start-on-event=DemSatellite_Invalid_OsApplicationInternalBehavior/GetDebouncingOfEvent, operation=EvtInfo_Manual_ETC2_message_Transcurrent_gear_Invalid_Serial_Data_Received.GetDebouncingOfEvent
        OpEventGetDebouncingOfEvent_GetDebouncingOfEvent_EvtInfo_SAS_ECU_erratic_communication_Erratic: start-on-event=DemSatellite_Invalid_OsApplicationInternalBehavior/GetDebouncingOfEvent, operation=EvtInfo_SAS_ECU_erratic_communication_Erratic.GetDebouncingOfEvent
        OpEventGetDebouncingOfEvent_GetDebouncingOfEvent_EvtInfo_VDC2_message_Yaw_rate_Invalid_Serial_Data_Received: start-on-event=DemSatellite_Invalid_OsApplicationInternalBehavior/GetDebouncingOfEvent, operation=EvtInfo_VDC2_message_Yaw_rate_Invalid_Serial_Data_Received.GetDebouncingOfEvent
        OpEventGetDebouncingOfEvent_GetDebouncingOfEvent_EvtInfo_Cluster_ECU_TD_erratic_communication_Erratic: start-on-event=DemSatellite_Invalid_OsApplicationInternalBehavior/GetDebouncingOfEvent, operation=EvtInfo_Cluster_ECU_TD_erratic_communication_Erratic.GetDebouncingOfEvent
        OpEventGetDebouncingOfEvent_GetDebouncingOfEvent_EvtInfo_EMS_ECU_CCVS1_message_Missing_Message: start-on-event=DemSatellite_Invalid_OsApplicationInternalBehavior/GetDebouncingOfEvent, operation=EvtInfo_EMS_ECU_CCVS1_message_Missing_Message.GetDebouncingOfEvent
        OpEventGetDebouncingOfEvent_GetDebouncingOfEvent_EvtInfo_Radar_Mounting_Orientation_Incorrect_Assembly: start-on-event=DemSatellite_Invalid_OsApplicationInternalBehavior/GetDebouncingOfEvent, operation=EvtInfo_Radar_Mounting_Orientation_Incorrect_Assembly.GetDebouncingOfEvent
        OpEventGetDebouncingOfEvent_GetDebouncingOfEvent_EvtInfo_EMS_ECU_ETC2_erratic_communication_Erractic: start-on-event=DemSatellite_Invalid_OsApplicationInternalBehavior/GetDebouncingOfEvent, operation=EvtInfo_EMS_ECU_ETC2_erratic_communication_Erractic.GetDebouncingOfEvent
        OpEventGetDebouncingOfEvent_GetDebouncingOfEvent_EvtInfo_Cluster_ECU_ADAS_FN_STS_erratic_communication_Erratic: start-on-event=DemSatellite_Invalid_OsApplicationInternalBehavior/GetDebouncingOfEvent, operation=EvtInfo_Cluster_ECU_ADAS_FN_STS_erratic_communication_Erratic.GetDebouncingOfEvent
        OpEventGetDebouncingOfEvent_GetDebouncingOfEvent_EvtInfo_ESC_ECU_VDC2_message_Missing_Message: start-on-event=DemSatellite_Invalid_OsApplicationInternalBehavior/GetDebouncingOfEvent, operation=EvtInfo_ESC_ECU_VDC2_message_Missing_Message.GetDebouncingOfEvent
        OpEventGetDebouncingOfEvent_GetDebouncingOfEvent_EvtInfo_CLS_TX_16_message_Transmission_Type_info_Invalid_Serial_Data_Received: start-on-event=DemSatellite_Invalid_OsApplicationInternalBehavior/GetDebouncingOfEvent, operation=EvtInfo_CLS_TX_16_message_Transmission_Type_info_Invalid_Serial_Data_Received.GetDebouncingOfEvent
        OpEventGetDebouncingOfEvent_GetDebouncingOfEvent_EvtInfo_Cluster_ECU_CLS_Tx_4_erratic_communication_Erratic: start-on-event=DemSatellite_Invalid_OsApplicationInternalBehavior/GetDebouncingOfEvent, operation=EvtInfo_Cluster_ECU_CLS_Tx_4_erratic_communication_Erratic.GetDebouncingOfEvent
        OpEventGetDebouncingOfEvent_GetDebouncingOfEvent_EvtInfo_Cluster_ECU_ADAS_FN_STS_message_Missing_Message: start-on-event=DemSatellite_Invalid_OsApplicationInternalBehavior/GetDebouncingOfEvent, operation=EvtInfo_Cluster_ECU_ADAS_FN_STS_message_Missing_Message.GetDebouncingOfEvent
        OpEventGetDebouncingOfEvent_GetDebouncingOfEvent_EvtInfo_Vehicle_Dataset_value_of_signal_protection_calculation_Incorrect: start-on-event=DemSatellite_Invalid_OsApplicationInternalBehavior/GetDebouncingOfEvent, operation=EvtInfo_Vehicle_Dataset_value_of_signal_protection_calculation_Incorrect.GetDebouncingOfEvent
        OpEventGetDebouncingOfEvent_GetDebouncingOfEvent_EvtInfo_Cluster_ECU_CLS_Tx_16_erratic_communication_Erratic: start-on-event=DemSatellite_Invalid_OsApplicationInternalBehavior/GetDebouncingOfEvent, operation=EvtInfo_Cluster_ECU_CLS_Tx_16_erratic_communication_Erratic.GetDebouncingOfEvent
        OpEventGetDebouncingOfEvent_GetDebouncingOfEvent_EvtInfo_Cluster_ECU_OEL_erratic_communication_Erratic: start-on-event=DemSatellite_Invalid_OsApplicationInternalBehavior/GetDebouncingOfEvent, operation=EvtInfo_Cluster_ECU_OEL_erratic_communication_Erratic.GetDebouncingOfEvent
        OpEventGetDebouncingOfEvent_GetDebouncingOfEvent_EvtInfo_Cluster_ECU_CLS_Tx_4_message_Missing_Message: start-on-event=DemSatellite_Invalid_OsApplicationInternalBehavior/GetDebouncingOfEvent, operation=EvtInfo_Cluster_ECU_CLS_Tx_4_message_Missing_Message.GetDebouncingOfEvent
        OpEventGetDebouncingOfEvent_GetDebouncingOfEvent_EvtInfo_Radar_Performance_Capability_Algorithm_Based_Failure: start-on-event=DemSatellite_Invalid_OsApplicationInternalBehavior/GetDebouncingOfEvent, operation=EvtInfo_Radar_Performance_Capability_Algorithm_Based_Failure.GetDebouncingOfEvent
        OpEventGetDebouncingOfEvent_GetDebouncingOfEvent_EvtInfo_Radar_AutoAlignment_Range_Alignment_or_Adjustement_Incorrect: start-on-event=DemSatellite_Invalid_OsApplicationInternalBehavior/GetDebouncingOfEvent, operation=EvtInfo_Radar_AutoAlignment_Range_Alignment_or_Adjustement_Incorrect.GetDebouncingOfEvent
        OpEventGetDebouncingOfEvent_GetDebouncingOfEvent_EvtInfo_EMS_ECU_CCVS1_erratic_communication_Erractic: start-on-event=DemSatellite_Invalid_OsApplicationInternalBehavior/GetDebouncingOfEvent, operation=EvtInfo_EMS_ECU_CCVS1_erratic_communication_Erractic.GetDebouncingOfEvent
        OpEventGetDebouncingOfEvent_GetDebouncingOfEvent_EvtInfo_Radar_System_Battery_Low_Voltage_System_Voltage_Low: start-on-event=DemSatellite_Invalid_OsApplicationInternalBehavior/GetDebouncingOfEvent, operation=EvtInfo_Radar_System_Battery_Low_Voltage_System_Voltage_Low.GetDebouncingOfEvent
        OpEventGetDebouncingOfEvent_GetDebouncingOfEvent_EvtInfo_Radar_SMC_General_Checksum_Failure: start-on-event=DemSatellite_Invalid_OsApplicationInternalBehavior/GetDebouncingOfEvent, operation=EvtInfo_Radar_SMC_General_Checksum_Failure.GetDebouncingOfEvent
        OpEventGetDebouncingOfEvent_GetDebouncingOfEvent_EvtInfo_Radar_Pin_Position_Wrong_Mounting_Position: start-on-event=DemSatellite_Invalid_OsApplicationInternalBehavior/GetDebouncingOfEvent, operation=EvtInfo_Radar_Pin_Position_Wrong_Mounting_Position.GetDebouncingOfEvent
        OpEventGetDebouncingOfEvent_GetDebouncingOfEvent_EvtInfo_VDC2_message_Lateral_Accleration_Invalid_Serial_Data_Received: start-on-event=DemSatellite_Invalid_OsApplicationInternalBehavior/GetDebouncingOfEvent, operation=EvtInfo_VDC2_message_Lateral_Accleration_Invalid_Serial_Data_Received.GetDebouncingOfEvent
        OpEventGetDebouncingOfEvent_GetDebouncingOfEvent_EvtInfo_ADAS_FN_STS_message_BSIS_FN_Switch_STS_Invalid_Serial_Data_Received: start-on-event=DemSatellite_Invalid_OsApplicationInternalBehavior/GetDebouncingOfEvent, operation=EvtInfo_ADAS_FN_STS_message_BSIS_FN_Switch_STS_Invalid_Serial_Data_Received.GetDebouncingOfEvent
        OpEventGetDebouncingOfEvent_GetDebouncingOfEvent_EvtInfo_Radar_AutoAlignment_Misalignment_Performance_or_Incorrect_Operation: start-on-event=DemSatellite_Invalid_OsApplicationInternalBehavior/GetDebouncingOfEvent, operation=EvtInfo_Radar_AutoAlignment_Misalignment_Performance_or_Incorrect_Operation.GetDebouncingOfEvent
        OpEventGetDebouncingOfEvent_GetDebouncingOfEvent_EvtInfo_ESC_ECU_VDC2_erratic_communication_Erratic: start-on-event=DemSatellite_Invalid_OsApplicationInternalBehavior/GetDebouncingOfEvent, operation=EvtInfo_ESC_ECU_VDC2_erratic_communication_Erratic.GetDebouncingOfEvent
        OpEventGetDebouncingOfEvent_GetDebouncingOfEvent_EvtInfo_Application_Interface_Lookup_Performance_or_Incorrect_Operation: start-on-event=DemSatellite_Invalid_OsApplicationInternalBehavior/GetDebouncingOfEvent, operation=EvtInfo_Application_Interface_Lookup_Performance_or_Incorrect_Operation.GetDebouncingOfEvent
        OpEventGetDebouncingOfEvent_GetDebouncingOfEvent_EvtInfo_EMS_ECU_VD_message_Missing_Message: start-on-event=DemSatellite_Invalid_OsApplicationInternalBehavior/GetDebouncingOfEvent, operation=EvtInfo_EMS_ECU_VD_message_Missing_Message.GetDebouncingOfEvent
        OpEventGetDebouncingOfEvent_GetDebouncingOfEvent_EvtInfo_Radar_Platform_Time_System_Programming_Failure: start-on-event=DemSatellite_Invalid_OsApplicationInternalBehavior/GetDebouncingOfEvent, operation=EvtInfo_Radar_Platform_Time_System_Programming_Failure.GetDebouncingOfEvent
        OpEventGetDebouncingOfEvent_GetDebouncingOfEvent_EvtInfo_OEL_message_Turn_Signal_Switch_Invalid_Serial_Data_Received: start-on-event=DemSatellite_Invalid_OsApplicationInternalBehavior/GetDebouncingOfEvent, operation=EvtInfo_OEL_message_Turn_Signal_Switch_Invalid_Serial_Data_Received.GetDebouncingOfEvent
        OpEventGetDebouncingOfEvent_GetDebouncingOfEvent_EvtInfo_Radar_calibration_Calibration_or_Paramater_Memory_Failure: start-on-event=DemSatellite_Invalid_OsApplicationInternalBehavior/GetDebouncingOfEvent, operation=EvtInfo_Radar_calibration_Calibration_or_Paramater_Memory_Failure.GetDebouncingOfEvent
        OpEventGetDebouncingOfEvent_GetDebouncingOfEvent_GeneralEvtInfo: start-on-event=DemSatellite_Invalid_OsApplicationInternalBehavior/GetDebouncingOfEvent, operation=GeneralEvtInfo.GetDebouncingOfEvent
        OpEventGetMonitorStatus_GetMonitorStatus_EvtInfo_SAS_message_Steering_Wheel_Angle_Invalid_Serial_Data_Received: start-on-event=DemSatellite_Invalid_OsApplicationInternalBehavior/GetMonitorStatus, operation=EvtInfo_SAS_message_Steering_Wheel_Angle_Invalid_Serial_Data_Received.GetMonitorStatus
        OpEventGetMonitorStatus_GetMonitorStatus_EvtInfo_AT_AMT_ETC2_message_Transcurrent_gear_Invalid_Serial_Data_Received: start-on-event=DemSatellite_Invalid_OsApplicationInternalBehavior/GetMonitorStatus, operation=EvtInfo_AT_AMT_ETC2_message_Transcurrent_gear_Invalid_Serial_Data_Received.GetMonitorStatus
        OpEventGetMonitorStatus_GetMonitorStatus_EvtInfo_Radar_AutoAlignment_Algorithm_Signal_Calculation_Failure: start-on-event=DemSatellite_Invalid_OsApplicationInternalBehavior/GetMonitorStatus, operation=EvtInfo_Radar_AutoAlignment_Algorithm_Signal_Calculation_Failure.GetMonitorStatus
        OpEventGetMonitorStatus_GetMonitorStatus_EvtInfo_Vehicle_DataSet_Not_Configured: start-on-event=DemSatellite_Invalid_OsApplicationInternalBehavior/GetMonitorStatus, operation=EvtInfo_Vehicle_DataSet_Not_Configured.GetMonitorStatus
        OpEventGetMonitorStatus_GetMonitorStatus_EvtInfo_Radar_Module_System_Internal_Failure: start-on-event=DemSatellite_Invalid_OsApplicationInternalBehavior/GetMonitorStatus, operation=EvtInfo_Radar_Module_System_Internal_Failure.GetMonitorStatus
        OpEventGetMonitorStatus_GetMonitorStatus_EvtInfo_Radar_MMIC_Component_Failure: start-on-event=DemSatellite_Invalid_OsApplicationInternalBehavior/GetMonitorStatus, operation=EvtInfo_Radar_MMIC_Component_Failure.GetMonitorStatus
        OpEventGetMonitorStatus_GetMonitorStatus_EvtInfo_Radar_Module_General_Memory_Failure: start-on-event=DemSatellite_Invalid_OsApplicationInternalBehavior/GetMonitorStatus, operation=EvtInfo_Radar_Module_General_Memory_Failure.GetMonitorStatus
        OpEventGetMonitorStatus_GetMonitorStatus_EvtInfo_Radar_System_Battery_High_Voltage_System_Voltage_High: start-on-event=DemSatellite_Invalid_OsApplicationInternalBehavior/GetMonitorStatus, operation=EvtInfo_Radar_System_Battery_High_Voltage_System_Voltage_High.GetMonitorStatus
        OpEventGetMonitorStatus_GetMonitorStatus_EvtInfo_CCVS1_message_Vehicle_Speed_Invalid_Serial_Data_Received: start-on-event=DemSatellite_Invalid_OsApplicationInternalBehavior/GetMonitorStatus, operation=EvtInfo_CCVS1_message_Vehicle_Speed_Invalid_Serial_Data_Received.GetMonitorStatus
        OpEventGetMonitorStatus_GetMonitorStatus_EvtInfo_EMS_ECU_VD_erratic_communication_Erratic: start-on-event=DemSatellite_Invalid_OsApplicationInternalBehavior/GetMonitorStatus, operation=EvtInfo_EMS_ECU_VD_erratic_communication_Erratic.GetMonitorStatus
        OpEventGetMonitorStatus_GetMonitorStatus_EvtInfo_EMS_ECU_ETC2_00_message_Missing_Message: start-on-event=DemSatellite_Invalid_OsApplicationInternalBehavior/GetMonitorStatus, operation=EvtInfo_EMS_ECU_ETC2_00_message_Missing_Message.GetMonitorStatus
        OpEventGetMonitorStatus_GetMonitorStatus_EvtInfo_Cluster_ECU_CLS_Tx_16_message_Missing_Message: start-on-event=DemSatellite_Invalid_OsApplicationInternalBehavior/GetMonitorStatus, operation=EvtInfo_Cluster_ECU_CLS_Tx_16_message_Missing_Message.GetMonitorStatus
        OpEventGetMonitorStatus_GetMonitorStatus_EvtInfo_Exceeded_Security_Access_0x27_Attempt_Threshold_Authentication_Failure: start-on-event=DemSatellite_Invalid_OsApplicationInternalBehavior/GetMonitorStatus, operation=EvtInfo_Exceeded_Security_Access_0x27_Attempt_Threshold_Authentication_Failure.GetMonitorStatus
        OpEventGetMonitorStatus_GetMonitorStatus_EvtInfo_Front_Left_Side_Radar_value_of_signal_protection_calculation_Incorrect: start-on-event=DemSatellite_Invalid_OsApplicationInternalBehavior/GetMonitorStatus, operation=EvtInfo_Front_Left_Side_Radar_value_of_signal_protection_calculation_Incorrect.GetMonitorStatus
        OpEventGetMonitorStatus_GetMonitorStatus_EvtInfo_AT_AMT_ETC2_erratic_communication_Erratic: start-on-event=DemSatellite_Invalid_OsApplicationInternalBehavior/GetMonitorStatus, operation=EvtInfo_AT_AMT_ETC2_erratic_communication_Erratic.GetMonitorStatus
        OpEventGetMonitorStatus_GetMonitorStatus_EvtInfo_VCAN_Communication_Bus_Off: start-on-event=DemSatellite_Invalid_OsApplicationInternalBehavior/GetMonitorStatus, operation=EvtInfo_VCAN_Communication_Bus_Off.GetMonitorStatus
        OpEventGetMonitorStatus_GetMonitorStatus_EvtInfo_VDC2_message_LongitudinalAcceleration_Invalid_Serial_Data_Received: start-on-event=DemSatellite_Invalid_OsApplicationInternalBehavior/GetMonitorStatus, operation=EvtInfo_VDC2_message_LongitudinalAcceleration_Invalid_Serial_Data_Received.GetMonitorStatus
        OpEventGetMonitorStatus_GetMonitorStatus_EvtInfo_Radar_MMIC_RFBIST_Component_Internal_Failure: start-on-event=DemSatellite_Invalid_OsApplicationInternalBehavior/GetMonitorStatus, operation=EvtInfo_Radar_MMIC_RFBIST_Component_Internal_Failure.GetMonitorStatus
        OpEventGetMonitorStatus_GetMonitorStatus_EvtInfo_Radar_Initial_Alignment_Missing_Calibration: start-on-event=DemSatellite_Invalid_OsApplicationInternalBehavior/GetMonitorStatus, operation=EvtInfo_Radar_Initial_Alignment_Missing_Calibration.GetMonitorStatus
        OpEventGetMonitorStatus_GetMonitorStatus_EvtInfo_Cluster_ECU_OEL_message_Missing_Message: start-on-event=DemSatellite_Invalid_OsApplicationInternalBehavior/GetMonitorStatus, operation=EvtInfo_Cluster_ECU_OEL_message_Missing_Message.GetMonitorStatus
        OpEventGetMonitorStatus_GetMonitorStatus_EvtInfo_AT_AMT_ECU_ETC2_03_message_Missing_Message: start-on-event=DemSatellite_Invalid_OsApplicationInternalBehavior/GetMonitorStatus, operation=EvtInfo_AT_AMT_ECU_ETC2_03_message_Missing_Message.GetMonitorStatus
        OpEventGetMonitorStatus_GetMonitorStatus_EvtInfo_ADAS_FN_STS_message_MOIS_FN_Switch_STS_Invalid_Serial_Data_Received: start-on-event=DemSatellite_Invalid_OsApplicationInternalBehavior/GetMonitorStatus, operation=EvtInfo_ADAS_FN_STS_message_MOIS_FN_Switch_STS_Invalid_Serial_Data_Received.GetMonitorStatus
        OpEventGetMonitorStatus_GetMonitorStatus_EvtInfo_Radar_Module_Over_Temperature: start-on-event=DemSatellite_Invalid_OsApplicationInternalBehavior/GetMonitorStatus, operation=EvtInfo_Radar_Module_Over_Temperature.GetMonitorStatus
        OpEventGetMonitorStatus_GetMonitorStatus_EvtInfo_PCAN_TimeSync_Missing_Message: start-on-event=DemSatellite_Invalid_OsApplicationInternalBehavior/GetMonitorStatus, operation=EvtInfo_PCAN_TimeSync_Missing_Message.GetMonitorStatus
        OpEventGetMonitorStatus_GetMonitorStatus_EvtInfo_Radar_Module_Watchdog_Failure: start-on-event=DemSatellite_Invalid_OsApplicationInternalBehavior/GetMonitorStatus, operation=EvtInfo_Radar_Module_Watchdog_Failure.GetMonitorStatus
        OpEventGetMonitorStatus_GetMonitorStatus_EvtInfo_SAS_ECU_SAS_message_Missing_Message: start-on-event=DemSatellite_Invalid_OsApplicationInternalBehavior/GetMonitorStatus, operation=EvtInfo_SAS_ECU_SAS_message_Missing_Message.GetMonitorStatus
        OpEventGetMonitorStatus_GetMonitorStatus_EvtInfo_ECU_NVM_Corruption_Program_memory_Failure: start-on-event=DemSatellite_Invalid_OsApplicationInternalBehavior/GetMonitorStatus, operation=EvtInfo_ECU_NVM_Corruption_Program_memory_Failure.GetMonitorStatus
        OpEventGetMonitorStatus_GetMonitorStatus_EvtInfo_Cluster_ECU_TD_message_Missing_Message: start-on-event=DemSatellite_Invalid_OsApplicationInternalBehavior/GetMonitorStatus, operation=EvtInfo_Cluster_ECU_TD_message_Missing_Message.GetMonitorStatus
        OpEventGetMonitorStatus_GetMonitorStatus_EvtInfo_PCAN_Communication_Bus_Off: start-on-event=DemSatellite_Invalid_OsApplicationInternalBehavior/GetMonitorStatus, operation=EvtInfo_PCAN_Communication_Bus_Off.GetMonitorStatus
        OpEventGetMonitorStatus_GetMonitorStatus_EvtInfo_Front_Left_Side_Radar_Missing_Message: start-on-event=DemSatellite_Invalid_OsApplicationInternalBehavior/GetMonitorStatus, operation=EvtInfo_Front_Left_Side_Radar_Missing_Message.GetMonitorStatus
        OpEventGetMonitorStatus_GetMonitorStatus_EvtInfo_Manual_ETC2_message_Transcurrent_gear_Invalid_Serial_Data_Received: start-on-event=DemSatellite_Invalid_OsApplicationInternalBehavior/GetMonitorStatus, operation=EvtInfo_Manual_ETC2_message_Transcurrent_gear_Invalid_Serial_Data_Received.GetMonitorStatus
        OpEventGetMonitorStatus_GetMonitorStatus_EvtInfo_SAS_ECU_erratic_communication_Erratic: start-on-event=DemSatellite_Invalid_OsApplicationInternalBehavior/GetMonitorStatus, operation=EvtInfo_SAS_ECU_erratic_communication_Erratic.GetMonitorStatus
        OpEventGetMonitorStatus_GetMonitorStatus_EvtInfo_VDC2_message_Yaw_rate_Invalid_Serial_Data_Received: start-on-event=DemSatellite_Invalid_OsApplicationInternalBehavior/GetMonitorStatus, operation=EvtInfo_VDC2_message_Yaw_rate_Invalid_Serial_Data_Received.GetMonitorStatus
        OpEventGetMonitorStatus_GetMonitorStatus_EvtInfo_Cluster_ECU_TD_erratic_communication_Erratic: start-on-event=DemSatellite_Invalid_OsApplicationInternalBehavior/GetMonitorStatus, operation=EvtInfo_Cluster_ECU_TD_erratic_communication_Erratic.GetMonitorStatus
        OpEventGetMonitorStatus_GetMonitorStatus_EvtInfo_EMS_ECU_CCVS1_message_Missing_Message: start-on-event=DemSatellite_Invalid_OsApplicationInternalBehavior/GetMonitorStatus, operation=EvtInfo_EMS_ECU_CCVS1_message_Missing_Message.GetMonitorStatus
        OpEventGetMonitorStatus_GetMonitorStatus_EvtInfo_Radar_Mounting_Orientation_Incorrect_Assembly: start-on-event=DemSatellite_Invalid_OsApplicationInternalBehavior/GetMonitorStatus, operation=EvtInfo_Radar_Mounting_Orientation_Incorrect_Assembly.GetMonitorStatus
        OpEventGetMonitorStatus_GetMonitorStatus_EvtInfo_EMS_ECU_ETC2_erratic_communication_Erractic: start-on-event=DemSatellite_Invalid_OsApplicationInternalBehavior/GetMonitorStatus, operation=EvtInfo_EMS_ECU_ETC2_erratic_communication_Erractic.GetMonitorStatus
        OpEventGetMonitorStatus_GetMonitorStatus_EvtInfo_Cluster_ECU_ADAS_FN_STS_erratic_communication_Erratic: start-on-event=DemSatellite_Invalid_OsApplicationInternalBehavior/GetMonitorStatus, operation=EvtInfo_Cluster_ECU_ADAS_FN_STS_erratic_communication_Erratic.GetMonitorStatus
        OpEventGetMonitorStatus_GetMonitorStatus_EvtInfo_ESC_ECU_VDC2_message_Missing_Message: start-on-event=DemSatellite_Invalid_OsApplicationInternalBehavior/GetMonitorStatus, operation=EvtInfo_ESC_ECU_VDC2_message_Missing_Message.GetMonitorStatus
        OpEventGetMonitorStatus_GetMonitorStatus_EvtInfo_CLS_TX_16_message_Transmission_Type_info_Invalid_Serial_Data_Received: start-on-event=DemSatellite_Invalid_OsApplicationInternalBehavior/GetMonitorStatus, operation=EvtInfo_CLS_TX_16_message_Transmission_Type_info_Invalid_Serial_Data_Received.GetMonitorStatus
        OpEventGetMonitorStatus_GetMonitorStatus_EvtInfo_Cluster_ECU_CLS_Tx_4_erratic_communication_Erratic: start-on-event=DemSatellite_Invalid_OsApplicationInternalBehavior/GetMonitorStatus, operation=EvtInfo_Cluster_ECU_CLS_Tx_4_erratic_communication_Erratic.GetMonitorStatus
        OpEventGetMonitorStatus_GetMonitorStatus_EvtInfo_Cluster_ECU_ADAS_FN_STS_message_Missing_Message: start-on-event=DemSatellite_Invalid_OsApplicationInternalBehavior/GetMonitorStatus, operation=EvtInfo_Cluster_ECU_ADAS_FN_STS_message_Missing_Message.GetMonitorStatus
        OpEventGetMonitorStatus_GetMonitorStatus_EvtInfo_Vehicle_Dataset_value_of_signal_protection_calculation_Incorrect: start-on-event=DemSatellite_Invalid_OsApplicationInternalBehavior/GetMonitorStatus, operation=EvtInfo_Vehicle_Dataset_value_of_signal_protection_calculation_Incorrect.GetMonitorStatus
        OpEventGetMonitorStatus_GetMonitorStatus_EvtInfo_Cluster_ECU_CLS_Tx_16_erratic_communication_Erratic: start-on-event=DemSatellite_Invalid_OsApplicationInternalBehavior/GetMonitorStatus, operation=EvtInfo_Cluster_ECU_CLS_Tx_16_erratic_communication_Erratic.GetMonitorStatus
        OpEventGetMonitorStatus_GetMonitorStatus_EvtInfo_Cluster_ECU_OEL_erratic_communication_Erratic: start-on-event=DemSatellite_Invalid_OsApplicationInternalBehavior/GetMonitorStatus, operation=EvtInfo_Cluster_ECU_OEL_erratic_communication_Erratic.GetMonitorStatus
        OpEventGetMonitorStatus_GetMonitorStatus_EvtInfo_Cluster_ECU_CLS_Tx_4_message_Missing_Message: start-on-event=DemSatellite_Invalid_OsApplicationInternalBehavior/GetMonitorStatus, operation=EvtInfo_Cluster_ECU_CLS_Tx_4_message_Missing_Message.GetMonitorStatus
        OpEventGetMonitorStatus_GetMonitorStatus_EvtInfo_Radar_Performance_Capability_Algorithm_Based_Failure: start-on-event=DemSatellite_Invalid_OsApplicationInternalBehavior/GetMonitorStatus, operation=EvtInfo_Radar_Performance_Capability_Algorithm_Based_Failure.GetMonitorStatus
        OpEventGetMonitorStatus_GetMonitorStatus_EvtInfo_Radar_AutoAlignment_Range_Alignment_or_Adjustement_Incorrect: start-on-event=DemSatellite_Invalid_OsApplicationInternalBehavior/GetMonitorStatus, operation=EvtInfo_Radar_AutoAlignment_Range_Alignment_or_Adjustement_Incorrect.GetMonitorStatus
        OpEventGetMonitorStatus_GetMonitorStatus_EvtInfo_EMS_ECU_CCVS1_erratic_communication_Erractic: start-on-event=DemSatellite_Invalid_OsApplicationInternalBehavior/GetMonitorStatus, operation=EvtInfo_EMS_ECU_CCVS1_erratic_communication_Erractic.GetMonitorStatus
        OpEventGetMonitorStatus_GetMonitorStatus_EvtInfo_Radar_System_Battery_Low_Voltage_System_Voltage_Low: start-on-event=DemSatellite_Invalid_OsApplicationInternalBehavior/GetMonitorStatus, operation=EvtInfo_Radar_System_Battery_Low_Voltage_System_Voltage_Low.GetMonitorStatus
        OpEventGetMonitorStatus_GetMonitorStatus_EvtInfo_Radar_SMC_General_Checksum_Failure: start-on-event=DemSatellite_Invalid_OsApplicationInternalBehavior/GetMonitorStatus, operation=EvtInfo_Radar_SMC_General_Checksum_Failure.GetMonitorStatus
        OpEventGetMonitorStatus_GetMonitorStatus_EvtInfo_Radar_Pin_Position_Wrong_Mounting_Position: start-on-event=DemSatellite_Invalid_OsApplicationInternalBehavior/GetMonitorStatus, operation=EvtInfo_Radar_Pin_Position_Wrong_Mounting_Position.GetMonitorStatus
        OpEventGetMonitorStatus_GetMonitorStatus_EvtInfo_VDC2_message_Lateral_Accleration_Invalid_Serial_Data_Received: start-on-event=DemSatellite_Invalid_OsApplicationInternalBehavior/GetMonitorStatus, operation=EvtInfo_VDC2_message_Lateral_Accleration_Invalid_Serial_Data_Received.GetMonitorStatus
        OpEventGetMonitorStatus_GetMonitorStatus_EvtInfo_ADAS_FN_STS_message_BSIS_FN_Switch_STS_Invalid_Serial_Data_Received: start-on-event=DemSatellite_Invalid_OsApplicationInternalBehavior/GetMonitorStatus, operation=EvtInfo_ADAS_FN_STS_message_BSIS_FN_Switch_STS_Invalid_Serial_Data_Received.GetMonitorStatus
        OpEventGetMonitorStatus_GetMonitorStatus_EvtInfo_Radar_AutoAlignment_Misalignment_Performance_or_Incorrect_Operation: start-on-event=DemSatellite_Invalid_OsApplicationInternalBehavior/GetMonitorStatus, operation=EvtInfo_Radar_AutoAlignment_Misalignment_Performance_or_Incorrect_Operation.GetMonitorStatus
        OpEventGetMonitorStatus_GetMonitorStatus_EvtInfo_ESC_ECU_VDC2_erratic_communication_Erratic: start-on-event=DemSatellite_Invalid_OsApplicationInternalBehavior/GetMonitorStatus, operation=EvtInfo_ESC_ECU_VDC2_erratic_communication_Erratic.GetMonitorStatus
        OpEventGetMonitorStatus_GetMonitorStatus_EvtInfo_Application_Interface_Lookup_Performance_or_Incorrect_Operation: start-on-event=DemSatellite_Invalid_OsApplicationInternalBehavior/GetMonitorStatus, operation=EvtInfo_Application_Interface_Lookup_Performance_or_Incorrect_Operation.GetMonitorStatus
        OpEventGetMonitorStatus_GetMonitorStatus_EvtInfo_EMS_ECU_VD_message_Missing_Message: start-on-event=DemSatellite_Invalid_OsApplicationInternalBehavior/GetMonitorStatus, operation=EvtInfo_EMS_ECU_VD_message_Missing_Message.GetMonitorStatus
        OpEventGetMonitorStatus_GetMonitorStatus_EvtInfo_Radar_Platform_Time_System_Programming_Failure: start-on-event=DemSatellite_Invalid_OsApplicationInternalBehavior/GetMonitorStatus, operation=EvtInfo_Radar_Platform_Time_System_Programming_Failure.GetMonitorStatus
        OpEventGetMonitorStatus_GetMonitorStatus_EvtInfo_OEL_message_Turn_Signal_Switch_Invalid_Serial_Data_Received: start-on-event=DemSatellite_Invalid_OsApplicationInternalBehavior/GetMonitorStatus, operation=EvtInfo_OEL_message_Turn_Signal_Switch_Invalid_Serial_Data_Received.GetMonitorStatus
        OpEventGetMonitorStatus_GetMonitorStatus_EvtInfo_Radar_calibration_Calibration_or_Paramater_Memory_Failure: start-on-event=DemSatellite_Invalid_OsApplicationInternalBehavior/GetMonitorStatus, operation=EvtInfo_Radar_calibration_Calibration_or_Paramater_Memory_Failure.GetMonitorStatus
        OpEventGetMonitorStatus_GetMonitorStatus_GeneralEvtInfo: start-on-event=DemSatellite_Invalid_OsApplicationInternalBehavior/GetMonitorStatus, operation=GeneralEvtInfo.GetMonitorStatus
        OpEventSetEventStatus_SetEventStatus_Event_SAS_message_Steering_Wheel_Angle_Invalid_Serial_Data_Received: start-on-event=SetEventStatus, operation=Event_SAS_message_Steering_Wheel_Angle_Invalid_Serial_Data_Received.SetEventStatus
        OpEventSetEventStatus_SetEventStatus_Event_AT_AMT_ETC2_message_Transcurrent_gear_Invalid_Serial_Data_Received: start-on-event=SetEventStatus, operation=Event_AT_AMT_ETC2_message_Transcurrent_gear_Invalid_Serial_Data_Received.SetEventStatus
        OpEventSetEventStatus_SetEventStatus_Event_Radar_AutoAlignment_Algorithm_Signal_Calculation_Failure: start-on-event=SetEventStatus, operation=Event_Radar_AutoAlignment_Algorithm_Signal_Calculation_Failure.SetEventStatus
        OpEventSetEventStatus_SetEventStatus_Event_Vehicle_DataSet_Not_Configured: start-on-event=SetEventStatus, operation=Event_Vehicle_DataSet_Not_Configured.SetEventStatus
        OpEventSetEventStatus_SetEventStatus_Event_Radar_Module_System_Internal_Failure: start-on-event=SetEventStatus, operation=Event_Radar_Module_System_Internal_Failure.SetEventStatus
        OpEventSetEventStatus_SetEventStatus_Event_Radar_MMIC_Component_Failure: start-on-event=SetEventStatus, operation=Event_Radar_MMIC_Component_Failure.SetEventStatus
        OpEventSetEventStatus_SetEventStatus_Event_Radar_Module_General_Memory_Failure: start-on-event=SetEventStatus, operation=Event_Radar_Module_General_Memory_Failure.SetEventStatus
        OpEventSetEventStatus_SetEventStatus_Event_Radar_System_Battery_High_Voltage_System_Voltage_High: start-on-event=SetEventStatus, operation=Event_Radar_System_Battery_High_Voltage_System_Voltage_High.SetEventStatus
        OpEventSetEventStatus_SetEventStatus_Event_CCVS1_message_Vehicle_Speed_Invalid_Serial_Data_Received: start-on-event=SetEventStatus, operation=Event_CCVS1_message_Vehicle_Speed_Invalid_Serial_Data_Received.SetEventStatus
        OpEventSetEventStatus_SetEventStatus_Event_EMS_ECU_VD_erratic_communication_Erratic: start-on-event=SetEventStatus, operation=Event_EMS_ECU_VD_erratic_communication_Erratic.SetEventStatus
        OpEventSetEventStatus_SetEventStatus_Event_EMS_ECU_ETC2_00_message_Missing_Message: start-on-event=SetEventStatus, operation=Event_EMS_ECU_ETC2_00_message_Missing_Message.SetEventStatus
        OpEventSetEventStatus_SetEventStatus_Event_Cluster_ECU_CLS_Tx_16_message_Missing_Message: start-on-event=SetEventStatus, operation=Event_Cluster_ECU_CLS_Tx_16_message_Missing_Message.SetEventStatus
        OpEventSetEventStatus_SetEventStatus_Event_Exceeded_Security_Access_0x27_Attempt_Threshold_Authentication_Failure: start-on-event=SetEventStatus, operation=Event_Exceeded_Security_Access_0x27_Attempt_Threshold_Authentication_Failure.SetEventStatus
        OpEventSetEventStatus_SetEventStatus_Event_Front_Left_Side_Radar_value_of_signal_protection_calculation_Incorrect: start-on-event=SetEventStatus, operation=Event_Front_Left_Side_Radar_value_of_signal_protection_calculation_Incorrect.SetEventStatus
        OpEventSetEventStatus_SetEventStatus_Event_AT_AMT_ETC2_erratic_communication_Erratic: start-on-event=SetEventStatus, operation=Event_AT_AMT_ETC2_erratic_communication_Erratic.SetEventStatus
        OpEventSetEventStatus_SetEventStatus_Event_VCAN_Communication_Bus_Off: start-on-event=SetEventStatus, operation=Event_VCAN_Communication_Bus_Off.SetEventStatus
        OpEventSetEventStatus_SetEventStatus_Event_VDC2_message_LongitudinalAcceleration_Invalid_Serial_Data_Received: start-on-event=SetEventStatus, operation=Event_VDC2_message_LongitudinalAcceleration_Invalid_Serial_Data_Received.SetEventStatus
        OpEventSetEventStatus_SetEventStatus_Event_Radar_MMIC_RFBIST_Component_Internal_Failure: start-on-event=SetEventStatus, operation=Event_Radar_MMIC_RFBIST_Component_Internal_Failure.SetEventStatus
        OpEventSetEventStatus_SetEventStatus_Event_Radar_Initial_Alignment_Missing_Calibration: start-on-event=SetEventStatus, operation=Event_Radar_Initial_Alignment_Missing_Calibration.SetEventStatus
        OpEventSetEventStatus_SetEventStatus_Event_Cluster_ECU_OEL_message_Missing_Message: start-on-event=SetEventStatus, operation=Event_Cluster_ECU_OEL_message_Missing_Message.SetEventStatus
        OpEventSetEventStatus_SetEventStatus_Event_AT_AMT_ECU_ETC2_03_message_Missing_Message: start-on-event=SetEventStatus, operation=Event_AT_AMT_ECU_ETC2_03_message_Missing_Message.SetEventStatus
        OpEventSetEventStatus_SetEventStatus_Event_ADAS_FN_STS_message_MOIS_FN_Switch_STS_Invalid_Serial_Data_Received: start-on-event=SetEventStatus, operation=Event_ADAS_FN_STS_message_MOIS_FN_Switch_STS_Invalid_Serial_Data_Received.SetEventStatus
        OpEventSetEventStatus_SetEventStatus_Event_Radar_Module_Over_Temperature: start-on-event=SetEventStatus, operation=Event_Radar_Module_Over_Temperature.SetEventStatus
        OpEventSetEventStatus_SetEventStatus_Event_PCAN_TimeSync_Missing_Message: start-on-event=SetEventStatus, operation=Event_PCAN_TimeSync_Missing_Message.SetEventStatus
        OpEventSetEventStatus_SetEventStatus_Event_Radar_Module_Watchdog_Failure: start-on-event=SetEventStatus, operation=Event_Radar_Module_Watchdog_Failure.SetEventStatus
        OpEventSetEventStatus_SetEventStatus_Event_SAS_ECU_SAS_message_Missing_Message: start-on-event=SetEventStatus, operation=Event_SAS_ECU_SAS_message_Missing_Message.SetEventStatus
        OpEventSetEventStatus_SetEventStatus_Event_ECU_NVM_Corruption_Program_memory_Failure: start-on-event=SetEventStatus, operation=Event_ECU_NVM_Corruption_Program_memory_Failure.SetEventStatus
        OpEventSetEventStatus_SetEventStatus_Event_Cluster_ECU_TD_message_Missing_Message: start-on-event=SetEventStatus, operation=Event_Cluster_ECU_TD_message_Missing_Message.SetEventStatus
        OpEventSetEventStatus_SetEventStatus_Event_PCAN_Communication_Bus_Off: start-on-event=SetEventStatus, operation=Event_PCAN_Communication_Bus_Off.SetEventStatus
        OpEventSetEventStatus_SetEventStatus_Event_Front_Left_Side_Radar_Missing_Message: start-on-event=SetEventStatus, operation=Event_Front_Left_Side_Radar_Missing_Message.SetEventStatus
        OpEventSetEventStatus_SetEventStatus_Event_Manual_ETC2_message_Transcurrent_gear_Invalid_Serial_Data_Received: start-on-event=SetEventStatus, operation=Event_Manual_ETC2_message_Transcurrent_gear_Invalid_Serial_Data_Received.SetEventStatus
        OpEventSetEventStatus_SetEventStatus_Event_SAS_ECU_erratic_communication_Erratic: start-on-event=SetEventStatus, operation=Event_SAS_ECU_erratic_communication_Erratic.SetEventStatus
        OpEventSetEventStatus_SetEventStatus_Event_VDC2_message_Yaw_rate_Invalid_Serial_Data_Received: start-on-event=SetEventStatus, operation=Event_VDC2_message_Yaw_rate_Invalid_Serial_Data_Received.SetEventStatus
        OpEventSetEventStatus_SetEventStatus_Event_Cluster_ECU_TD_erratic_communication_Erratic: start-on-event=SetEventStatus, operation=Event_Cluster_ECU_TD_erratic_communication_Erratic.SetEventStatus
        OpEventSetEventStatus_SetEventStatus_Event_EMS_ECU_CCVS1_message_Missing_Message: start-on-event=SetEventStatus, operation=Event_EMS_ECU_CCVS1_message_Missing_Message.SetEventStatus
        OpEventSetEventStatus_SetEventStatus_Event_Radar_Mounting_Orientation_Incorrect_Assembly: start-on-event=SetEventStatus, operation=Event_Radar_Mounting_Orientation_Incorrect_Assembly.SetEventStatus
        OpEventSetEventStatus_SetEventStatus_Event_EMS_ECU_ETC2_erratic_communication_Erractic: start-on-event=SetEventStatus, operation=Event_EMS_ECU_ETC2_erratic_communication_Erractic.SetEventStatus
        OpEventSetEventStatus_SetEventStatus_Event_Cluster_ECU_ADAS_FN_STS_erratic_communication_Erratic: start-on-event=SetEventStatus, operation=Event_Cluster_ECU_ADAS_FN_STS_erratic_communication_Erratic.SetEventStatus
        OpEventSetEventStatus_SetEventStatus_Event_ESC_ECU_VDC2_message_Missing_Message: start-on-event=SetEventStatus, operation=Event_ESC_ECU_VDC2_message_Missing_Message.SetEventStatus
        OpEventSetEventStatus_SetEventStatus_Event_CLS_TX_16_message_Transmission_Type_info_Invalid_Serial_Data_Received: start-on-event=SetEventStatus, operation=Event_CLS_TX_16_message_Transmission_Type_info_Invalid_Serial_Data_Received.SetEventStatus
        OpEventSetEventStatus_SetEventStatus_Event_Cluster_ECU_CLS_Tx_4_erratic_communication_Erratic: start-on-event=SetEventStatus, operation=Event_Cluster_ECU_CLS_Tx_4_erratic_communication_Erratic.SetEventStatus
        OpEventSetEventStatus_SetEventStatus_Event_Cluster_ECU_ADAS_FN_STS_message_Missing_Message: start-on-event=SetEventStatus, operation=Event_Cluster_ECU_ADAS_FN_STS_message_Missing_Message.SetEventStatus
        OpEventSetEventStatus_SetEventStatus_Event_Vehicle_Dataset_value_of_signal_protection_calculation_Incorrect: start-on-event=SetEventStatus, operation=Event_Vehicle_Dataset_value_of_signal_protection_calculation_Incorrect.SetEventStatus
        OpEventSetEventStatus_SetEventStatus_Event_Cluster_ECU_CLS_Tx_16_erratic_communication_Erratic: start-on-event=SetEventStatus, operation=Event_Cluster_ECU_CLS_Tx_16_erratic_communication_Erratic.SetEventStatus
        OpEventSetEventStatus_SetEventStatus_Event_Cluster_ECU_OEL_erratic_communication_Erratic: start-on-event=SetEventStatus, operation=Event_Cluster_ECU_OEL_erratic_communication_Erratic.SetEventStatus
        OpEventSetEventStatus_SetEventStatus_Event_Cluster_ECU_CLS_Tx_4_message_Missing_Message: start-on-event=SetEventStatus, operation=Event_Cluster_ECU_CLS_Tx_4_message_Missing_Message.SetEventStatus
        OpEventSetEventStatus_SetEventStatus_Event_Radar_Performance_Capability_Algorithm_Based_Failure: start-on-event=SetEventStatus, operation=Event_Radar_Performance_Capability_Algorithm_Based_Failure.SetEventStatus
        OpEventSetEventStatus_SetEventStatus_Event_Radar_AutoAlignment_Range_Alignment_or_Adjustement_Incorrect: start-on-event=SetEventStatus, operation=Event_Radar_AutoAlignment_Range_Alignment_or_Adjustement_Incorrect.SetEventStatus
        OpEventSetEventStatus_SetEventStatus_Event_EMS_ECU_CCVS1_erratic_communication_Erractic: start-on-event=SetEventStatus, operation=Event_EMS_ECU_CCVS1_erratic_communication_Erractic.SetEventStatus
        OpEventSetEventStatus_SetEventStatus_Event_Radar_System_Battery_Low_Voltage_System_Voltage_Low: start-on-event=SetEventStatus, operation=Event_Radar_System_Battery_Low_Voltage_System_Voltage_Low.SetEventStatus
        OpEventSetEventStatus_SetEventStatus_Event_Radar_SMC_General_Checksum_Failure: start-on-event=SetEventStatus, operation=Event_Radar_SMC_General_Checksum_Failure.SetEventStatus
        OpEventSetEventStatus_SetEventStatus_Event_Radar_Pin_Position_Wrong_Mounting_Position: start-on-event=SetEventStatus, operation=Event_Radar_Pin_Position_Wrong_Mounting_Position.SetEventStatus
        OpEventSetEventStatus_SetEventStatus_Event_VDC2_message_Lateral_Accleration_Invalid_Serial_Data_Received: start-on-event=SetEventStatus, operation=Event_VDC2_message_Lateral_Accleration_Invalid_Serial_Data_Received.SetEventStatus
        OpEventSetEventStatus_SetEventStatus_Event_ADAS_FN_STS_message_BSIS_FN_Switch_STS_Invalid_Serial_Data_Received: start-on-event=SetEventStatus, operation=Event_ADAS_FN_STS_message_BSIS_FN_Switch_STS_Invalid_Serial_Data_Received.SetEventStatus
        OpEventSetEventStatus_SetEventStatus_Event_Radar_AutoAlignment_Misalignment_Performance_or_Incorrect_Operation: start-on-event=SetEventStatus, operation=Event_Radar_AutoAlignment_Misalignment_Performance_or_Incorrect_Operation.SetEventStatus
        OpEventSetEventStatus_SetEventStatus_Event_ESC_ECU_VDC2_erratic_communication_Erratic: start-on-event=SetEventStatus, operation=Event_ESC_ECU_VDC2_erratic_communication_Erratic.SetEventStatus
        OpEventSetEventStatus_SetEventStatus_Event_Application_Interface_Lookup_Performance_or_Incorrect_Operation: start-on-event=SetEventStatus, operation=Event_Application_Interface_Lookup_Performance_or_Incorrect_Operation.SetEventStatus
        OpEventSetEventStatus_SetEventStatus_Event_EMS_ECU_VD_message_Missing_Message: start-on-event=SetEventStatus, operation=Event_EMS_ECU_VD_message_Missing_Message.SetEventStatus
        OpEventSetEventStatus_SetEventStatus_Event_Radar_Platform_Time_System_Programming_Failure: start-on-event=SetEventStatus, operation=Event_Radar_Platform_Time_System_Programming_Failure.SetEventStatus
        OpEventSetEventStatus_SetEventStatus_Event_OEL_message_Turn_Signal_Switch_Invalid_Serial_Data_Received: start-on-event=SetEventStatus, operation=Event_OEL_message_Turn_Signal_Switch_Invalid_Serial_Data_Received.SetEventStatus
        OpEventSetEventStatus_SetEventStatus_Event_Radar_calibration_Calibration_or_Paramater_Memory_Failure: start-on-event=SetEventStatus, operation=Event_Radar_calibration_Calibration_or_Paramater_Memory_Failure.SetEventStatus
        OpEventResetEventStatus_ResetEventStatus_Event_SAS_message_Steering_Wheel_Angle_Invalid_Serial_Data_Received: start-on-event=ResetEventStatus, operation=Event_SAS_message_Steering_Wheel_Angle_Invalid_Serial_Data_Received.ResetEventStatus
        OpEventResetEventStatus_ResetEventStatus_Event_AT_AMT_ETC2_message_Transcurrent_gear_Invalid_Serial_Data_Received: start-on-event=ResetEventStatus, operation=Event_AT_AMT_ETC2_message_Transcurrent_gear_Invalid_Serial_Data_Received.ResetEventStatus
        OpEventResetEventStatus_ResetEventStatus_Event_Radar_AutoAlignment_Algorithm_Signal_Calculation_Failure: start-on-event=ResetEventStatus, operation=Event_Radar_AutoAlignment_Algorithm_Signal_Calculation_Failure.ResetEventStatus
        OpEventResetEventStatus_ResetEventStatus_Event_Vehicle_DataSet_Not_Configured: start-on-event=ResetEventStatus, operation=Event_Vehicle_DataSet_Not_Configured.ResetEventStatus
        OpEventResetEventStatus_ResetEventStatus_Event_Radar_Module_System_Internal_Failure: start-on-event=ResetEventStatus, operation=Event_Radar_Module_System_Internal_Failure.ResetEventStatus
        OpEventResetEventStatus_ResetEventStatus_Event_Radar_MMIC_Component_Failure: start-on-event=ResetEventStatus, operation=Event_Radar_MMIC_Component_Failure.ResetEventStatus
        OpEventResetEventStatus_ResetEventStatus_Event_Radar_Module_General_Memory_Failure: start-on-event=ResetEventStatus, operation=Event_Radar_Module_General_Memory_Failure.ResetEventStatus
        OpEventResetEventStatus_ResetEventStatus_Event_Radar_System_Battery_High_Voltage_System_Voltage_High: start-on-event=ResetEventStatus, operation=Event_Radar_System_Battery_High_Voltage_System_Voltage_High.ResetEventStatus
        OpEventResetEventStatus_ResetEventStatus_Event_CCVS1_message_Vehicle_Speed_Invalid_Serial_Data_Received: start-on-event=ResetEventStatus, operation=Event_CCVS1_message_Vehicle_Speed_Invalid_Serial_Data_Received.ResetEventStatus
        OpEventResetEventStatus_ResetEventStatus_Event_EMS_ECU_VD_erratic_communication_Erratic: start-on-event=ResetEventStatus, operation=Event_EMS_ECU_VD_erratic_communication_Erratic.ResetEventStatus
        OpEventResetEventStatus_ResetEventStatus_Event_EMS_ECU_ETC2_00_message_Missing_Message: start-on-event=ResetEventStatus, operation=Event_EMS_ECU_ETC2_00_message_Missing_Message.ResetEventStatus
        OpEventResetEventStatus_ResetEventStatus_Event_Cluster_ECU_CLS_Tx_16_message_Missing_Message: start-on-event=ResetEventStatus, operation=Event_Cluster_ECU_CLS_Tx_16_message_Missing_Message.ResetEventStatus
        OpEventResetEventStatus_ResetEventStatus_Event_Exceeded_Security_Access_0x27_Attempt_Threshold_Authentication_Failure: start-on-event=ResetEventStatus, operation=Event_Exceeded_Security_Access_0x27_Attempt_Threshold_Authentication_Failure.ResetEventStatus
        OpEventResetEventStatus_ResetEventStatus_Event_Front_Left_Side_Radar_value_of_signal_protection_calculation_Incorrect: start-on-event=ResetEventStatus, operation=Event_Front_Left_Side_Radar_value_of_signal_protection_calculation_Incorrect.ResetEventStatus
        OpEventResetEventStatus_ResetEventStatus_Event_AT_AMT_ETC2_erratic_communication_Erratic: start-on-event=ResetEventStatus, operation=Event_AT_AMT_ETC2_erratic_communication_Erratic.ResetEventStatus
        OpEventResetEventStatus_ResetEventStatus_Event_VCAN_Communication_Bus_Off: start-on-event=ResetEventStatus, operation=Event_VCAN_Communication_Bus_Off.ResetEventStatus
        OpEventResetEventStatus_ResetEventStatus_Event_VDC2_message_LongitudinalAcceleration_Invalid_Serial_Data_Received: start-on-event=ResetEventStatus, operation=Event_VDC2_message_LongitudinalAcceleration_Invalid_Serial_Data_Received.ResetEventStatus
        OpEventResetEventStatus_ResetEventStatus_Event_Radar_MMIC_RFBIST_Component_Internal_Failure: start-on-event=ResetEventStatus, operation=Event_Radar_MMIC_RFBIST_Component_Internal_Failure.ResetEventStatus
        OpEventResetEventStatus_ResetEventStatus_Event_Radar_Initial_Alignment_Missing_Calibration: start-on-event=ResetEventStatus, operation=Event_Radar_Initial_Alignment_Missing_Calibration.ResetEventStatus
        OpEventResetEventStatus_ResetEventStatus_Event_Cluster_ECU_OEL_message_Missing_Message: start-on-event=ResetEventStatus, operation=Event_Cluster_ECU_OEL_message_Missing_Message.ResetEventStatus
        OpEventResetEventStatus_ResetEventStatus_Event_AT_AMT_ECU_ETC2_03_message_Missing_Message: start-on-event=ResetEventStatus, operation=Event_AT_AMT_ECU_ETC2_03_message_Missing_Message.ResetEventStatus
        OpEventResetEventStatus_ResetEventStatus_Event_ADAS_FN_STS_message_MOIS_FN_Switch_STS_Invalid_Serial_Data_Received: start-on-event=ResetEventStatus, operation=Event_ADAS_FN_STS_message_MOIS_FN_Switch_STS_Invalid_Serial_Data_Received.ResetEventStatus
        OpEventResetEventStatus_ResetEventStatus_Event_Radar_Module_Over_Temperature: start-on-event=ResetEventStatus, operation=Event_Radar_Module_Over_Temperature.ResetEventStatus
        OpEventResetEventStatus_ResetEventStatus_Event_PCAN_TimeSync_Missing_Message: start-on-event=ResetEventStatus, operation=Event_PCAN_TimeSync_Missing_Message.ResetEventStatus
        OpEventResetEventStatus_ResetEventStatus_Event_Radar_Module_Watchdog_Failure: start-on-event=ResetEventStatus, operation=Event_Radar_Module_Watchdog_Failure.ResetEventStatus
        OpEventResetEventStatus_ResetEventStatus_Event_SAS_ECU_SAS_message_Missing_Message: start-on-event=ResetEventStatus, operation=Event_SAS_ECU_SAS_message_Missing_Message.ResetEventStatus
        OpEventResetEventStatus_ResetEventStatus_Event_ECU_NVM_Corruption_Program_memory_Failure: start-on-event=ResetEventStatus, operation=Event_ECU_NVM_Corruption_Program_memory_Failure.ResetEventStatus
        OpEventResetEventStatus_ResetEventStatus_Event_Cluster_ECU_TD_message_Missing_Message: start-on-event=ResetEventStatus, operation=Event_Cluster_ECU_TD_message_Missing_Message.ResetEventStatus
        OpEventResetEventStatus_ResetEventStatus_Event_PCAN_Communication_Bus_Off: start-on-event=ResetEventStatus, operation=Event_PCAN_Communication_Bus_Off.ResetEventStatus
        OpEventResetEventStatus_ResetEventStatus_Event_Front_Left_Side_Radar_Missing_Message: start-on-event=ResetEventStatus, operation=Event_Front_Left_Side_Radar_Missing_Message.ResetEventStatus
        OpEventResetEventStatus_ResetEventStatus_Event_Manual_ETC2_message_Transcurrent_gear_Invalid_Serial_Data_Received: start-on-event=ResetEventStatus, operation=Event_Manual_ETC2_message_Transcurrent_gear_Invalid_Serial_Data_Received.ResetEventStatus
        OpEventResetEventStatus_ResetEventStatus_Event_SAS_ECU_erratic_communication_Erratic: start-on-event=ResetEventStatus, operation=Event_SAS_ECU_erratic_communication_Erratic.ResetEventStatus
        OpEventResetEventStatus_ResetEventStatus_Event_VDC2_message_Yaw_rate_Invalid_Serial_Data_Received: start-on-event=ResetEventStatus, operation=Event_VDC2_message_Yaw_rate_Invalid_Serial_Data_Received.ResetEventStatus
        OpEventResetEventStatus_ResetEventStatus_Event_Cluster_ECU_TD_erratic_communication_Erratic: start-on-event=ResetEventStatus, operation=Event_Cluster_ECU_TD_erratic_communication_Erratic.ResetEventStatus
        OpEventResetEventStatus_ResetEventStatus_Event_EMS_ECU_CCVS1_message_Missing_Message: start-on-event=ResetEventStatus, operation=Event_EMS_ECU_CCVS1_message_Missing_Message.ResetEventStatus
        OpEventResetEventStatus_ResetEventStatus_Event_Radar_Mounting_Orientation_Incorrect_Assembly: start-on-event=ResetEventStatus, operation=Event_Radar_Mounting_Orientation_Incorrect_Assembly.ResetEventStatus
        OpEventResetEventStatus_ResetEventStatus_Event_EMS_ECU_ETC2_erratic_communication_Erractic: start-on-event=ResetEventStatus, operation=Event_EMS_ECU_ETC2_erratic_communication_Erractic.ResetEventStatus
        OpEventResetEventStatus_ResetEventStatus_Event_Cluster_ECU_ADAS_FN_STS_erratic_communication_Erratic: start-on-event=ResetEventStatus, operation=Event_Cluster_ECU_ADAS_FN_STS_erratic_communication_Erratic.ResetEventStatus
        OpEventResetEventStatus_ResetEventStatus_Event_ESC_ECU_VDC2_message_Missing_Message: start-on-event=ResetEventStatus, operation=Event_ESC_ECU_VDC2_message_Missing_Message.ResetEventStatus
        OpEventResetEventStatus_ResetEventStatus_Event_CLS_TX_16_message_Transmission_Type_info_Invalid_Serial_Data_Received: start-on-event=ResetEventStatus, operation=Event_CLS_TX_16_message_Transmission_Type_info_Invalid_Serial_Data_Received.ResetEventStatus
        OpEventResetEventStatus_ResetEventStatus_Event_Cluster_ECU_CLS_Tx_4_erratic_communication_Erratic: start-on-event=ResetEventStatus, operation=Event_Cluster_ECU_CLS_Tx_4_erratic_communication_Erratic.ResetEventStatus
        OpEventResetEventStatus_ResetEventStatus_Event_Cluster_ECU_ADAS_FN_STS_message_Missing_Message: start-on-event=ResetEventStatus, operation=Event_Cluster_ECU_ADAS_FN_STS_message_Missing_Message.ResetEventStatus
        OpEventResetEventStatus_ResetEventStatus_Event_Vehicle_Dataset_value_of_signal_protection_calculation_Incorrect: start-on-event=ResetEventStatus, operation=Event_Vehicle_Dataset_value_of_signal_protection_calculation_Incorrect.ResetEventStatus
        OpEventResetEventStatus_ResetEventStatus_Event_Cluster_ECU_CLS_Tx_16_erratic_communication_Erratic: start-on-event=ResetEventStatus, operation=Event_Cluster_ECU_CLS_Tx_16_erratic_communication_Erratic.ResetEventStatus
        OpEventResetEventStatus_ResetEventStatus_Event_Cluster_ECU_OEL_erratic_communication_Erratic: start-on-event=ResetEventStatus, operation=Event_Cluster_ECU_OEL_erratic_communication_Erratic.ResetEventStatus
        OpEventResetEventStatus_ResetEventStatus_Event_Cluster_ECU_CLS_Tx_4_message_Missing_Message: start-on-event=ResetEventStatus, operation=Event_Cluster_ECU_CLS_Tx_4_message_Missing_Message.ResetEventStatus
        OpEventResetEventStatus_ResetEventStatus_Event_Radar_Performance_Capability_Algorithm_Based_Failure: start-on-event=ResetEventStatus, operation=Event_Radar_Performance_Capability_Algorithm_Based_Failure.ResetEventStatus
        OpEventResetEventStatus_ResetEventStatus_Event_Radar_AutoAlignment_Range_Alignment_or_Adjustement_Incorrect: start-on-event=ResetEventStatus, operation=Event_Radar_AutoAlignment_Range_Alignment_or_Adjustement_Incorrect.ResetEventStatus
        OpEventResetEventStatus_ResetEventStatus_Event_EMS_ECU_CCVS1_erratic_communication_Erractic: start-on-event=ResetEventStatus, operation=Event_EMS_ECU_CCVS1_erratic_communication_Erractic.ResetEventStatus
        OpEventResetEventStatus_ResetEventStatus_Event_Radar_System_Battery_Low_Voltage_System_Voltage_Low: start-on-event=ResetEventStatus, operation=Event_Radar_System_Battery_Low_Voltage_System_Voltage_Low.ResetEventStatus
        OpEventResetEventStatus_ResetEventStatus_Event_Radar_SMC_General_Checksum_Failure: start-on-event=ResetEventStatus, operation=Event_Radar_SMC_General_Checksum_Failure.ResetEventStatus
        OpEventResetEventStatus_ResetEventStatus_Event_Radar_Pin_Position_Wrong_Mounting_Position: start-on-event=ResetEventStatus, operation=Event_Radar_Pin_Position_Wrong_Mounting_Position.ResetEventStatus
        OpEventResetEventStatus_ResetEventStatus_Event_VDC2_message_Lateral_Accleration_Invalid_Serial_Data_Received: start-on-event=ResetEventStatus, operation=Event_VDC2_message_Lateral_Accleration_Invalid_Serial_Data_Received.ResetEventStatus
        OpEventResetEventStatus_ResetEventStatus_Event_ADAS_FN_STS_message_BSIS_FN_Switch_STS_Invalid_Serial_Data_Received: start-on-event=ResetEventStatus, operation=Event_ADAS_FN_STS_message_BSIS_FN_Switch_STS_Invalid_Serial_Data_Received.ResetEventStatus
        OpEventResetEventStatus_ResetEventStatus_Event_Radar_AutoAlignment_Misalignment_Performance_or_Incorrect_Operation: start-on-event=ResetEventStatus, operation=Event_Radar_AutoAlignment_Misalignment_Performance_or_Incorrect_Operation.ResetEventStatus
        OpEventResetEventStatus_ResetEventStatus_Event_ESC_ECU_VDC2_erratic_communication_Erratic: start-on-event=ResetEventStatus, operation=Event_ESC_ECU_VDC2_erratic_communication_Erratic.ResetEventStatus
        OpEventResetEventStatus_ResetEventStatus_Event_Application_Interface_Lookup_Performance_or_Incorrect_Operation: start-on-event=ResetEventStatus, operation=Event_Application_Interface_Lookup_Performance_or_Incorrect_Operation.ResetEventStatus
        OpEventResetEventStatus_ResetEventStatus_Event_EMS_ECU_VD_message_Missing_Message: start-on-event=ResetEventStatus, operation=Event_EMS_ECU_VD_message_Missing_Message.ResetEventStatus
        OpEventResetEventStatus_ResetEventStatus_Event_Radar_Platform_Time_System_Programming_Failure: start-on-event=ResetEventStatus, operation=Event_Radar_Platform_Time_System_Programming_Failure.ResetEventStatus
        OpEventResetEventStatus_ResetEventStatus_Event_OEL_message_Turn_Signal_Switch_Invalid_Serial_Data_Received: start-on-event=ResetEventStatus, operation=Event_OEL_message_Turn_Signal_Switch_Invalid_Serial_Data_Received.ResetEventStatus
        OpEventResetEventStatus_ResetEventStatus_Event_Radar_calibration_Calibration_or_Paramater_Memory_Failure: start-on-event=ResetEventStatus, operation=Event_Radar_calibration_Calibration_or_Paramater_Memory_Failure.ResetEventStatus
        OpEventResetEventDebounceStatus_ResetEventDebounceStatus_Event_SAS_message_Steering_Wheel_Angle_Invalid_Serial_Data_Received: start-on-event=ResetEventDebounceStatus, operation=Event_SAS_message_Steering_Wheel_Angle_Invalid_Serial_Data_Received.ResetEventDebounceStatus
        OpEventResetEventDebounceStatus_ResetEventDebounceStatus_Event_AT_AMT_ETC2_message_Transcurrent_gear_Invalid_Serial_Dat_3b6a62f4: start-on-event=ResetEventDebounceStatus, operation=Event_AT_AMT_ETC2_message_Transcurrent_gear_Invalid_Serial_Data_Received.ResetEventDebounceStatus
        OpEventResetEventDebounceStatus_ResetEventDebounceStatus_Event_Radar_AutoAlignment_Algorithm_Signal_Calculation_Failure: start-on-event=ResetEventDebounceStatus, operation=Event_Radar_AutoAlignment_Algorithm_Signal_Calculation_Failure.ResetEventDebounceStatus
        OpEventResetEventDebounceStatus_ResetEventDebounceStatus_Event_Vehicle_DataSet_Not_Configured: start-on-event=ResetEventDebounceStatus, operation=Event_Vehicle_DataSet_Not_Configured.ResetEventDebounceStatus
        OpEventResetEventDebounceStatus_ResetEventDebounceStatus_Event_Radar_Module_System_Internal_Failure: start-on-event=ResetEventDebounceStatus, operation=Event_Radar_Module_System_Internal_Failure.ResetEventDebounceStatus
        OpEventResetEventDebounceStatus_ResetEventDebounceStatus_Event_Radar_MMIC_Component_Failure: start-on-event=ResetEventDebounceStatus, operation=Event_Radar_MMIC_Component_Failure.ResetEventDebounceStatus
        OpEventResetEventDebounceStatus_ResetEventDebounceStatus_Event_Radar_Module_General_Memory_Failure: start-on-event=ResetEventDebounceStatus, operation=Event_Radar_Module_General_Memory_Failure.ResetEventDebounceStatus
        OpEventResetEventDebounceStatus_ResetEventDebounceStatus_Event_Radar_System_Battery_High_Voltage_System_Voltage_High: start-on-event=ResetEventDebounceStatus, operation=Event_Radar_System_Battery_High_Voltage_System_Voltage_High.ResetEventDebounceStatus
        OpEventResetEventDebounceStatus_ResetEventDebounceStatus_Event_CCVS1_message_Vehicle_Speed_Invalid_Serial_Data_Received: start-on-event=ResetEventDebounceStatus, operation=Event_CCVS1_message_Vehicle_Speed_Invalid_Serial_Data_Received.ResetEventDebounceStatus
        OpEventResetEventDebounceStatus_ResetEventDebounceStatus_Event_EMS_ECU_VD_erratic_communication_Erratic: start-on-event=ResetEventDebounceStatus, operation=Event_EMS_ECU_VD_erratic_communication_Erratic.ResetEventDebounceStatus
        OpEventResetEventDebounceStatus_ResetEventDebounceStatus_Event_EMS_ECU_ETC2_00_message_Missing_Message: start-on-event=ResetEventDebounceStatus, operation=Event_EMS_ECU_ETC2_00_message_Missing_Message.ResetEventDebounceStatus
        OpEventResetEventDebounceStatus_ResetEventDebounceStatus_Event_Cluster_ECU_CLS_Tx_16_message_Missing_Message: start-on-event=ResetEventDebounceStatus, operation=Event_Cluster_ECU_CLS_Tx_16_message_Missing_Message.ResetEventDebounceStatus
        OpEventResetEventDebounceStatus_ResetEventDebounceStatus_Event_Exceeded_Security_Access_0x27_Attempt_Threshold_Authenti_4010bb14: start-on-event=ResetEventDebounceStatus, operation=Event_Exceeded_Security_Access_0x27_Attempt_Threshold_Authentication_Failure.ResetEventDebounceStatus
        OpEventResetEventDebounceStatus_ResetEventDebounceStatus_Event_Front_Left_Side_Radar_value_of_signal_protection_calcula_0a896f5c: start-on-event=ResetEventDebounceStatus, operation=Event_Front_Left_Side_Radar_value_of_signal_protection_calculation_Incorrect.ResetEventDebounceStatus
        OpEventResetEventDebounceStatus_ResetEventDebounceStatus_Event_AT_AMT_ETC2_erratic_communication_Erratic: start-on-event=ResetEventDebounceStatus, operation=Event_AT_AMT_ETC2_erratic_communication_Erratic.ResetEventDebounceStatus
        OpEventResetEventDebounceStatus_ResetEventDebounceStatus_Event_VCAN_Communication_Bus_Off: start-on-event=ResetEventDebounceStatus, operation=Event_VCAN_Communication_Bus_Off.ResetEventDebounceStatus
        OpEventResetEventDebounceStatus_ResetEventDebounceStatus_Event_VDC2_message_LongitudinalAcceleration_Invalid_Serial_Dat_bb86385b: start-on-event=ResetEventDebounceStatus, operation=Event_VDC2_message_LongitudinalAcceleration_Invalid_Serial_Data_Received.ResetEventDebounceStatus
        OpEventResetEventDebounceStatus_ResetEventDebounceStatus_Event_Radar_MMIC_RFBIST_Component_Internal_Failure: start-on-event=ResetEventDebounceStatus, operation=Event_Radar_MMIC_RFBIST_Component_Internal_Failure.ResetEventDebounceStatus
        OpEventResetEventDebounceStatus_ResetEventDebounceStatus_Event_Radar_Initial_Alignment_Missing_Calibration: start-on-event=ResetEventDebounceStatus, operation=Event_Radar_Initial_Alignment_Missing_Calibration.ResetEventDebounceStatus
        OpEventResetEventDebounceStatus_ResetEventDebounceStatus_Event_Cluster_ECU_OEL_message_Missing_Message: start-on-event=ResetEventDebounceStatus, operation=Event_Cluster_ECU_OEL_message_Missing_Message.ResetEventDebounceStatus
        OpEventResetEventDebounceStatus_ResetEventDebounceStatus_Event_AT_AMT_ECU_ETC2_03_message_Missing_Message: start-on-event=ResetEventDebounceStatus, operation=Event_AT_AMT_ECU_ETC2_03_message_Missing_Message.ResetEventDebounceStatus
        OpEventResetEventDebounceStatus_ResetEventDebounceStatus_Event_ADAS_FN_STS_message_MOIS_FN_Switch_STS_Invalid_Serial_Da_899b3188: start-on-event=ResetEventDebounceStatus, operation=Event_ADAS_FN_STS_message_MOIS_FN_Switch_STS_Invalid_Serial_Data_Received.ResetEventDebounceStatus
        OpEventResetEventDebounceStatus_ResetEventDebounceStatus_Event_Radar_Module_Over_Temperature: start-on-event=ResetEventDebounceStatus, operation=Event_Radar_Module_Over_Temperature.ResetEventDebounceStatus
        OpEventResetEventDebounceStatus_ResetEventDebounceStatus_Event_PCAN_TimeSync_Missing_Message: start-on-event=ResetEventDebounceStatus, operation=Event_PCAN_TimeSync_Missing_Message.ResetEventDebounceStatus
        OpEventResetEventDebounceStatus_ResetEventDebounceStatus_Event_Radar_Module_Watchdog_Failure: start-on-event=ResetEventDebounceStatus, operation=Event_Radar_Module_Watchdog_Failure.ResetEventDebounceStatus
        OpEventResetEventDebounceStatus_ResetEventDebounceStatus_Event_SAS_ECU_SAS_message_Missing_Message: start-on-event=ResetEventDebounceStatus, operation=Event_SAS_ECU_SAS_message_Missing_Message.ResetEventDebounceStatus
        OpEventResetEventDebounceStatus_ResetEventDebounceStatus_Event_ECU_NVM_Corruption_Program_memory_Failure: start-on-event=ResetEventDebounceStatus, operation=Event_ECU_NVM_Corruption_Program_memory_Failure.ResetEventDebounceStatus
        OpEventResetEventDebounceStatus_ResetEventDebounceStatus_Event_Cluster_ECU_TD_message_Missing_Message: start-on-event=ResetEventDebounceStatus, operation=Event_Cluster_ECU_TD_message_Missing_Message.ResetEventDebounceStatus
        OpEventResetEventDebounceStatus_ResetEventDebounceStatus_Event_PCAN_Communication_Bus_Off: start-on-event=ResetEventDebounceStatus, operation=Event_PCAN_Communication_Bus_Off.ResetEventDebounceStatus
        OpEventResetEventDebounceStatus_ResetEventDebounceStatus_Event_Front_Left_Side_Radar_Missing_Message: start-on-event=ResetEventDebounceStatus, operation=Event_Front_Left_Side_Radar_Missing_Message.ResetEventDebounceStatus
        OpEventResetEventDebounceStatus_ResetEventDebounceStatus_Event_Manual_ETC2_message_Transcurrent_gear_Invalid_Serial_Dat_27fe104f: start-on-event=ResetEventDebounceStatus, operation=Event_Manual_ETC2_message_Transcurrent_gear_Invalid_Serial_Data_Received.ResetEventDebounceStatus
        OpEventResetEventDebounceStatus_ResetEventDebounceStatus_Event_SAS_ECU_erratic_communication_Erratic: start-on-event=ResetEventDebounceStatus, operation=Event_SAS_ECU_erratic_communication_Erratic.ResetEventDebounceStatus
        OpEventResetEventDebounceStatus_ResetEventDebounceStatus_Event_VDC2_message_Yaw_rate_Invalid_Serial_Data_Received: start-on-event=ResetEventDebounceStatus, operation=Event_VDC2_message_Yaw_rate_Invalid_Serial_Data_Received.ResetEventDebounceStatus
        OpEventResetEventDebounceStatus_ResetEventDebounceStatus_Event_Cluster_ECU_TD_erratic_communication_Erratic: start-on-event=ResetEventDebounceStatus, operation=Event_Cluster_ECU_TD_erratic_communication_Erratic.ResetEventDebounceStatus
        OpEventResetEventDebounceStatus_ResetEventDebounceStatus_Event_EMS_ECU_CCVS1_message_Missing_Message: start-on-event=ResetEventDebounceStatus, operation=Event_EMS_ECU_CCVS1_message_Missing_Message.ResetEventDebounceStatus
        OpEventResetEventDebounceStatus_ResetEventDebounceStatus_Event_Radar_Mounting_Orientation_Incorrect_Assembly: start-on-event=ResetEventDebounceStatus, operation=Event_Radar_Mounting_Orientation_Incorrect_Assembly.ResetEventDebounceStatus
        OpEventResetEventDebounceStatus_ResetEventDebounceStatus_Event_EMS_ECU_ETC2_erratic_communication_Erractic: start-on-event=ResetEventDebounceStatus, operation=Event_EMS_ECU_ETC2_erratic_communication_Erractic.ResetEventDebounceStatus
        OpEventResetEventDebounceStatus_ResetEventDebounceStatus_Event_Cluster_ECU_ADAS_FN_STS_erratic_communication_Erratic: start-on-event=ResetEventDebounceStatus, operation=Event_Cluster_ECU_ADAS_FN_STS_erratic_communication_Erratic.ResetEventDebounceStatus
        OpEventResetEventDebounceStatus_ResetEventDebounceStatus_Event_ESC_ECU_VDC2_message_Missing_Message: start-on-event=ResetEventDebounceStatus, operation=Event_ESC_ECU_VDC2_message_Missing_Message.ResetEventDebounceStatus
        OpEventResetEventDebounceStatus_ResetEventDebounceStatus_Event_CLS_TX_16_message_Transmission_Type_info_Invalid_Serial_b9736b5a: start-on-event=ResetEventDebounceStatus, operation=Event_CLS_TX_16_message_Transmission_Type_info_Invalid_Serial_Data_Received.ResetEventDebounceStatus
        OpEventResetEventDebounceStatus_ResetEventDebounceStatus_Event_Cluster_ECU_CLS_Tx_4_erratic_communication_Erratic: start-on-event=ResetEventDebounceStatus, operation=Event_Cluster_ECU_CLS_Tx_4_erratic_communication_Erratic.ResetEventDebounceStatus
        OpEventResetEventDebounceStatus_ResetEventDebounceStatus_Event_Cluster_ECU_ADAS_FN_STS_message_Missing_Message: start-on-event=ResetEventDebounceStatus, operation=Event_Cluster_ECU_ADAS_FN_STS_message_Missing_Message.ResetEventDebounceStatus
        OpEventResetEventDebounceStatus_ResetEventDebounceStatus_Event_Vehicle_Dataset_value_of_signal_protection_calculation_Incorrect: start-on-event=ResetEventDebounceStatus, operation=Event_Vehicle_Dataset_value_of_signal_protection_calculation_Incorrect.ResetEventDebounceStatus
        OpEventResetEventDebounceStatus_ResetEventDebounceStatus_Event_Cluster_ECU_CLS_Tx_16_erratic_communication_Erratic: start-on-event=ResetEventDebounceStatus, operation=Event_Cluster_ECU_CLS_Tx_16_erratic_communication_Erratic.ResetEventDebounceStatus
        OpEventResetEventDebounceStatus_ResetEventDebounceStatus_Event_Cluster_ECU_OEL_erratic_communication_Erratic: start-on-event=ResetEventDebounceStatus, operation=Event_Cluster_ECU_OEL_erratic_communication_Erratic.ResetEventDebounceStatus
        OpEventResetEventDebounceStatus_ResetEventDebounceStatus_Event_Cluster_ECU_CLS_Tx_4_message_Missing_Message: start-on-event=ResetEventDebounceStatus, operation=Event_Cluster_ECU_CLS_Tx_4_message_Missing_Message.ResetEventDebounceStatus
        OpEventResetEventDebounceStatus_ResetEventDebounceStatus_Event_Radar_Performance_Capability_Algorithm_Based_Failure: start-on-event=ResetEventDebounceStatus, operation=Event_Radar_Performance_Capability_Algorithm_Based_Failure.ResetEventDebounceStatus
        OpEventResetEventDebounceStatus_ResetEventDebounceStatus_Event_Radar_AutoAlignment_Range_Alignment_or_Adjustement_Incorrect: start-on-event=ResetEventDebounceStatus, operation=Event_Radar_AutoAlignment_Range_Alignment_or_Adjustement_Incorrect.ResetEventDebounceStatus
        OpEventResetEventDebounceStatus_ResetEventDebounceStatus_Event_EMS_ECU_CCVS1_erratic_communication_Erractic: start-on-event=ResetEventDebounceStatus, operation=Event_EMS_ECU_CCVS1_erratic_communication_Erractic.ResetEventDebounceStatus
        OpEventResetEventDebounceStatus_ResetEventDebounceStatus_Event_Radar_System_Battery_Low_Voltage_System_Voltage_Low: start-on-event=ResetEventDebounceStatus, operation=Event_Radar_System_Battery_Low_Voltage_System_Voltage_Low.ResetEventDebounceStatus
        OpEventResetEventDebounceStatus_ResetEventDebounceStatus_Event_Radar_SMC_General_Checksum_Failure: start-on-event=ResetEventDebounceStatus, operation=Event_Radar_SMC_General_Checksum_Failure.ResetEventDebounceStatus
        OpEventResetEventDebounceStatus_ResetEventDebounceStatus_Event_Radar_Pin_Position_Wrong_Mounting_Position: start-on-event=ResetEventDebounceStatus, operation=Event_Radar_Pin_Position_Wrong_Mounting_Position.ResetEventDebounceStatus
        OpEventResetEventDebounceStatus_ResetEventDebounceStatus_Event_VDC2_message_Lateral_Accleration_Invalid_Serial_Data_Received: start-on-event=ResetEventDebounceStatus, operation=Event_VDC2_message_Lateral_Accleration_Invalid_Serial_Data_Received.ResetEventDebounceStatus
        OpEventResetEventDebounceStatus_ResetEventDebounceStatus_Event_ADAS_FN_STS_message_BSIS_FN_Switch_STS_Invalid_Serial_Da_4c0b487b: start-on-event=ResetEventDebounceStatus, operation=Event_ADAS_FN_STS_message_BSIS_FN_Switch_STS_Invalid_Serial_Data_Received.ResetEventDebounceStatus
        OpEventResetEventDebounceStatus_ResetEventDebounceStatus_Event_Radar_AutoAlignment_Misalignment_Performance_or_Incorrec_1a52e0d2: start-on-event=ResetEventDebounceStatus, operation=Event_Radar_AutoAlignment_Misalignment_Performance_or_Incorrect_Operation.ResetEventDebounceStatus
        OpEventResetEventDebounceStatus_ResetEventDebounceStatus_Event_ESC_ECU_VDC2_erratic_communication_Erratic: start-on-event=ResetEventDebounceStatus, operation=Event_ESC_ECU_VDC2_erratic_communication_Erratic.ResetEventDebounceStatus
        OpEventResetEventDebounceStatus_ResetEventDebounceStatus_Event_Application_Interface_Lookup_Performance_or_Incorrect_Operation: start-on-event=ResetEventDebounceStatus, operation=Event_Application_Interface_Lookup_Performance_or_Incorrect_Operation.ResetEventDebounceStatus
        OpEventResetEventDebounceStatus_ResetEventDebounceStatus_Event_EMS_ECU_VD_message_Missing_Message: start-on-event=ResetEventDebounceStatus, operation=Event_EMS_ECU_VD_message_Missing_Message.ResetEventDebounceStatus
        OpEventResetEventDebounceStatus_ResetEventDebounceStatus_Event_Radar_Platform_Time_System_Programming_Failure: start-on-event=ResetEventDebounceStatus, operation=Event_Radar_Platform_Time_System_Programming_Failure.ResetEventDebounceStatus
        OpEventResetEventDebounceStatus_ResetEventDebounceStatus_Event_OEL_message_Turn_Signal_Switch_Invalid_Serial_Data_Received: start-on-event=ResetEventDebounceStatus, operation=Event_OEL_message_Turn_Signal_Switch_Invalid_Serial_Data_Received.ResetEventDebounceStatus
        OpEventResetEventDebounceStatus_ResetEventDebounceStatus_Event_Radar_calibration_Calibration_or_Paramater_Memory_Failure: start-on-event=ResetEventDebounceStatus, operation=Event_Radar_calibration_Calibration_or_Paramater_Memory_Failure.ResetEventDebounceStatus
        OpEventGetEventUdsStatus_GetEventUdsStatus_EvtInfo_DemEventParameter: start-on-event=DemSatellite_Invalid_OsApplicationInternalBehavior/GetEventUdsStatus, operation=EvtInfo_DemEventParameter.GetEventUdsStatus
        OpEventGetEventUdsStatus_GetEventUdsStatus_Event_DemEventParameter: start-on-event=DemSatellite_Invalid_OsApplicationInternalBehavior/GetEventUdsStatus, operation=Event_DemEventParameter.GetEventUdsStatus
        OpEventGetEventStatus_GetEventStatus_EvtInfo_DemEventParameter: start-on-event=DemSatellite_Invalid_OsApplicationInternalBehavior/GetEventStatus, operation=EvtInfo_DemEventParameter.GetEventStatus
        OpEventGetEventStatus_GetEventStatus_Event_DemEventParameter: start-on-event=DemSatellite_Invalid_OsApplicationInternalBehavior/GetEventStatus, operation=Event_DemEventParameter.GetEventStatus
        OpEventGetEventFailed_GetEventFailed_EvtInfo_DemEventParameter: start-on-event=DemSatellite_Invalid_OsApplicationInternalBehavior/GetEventFailed, operation=EvtInfo_DemEventParameter.GetEventFailed
        OpEventGetEventFailed_GetEventFailed_Event_DemEventParameter: start-on-event=DemSatellite_Invalid_OsApplicationInternalBehavior/GetEventFailed, operation=Event_DemEventParameter.GetEventFailed
        OpEventGetEventTested_GetEventTested_EvtInfo_DemEventParameter: start-on-event=DemSatellite_Invalid_OsApplicationInternalBehavior/GetEventTested, operation=EvtInfo_DemEventParameter.GetEventTested
        OpEventGetEventTested_GetEventTested_Event_DemEventParameter: start-on-event=DemSatellite_Invalid_OsApplicationInternalBehavior/GetEventTested, operation=Event_DemEventParameter.GetEventTested
        OpEventGetDTCOfEvent_GetDTCOfEvent_EvtInfo_DemEventParameter: start-on-event=DemSatellite_Invalid_OsApplicationInternalBehavior/GetDTCOfEvent, operation=EvtInfo_DemEventParameter.GetDTCOfEvent
        OpEventGetDTCOfEvent_GetDTCOfEvent_Event_DemEventParameter: start-on-event=DemSatellite_Invalid_OsApplicationInternalBehavior/GetDTCOfEvent, operation=Event_DemEventParameter.GetDTCOfEvent
        OpEventGetFaultDetectionCounter_GetFaultDetectionCounter_EvtInfo_DemEventParameter: start-on-event=DemSatellite_Invalid_OsApplicationInternalBehavior/GetFaultDetectionCounter, operation=EvtInfo_DemEventParameter.GetFaultDetectionCounter
        OpEventGetFaultDetectionCounter_GetFaultDetectionCounter_Event_DemEventParameter: start-on-event=DemSatellite_Invalid_OsApplicationInternalBehavior/GetFaultDetectionCounter, operation=Event_DemEventParameter.GetFaultDetectionCounter
        OpEventGetEventFreezeFrameDataEx_GetEventFreezeFrameDataEx_EvtInfo_DemEventParameter: start-on-event=DemSatellite_Invalid_OsApplicationInternalBehavior/GetEventFreezeFrameDataEx, operation=EvtInfo_DemEventParameter.GetEventFreezeFrameDataEx
        OpEventGetEventFreezeFrameDataEx_GetEventFreezeFrameDataEx_Event_DemEventParameter: start-on-event=DemSatellite_Invalid_OsApplicationInternalBehavior/GetEventFreezeFrameDataEx, operation=Event_DemEventParameter.GetEventFreezeFrameDataEx
        OpEventGetEventExtendedDataRecordEx_GetEventExtendedDataRecordEx_EvtInfo_DemEventParameter: start-on-event=DemSatellite_Invalid_OsApplicationInternalBehavior/GetEventExtendedDataRecordEx, operation=EvtInfo_DemEventParameter.GetEventExtendedDataRecordEx
        OpEventGetEventExtendedDataRecordEx_GetEventExtendedDataRecordEx_Event_DemEventParameter: start-on-event=DemSatellite_Invalid_OsApplicationInternalBehavior/GetEventExtendedDataRecordEx, operation=Event_DemEventParameter.GetEventExtendedDataRecordEx
        OpEventGetEventEnableCondition_GetEventEnableCondition_EvtInfo_DemEventParameter: start-on-event=DemSatellite_Invalid_OsApplicationInternalBehavior/GetEventEnableCondition, operation=EvtInfo_DemEventParameter.GetEventEnableCondition
        OpEventGetDebouncingOfEvent_GetDebouncingOfEvent_EvtInfo_DemEventParameter: start-on-event=DemSatellite_Invalid_OsApplicationInternalBehavior/GetDebouncingOfEvent, operation=EvtInfo_DemEventParameter.GetDebouncingOfEvent
        OpEventGetMonitorStatus_GetMonitorStatus_EvtInfo_DemEventParameter: start-on-event=DemSatellite_Invalid_OsApplicationInternalBehavior/GetMonitorStatus, operation=EvtInfo_DemEventParameter.GetMonitorStatus
        OpEventSetEventStatus_SetEventStatus_Event_DemEventParameter: start-on-event=SetEventStatus, operation=Event_DemEventParameter.SetEventStatus
        OpEventResetEventStatus_ResetEventStatus_Event_DemEventParameter: start-on-event=ResetEventStatus, operation=Event_DemEventParameter.ResetEventStatus
        OpEventResetEventDebounceStatus_ResetEventDebounceStatus_Event_DemEventParameter: start-on-event=ResetEventDebounceStatus, operation=Event_DemEventParameter.ResetEventDebounceStatus
      port-api-options:
        enable-take-address=true, indirect-api=false, port=DemSatellite_Invalid_OsApplication/GeneralEvtInfo
        {enable-take-address=true, indirect-api=false, port-defined-argument-value{value=55, value-type=Dem_EventIdType}, port=EvtInfo_SAS_message_Steering_Wheel_Angle_Invalid_Serial_Data_Received}
        {enable-take-address=true, indirect-api=false, port-defined-argument-value{value=55, value-type=Dem_EventIdType}, port=Event_SAS_message_Steering_Wheel_Angle_Invalid_Serial_Data_Received}
        {enable-take-address=true, indirect-api=false, port-defined-argument-value{value=5, value-type=Dem_EventIdType}, port=EvtInfo_AT_AMT_ETC2_message_Transcurrent_gear_Invalid_Serial_Data_Received}
        {enable-take-address=true, indirect-api=false, port-defined-argument-value{value=5, value-type=Dem_EventIdType}, port=Event_AT_AMT_ETC2_message_Transcurrent_gear_Invalid_Serial_Data_Received}
        {enable-take-address=true, indirect-api=false, port-defined-argument-value{value=35, value-type=Dem_EventIdType}, port=EvtInfo_Radar_AutoAlignment_Algorithm_Signal_Calculation_Failure}
        {enable-take-address=true, indirect-api=false, port-defined-argument-value{value=35, value-type=Dem_EventIdType}, port=Event_Radar_AutoAlignment_Algorithm_Signal_Calculation_Failure}
        {enable-take-address=true, indirect-api=false, port-defined-argument-value{value=60, value-type=Dem_EventIdType}, port=EvtInfo_Vehicle_DataSet_Not_Configured}
        {enable-take-address=true, indirect-api=false, port-defined-argument-value{value=60, value-type=Dem_EventIdType}, port=Event_Vehicle_DataSet_Not_Configured}
        {enable-take-address=true, indirect-api=false, port-defined-argument-value{value=43, value-type=Dem_EventIdType}, port=EvtInfo_Radar_Module_System_Internal_Failure}
        {enable-take-address=true, indirect-api=false, port-defined-argument-value{value=43, value-type=Dem_EventIdType}, port=Event_Radar_Module_System_Internal_Failure}
        {enable-take-address=true, indirect-api=false, port-defined-argument-value{value=39, value-type=Dem_EventIdType}, port=EvtInfo_Radar_MMIC_Component_Failure}
        {enable-take-address=true, indirect-api=false, port-defined-argument-value{value=39, value-type=Dem_EventIdType}, port=Event_Radar_MMIC_Component_Failure}
        {enable-take-address=true, indirect-api=false, port-defined-argument-value{value=41, value-type=Dem_EventIdType}, port=EvtInfo_Radar_Module_General_Memory_Failure}
        {enable-take-address=true, indirect-api=false, port-defined-argument-value{value=41, value-type=Dem_EventIdType}, port=Event_Radar_Module_General_Memory_Failure}
        {enable-take-address=true, indirect-api=false, port-defined-argument-value{value=50, value-type=Dem_EventIdType}, port=EvtInfo_Radar_System_Battery_High_Voltage_System_Voltage_High}
        {enable-take-address=true, indirect-api=false, port-defined-argument-value{value=50, value-type=Dem_EventIdType}, port=Event_Radar_System_Battery_High_Voltage_System_Voltage_High}
        {enable-take-address=true, indirect-api=false, port-defined-argument-value{value=7, value-type=Dem_EventIdType}, port=EvtInfo_CCVS1_message_Vehicle_Speed_Invalid_Serial_Data_Received}
        {enable-take-address=true, indirect-api=false, port-defined-argument-value{value=7, value-type=Dem_EventIdType}, port=Event_CCVS1_message_Vehicle_Speed_Invalid_Serial_Data_Received}
        {enable-take-address=true, indirect-api=false, port-defined-argument-value{value=24, value-type=Dem_EventIdType}, port=EvtInfo_EMS_ECU_VD_erratic_communication_Erratic}
        {enable-take-address=true, indirect-api=false, port-defined-argument-value{value=24, value-type=Dem_EventIdType}, port=Event_EMS_ECU_VD_erratic_communication_Erratic}
        {enable-take-address=true, indirect-api=false, port-defined-argument-value{value=22, value-type=Dem_EventIdType}, port=EvtInfo_EMS_ECU_ETC2_00_message_Missing_Message}
        {enable-take-address=true, indirect-api=false, port-defined-argument-value{value=22, value-type=Dem_EventIdType}, port=Event_EMS_ECU_ETC2_00_message_Missing_Message}
        {enable-take-address=true, indirect-api=false, port-defined-argument-value{value=14, value-type=Dem_EventIdType}, port=EvtInfo_Cluster_ECU_CLS_Tx_16_message_Missing_Message}
        {enable-take-address=true, indirect-api=false, port-defined-argument-value{value=14, value-type=Dem_EventIdType}, port=Event_Cluster_ECU_CLS_Tx_16_message_Missing_Message}
        {enable-take-address=true, indirect-api=false, port-defined-argument-value{value=28, value-type=Dem_EventIdType}, port=EvtInfo_Exceeded_Security_Access_0x27_Attempt_Threshold_Authentication_Failure}
        {enable-take-address=true, indirect-api=false, port-defined-argument-value{value=28, value-type=Dem_EventIdType}, port=Event_Exceeded_Security_Access_0x27_Attempt_Threshold_Authentication_Failure}
        {enable-take-address=true, indirect-api=false, port-defined-argument-value{value=30, value-type=Dem_EventIdType}, port=EvtInfo_Front_Left_Side_Radar_value_of_signal_protection_calculation_Incorrect}
        {enable-take-address=true, indirect-api=false, port-defined-argument-value{value=30, value-type=Dem_EventIdType}, port=Event_Front_Left_Side_Radar_value_of_signal_protection_calculation_Incorrect}
        {enable-take-address=true, indirect-api=false, port-defined-argument-value{value=4, value-type=Dem_EventIdType}, port=EvtInfo_AT_AMT_ETC2_erratic_communication_Erratic}
        {enable-take-address=true, indirect-api=false, port-defined-argument-value{value=4, value-type=Dem_EventIdType}, port=Event_AT_AMT_ETC2_erratic_communication_Erratic}
        {enable-take-address=true, indirect-api=false, port-defined-argument-value{value=56, value-type=Dem_EventIdType}, port=EvtInfo_VCAN_Communication_Bus_Off}
        {enable-take-address=true, indirect-api=false, port-defined-argument-value{value=56, value-type=Dem_EventIdType}, port=Event_VCAN_Communication_Bus_Off}
        {enable-take-address=true, indirect-api=false, port-defined-argument-value{value=58, value-type=Dem_EventIdType}, port=EvtInfo_VDC2_message_LongitudinalAcceleration_Invalid_Serial_Data_Received}
        {enable-take-address=true, indirect-api=false, port-defined-argument-value{value=58, value-type=Dem_EventIdType}, port=Event_VDC2_message_LongitudinalAcceleration_Invalid_Serial_Data_Received}
        {enable-take-address=true, indirect-api=false, port-defined-argument-value{value=40, value-type=Dem_EventIdType}, port=EvtInfo_Radar_MMIC_RFBIST_Component_Internal_Failure}
        {enable-take-address=true, indirect-api=false, port-defined-argument-value{value=40, value-type=Dem_EventIdType}, port=Event_Radar_MMIC_RFBIST_Component_Internal_Failure}
        {enable-take-address=true, indirect-api=false, port-defined-argument-value{value=38, value-type=Dem_EventIdType}, port=EvtInfo_Radar_Initial_Alignment_Missing_Calibration}
        {enable-take-address=true, indirect-api=false, port-defined-argument-value{value=38, value-type=Dem_EventIdType}, port=Event_Radar_Initial_Alignment_Missing_Calibration}
        {enable-take-address=true, indirect-api=false, port-defined-argument-value{value=16, value-type=Dem_EventIdType}, port=EvtInfo_Cluster_ECU_OEL_message_Missing_Message}
        {enable-take-address=true, indirect-api=false, port-defined-argument-value{value=16, value-type=Dem_EventIdType}, port=Event_Cluster_ECU_OEL_message_Missing_Message}
        {enable-take-address=true, indirect-api=false, port-defined-argument-value{value=3, value-type=Dem_EventIdType}, port=EvtInfo_AT_AMT_ECU_ETC2_03_message_Missing_Message}
        {enable-take-address=true, indirect-api=false, port-defined-argument-value{value=3, value-type=Dem_EventIdType}, port=Event_AT_AMT_ECU_ETC2_03_message_Missing_Message}
        {enable-take-address=true, indirect-api=false, port-defined-argument-value{value=2, value-type=Dem_EventIdType}, port=EvtInfo_ADAS_FN_STS_message_MOIS_FN_Switch_STS_Invalid_Serial_Data_Received}
        {enable-take-address=true, indirect-api=false, port-defined-argument-value{value=2, value-type=Dem_EventIdType}, port=Event_ADAS_FN_STS_message_MOIS_FN_Switch_STS_Invalid_Serial_Data_Received}
        {enable-take-address=true, indirect-api=false, port-defined-argument-value{value=42, value-type=Dem_EventIdType}, port=EvtInfo_Radar_Module_Over_Temperature}
        {enable-take-address=true, indirect-api=false, port-defined-argument-value{value=42, value-type=Dem_EventIdType}, port=Event_Radar_Module_Over_Temperature}
        {enable-take-address=true, indirect-api=false, port-defined-argument-value{value=34, value-type=Dem_EventIdType}, port=EvtInfo_PCAN_TimeSync_Missing_Message}
        {enable-take-address=true, indirect-api=false, port-defined-argument-value{value=34, value-type=Dem_EventIdType}, port=Event_PCAN_TimeSync_Missing_Message}
        {enable-take-address=true, indirect-api=false, port-defined-argument-value{value=44, value-type=Dem_EventIdType}, port=EvtInfo_Radar_Module_Watchdog_Failure}
        {enable-take-address=true, indirect-api=false, port-defined-argument-value{value=44, value-type=Dem_EventIdType}, port=Event_Radar_Module_Watchdog_Failure}
        {enable-take-address=true, indirect-api=false, port-defined-argument-value{value=53, value-type=Dem_EventIdType}, port=EvtInfo_SAS_ECU_SAS_message_Missing_Message}
        {enable-take-address=true, indirect-api=false, port-defined-argument-value{value=53, value-type=Dem_EventIdType}, port=Event_SAS_ECU_SAS_message_Missing_Message}
        {enable-take-address=true, indirect-api=false, port-defined-argument-value{value=19, value-type=Dem_EventIdType}, port=EvtInfo_ECU_NVM_Corruption_Program_memory_Failure}
        {enable-take-address=true, indirect-api=false, port-defined-argument-value{value=19, value-type=Dem_EventIdType}, port=Event_ECU_NVM_Corruption_Program_memory_Failure}
        {enable-take-address=true, indirect-api=false, port-defined-argument-value{value=18, value-type=Dem_EventIdType}, port=EvtInfo_Cluster_ECU_TD_message_Missing_Message}
        {enable-take-address=true, indirect-api=false, port-defined-argument-value{value=18, value-type=Dem_EventIdType}, port=Event_Cluster_ECU_TD_message_Missing_Message}
        {enable-take-address=true, indirect-api=false, port-defined-argument-value{value=33, value-type=Dem_EventIdType}, port=EvtInfo_PCAN_Communication_Bus_Off}
        {enable-take-address=true, indirect-api=false, port-defined-argument-value{value=33, value-type=Dem_EventIdType}, port=Event_PCAN_Communication_Bus_Off}
        {enable-take-address=true, indirect-api=false, port-defined-argument-value{value=29, value-type=Dem_EventIdType}, port=EvtInfo_Front_Left_Side_Radar_Missing_Message}
        {enable-take-address=true, indirect-api=false, port-defined-argument-value{value=29, value-type=Dem_EventIdType}, port=Event_Front_Left_Side_Radar_Missing_Message}
        {enable-take-address=true, indirect-api=false, port-defined-argument-value{value=31, value-type=Dem_EventIdType}, port=EvtInfo_Manual_ETC2_message_Transcurrent_gear_Invalid_Serial_Data_Received}
        {enable-take-address=true, indirect-api=false, port-defined-argument-value{value=31, value-type=Dem_EventIdType}, port=Event_Manual_ETC2_message_Transcurrent_gear_Invalid_Serial_Data_Received}
        {enable-take-address=true, indirect-api=false, port-defined-argument-value{value=54, value-type=Dem_EventIdType}, port=EvtInfo_SAS_ECU_erratic_communication_Erratic}
        {enable-take-address=true, indirect-api=false, port-defined-argument-value{value=54, value-type=Dem_EventIdType}, port=Event_SAS_ECU_erratic_communication_Erratic}
        {enable-take-address=true, indirect-api=false, port-defined-argument-value{value=59, value-type=Dem_EventIdType}, port=EvtInfo_VDC2_message_Yaw_rate_Invalid_Serial_Data_Received}
        {enable-take-address=true, indirect-api=false, port-defined-argument-value{value=59, value-type=Dem_EventIdType}, port=Event_VDC2_message_Yaw_rate_Invalid_Serial_Data_Received}
        {enable-take-address=true, indirect-api=false, port-defined-argument-value{value=17, value-type=Dem_EventIdType}, port=EvtInfo_Cluster_ECU_TD_erratic_communication_Erratic}
        {enable-take-address=true, indirect-api=false, port-defined-argument-value{value=17, value-type=Dem_EventIdType}, port=Event_Cluster_ECU_TD_erratic_communication_Erratic}
        {enable-take-address=true, indirect-api=false, port-defined-argument-value{value=21, value-type=Dem_EventIdType}, port=EvtInfo_EMS_ECU_CCVS1_message_Missing_Message}
        {enable-take-address=true, indirect-api=false, port-defined-argument-value{value=21, value-type=Dem_EventIdType}, port=Event_EMS_ECU_CCVS1_message_Missing_Message}
        {enable-take-address=true, indirect-api=false, port-defined-argument-value{value=45, value-type=Dem_EventIdType}, port=EvtInfo_Radar_Mounting_Orientation_Incorrect_Assembly}
        {enable-take-address=true, indirect-api=false, port-defined-argument-value{value=45, value-type=Dem_EventIdType}, port=Event_Radar_Mounting_Orientation_Incorrect_Assembly}
        {enable-take-address=true, indirect-api=false, port-defined-argument-value{value=23, value-type=Dem_EventIdType}, port=EvtInfo_EMS_ECU_ETC2_erratic_communication_Erractic}
        {enable-take-address=true, indirect-api=false, port-defined-argument-value{value=23, value-type=Dem_EventIdType}, port=Event_EMS_ECU_ETC2_erratic_communication_Erractic}
        {enable-take-address=true, indirect-api=false, port-defined-argument-value{value=9, value-type=Dem_EventIdType}, port=EvtInfo_Cluster_ECU_ADAS_FN_STS_erratic_communication_Erratic}
        {enable-take-address=true, indirect-api=false, port-defined-argument-value{value=9, value-type=Dem_EventIdType}, port=Event_Cluster_ECU_ADAS_FN_STS_erratic_communication_Erratic}
        {enable-take-address=true, indirect-api=false, port-defined-argument-value{value=27, value-type=Dem_EventIdType}, port=EvtInfo_ESC_ECU_VDC2_message_Missing_Message}
        {enable-take-address=true, indirect-api=false, port-defined-argument-value{value=27, value-type=Dem_EventIdType}, port=Event_ESC_ECU_VDC2_message_Missing_Message}
        {enable-take-address=true, indirect-api=false, port-defined-argument-value{value=8, value-type=Dem_EventIdType}, port=EvtInfo_CLS_TX_16_message_Transmission_Type_info_Invalid_Serial_Data_Received}
        {enable-take-address=true, indirect-api=false, port-defined-argument-value{value=8, value-type=Dem_EventIdType}, port=Event_CLS_TX_16_message_Transmission_Type_info_Invalid_Serial_Data_Received}
        {enable-take-address=true, indirect-api=false, port-defined-argument-value{value=11, value-type=Dem_EventIdType}, port=EvtInfo_Cluster_ECU_CLS_Tx_4_erratic_communication_Erratic}
        {enable-take-address=true, indirect-api=false, port-defined-argument-value{value=11, value-type=Dem_EventIdType}, port=Event_Cluster_ECU_CLS_Tx_4_erratic_communication_Erratic}
        {enable-take-address=true, indirect-api=false, port-defined-argument-value{value=10, value-type=Dem_EventIdType}, port=EvtInfo_Cluster_ECU_ADAS_FN_STS_message_Missing_Message}
        {enable-take-address=true, indirect-api=false, port-defined-argument-value{value=10, value-type=Dem_EventIdType}, port=Event_Cluster_ECU_ADAS_FN_STS_message_Missing_Message}
        {enable-take-address=true, indirect-api=false, port-defined-argument-value{value=61, value-type=Dem_EventIdType}, port=EvtInfo_Vehicle_Dataset_value_of_signal_protection_calculation_Incorrect}
        {enable-take-address=true, indirect-api=false, port-defined-argument-value{value=61, value-type=Dem_EventIdType}, port=Event_Vehicle_Dataset_value_of_signal_protection_calculation_Incorrect}
        {enable-take-address=true, indirect-api=false, port-defined-argument-value{value=13, value-type=Dem_EventIdType}, port=EvtInfo_Cluster_ECU_CLS_Tx_16_erratic_communication_Erratic}
        {enable-take-address=true, indirect-api=false, port-defined-argument-value{value=13, value-type=Dem_EventIdType}, port=Event_Cluster_ECU_CLS_Tx_16_erratic_communication_Erratic}
        {enable-take-address=true, indirect-api=false, port-defined-argument-value{value=15, value-type=Dem_EventIdType}, port=EvtInfo_Cluster_ECU_OEL_erratic_communication_Erratic}
        {enable-take-address=true, indirect-api=false, port-defined-argument-value{value=15, value-type=Dem_EventIdType}, port=Event_Cluster_ECU_OEL_erratic_communication_Erratic}
        {enable-take-address=true, indirect-api=false, port-defined-argument-value{value=12, value-type=Dem_EventIdType}, port=EvtInfo_Cluster_ECU_CLS_Tx_4_message_Missing_Message}
        {enable-take-address=true, indirect-api=false, port-defined-argument-value{value=12, value-type=Dem_EventIdType}, port=Event_Cluster_ECU_CLS_Tx_4_message_Missing_Message}
        {enable-take-address=true, indirect-api=false, port-defined-argument-value{value=46, value-type=Dem_EventIdType}, port=EvtInfo_Radar_Performance_Capability_Algorithm_Based_Failure}
        {enable-take-address=true, indirect-api=false, port-defined-argument-value{value=46, value-type=Dem_EventIdType}, port=Event_Radar_Performance_Capability_Algorithm_Based_Failure}
        {enable-take-address=true, indirect-api=false, port-defined-argument-value{value=37, value-type=Dem_EventIdType}, port=EvtInfo_Radar_AutoAlignment_Range_Alignment_or_Adjustement_Incorrect}
        {enable-take-address=true, indirect-api=false, port-defined-argument-value{value=37, value-type=Dem_EventIdType}, port=Event_Radar_AutoAlignment_Range_Alignment_or_Adjustement_Incorrect}
        {enable-take-address=true, indirect-api=false, port-defined-argument-value{value=20, value-type=Dem_EventIdType}, port=EvtInfo_EMS_ECU_CCVS1_erratic_communication_Erractic}
        {enable-take-address=true, indirect-api=false, port-defined-argument-value{value=20, value-type=Dem_EventIdType}, port=Event_EMS_ECU_CCVS1_erratic_communication_Erractic}
        {enable-take-address=true, indirect-api=false, port-defined-argument-value{value=51, value-type=Dem_EventIdType}, port=EvtInfo_Radar_System_Battery_Low_Voltage_System_Voltage_Low}
        {enable-take-address=true, indirect-api=false, port-defined-argument-value{value=51, value-type=Dem_EventIdType}, port=Event_Radar_System_Battery_Low_Voltage_System_Voltage_Low}
        {enable-take-address=true, indirect-api=false, port-defined-argument-value{value=49, value-type=Dem_EventIdType}, port=EvtInfo_Radar_SMC_General_Checksum_Failure}
        {enable-take-address=true, indirect-api=false, port-defined-argument-value{value=49, value-type=Dem_EventIdType}, port=Event_Radar_SMC_General_Checksum_Failure}
        {enable-take-address=true, indirect-api=false, port-defined-argument-value{value=47, value-type=Dem_EventIdType}, port=EvtInfo_Radar_Pin_Position_Wrong_Mounting_Position}
        {enable-take-address=true, indirect-api=false, port-defined-argument-value{value=47, value-type=Dem_EventIdType}, port=Event_Radar_Pin_Position_Wrong_Mounting_Position}
        {enable-take-address=true, indirect-api=false, port-defined-argument-value{value=57, value-type=Dem_EventIdType}, port=EvtInfo_VDC2_message_Lateral_Accleration_Invalid_Serial_Data_Received}
        {enable-take-address=true, indirect-api=false, port-defined-argument-value{value=57, value-type=Dem_EventIdType}, port=Event_VDC2_message_Lateral_Accleration_Invalid_Serial_Data_Received}
        {enable-take-address=true, indirect-api=false, port-defined-argument-value{value=1, value-type=Dem_EventIdType}, port=EvtInfo_ADAS_FN_STS_message_BSIS_FN_Switch_STS_Invalid_Serial_Data_Received}
        {enable-take-address=true, indirect-api=false, port-defined-argument-value{value=1, value-type=Dem_EventIdType}, port=Event_ADAS_FN_STS_message_BSIS_FN_Switch_STS_Invalid_Serial_Data_Received}
        {enable-take-address=true, indirect-api=false, port-defined-argument-value{value=36, value-type=Dem_EventIdType}, port=EvtInfo_Radar_AutoAlignment_Misalignment_Performance_or_Incorrect_Operation}
        {enable-take-address=true, indirect-api=false, port-defined-argument-value{value=36, value-type=Dem_EventIdType}, port=Event_Radar_AutoAlignment_Misalignment_Performance_or_Incorrect_Operation}
        {enable-take-address=true, indirect-api=false, port-defined-argument-value{value=26, value-type=Dem_EventIdType}, port=EvtInfo_ESC_ECU_VDC2_erratic_communication_Erratic}
        {enable-take-address=true, indirect-api=false, port-defined-argument-value{value=26, value-type=Dem_EventIdType}, port=Event_ESC_ECU_VDC2_erratic_communication_Erratic}
        {enable-take-address=true, indirect-api=false, port-defined-argument-value{value=6, value-type=Dem_EventIdType}, port=EvtInfo_Application_Interface_Lookup_Performance_or_Incorrect_Operation}
        {enable-take-address=true, indirect-api=false, port-defined-argument-value{value=6, value-type=Dem_EventIdType}, port=Event_Application_Interface_Lookup_Performance_or_Incorrect_Operation}
        {enable-take-address=true, indirect-api=false, port-defined-argument-value{value=25, value-type=Dem_EventIdType}, port=EvtInfo_EMS_ECU_VD_message_Missing_Message}
        {enable-take-address=true, indirect-api=false, port-defined-argument-value{value=25, value-type=Dem_EventIdType}, port=Event_EMS_ECU_VD_message_Missing_Message}
        {enable-take-address=true, indirect-api=false, port-defined-argument-value{value=48, value-type=Dem_EventIdType}, port=EvtInfo_Radar_Platform_Time_System_Programming_Failure}
        {enable-take-address=true, indirect-api=false, port-defined-argument-value{value=48, value-type=Dem_EventIdType}, port=Event_Radar_Platform_Time_System_Programming_Failure}
        {enable-take-address=true, indirect-api=false, port-defined-argument-value{value=32, value-type=Dem_EventIdType}, port=EvtInfo_OEL_message_Turn_Signal_Switch_Invalid_Serial_Data_Received}
        {enable-take-address=true, indirect-api=false, port-defined-argument-value{value=32, value-type=Dem_EventIdType}, port=Event_OEL_message_Turn_Signal_Switch_Invalid_Serial_Data_Received}
        {enable-take-address=true, indirect-api=false, port-defined-argument-value{value=52, value-type=Dem_EventIdType}, port=EvtInfo_Radar_calibration_Calibration_or_Paramater_Memory_Failure}
        {enable-take-address=true, indirect-api=false, port-defined-argument-value{value=52, value-type=Dem_EventIdType}, port=Event_Radar_calibration_Calibration_or_Paramater_Memory_Failure}
        {enable-take-address=true, indirect-api=false, port-defined-argument-value{value=62, value-type=Dem_EventIdType}, port=EvtInfo_DemEventParameter}
        {enable-take-address=true, indirect-api=false, port-defined-argument-value{value=62, value-type=Dem_EventIdType}, port=Event_DemEventParameter}
      15 x runnable:
        Dem_SatelliteMainFunction
        GetEventUdsStatus: can-be-invoked-concurrently=true, symbol=Dem_GetEventUdsStatus
        GetEventStatus: can-be-invoked-concurrently=true, symbol=Dem_GetEventUdsStatus
        GetEventFailed: can-be-invoked-concurrently=true, symbol=Dem_GetEventFailed
        GetEventTested: can-be-invoked-concurrently=true, symbol=Dem_GetEventTested
        GetDTCOfEvent: can-be-invoked-concurrently=true, symbol=Dem_GetDTCOfEvent
        GetFaultDetectionCounter: can-be-invoked-concurrently=true, symbol=Dem_GetFaultDetectionCounter
        GetEventFreezeFrameDataEx: can-be-invoked-concurrently=true, symbol=Dem_GetEventFreezeFrameDataEx
        GetEventExtendedDataRecordEx: can-be-invoked-concurrently=true, symbol=Dem_GetEventExtendedDataRecordEx
        GetEventEnableCondition: can-be-invoked-concurrently=true, symbol=Dem_GetEventEnableCondition
        GetDebouncingOfEvent: can-be-invoked-concurrently=true, symbol=Dem_GetDebouncingOfEvent
        GetMonitorStatus: can-be-invoked-concurrently=true, symbol=Dem_GetMonitorStatus
        SetEventStatus: can-be-invoked-concurrently=true, symbol=Dem_SetEventStatus
        ResetEventStatus: can-be-invoked-concurrently=true, symbol=Dem_ResetEventStatus
        ResetEventDebounceStatus: can-be-invoked-concurrently=true, symbol=Dem_ResetEventDebounceStatus
  swc implementation DemSatellite_Invalid_OsApplicationImplementation: programming-language=C, behavior=DemSatellite_Invalid_OsApplicationInternalBehavior
