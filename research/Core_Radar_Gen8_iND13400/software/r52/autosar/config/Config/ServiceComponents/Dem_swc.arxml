[part 2 of 3: package /MICROSAR/Dem_swc/ComponentTypes]
AUTOSAR XML (schema 00053)
package /MICROSAR/Dem_swc/ComponentTypes  (continued)
  service sw component type DemSatellite_Invalid_OsApplication: category=SERVICE_COMPONENT  (continued)
    behavior DemSatellite_Invalid_OsApplicationInternalBehavior: handle-termination-and-restart=NO-SUPPORT, included-data-type-set=data-type=[Dem_EventIdType, Dem_BufferLengthType, Dcm_NegativeResponseCodeType, Dem_RatioIdType, Dem_EventStatusType, Dem_UdsStatusByteType, Dem_DTCFormatType, Dem_InitMonitorReasonType, Dem_OperationCycleStateType, Dem_DTCStatusMaskType, Dem_IndicatorStatusType, Dem_MaxDataValueType, Dem_DTCKindType, Dem_DTCGroupType, Dem_IumprDenomCondIdType, Dem_IumprDenomCondStatusType, Dem_DebounceResetStatusType, Dem_DebouncingStateType, Dem_IumprReadinessGroupType, Dem_DTRControlType, Dem_DTCSeverityType, Dem_MonitorStatusType]  (continued)
      1375 x operation invoked event:  (continued)
        OpEventGetEventTested_GetEventTested_EvtInfo_VDC2_message_LongitudinalAcceleration_Invalid_Serial_Data_Received: start-on-event=DemSatellite_Invalid_OsApplicationInternalBehavior/GetEventTested, operation=EvtInfo_VDC2_message_LongitudinalAcceleration_Invalid_Serial_Data_Received.GetEventTested
        OpEventGetEventTested_GetEventTested_Event_VDC2_message_LongitudinalAcceleration_Invalid_Serial_Data_Received: start-on-event=DemSatellite_Invalid_OsApplicationInternalBehavior/GetEventTested, operation=Event_VDC2_message_LongitudinalAcceleration_Invalid_Serial_Data_Received.GetEventTested
        OpEventGetEventTested_GetEventTested_EvtInfo_Radar_MMIC_RFBIST_Component_Internal_Failure: start-on-event=DemSatellite_Invalid_OsApplicationInternalBehavior/GetEventTested, operation=EvtInfo_Radar_MMIC_RFBIST_Component_Internal_Failure.GetEventTested
        OpEventGetEventTested_GetEventTested_Event_Radar_MMIC_RFBIST_Component_Internal_Failure: start-on-event=DemSatellite_Invalid_OsApplicationInternalBehavior/GetEventTested, operation=Event_Radar_MMIC_RFBIST_Component_Internal_Failure.GetEventTested
        OpEventGetEventTested_GetEventTested_EvtInfo_Radar_Initial_Alignment_Missing_Calibration: start-on-event=DemSatellite_Invalid_OsApplicationInternalBehavior/GetEventTested, operation=EvtInfo_Radar_Initial_Alignment_Missing_Calibration.GetEventTested
        OpEventGetEventTested_GetEventTested_Event_Radar_Initial_Alignment_Missing_Calibration: start-on-event=DemSatellite_Invalid_OsApplicationInternalBehavior/GetEventTested, operation=Event_Radar_Initial_Alignment_Missing_Calibration.GetEventTested
        OpEventGetEventTested_GetEventTested_EvtInfo_Cluster_ECU_OEL_message_Missing_Message: start-on-event=DemSatellite_Invalid_OsApplicationInternalBehavior/GetEventTested, operation=EvtInfo_Cluster_ECU_OEL_message_Missing_Message.GetEventTested
        OpEventGetEventTested_GetEventTested_Event_Cluster_ECU_OEL_message_Missing_Message: start-on-event=DemSatellite_Invalid_OsApplicationInternalBehavior/GetEventTested, operation=Event_Cluster_ECU_OEL_message_Missing_Message.GetEventTested
        OpEventGetEventTested_GetEventTested_EvtInfo_AT_AMT_ECU_ETC2_03_message_Missing_Message: start-on-event=DemSatellite_Invalid_OsApplicationInternalBehavior/GetEventTested, operation=EvtInfo_AT_AMT_ECU_ETC2_03_message_Missing_Message.GetEventTested
        OpEventGetEventTested_GetEventTested_Event_AT_AMT_ECU_ETC2_03_message_Missing_Message: start-on-event=DemSatellite_Invalid_OsApplicationInternalBehavior/GetEventTested, operation=Event_AT_AMT_ECU_ETC2_03_message_Missing_Message.GetEventTested
        OpEventGetEventTested_GetEventTested_EvtInfo_ADAS_FN_STS_message_MOIS_FN_Switch_STS_Invalid_Serial_Data_Received: start-on-event=DemSatellite_Invalid_OsApplicationInternalBehavior/GetEventTested, operation=EvtInfo_ADAS_FN_STS_message_MOIS_FN_Switch_STS_Invalid_Serial_Data_Received.GetEventTested
        OpEventGetEventTested_GetEventTested_Event_ADAS_FN_STS_message_MOIS_FN_Switch_STS_Invalid_Serial_Data_Received: start-on-event=DemSatellite_Invalid_OsApplicationInternalBehavior/GetEventTested, operation=Event_ADAS_FN_STS_message_MOIS_FN_Switch_STS_Invalid_Serial_Data_Received.GetEventTested
        OpEventGetEventTested_GetEventTested_EvtInfo_Radar_Module_Over_Temperature: start-on-event=DemSatellite_Invalid_OsApplicationInternalBehavior/GetEventTested, operation=EvtInfo_Radar_Module_Over_Temperature.GetEventTested
        OpEventGetEventTested_GetEventTested_Event_Radar_Module_Over_Temperature: start-on-event=DemSatellite_Invalid_OsApplicationInternalBehavior/GetEventTested, operation=Event_Radar_Module_Over_Temperature.GetEventTested
        OpEventGetEventTested_GetEventTested_EvtInfo_PCAN_TimeSync_Missing_Message: start-on-event=DemSatellite_Invalid_OsApplicationInternalBehavior/GetEventTested, operation=EvtInfo_PCAN_TimeSync_Missing_Message.GetEventTested
        OpEventGetEventTested_GetEventTested_Event_PCAN_TimeSync_Missing_Message: start-on-event=DemSatellite_Invalid_OsApplicationInternalBehavior/GetEventTested, operation=Event_PCAN_TimeSync_Missing_Message.GetEventTested
        OpEventGetEventTested_GetEventTested_EvtInfo_Radar_Module_Watchdog_Failure: start-on-event=DemSatellite_Invalid_OsApplicationInternalBehavior/GetEventTested, operation=EvtInfo_Radar_Module_Watchdog_Failure.GetEventTested
        OpEventGetEventTested_GetEventTested_Event_Radar_Module_Watchdog_Failure: start-on-event=DemSatellite_Invalid_OsApplicationInternalBehavior/GetEventTested, operation=Event_Radar_Module_Watchdog_Failure.GetEventTested
        OpEventGetEventTested_GetEventTested_EvtInfo_SAS_ECU_SAS_message_Missing_Message: start-on-event=DemSatellite_Invalid_OsApplicationInternalBehavior/GetEventTested, operation=EvtInfo_SAS_ECU_SAS_message_Missing_Message.GetEventTested
        OpEventGetEventTested_GetEventTested_Event_SAS_ECU_SAS_message_Missing_Message: start-on-event=DemSatellite_Invalid_OsApplicationInternalBehavior/GetEventTested, operation=Event_SAS_ECU_SAS_message_Missing_Message.GetEventTested
        OpEventGetEventTested_GetEventTested_EvtInfo_ECU_NVM_Corruption_Program_memory_Failure: start-on-event=DemSatellite_Invalid_OsApplicationInternalBehavior/GetEventTested, operation=EvtInfo_ECU_NVM_Corruption_Program_memory_Failure.GetEventTested
        OpEventGetEventTested_GetEventTested_Event_ECU_NVM_Corruption_Program_memory_Failure: start-on-event=DemSatellite_Invalid_OsApplicationInternalBehavior/GetEventTested, operation=Event_ECU_NVM_Corruption_Program_memory_Failure.GetEventTested
        OpEventGetEventTested_GetEventTested_EvtInfo_Cluster_ECU_TD_message_Missing_Message: start-on-event=DemSatellite_Invalid_OsApplicationInternalBehavior/GetEventTested, operation=EvtInfo_Cluster_ECU_TD_message_Missing_Message.GetEventTested
        OpEventGetEventTested_GetEventTested_Event_Cluster_ECU_TD_message_Missing_Message: start-on-event=DemSatellite_Invalid_OsApplicationInternalBehavior/GetEventTested, operation=Event_Cluster_ECU_TD_message_Missing_Message.GetEventTested
        OpEventGetEventTested_GetEventTested_EvtInfo_PCAN_Communication_Bus_Off: start-on-event=DemSatellite_Invalid_OsApplicationInternalBehavior/GetEventTested, operation=EvtInfo_PCAN_Communication_Bus_Off.GetEventTested
        OpEventGetEventTested_GetEventTested_Event_PCAN_Communication_Bus_Off: start-on-event=DemSatellite_Invalid_OsApplicationInternalBehavior/GetEventTested, operation=Event_PCAN_Communication_Bus_Off.GetEventTested
        OpEventGetEventTested_GetEventTested_EvtInfo_Front_Left_Side_Radar_Missing_Message: start-on-event=DemSatellite_Invalid_OsApplicationInternalBehavior/GetEventTested, operation=EvtInfo_Front_Left_Side_Radar_Missing_Message.GetEventTested
        OpEventGetEventTested_GetEventTested_Event_Front_Left_Side_Radar_Missing_Message: start-on-event=DemSatellite_Invalid_OsApplicationInternalBehavior/GetEventTested, operation=Event_Front_Left_Side_Radar_Missing_Message.GetEventTested
        OpEventGetEventTested_GetEventTested_EvtInfo_Manual_ETC2_message_Transcurrent_gear_Invalid_Serial_Data_Received: start-on-event=DemSatellite_Invalid_OsApplicationInternalBehavior/GetEventTested, operation=EvtInfo_Manual_ETC2_message_Transcurrent_gear_Invalid_Serial_Data_Received.GetEventTested
        OpEventGetEventTested_GetEventTested_Event_Manual_ETC2_message_Transcurrent_gear_Invalid_Serial_Data_Received: start-on-event=DemSatellite_Invalid_OsApplicationInternalBehavior/GetEventTested, operation=Event_Manual_ETC2_message_Transcurrent_gear_Invalid_Serial_Data_Received.GetEventTested
        OpEventGetEventTested_GetEventTested_EvtInfo_SAS_ECU_erratic_communication_Erratic: start-on-event=DemSatellite_Invalid_OsApplicationInternalBehavior/GetEventTested, operation=EvtInfo_SAS_ECU_erratic_communication_Erratic.GetEventTested
        OpEventGetEventTested_GetEventTested_Event_SAS_ECU_erratic_communication_Erratic: start-on-event=DemSatellite_Invalid_OsApplicationInternalBehavior/GetEventTested, operation=Event_SAS_ECU_erratic_communication_Erratic.GetEventTested
        OpEventGetEventTested_GetEventTested_EvtInfo_VDC2_message_Yaw_rate_Invalid_Serial_Data_Received: start-on-event=DemSatellite_Invalid_OsApplicationInternalBehavior/GetEventTested, operation=EvtInfo_VDC2_message_Yaw_rate_Invalid_Serial_Data_Received.GetEventTested
        OpEventGetEventTested_GetEventTested_Event_VDC2_message_Yaw_rate_Invalid_Serial_Data_Received: start-on-event=DemSatellite_Invalid_OsApplicationInternalBehavior/GetEventTested, operation=Event_VDC2_message_Yaw_rate_Invalid_Serial_Data_Received.GetEventTested
        OpEventGetEventTested_GetEventTested_EvtInfo_Cluster_ECU_TD_erratic_communication_Erratic: start-on-event=DemSatellite_Invalid_OsApplicationInternalBehavior/GetEventTested, operation=EvtInfo_Cluster_ECU_TD_erratic_communication_Erratic.GetEventTested
        OpEventGetEventTested_GetEventTested_Event_Cluster_ECU_TD_erratic_communication_Erratic: start-on-event=DemSatellite_Invalid_OsApplicationInternalBehavior/GetEventTested, operation=Event_Cluster_ECU_TD_erratic_communication_Erratic.GetEventTested
        OpEventGetEventTested_GetEventTested_EvtInfo_EMS_ECU_CCVS1_message_Missing_Message: start-on-event=DemSatellite_Invalid_OsApplicationInternalBehavior/GetEventTested, operation=EvtInfo_EMS_ECU_CCVS1_message_Missing_Message.GetEventTested
        OpEventGetEventTested_GetEventTested_Event_EMS_ECU_CCVS1_message_Missing_Message: start-on-event=DemSatellite_Invalid_OsApplicationInternalBehavior/GetEventTested, operation=Event_EMS_ECU_CCVS1_message_Missing_Message.GetEventTested
        OpEventGetEventTested_GetEventTested_EvtInfo_Radar_Mounting_Orientation_Incorrect_Assembly: start-on-event=DemSatellite_Invalid_OsApplicationInternalBehavior/GetEventTested, operation=EvtInfo_Radar_Mounting_Orientation_Incorrect_Assembly.GetEventTested
        OpEventGetEventTested_GetEventTested_Event_Radar_Mounting_Orientation_Incorrect_Assembly: start-on-event=DemSatellite_Invalid_OsApplicationInternalBehavior/GetEventTested, operation=Event_Radar_Mounting_Orientation_Incorrect_Assembly.GetEventTested
        OpEventGetEventTested_GetEventTested_EvtInfo_EMS_ECU_ETC2_erratic_communication_Erractic: start-on-event=DemSatellite_Invalid_OsApplicationInternalBehavior/GetEventTested, operation=EvtInfo_EMS_ECU_ETC2_erratic_communication_Erractic.GetEventTested
        OpEventGetEventTested_GetEventTested_Event_EMS_ECU_ETC2_erratic_communication_Erractic: start-on-event=DemSatellite_Invalid_OsApplicationInternalBehavior/GetEventTested, operation=Event_EMS_ECU_ETC2_erratic_communication_Erractic.GetEventTested
        OpEventGetEventTested_GetEventTested_EvtInfo_Cluster_ECU_ADAS_FN_STS_erratic_communication_Erratic: start-on-event=DemSatellite_Invalid_OsApplicationInternalBehavior/GetEventTested, operation=EvtInfo_Cluster_ECU_ADAS_FN_STS_erratic_communication_Erratic.GetEventTested
        OpEventGetEventTested_GetEventTested_Event_Cluster_ECU_ADAS_FN_STS_erratic_communication_Erratic: start-on-event=DemSatellite_Invalid_OsApplicationInternalBehavior/GetEventTested, operation=Event_Cluster_ECU_ADAS_FN_STS_erratic_communication_Erratic.GetEventTested
        OpEventGetEventTested_GetEventTested_EvtInfo_ESC_ECU_VDC2_message_Missing_Message: start-on-event=DemSatellite_Invalid_OsApplicationInternalBehavior/GetEventTested, operation=EvtInfo_ESC_ECU_VDC2_message_Missing_Message.GetEventTested
        OpEventGetEventTested_GetEventTested_Event_ESC_ECU_VDC2_message_Missing_Message: start-on-event=DemSatellite_Invalid_OsApplicationInternalBehavior/GetEventTested, operation=Event_ESC_ECU_VDC2_message_Missing_Message.GetEventTested
        OpEventGetEventTested_GetEventTested_EvtInfo_CLS_TX_16_message_Transmission_Type_info_Invalid_Serial_Data_Received: start-on-event=DemSatellite_Invalid_OsApplicationInternalBehavior/GetEventTested, operation=EvtInfo_CLS_TX_16_message_Transmission_Type_info_Invalid_Serial_Data_Received.GetEventTested
        OpEventGetEventTested_GetEventTested_Event_CLS_TX_16_message_Transmission_Type_info_Invalid_Serial_Data_Received: start-on-event=DemSatellite_Invalid_OsApplicationInternalBehavior/GetEventTested, operation=Event_CLS_TX_16_message_Transmission_Type_info_Invalid_Serial_Data_Received.GetEventTested
        OpEventGetEventTested_GetEventTested_EvtInfo_Cluster_ECU_CLS_Tx_4_erratic_communication_Erratic: start-on-event=DemSatellite_Invalid_OsApplicationInternalBehavior/GetEventTested, operation=EvtInfo_Cluster_ECU_CLS_Tx_4_erratic_communication_Erratic.GetEventTested
        OpEventGetEventTested_GetEventTested_Event_Cluster_ECU_CLS_Tx_4_erratic_communication_Erratic: start-on-event=DemSatellite_Invalid_OsApplicationInternalBehavior/GetEventTested, operation=Event_Cluster_ECU_CLS_Tx_4_erratic_communication_Erratic.GetEventTested
        OpEventGetEventTested_GetEventTested_EvtInfo_Cluster_ECU_ADAS_FN_STS_message_Missing_Message: start-on-event=DemSatellite_Invalid_OsApplicationInternalBehavior/GetEventTested, operation=EvtInfo_Cluster_ECU_ADAS_FN_STS_message_Missing_Message.GetEventTested
        OpEventGetEventTested_GetEventTested_Event_Cluster_ECU_ADAS_FN_STS_message_Missing_Message: start-on-event=DemSatellite_Invalid_OsApplicationInternalBehavior/GetEventTested, operation=Event_Cluster_ECU_ADAS_FN_STS_message_Missing_Message.GetEventTested
        OpEventGetEventTested_GetEventTested_EvtInfo_Vehicle_Dataset_value_of_signal_protection_calculation_Incorrect: start-on-event=DemSatellite_Invalid_OsApplicationInternalBehavior/GetEventTested, operation=EvtInfo_Vehicle_Dataset_value_of_signal_protection_calculation_Incorrect.GetEventTested
        OpEventGetEventTested_GetEventTested_Event_Vehicle_Dataset_value_of_signal_protection_calculation_Incorrect: start-on-event=DemSatellite_Invalid_OsApplicationInternalBehavior/GetEventTested, operation=Event_Vehicle_Dataset_value_of_signal_protection_calculation_Incorrect.GetEventTested
        OpEventGetEventTested_GetEventTested_EvtInfo_Cluster_ECU_CLS_Tx_16_erratic_communication_Erratic: start-on-event=DemSatellite_Invalid_OsApplicationInternalBehavior/GetEventTested, operation=EvtInfo_Cluster_ECU_CLS_Tx_16_erratic_communication_Erratic.GetEventTested
        OpEventGetEventTested_GetEventTested_Event_Cluster_ECU_CLS_Tx_16_erratic_communication_Erratic: start-on-event=DemSatellite_Invalid_OsApplicationInternalBehavior/GetEventTested, operation=Event_Cluster_ECU_CLS_Tx_16_erratic_communication_Erratic.GetEventTested
        OpEventGetEventTested_GetEventTested_EvtInfo_Cluster_ECU_OEL_erratic_communication_Erratic: start-on-event=DemSatellite_Invalid_OsApplicationInternalBehavior/GetEventTested, operation=EvtInfo_Cluster_ECU_OEL_erratic_communication_Erratic.GetEventTested
        OpEventGetEventTested_GetEventTested_Event_Cluster_ECU_OEL_erratic_communication_Erratic: start-on-event=DemSatellite_Invalid_OsApplicationInternalBehavior/GetEventTested, operation=Event_Cluster_ECU_OEL_erratic_communication_Erratic.GetEventTested
        OpEventGetEventTested_GetEventTested_EvtInfo_Cluster_ECU_CLS_Tx_4_message_Missing_Message: start-on-event=DemSatellite_Invalid_OsApplicationInternalBehavior/GetEventTested, operation=EvtInfo_Cluster_ECU_CLS_Tx_4_message_Missing_Message.GetEventTested
        OpEventGetEventTested_GetEventTested_Event_Cluster_ECU_CLS_Tx_4_message_Missing_Message: start-on-event=DemSatellite_Invalid_OsApplicationInternalBehavior/GetEventTested, operation=Event_Cluster_ECU_CLS_Tx_4_message_Missing_Message.GetEventTested
        OpEventGetEventTested_GetEventTested_EvtInfo_Radar_Performance_Capability_Algorithm_Based_Failure: start-on-event=DemSatellite_Invalid_OsApplicationInternalBehavior/GetEventTested, operation=EvtInfo_Radar_Performance_Capability_Algorithm_Based_Failure.GetEventTested
        OpEventGetEventTested_GetEventTested_Event_Radar_Performance_Capability_Algorithm_Based_Failure: start-on-event=DemSatellite_Invalid_OsApplicationInternalBehavior/GetEventTested, operation=Event_Radar_Performance_Capability_Algorithm_Based_Failure.GetEventTested
        OpEventGetEventTested_GetEventTested_EvtInfo_Radar_AutoAlignment_Range_Alignment_or_Adjustement_Incorrect: start-on-event=DemSatellite_Invalid_OsApplicationInternalBehavior/GetEventTested, operation=EvtInfo_Radar_AutoAlignment_Range_Alignment_or_Adjustement_Incorrect.GetEventTested
        OpEventGetEventTested_GetEventTested_Event_Radar_AutoAlignment_Range_Alignment_or_Adjustement_Incorrect: start-on-event=DemSatellite_Invalid_OsApplicationInternalBehavior/GetEventTested, operation=Event_Radar_AutoAlignment_Range_Alignment_or_Adjustement_Incorrect.GetEventTested
        OpEventGetEventTested_GetEventTested_EvtInfo_EMS_ECU_CCVS1_erratic_communication_Erractic: start-on-event=DemSatellite_Invalid_OsApplicationInternalBehavior/GetEventTested, operation=EvtInfo_EMS_ECU_CCVS1_erratic_communication_Erractic.GetEventTested
        OpEventGetEventTested_GetEventTested_Event_EMS_ECU_CCVS1_erratic_communication_Erractic: start-on-event=DemSatellite_Invalid_OsApplicationInternalBehavior/GetEventTested, operation=Event_EMS_ECU_CCVS1_erratic_communication_Erractic.GetEventTested
        OpEventGetEventTested_GetEventTested_EvtInfo_Radar_System_Battery_Low_Voltage_System_Voltage_Low: start-on-event=DemSatellite_Invalid_OsApplicationInternalBehavior/GetEventTested, operation=EvtInfo_Radar_System_Battery_Low_Voltage_System_Voltage_Low.GetEventTested
        OpEventGetEventTested_GetEventTested_Event_Radar_System_Battery_Low_Voltage_System_Voltage_Low: start-on-event=DemSatellite_Invalid_OsApplicationInternalBehavior/GetEventTested, operation=Event_Radar_System_Battery_Low_Voltage_System_Voltage_Low.GetEventTested
        OpEventGetEventTested_GetEventTested_EvtInfo_Radar_SMC_General_Checksum_Failure: start-on-event=DemSatellite_Invalid_OsApplicationInternalBehavior/GetEventTested, operation=EvtInfo_Radar_SMC_General_Checksum_Failure.GetEventTested
        OpEventGetEventTested_GetEventTested_Event_Radar_SMC_General_Checksum_Failure: start-on-event=DemSatellite_Invalid_OsApplicationInternalBehavior/GetEventTested, operation=Event_Radar_SMC_General_Checksum_Failure.GetEventTested
        OpEventGetEventTested_GetEventTested_EvtInfo_Radar_Pin_Position_Wrong_Mounting_Position: start-on-event=DemSatellite_Invalid_OsApplicationInternalBehavior/GetEventTested, operation=EvtInfo_Radar_Pin_Position_Wrong_Mounting_Position.GetEventTested
        OpEventGetEventTested_GetEventTested_Event_Radar_Pin_Position_Wrong_Mounting_Position: start-on-event=DemSatellite_Invalid_OsApplicationInternalBehavior/GetEventTested, operation=Event_Radar_Pin_Position_Wrong_Mounting_Position.GetEventTested
        OpEventGetEventTested_GetEventTested_EvtInfo_VDC2_message_Lateral_Accleration_Invalid_Serial_Data_Received: start-on-event=DemSatellite_Invalid_OsApplicationInternalBehavior/GetEventTested, operation=EvtInfo_VDC2_message_Lateral_Accleration_Invalid_Serial_Data_Received.GetEventTested
        OpEventGetEventTested_GetEventTested_Event_VDC2_message_Lateral_Accleration_Invalid_Serial_Data_Received: start-on-event=DemSatellite_Invalid_OsApplicationInternalBehavior/GetEventTested, operation=Event_VDC2_message_Lateral_Accleration_Invalid_Serial_Data_Received.GetEventTested
        OpEventGetEventTested_GetEventTested_EvtInfo_ADAS_FN_STS_message_BSIS_FN_Switch_STS_Invalid_Serial_Data_Received: start-on-event=DemSatellite_Invalid_OsApplicationInternalBehavior/GetEventTested, operation=EvtInfo_ADAS_FN_STS_message_BSIS_FN_Switch_STS_Invalid_Serial_Data_Received.GetEventTested
        OpEventGetEventTested_GetEventTested_Event_ADAS_FN_STS_message_BSIS_FN_Switch_STS_Invalid_Serial_Data_Received: start-on-event=DemSatellite_Invalid_OsApplicationInternalBehavior/GetEventTested, operation=Event_ADAS_FN_STS_message_BSIS_FN_Switch_STS_Invalid_Serial_Data_Received.GetEventTested
        OpEventGetEventTested_GetEventTested_EvtInfo_Radar_AutoAlignment_Misalignment_Performance_or_Incorrect_Operation: start-on-event=DemSatellite_Invalid_OsApplicationInternalBehavior/GetEventTested, operation=EvtInfo_Radar_AutoAlignment_Misalignment_Performance_or_Incorrect_Operation.GetEventTested
        OpEventGetEventTested_GetEventTested_Event_Radar_AutoAlignment_Misalignment_Performance_or_Incorrect_Operation: start-on-event=DemSatellite_Invalid_OsApplicationInternalBehavior/GetEventTested, operation=Event_Radar_AutoAlignment_Misalignment_Performance_or_Incorrect_Operation.GetEventTested
        OpEventGetEventTested_GetEventTested_EvtInfo_ESC_ECU_VDC2_erratic_communication_Erratic: start-on-event=DemSatellite_Invalid_OsApplicationInternalBehavior/GetEventTested, operation=EvtInfo_ESC_ECU_VDC2_erratic_communication_Erratic.GetEventTested
        OpEventGetEventTested_GetEventTested_Event_ESC_ECU_VDC2_erratic_communication_Erratic: start-on-event=DemSatellite_Invalid_OsApplicationInternalBehavior/GetEventTested, operation=Event_ESC_ECU_VDC2_erratic_communication_Erratic.GetEventTested
        OpEventGetEventTested_GetEventTested_EvtInfo_Application_Interface_Lookup_Performance_or_Incorrect_Operation: start-on-event=DemSatellite_Invalid_OsApplicationInternalBehavior/GetEventTested, operation=EvtInfo_Application_Interface_Lookup_Performance_or_Incorrect_Operation.GetEventTested
        OpEventGetEventTested_GetEventTested_Event_Application_Interface_Lookup_Performance_or_Incorrect_Operation: start-on-event=DemSatellite_Invalid_OsApplicationInternalBehavior/GetEventTested, operation=Event_Application_Interface_Lookup_Performance_or_Incorrect_Operation.GetEventTested
        OpEventGetEventTested_GetEventTested_EvtInfo_EMS_ECU_VD_message_Missing_Message: start-on-event=DemSatellite_Invalid_OsApplicationInternalBehavior/GetEventTested, operation=EvtInfo_EMS_ECU_VD_message_Missing_Message.GetEventTested
        OpEventGetEventTested_GetEventTested_Event_EMS_ECU_VD_message_Missing_Message: start-on-event=DemSatellite_Invalid_OsApplicationInternalBehavior/GetEventTested, operation=Event_EMS_ECU_VD_message_Missing_Message.GetEventTested
        OpEventGetEventTested_GetEventTested_EvtInfo_Radar_Platform_Time_System_Programming_Failure: start-on-event=DemSatellite_Invalid_OsApplicationInternalBehavior/GetEventTested, operation=EvtInfo_Radar_Platform_Time_System_Programming_Failure.GetEventTested
        OpEventGetEventTested_GetEventTested_Event_Radar_Platform_Time_System_Programming_Failure: start-on-event=DemSatellite_Invalid_OsApplicationInternalBehavior/GetEventTested, operation=Event_Radar_Platform_Time_System_Programming_Failure.GetEventTested
        OpEventGetEventTested_GetEventTested_EvtInfo_OEL_message_Turn_Signal_Switch_Invalid_Serial_Data_Received: start-on-event=DemSatellite_Invalid_OsApplicationInternalBehavior/GetEventTested, operation=EvtInfo_OEL_message_Turn_Signal_Switch_Invalid_Serial_Data_Received.GetEventTested
        OpEventGetEventTested_GetEventTested_Event_OEL_message_Turn_Signal_Switch_Invalid_Serial_Data_Received: start-on-event=DemSatellite_Invalid_OsApplicationInternalBehavior/GetEventTested, operation=Event_OEL_message_Turn_Signal_Switch_Invalid_Serial_Data_Received.GetEventTested
        OpEventGetEventTested_GetEventTested_EvtInfo_Radar_calibration_Calibration_or_Paramater_Memory_Failure: start-on-event=DemSatellite_Invalid_OsApplicationInternalBehavior/GetEventTested, operation=EvtInfo_Radar_calibration_Calibration_or_Paramater_Memory_Failure.GetEventTested
        OpEventGetEventTested_GetEventTested_Event_Radar_calibration_Calibration_or_Paramater_Memory_Failure: start-on-event=DemSatellite_Invalid_OsApplicationInternalBehavior/GetEventTested, operation=Event_Radar_calibration_Calibration_or_Paramater_Memory_Failure.GetEventTested
        OpEventGetEventTested_GetEventTested_GeneralEvtInfo: start-on-event=DemSatellite_Invalid_OsApplicationInternalBehavior/GetEventTested, operation=GeneralEvtInfo.GetEventTested
        OpEventGetDTCOfEvent_GetDTCOfEvent_EvtInfo_SAS_message_Steering_Wheel_Angle_Invalid_Serial_Data_Received: start-on-event=DemSatellite_Invalid_OsApplicationInternalBehavior/GetDTCOfEvent, operation=EvtInfo_SAS_message_Steering_Wheel_Angle_Invalid_Serial_Data_Received.GetDTCOfEvent
        OpEventGetDTCOfEvent_GetDTCOfEvent_Event_SAS_message_Steering_Wheel_Angle_Invalid_Serial_Data_Received: start-on-event=DemSatellite_Invalid_OsApplicationInternalBehavior/GetDTCOfEvent, operation=Event_SAS_message_Steering_Wheel_Angle_Invalid_Serial_Data_Received.GetDTCOfEvent
        OpEventGetDTCOfEvent_GetDTCOfEvent_EvtInfo_AT_AMT_ETC2_message_Transcurrent_gear_Invalid_Serial_Data_Received: start-on-event=DemSatellite_Invalid_OsApplicationInternalBehavior/GetDTCOfEvent, operation=EvtInfo_AT_AMT_ETC2_message_Transcurrent_gear_Invalid_Serial_Data_Received.GetDTCOfEvent
        OpEventGetDTCOfEvent_GetDTCOfEvent_Event_AT_AMT_ETC2_message_Transcurrent_gear_Invalid_Serial_Data_Received: start-on-event=DemSatellite_Invalid_OsApplicationInternalBehavior/GetDTCOfEvent, operation=Event_AT_AMT_ETC2_message_Transcurrent_gear_Invalid_Serial_Data_Received.GetDTCOfEvent
        OpEventGetDTCOfEvent_GetDTCOfEvent_EvtInfo_Radar_AutoAlignment_Algorithm_Signal_Calculation_Failure: start-on-event=DemSatellite_Invalid_OsApplicationInternalBehavior/GetDTCOfEvent, operation=EvtInfo_Radar_AutoAlignment_Algorithm_Signal_Calculation_Failure.GetDTCOfEvent
        OpEventGetDTCOfEvent_GetDTCOfEvent_Event_Radar_AutoAlignment_Algorithm_Signal_Calculation_Failure: start-on-event=DemSatellite_Invalid_OsApplicationInternalBehavior/GetDTCOfEvent, operation=Event_Radar_AutoAlignment_Algorithm_Signal_Calculation_Failure.GetDTCOfEvent
        OpEventGetDTCOfEvent_GetDTCOfEvent_EvtInfo_Vehicle_DataSet_Not_Configured: start-on-event=DemSatellite_Invalid_OsApplicationInternalBehavior/GetDTCOfEvent, operation=EvtInfo_Vehicle_DataSet_Not_Configured.GetDTCOfEvent
        OpEventGetDTCOfEvent_GetDTCOfEvent_Event_Vehicle_DataSet_Not_Configured: start-on-event=DemSatellite_Invalid_OsApplicationInternalBehavior/GetDTCOfEvent, operation=Event_Vehicle_DataSet_Not_Configured.GetDTCOfEvent
        OpEventGetDTCOfEvent_GetDTCOfEvent_EvtInfo_Radar_Module_System_Internal_Failure: start-on-event=DemSatellite_Invalid_OsApplicationInternalBehavior/GetDTCOfEvent, operation=EvtInfo_Radar_Module_System_Internal_Failure.GetDTCOfEvent
        OpEventGetDTCOfEvent_GetDTCOfEvent_Event_Radar_Module_System_Internal_Failure: start-on-event=DemSatellite_Invalid_OsApplicationInternalBehavior/GetDTCOfEvent, operation=Event_Radar_Module_System_Internal_Failure.GetDTCOfEvent
        OpEventGetDTCOfEvent_GetDTCOfEvent_EvtInfo_Radar_MMIC_Component_Failure: start-on-event=DemSatellite_Invalid_OsApplicationInternalBehavior/GetDTCOfEvent, operation=EvtInfo_Radar_MMIC_Component_Failure.GetDTCOfEvent
        OpEventGetDTCOfEvent_GetDTCOfEvent_Event_Radar_MMIC_Component_Failure: start-on-event=DemSatellite_Invalid_OsApplicationInternalBehavior/GetDTCOfEvent, operation=Event_Radar_MMIC_Component_Failure.GetDTCOfEvent
        OpEventGetDTCOfEvent_GetDTCOfEvent_EvtInfo_Radar_Module_General_Memory_Failure: start-on-event=DemSatellite_Invalid_OsApplicationInternalBehavior/GetDTCOfEvent, operation=EvtInfo_Radar_Module_General_Memory_Failure.GetDTCOfEvent
        OpEventGetDTCOfEvent_GetDTCOfEvent_Event_Radar_Module_General_Memory_Failure: start-on-event=DemSatellite_Invalid_OsApplicationInternalBehavior/GetDTCOfEvent, operation=Event_Radar_Module_General_Memory_Failure.GetDTCOfEvent
        OpEventGetDTCOfEvent_GetDTCOfEvent_EvtInfo_Radar_System_Battery_High_Voltage_System_Voltage_High: start-on-event=DemSatellite_Invalid_OsApplicationInternalBehavior/GetDTCOfEvent, operation=EvtInfo_Radar_System_Battery_High_Voltage_System_Voltage_High.GetDTCOfEvent
        OpEventGetDTCOfEvent_GetDTCOfEvent_Event_Radar_System_Battery_High_Voltage_System_Voltage_High: start-on-event=DemSatellite_Invalid_OsApplicationInternalBehavior/GetDTCOfEvent, operation=Event_Radar_System_Battery_High_Voltage_System_Voltage_High.GetDTCOfEvent
        OpEventGetDTCOfEvent_GetDTCOfEvent_EvtInfo_CCVS1_message_Vehicle_Speed_Invalid_Serial_Data_Received: start-on-event=DemSatellite_Invalid_OsApplicationInternalBehavior/GetDTCOfEvent, operation=EvtInfo_CCVS1_message_Vehicle_Speed_Invalid_Serial_Data_Received.GetDTCOfEvent
        OpEventGetDTCOfEvent_GetDTCOfEvent_Event_CCVS1_message_Vehicle_Speed_Invalid_Serial_Data_Received: start-on-event=DemSatellite_Invalid_OsApplicationInternalBehavior/GetDTCOfEvent, operation=Event_CCVS1_message_Vehicle_Speed_Invalid_Serial_Data_Received.GetDTCOfEvent
        OpEventGetDTCOfEvent_GetDTCOfEvent_EvtInfo_EMS_ECU_VD_erratic_communication_Erratic: start-on-event=DemSatellite_Invalid_OsApplicationInternalBehavior/GetDTCOfEvent, operation=EvtInfo_EMS_ECU_VD_erratic_communication_Erratic.GetDTCOfEvent
        OpEventGetDTCOfEvent_GetDTCOfEvent_Event_EMS_ECU_VD_erratic_communication_Erratic: start-on-event=DemSatellite_Invalid_OsApplicationInternalBehavior/GetDTCOfEvent, operation=Event_EMS_ECU_VD_erratic_communication_Erratic.GetDTCOfEvent
        OpEventGetDTCOfEvent_GetDTCOfEvent_EvtInfo_EMS_ECU_ETC2_00_message_Missing_Message: start-on-event=DemSatellite_Invalid_OsApplicationInternalBehavior/GetDTCOfEvent, operation=EvtInfo_EMS_ECU_ETC2_00_message_Missing_Message.GetDTCOfEvent
        OpEventGetDTCOfEvent_GetDTCOfEvent_Event_EMS_ECU_ETC2_00_message_Missing_Message: start-on-event=DemSatellite_Invalid_OsApplicationInternalBehavior/GetDTCOfEvent, operation=Event_EMS_ECU_ETC2_00_message_Missing_Message.GetDTCOfEvent
        OpEventGetDTCOfEvent_GetDTCOfEvent_EvtInfo_Cluster_ECU_CLS_Tx_16_message_Missing_Message: start-on-event=DemSatellite_Invalid_OsApplicationInternalBehavior/GetDTCOfEvent, operation=EvtInfo_Cluster_ECU_CLS_Tx_16_message_Missing_Message.GetDTCOfEvent
        OpEventGetDTCOfEvent_GetDTCOfEvent_Event_Cluster_ECU_CLS_Tx_16_message_Missing_Message: start-on-event=DemSatellite_Invalid_OsApplicationInternalBehavior/GetDTCOfEvent, operation=Event_Cluster_ECU_CLS_Tx_16_message_Missing_Message.GetDTCOfEvent
        OpEventGetDTCOfEvent_GetDTCOfEvent_EvtInfo_Exceeded_Security_Access_0x27_Attempt_Threshold_Authentication_Failure: start-on-event=DemSatellite_Invalid_OsApplicationInternalBehavior/GetDTCOfEvent, operation=EvtInfo_Exceeded_Security_Access_0x27_Attempt_Threshold_Authentication_Failure.GetDTCOfEvent
        OpEventGetDTCOfEvent_GetDTCOfEvent_Event_Exceeded_Security_Access_0x27_Attempt_Threshold_Authentication_Failure: start-on-event=DemSatellite_Invalid_OsApplicationInternalBehavior/GetDTCOfEvent, operation=Event_Exceeded_Security_Access_0x27_Attempt_Threshold_Authentication_Failure.GetDTCOfEvent
        OpEventGetDTCOfEvent_GetDTCOfEvent_EvtInfo_Front_Left_Side_Radar_value_of_signal_protection_calculation_Incorrect: start-on-event=DemSatellite_Invalid_OsApplicationInternalBehavior/GetDTCOfEvent, operation=EvtInfo_Front_Left_Side_Radar_value_of_signal_protection_calculation_Incorrect.GetDTCOfEvent
        OpEventGetDTCOfEvent_GetDTCOfEvent_Event_Front_Left_Side_Radar_value_of_signal_protection_calculation_Incorrect: start-on-event=DemSatellite_Invalid_OsApplicationInternalBehavior/GetDTCOfEvent, operation=Event_Front_Left_Side_Radar_value_of_signal_protection_calculation_Incorrect.GetDTCOfEvent
        OpEventGetDTCOfEvent_GetDTCOfEvent_EvtInfo_AT_AMT_ETC2_erratic_communication_Erratic: start-on-event=DemSatellite_Invalid_OsApplicationInternalBehavior/GetDTCOfEvent, operation=EvtInfo_AT_AMT_ETC2_erratic_communication_Erratic.GetDTCOfEvent
        OpEventGetDTCOfEvent_GetDTCOfEvent_Event_AT_AMT_ETC2_erratic_communication_Erratic: start-on-event=DemSatellite_Invalid_OsApplicationInternalBehavior/GetDTCOfEvent, operation=Event_AT_AMT_ETC2_erratic_communication_Erratic.GetDTCOfEvent
        OpEventGetDTCOfEvent_GetDTCOfEvent_EvtInfo_VCAN_Communication_Bus_Off: start-on-event=DemSatellite_Invalid_OsApplicationInternalBehavior/GetDTCOfEvent, operation=EvtInfo_VCAN_Communication_Bus_Off.GetDTCOfEvent
        OpEventGetDTCOfEvent_GetDTCOfEvent_Event_VCAN_Communication_Bus_Off: start-on-event=DemSatellite_Invalid_OsApplicationInternalBehavior/GetDTCOfEvent, operation=Event_VCAN_Communication_Bus_Off.GetDTCOfEvent
        OpEventGetDTCOfEvent_GetDTCOfEvent_EvtInfo_VDC2_message_LongitudinalAcceleration_Invalid_Serial_Data_Received: start-on-event=DemSatellite_Invalid_OsApplicationInternalBehavior/GetDTCOfEvent, operation=EvtInfo_VDC2_message_LongitudinalAcceleration_Invalid_Serial_Data_Received.GetDTCOfEvent
        OpEventGetDTCOfEvent_GetDTCOfEvent_Event_VDC2_message_LongitudinalAcceleration_Invalid_Serial_Data_Received: start-on-event=DemSatellite_Invalid_OsApplicationInternalBehavior/GetDTCOfEvent, operation=Event_VDC2_message_LongitudinalAcceleration_Invalid_Serial_Data_Received.GetDTCOfEvent
        OpEventGetDTCOfEvent_GetDTCOfEvent_EvtInfo_Radar_MMIC_RFBIST_Component_Internal_Failure: start-on-event=DemSatellite_Invalid_OsApplicationInternalBehavior/GetDTCOfEvent, operation=EvtInfo_Radar_MMIC_RFBIST_Component_Internal_Failure.GetDTCOfEvent
        OpEventGetDTCOfEvent_GetDTCOfEvent_Event_Radar_MMIC_RFBIST_Component_Internal_Failure: start-on-event=DemSatellite_Invalid_OsApplicationInternalBehavior/GetDTCOfEvent, operation=Event_Radar_MMIC_RFBIST_Component_Internal_Failure.GetDTCOfEvent
        OpEventGetDTCOfEvent_GetDTCOfEvent_EvtInfo_Radar_Initial_Alignment_Missing_Calibration: start-on-event=DemSatellite_Invalid_OsApplicationInternalBehavior/GetDTCOfEvent, operation=EvtInfo_Radar_Initial_Alignment_Missing_Calibration.GetDTCOfEvent
        OpEventGetDTCOfEvent_GetDTCOfEvent_Event_Radar_Initial_Alignment_Missing_Calibration: start-on-event=DemSatellite_Invalid_OsApplicationInternalBehavior/GetDTCOfEvent, operation=Event_Radar_Initial_Alignment_Missing_Calibration.GetDTCOfEvent
        OpEventGetDTCOfEvent_GetDTCOfEvent_EvtInfo_Cluster_ECU_OEL_message_Missing_Message: start-on-event=DemSatellite_Invalid_OsApplicationInternalBehavior/GetDTCOfEvent, operation=EvtInfo_Cluster_ECU_OEL_message_Missing_Message.GetDTCOfEvent
        OpEventGetDTCOfEvent_GetDTCOfEvent_Event_Cluster_ECU_OEL_message_Missing_Message: start-on-event=DemSatellite_Invalid_OsApplicationInternalBehavior/GetDTCOfEvent, operation=Event_Cluster_ECU_OEL_message_Missing_Message.GetDTCOfEvent
        OpEventGetDTCOfEvent_GetDTCOfEvent_EvtInfo_AT_AMT_ECU_ETC2_03_message_Missing_Message: start-on-event=DemSatellite_Invalid_OsApplicationInternalBehavior/GetDTCOfEvent, operation=EvtInfo_AT_AMT_ECU_ETC2_03_message_Missing_Message.GetDTCOfEvent
        OpEventGetDTCOfEvent_GetDTCOfEvent_Event_AT_AMT_ECU_ETC2_03_message_Missing_Message: start-on-event=DemSatellite_Invalid_OsApplicationInternalBehavior/GetDTCOfEvent, operation=Event_AT_AMT_ECU_ETC2_03_message_Missing_Message.GetDTCOfEvent
        OpEventGetDTCOfEvent_GetDTCOfEvent_EvtInfo_ADAS_FN_STS_message_MOIS_FN_Switch_STS_Invalid_Serial_Data_Received: start-on-event=DemSatellite_Invalid_OsApplicationInternalBehavior/GetDTCOfEvent, operation=EvtInfo_ADAS_FN_STS_message_MOIS_FN_Switch_STS_Invalid_Serial_Data_Received.GetDTCOfEvent
        OpEventGetDTCOfEvent_GetDTCOfEvent_Event_ADAS_FN_STS_message_MOIS_FN_Switch_STS_Invalid_Serial_Data_Received: start-on-event=DemSatellite_Invalid_OsApplicationInternalBehavior/GetDTCOfEvent, operation=Event_ADAS_FN_STS_message_MOIS_FN_Switch_STS_Invalid_Serial_Data_Received.GetDTCOfEvent
        OpEventGetDTCOfEvent_GetDTCOfEvent_EvtInfo_Radar_Module_Over_Temperature: start-on-event=DemSatellite_Invalid_OsApplicationInternalBehavior/GetDTCOfEvent, operation=EvtInfo_Radar_Module_Over_Temperature.GetDTCOfEvent
        OpEventGetDTCOfEvent_GetDTCOfEvent_Event_Radar_Module_Over_Temperature: start-on-event=DemSatellite_Invalid_OsApplicationInternalBehavior/GetDTCOfEvent, operation=Event_Radar_Module_Over_Temperature.GetDTCOfEvent
        OpEventGetDTCOfEvent_GetDTCOfEvent_EvtInfo_PCAN_TimeSync_Missing_Message: start-on-event=DemSatellite_Invalid_OsApplicationInternalBehavior/GetDTCOfEvent, operation=EvtInfo_PCAN_TimeSync_Missing_Message.GetDTCOfEvent
        OpEventGetDTCOfEvent_GetDTCOfEvent_Event_PCAN_TimeSync_Missing_Message: start-on-event=DemSatellite_Invalid_OsApplicationInternalBehavior/GetDTCOfEvent, operation=Event_PCAN_TimeSync_Missing_Message.GetDTCOfEvent
        OpEventGetDTCOfEvent_GetDTCOfEvent_EvtInfo_Radar_Module_Watchdog_Failure: start-on-event=DemSatellite_Invalid_OsApplicationInternalBehavior/GetDTCOfEvent, operation=EvtInfo_Radar_Module_Watchdog_Failure.GetDTCOfEvent
        OpEventGetDTCOfEvent_GetDTCOfEvent_Event_Radar_Module_Watchdog_Failure: start-on-event=DemSatellite_Invalid_OsApplicationInternalBehavior/GetDTCOfEvent, operation=Event_Radar_Module_Watchdog_Failure.GetDTCOfEvent
        OpEventGetDTCOfEvent_GetDTCOfEvent_EvtInfo_SAS_ECU_SAS_message_Missing_Message: start-on-event=DemSatellite_Invalid_OsApplicationInternalBehavior/GetDTCOfEvent, operation=EvtInfo_SAS_ECU_SAS_message_Missing_Message.GetDTCOfEvent
        OpEventGetDTCOfEvent_GetDTCOfEvent_Event_SAS_ECU_SAS_message_Missing_Message: start-on-event=DemSatellite_Invalid_OsApplicationInternalBehavior/GetDTCOfEvent, operation=Event_SAS_ECU_SAS_message_Missing_Message.GetDTCOfEvent
        OpEventGetDTCOfEvent_GetDTCOfEvent_EvtInfo_ECU_NVM_Corruption_Program_memory_Failure: start-on-event=DemSatellite_Invalid_OsApplicationInternalBehavior/GetDTCOfEvent, operation=EvtInfo_ECU_NVM_Corruption_Program_memory_Failure.GetDTCOfEvent
        OpEventGetDTCOfEvent_GetDTCOfEvent_Event_ECU_NVM_Corruption_Program_memory_Failure: start-on-event=DemSatellite_Invalid_OsApplicationInternalBehavior/GetDTCOfEvent, operation=Event_ECU_NVM_Corruption_Program_memory_Failure.GetDTCOfEvent
        OpEventGetDTCOfEvent_GetDTCOfEvent_EvtInfo_Cluster_ECU_TD_message_Missing_Message: start-on-event=DemSatellite_Invalid_OsApplicationInternalBehavior/GetDTCOfEvent, operation=EvtInfo_Cluster_ECU_TD_message_Missing_Message.GetDTCOfEvent
        OpEventGetDTCOfEvent_GetDTCOfEvent_Event_Cluster_ECU_TD_message_Missing_Message: start-on-event=DemSatellite_Invalid_OsApplicationInternalBehavior/GetDTCOfEvent, operation=Event_Cluster_ECU_TD_message_Missing_Message.GetDTCOfEvent
        OpEventGetDTCOfEvent_GetDTCOfEvent_EvtInfo_PCAN_Communication_Bus_Off: start-on-event=DemSatellite_Invalid_OsApplicationInternalBehavior/GetDTCOfEvent, operation=EvtInfo_PCAN_Communication_Bus_Off.GetDTCOfEvent
        OpEventGetDTCOfEvent_GetDTCOfEvent_Event_PCAN_Communication_Bus_Off: start-on-event=DemSatellite_Invalid_OsApplicationInternalBehavior/GetDTCOfEvent, operation=Event_PCAN_Communication_Bus_Off.GetDTCOfEvent
        OpEventGetDTCOfEvent_GetDTCOfEvent_EvtInfo_Front_Left_Side_Radar_Missing_Message: start-on-event=DemSatellite_Invalid_OsApplicationInternalBehavior/GetDTCOfEvent, operation=EvtInfo_Front_Left_Side_Radar_Missing_Message.GetDTCOfEvent
        OpEventGetDTCOfEvent_GetDTCOfEvent_Event_Front_Left_Side_Radar_Missing_Message: start-on-event=DemSatellite_Invalid_OsApplicationInternalBehavior/GetDTCOfEvent, operation=Event_Front_Left_Side_Radar_Missing_Message.GetDTCOfEvent
        OpEventGetDTCOfEvent_GetDTCOfEvent_EvtInfo_Manual_ETC2_message_Transcurrent_gear_Invalid_Serial_Data_Received: start-on-event=DemSatellite_Invalid_OsApplicationInternalBehavior/GetDTCOfEvent, operation=EvtInfo_Manual_ETC2_message_Transcurrent_gear_Invalid_Serial_Data_Received.GetDTCOfEvent
        OpEventGetDTCOfEvent_GetDTCOfEvent_Event_Manual_ETC2_message_Transcurrent_gear_Invalid_Serial_Data_Received: start-on-event=DemSatellite_Invalid_OsApplicationInternalBehavior/GetDTCOfEvent, operation=Event_Manual_ETC2_message_Transcurrent_gear_Invalid_Serial_Data_Received.GetDTCOfEvent
        OpEventGetDTCOfEvent_GetDTCOfEvent_EvtInfo_SAS_ECU_erratic_communication_Erratic: start-on-event=DemSatellite_Invalid_OsApplicationInternalBehavior/GetDTCOfEvent, operation=EvtInfo_SAS_ECU_erratic_communication_Erratic.GetDTCOfEvent
        OpEventGetDTCOfEvent_GetDTCOfEvent_Event_SAS_ECU_erratic_communication_Erratic: start-on-event=DemSatellite_Invalid_OsApplicationInternalBehavior/GetDTCOfEvent, operation=Event_SAS_ECU_erratic_communication_Erratic.GetDTCOfEvent
        OpEventGetDTCOfEvent_GetDTCOfEvent_EvtInfo_VDC2_message_Yaw_rate_Invalid_Serial_Data_Received: start-on-event=DemSatellite_Invalid_OsApplicationInternalBehavior/GetDTCOfEvent, operation=EvtInfo_VDC2_message_Yaw_rate_Invalid_Serial_Data_Received.GetDTCOfEvent
        OpEventGetDTCOfEvent_GetDTCOfEvent_Event_VDC2_message_Yaw_rate_Invalid_Serial_Data_Received: start-on-event=DemSatellite_Invalid_OsApplicationInternalBehavior/GetDTCOfEvent, operation=Event_VDC2_message_Yaw_rate_Invalid_Serial_Data_Received.GetDTCOfEvent
        OpEventGetDTCOfEvent_GetDTCOfEvent_EvtInfo_Cluster_ECU_TD_erratic_communication_Erratic: start-on-event=DemSatellite_Invalid_OsApplicationInternalBehavior/GetDTCOfEvent, operation=EvtInfo_Cluster_ECU_TD_erratic_communication_Erratic.GetDTCOfEvent
        OpEventGetDTCOfEvent_GetDTCOfEvent_Event_Cluster_ECU_TD_erratic_communication_Erratic: start-on-event=DemSatellite_Invalid_OsApplicationInternalBehavior/GetDTCOfEvent, operation=Event_Cluster_ECU_TD_erratic_communication_Erratic.GetDTCOfEvent
        OpEventGetDTCOfEvent_GetDTCOfEvent_EvtInfo_EMS_ECU_CCVS1_message_Missing_Message: start-on-event=DemSatellite_Invalid_OsApplicationInternalBehavior/GetDTCOfEvent, operation=EvtInfo_EMS_ECU_CCVS1_message_Missing_Message.GetDTCOfEvent
        OpEventGetDTCOfEvent_GetDTCOfEvent_Event_EMS_ECU_CCVS1_message_Missing_Message: start-on-event=DemSatellite_Invalid_OsApplicationInternalBehavior/GetDTCOfEvent, operation=Event_EMS_ECU_CCVS1_message_Missing_Message.GetDTCOfEvent
        OpEventGetDTCOfEvent_GetDTCOfEvent_EvtInfo_Radar_Mounting_Orientation_Incorrect_Assembly: start-on-event=DemSatellite_Invalid_OsApplicationInternalBehavior/GetDTCOfEvent, operation=EvtInfo_Radar_Mounting_Orientation_Incorrect_Assembly.GetDTCOfEvent
        OpEventGetDTCOfEvent_GetDTCOfEvent_Event_Radar_Mounting_Orientation_Incorrect_Assembly: start-on-event=DemSatellite_Invalid_OsApplicationInternalBehavior/GetDTCOfEvent, operation=Event_Radar_Mounting_Orientation_Incorrect_Assembly.GetDTCOfEvent
        OpEventGetDTCOfEvent_GetDTCOfEvent_EvtInfo_EMS_ECU_ETC2_erratic_communication_Erractic: start-on-event=DemSatellite_Invalid_OsApplicationInternalBehavior/GetDTCOfEvent, operation=EvtInfo_EMS_ECU_ETC2_erratic_communication_Erractic.GetDTCOfEvent
        OpEventGetDTCOfEvent_GetDTCOfEvent_Event_EMS_ECU_ETC2_erratic_communication_Erractic: start-on-event=DemSatellite_Invalid_OsApplicationInternalBehavior/GetDTCOfEvent, operation=Event_EMS_ECU_ETC2_erratic_communication_Erractic.GetDTCOfEvent
        OpEventGetDTCOfEvent_GetDTCOfEvent_EvtInfo_Cluster_ECU_ADAS_FN_STS_erratic_communication_Erratic: start-on-event=DemSatellite_Invalid_OsApplicationInternalBehavior/GetDTCOfEvent, operation=EvtInfo_Cluster_ECU_ADAS_FN_STS_erratic_communication_Erratic.GetDTCOfEvent
        OpEventGetDTCOfEvent_GetDTCOfEvent_Event_Cluster_ECU_ADAS_FN_STS_erratic_communication_Erratic: start-on-event=DemSatellite_Invalid_OsApplicationInternalBehavior/GetDTCOfEvent, operation=Event_Cluster_ECU_ADAS_FN_STS_erratic_communication_Erratic.GetDTCOfEvent
        OpEventGetDTCOfEvent_GetDTCOfEvent_EvtInfo_ESC_ECU_VDC2_message_Missing_Message: start-on-event=DemSatellite_Invalid_OsApplicationInternalBehavior/GetDTCOfEvent, operation=EvtInfo_ESC_ECU_VDC2_message_Missing_Message.GetDTCOfEvent
        OpEventGetDTCOfEvent_GetDTCOfEvent_Event_ESC_ECU_VDC2_message_Missing_Message: start-on-event=DemSatellite_Invalid_OsApplicationInternalBehavior/GetDTCOfEvent, operation=Event_ESC_ECU_VDC2_message_Missing_Message.GetDTCOfEvent
        OpEventGetDTCOfEvent_GetDTCOfEvent_EvtInfo_CLS_TX_16_message_Transmission_Type_info_Invalid_Serial_Data_Received: start-on-event=DemSatellite_Invalid_OsApplicationInternalBehavior/GetDTCOfEvent, operation=EvtInfo_CLS_TX_16_message_Transmission_Type_info_Invalid_Serial_Data_Received.GetDTCOfEvent
        OpEventGetDTCOfEvent_GetDTCOfEvent_Event_CLS_TX_16_message_Transmission_Type_info_Invalid_Serial_Data_Received: start-on-event=DemSatellite_Invalid_OsApplicationInternalBehavior/GetDTCOfEvent, operation=Event_CLS_TX_16_message_Transmission_Type_info_Invalid_Serial_Data_Received.GetDTCOfEvent
        OpEventGetDTCOfEvent_GetDTCOfEvent_EvtInfo_Cluster_ECU_CLS_Tx_4_erratic_communication_Erratic: start-on-event=DemSatellite_Invalid_OsApplicationInternalBehavior/GetDTCOfEvent, operation=EvtInfo_Cluster_ECU_CLS_Tx_4_erratic_communication_Erratic.GetDTCOfEvent
        OpEventGetDTCOfEvent_GetDTCOfEvent_Event_Cluster_ECU_CLS_Tx_4_erratic_communication_Erratic: start-on-event=DemSatellite_Invalid_OsApplicationInternalBehavior/GetDTCOfEvent, operation=Event_Cluster_ECU_CLS_Tx_4_erratic_communication_Erratic.GetDTCOfEvent
        OpEventGetDTCOfEvent_GetDTCOfEvent_EvtInfo_Cluster_ECU_ADAS_FN_STS_message_Missing_Message: start-on-event=DemSatellite_Invalid_OsApplicationInternalBehavior/GetDTCOfEvent, operation=EvtInfo_Cluster_ECU_ADAS_FN_STS_message_Missing_Message.GetDTCOfEvent
        OpEventGetDTCOfEvent_GetDTCOfEvent_Event_Cluster_ECU_ADAS_FN_STS_message_Missing_Message: start-on-event=DemSatellite_Invalid_OsApplicationInternalBehavior/GetDTCOfEvent, operation=Event_Cluster_ECU_ADAS_FN_STS_message_Missing_Message.GetDTCOfEvent
        OpEventGetDTCOfEvent_GetDTCOfEvent_EvtInfo_Vehicle_Dataset_value_of_signal_protection_calculation_Incorrect: start-on-event=DemSatellite_Invalid_OsApplicationInternalBehavior/GetDTCOfEvent, operation=EvtInfo_Vehicle_Dataset_value_of_signal_protection_calculation_Incorrect.GetDTCOfEvent
        OpEventGetDTCOfEvent_GetDTCOfEvent_Event_Vehicle_Dataset_value_of_signal_protection_calculation_Incorrect: start-on-event=DemSatellite_Invalid_OsApplicationInternalBehavior/GetDTCOfEvent, operation=Event_Vehicle_Dataset_value_of_signal_protection_calculation_Incorrect.GetDTCOfEvent
        OpEventGetDTCOfEvent_GetDTCOfEvent_EvtInfo_Cluster_ECU_CLS_Tx_16_erratic_communication_Erratic: start-on-event=DemSatellite_Invalid_OsApplicationInternalBehavior/GetDTCOfEvent, operation=EvtInfo_Cluster_ECU_CLS_Tx_16_erratic_communication_Erratic.GetDTCOfEvent
        OpEventGetDTCOfEvent_GetDTCOfEvent_Event_Cluster_ECU_CLS_Tx_16_erratic_communication_Erratic: start-on-event=DemSatellite_Invalid_OsApplicationInternalBehavior/GetDTCOfEvent, operation=Event_Cluster_ECU_CLS_Tx_16_erratic_communication_Erratic.GetDTCOfEvent
        OpEventGetDTCOfEvent_GetDTCOfEvent_EvtInfo_Cluster_ECU_OEL_erratic_communication_Erratic: start-on-event=DemSatellite_Invalid_OsApplicationInternalBehavior/GetDTCOfEvent, operation=EvtInfo_Cluster_ECU_OEL_erratic_communication_Erratic.GetDTCOfEvent
        OpEventGetDTCOfEvent_GetDTCOfEvent_Event_Cluster_ECU_OEL_erratic_communication_Erratic: start-on-event=DemSatellite_Invalid_OsApplicationInternalBehavior/GetDTCOfEvent, operation=Event_Cluster_ECU_OEL_erratic_communication_Erratic.GetDTCOfEvent
        OpEventGetDTCOfEvent_GetDTCOfEvent_EvtInfo_Cluster_ECU_CLS_Tx_4_message_Missing_Message: start-on-event=DemSatellite_Invalid_OsApplicationInternalBehavior/GetDTCOfEvent, operation=EvtInfo_Cluster_ECU_CLS_Tx_4_message_Missing_Message.GetDTCOfEvent
        OpEventGetDTCOfEvent_GetDTCOfEvent_Event_Cluster_ECU_CLS_Tx_4_message_Missing_Message: start-on-event=DemSatellite_Invalid_OsApplicationInternalBehavior/GetDTCOfEvent, operation=Event_Cluster_ECU_CLS_Tx_4_message_Missing_Message.GetDTCOfEvent
        OpEventGetDTCOfEvent_GetDTCOfEvent_EvtInfo_Radar_Performance_Capability_Algorithm_Based_Failure: start-on-event=DemSatellite_Invalid_OsApplicationInternalBehavior/GetDTCOfEvent, operation=EvtInfo_Radar_Performance_Capability_Algorithm_Based_Failure.GetDTCOfEvent
        OpEventGetDTCOfEvent_GetDTCOfEvent_Event_Radar_Performance_Capability_Algorithm_Based_Failure: start-on-event=DemSatellite_Invalid_OsApplicationInternalBehavior/GetDTCOfEvent, operation=Event_Radar_Performance_Capability_Algorithm_Based_Failure.GetDTCOfEvent
        OpEventGetDTCOfEvent_GetDTCOfEvent_EvtInfo_Radar_AutoAlignment_Range_Alignment_or_Adjustement_Incorrect: start-on-event=DemSatellite_Invalid_OsApplicationInternalBehavior/GetDTCOfEvent, operation=EvtInfo_Radar_AutoAlignment_Range_Alignment_or_Adjustement_Incorrect.GetDTCOfEvent
        OpEventGetDTCOfEvent_GetDTCOfEvent_Event_Radar_AutoAlignment_Range_Alignment_or_Adjustement_Incorrect: start-on-event=DemSatellite_Invalid_OsApplicationInternalBehavior/GetDTCOfEvent, operation=Event_Radar_AutoAlignment_Range_Alignment_or_Adjustement_Incorrect.GetDTCOfEvent
        OpEventGetDTCOfEvent_GetDTCOfEvent_EvtInfo_EMS_ECU_CCVS1_erratic_communication_Erractic: start-on-event=DemSatellite_Invalid_OsApplicationInternalBehavior/GetDTCOfEvent, operation=EvtInfo_EMS_ECU_CCVS1_erratic_communication_Erractic.GetDTCOfEvent
        OpEventGetDTCOfEvent_GetDTCOfEvent_Event_EMS_ECU_CCVS1_erratic_communication_Erractic: start-on-event=DemSatellite_Invalid_OsApplicationInternalBehavior/GetDTCOfEvent, operation=Event_EMS_ECU_CCVS1_erratic_communication_Erractic.GetDTCOfEvent
        OpEventGetDTCOfEvent_GetDTCOfEvent_EvtInfo_Radar_System_Battery_Low_Voltage_System_Voltage_Low: start-on-event=DemSatellite_Invalid_OsApplicationInternalBehavior/GetDTCOfEvent, operation=EvtInfo_Radar_System_Battery_Low_Voltage_System_Voltage_Low.GetDTCOfEvent
        OpEventGetDTCOfEvent_GetDTCOfEvent_Event_Radar_System_Battery_Low_Voltage_System_Voltage_Low: start-on-event=DemSatellite_Invalid_OsApplicationInternalBehavior/GetDTCOfEvent, operation=Event_Radar_System_Battery_Low_Voltage_System_Voltage_Low.GetDTCOfEvent
        OpEventGetDTCOfEvent_GetDTCOfEvent_EvtInfo_Radar_SMC_General_Checksum_Failure: start-on-event=DemSatellite_Invalid_OsApplicationInternalBehavior/GetDTCOfEvent, operation=EvtInfo_Radar_SMC_General_Checksum_Failure.GetDTCOfEvent
        OpEventGetDTCOfEvent_GetDTCOfEvent_Event_Radar_SMC_General_Checksum_Failure: start-on-event=DemSatellite_Invalid_OsApplicationInternalBehavior/GetDTCOfEvent, operation=Event_Radar_SMC_General_Checksum_Failure.GetDTCOfEvent
        OpEventGetDTCOfEvent_GetDTCOfEvent_EvtInfo_Radar_Pin_Position_Wrong_Mounting_Position: start-on-event=DemSatellite_Invalid_OsApplicationInternalBehavior/GetDTCOfEvent, operation=EvtInfo_Radar_Pin_Position_Wrong_Mounting_Position.GetDTCOfEvent
        OpEventGetDTCOfEvent_GetDTCOfEvent_Event_Radar_Pin_Position_Wrong_Mounting_Position: start-on-event=DemSatellite_Invalid_OsApplicationInternalBehavior/GetDTCOfEvent, operation=Event_Radar_Pin_Position_Wrong_Mounting_Position.GetDTCOfEvent
        OpEventGetDTCOfEvent_GetDTCOfEvent_EvtInfo_VDC2_message_Lateral_Accleration_Invalid_Serial_Data_Received: start-on-event=DemSatellite_Invalid_OsApplicationInternalBehavior/GetDTCOfEvent, operation=EvtInfo_VDC2_message_Lateral_Accleration_Invalid_Serial_Data_Received.GetDTCOfEvent
        OpEventGetDTCOfEvent_GetDTCOfEvent_Event_VDC2_message_Lateral_Accleration_Invalid_Serial_Data_Received: start-on-event=DemSatellite_Invalid_OsApplicationInternalBehavior/GetDTCOfEvent, operation=Event_VDC2_message_Lateral_Accleration_Invalid_Serial_Data_Received.GetDTCOfEvent
        OpEventGetDTCOfEvent_GetDTCOfEvent_EvtInfo_ADAS_FN_STS_message_BSIS_FN_Switch_STS_Invalid_Serial_Data_Received: start-on-event=DemSatellite_Invalid_OsApplicationInternalBehavior/GetDTCOfEvent, operation=EvtInfo_ADAS_FN_STS_message_BSIS_FN_Switch_STS_Invalid_Serial_Data_Received.GetDTCOfEvent
        OpEventGetDTCOfEvent_GetDTCOfEvent_Event_ADAS_FN_STS_message_BSIS_FN_Switch_STS_Invalid_Serial_Data_Received: start-on-event=DemSatellite_Invalid_OsApplicationInternalBehavior/GetDTCOfEvent, operation=Event_ADAS_FN_STS_message_BSIS_FN_Switch_STS_Invalid_Serial_Data_Received.GetDTCOfEvent
        OpEventGetDTCOfEvent_GetDTCOfEvent_EvtInfo_Radar_AutoAlignment_Misalignment_Performance_or_Incorrect_Operation: start-on-event=DemSatellite_Invalid_OsApplicationInternalBehavior/GetDTCOfEvent, operation=EvtInfo_Radar_AutoAlignment_Misalignment_Performance_or_Incorrect_Operation.GetDTCOfEvent
        OpEventGetDTCOfEvent_GetDTCOfEvent_Event_Radar_AutoAlignment_Misalignment_Performance_or_Incorrect_Operation: start-on-event=DemSatellite_Invalid_OsApplicationInternalBehavior/GetDTCOfEvent, operation=Event_Radar_AutoAlignment_Misalignment_Performance_or_Incorrect_Operation.GetDTCOfEvent
        OpEventGetDTCOfEvent_GetDTCOfEvent_EvtInfo_ESC_ECU_VDC2_erratic_communication_Erratic: start-on-event=DemSatellite_Invalid_OsApplicationInternalBehavior/GetDTCOfEvent, operation=EvtInfo_ESC_ECU_VDC2_erratic_communication_Erratic.GetDTCOfEvent
        OpEventGetDTCOfEvent_GetDTCOfEvent_Event_ESC_ECU_VDC2_erratic_communication_Erratic: start-on-event=DemSatellite_Invalid_OsApplicationInternalBehavior/GetDTCOfEvent, operation=Event_ESC_ECU_VDC2_erratic_communication_Erratic.GetDTCOfEvent
        OpEventGetDTCOfEvent_GetDTCOfEvent_EvtInfo_Application_Interface_Lookup_Performance_or_Incorrect_Operation: start-on-event=DemSatellite_Invalid_OsApplicationInternalBehavior/GetDTCOfEvent, operation=EvtInfo_Application_Interface_Lookup_Performance_or_Incorrect_Operation.GetDTCOfEvent
        OpEventGetDTCOfEvent_GetDTCOfEvent_Event_Application_Interface_Lookup_Performance_or_Incorrect_Operation: start-on-event=DemSatellite_Invalid_OsApplicationInternalBehavior/GetDTCOfEvent, operation=Event_Application_Interface_Lookup_Performance_or_Incorrect_Operation.GetDTCOfEvent
        OpEventGetDTCOfEvent_GetDTCOfEvent_EvtInfo_EMS_ECU_VD_message_Missing_Message: start-on-event=DemSatellite_Invalid_OsApplicationInternalBehavior/GetDTCOfEvent, operation=EvtInfo_EMS_ECU_VD_message_Missing_Message.GetDTCOfEvent
        OpEventGetDTCOfEvent_GetDTCOfEvent_Event_EMS_ECU_VD_message_Missing_Message: start-on-event=DemSatellite_Invalid_OsApplicationInternalBehavior/GetDTCOfEvent, operation=Event_EMS_ECU_VD_message_Missing_Message.GetDTCOfEvent
        OpEventGetDTCOfEvent_GetDTCOfEvent_EvtInfo_Radar_Platform_Time_System_Programming_Failure: start-on-event=DemSatellite_Invalid_OsApplicationInternalBehavior/GetDTCOfEvent, operation=EvtInfo_Radar_Platform_Time_System_Programming_Failure.GetDTCOfEvent
        OpEventGetDTCOfEvent_GetDTCOfEvent_Event_Radar_Platform_Time_System_Programming_Failure: start-on-event=DemSatellite_Invalid_OsApplicationInternalBehavior/GetDTCOfEvent, operation=Event_Radar_Platform_Time_System_Programming_Failure.GetDTCOfEvent
        OpEventGetDTCOfEvent_GetDTCOfEvent_EvtInfo_OEL_message_Turn_Signal_Switch_Invalid_Serial_Data_Received: start-on-event=DemSatellite_Invalid_OsApplicationInternalBehavior/GetDTCOfEvent, operation=EvtInfo_OEL_message_Turn_Signal_Switch_Invalid_Serial_Data_Received.GetDTCOfEvent
        OpEventGetDTCOfEvent_GetDTCOfEvent_Event_OEL_message_Turn_Signal_Switch_Invalid_Serial_Data_Received: start-on-event=DemSatellite_Invalid_OsApplicationInternalBehavior/GetDTCOfEvent, operation=Event_OEL_message_Turn_Signal_Switch_Invalid_Serial_Data_Received.GetDTCOfEvent
        OpEventGetDTCOfEvent_GetDTCOfEvent_EvtInfo_Radar_calibration_Calibration_or_Paramater_Memory_Failure: start-on-event=DemSatellite_Invalid_OsApplicationInternalBehavior/GetDTCOfEvent, operation=EvtInfo_Radar_calibration_Calibration_or_Paramater_Memory_Failure.GetDTCOfEvent
        OpEventGetDTCOfEvent_GetDTCOfEvent_Event_Radar_calibration_Calibration_or_Paramater_Memory_Failure: start-on-event=DemSatellite_Invalid_OsApplicationInternalBehavior/GetDTCOfEvent, operation=Event_Radar_calibration_Calibration_or_Paramater_Memory_Failure.GetDTCOfEvent
        OpEventGetDTCOfEvent_GetDTCOfEvent_GeneralEvtInfo: start-on-event=DemSatellite_Invalid_OsApplicationInternalBehavior/GetDTCOfEvent, operation=GeneralEvtInfo.GetDTCOfEvent
        OpEventGetFaultDetectionCounter_GetFaultDetectionCounter_EvtInfo_SAS_message_Steering_Wheel_Angle_Invalid_Serial_Data_Received: start-on-event=DemSatellite_Invalid_OsApplicationInternalBehavior/GetFaultDetectionCounter, operation=EvtInfo_SAS_message_Steering_Wheel_Angle_Invalid_Serial_Data_Received.GetFaultDetectionCounter
        OpEventGetFaultDetectionCounter_GetFaultDetectionCounter_Event_SAS_message_Steering_Wheel_Angle_Invalid_Serial_Data_Received: start-on-event=DemSatellite_Invalid_OsApplicationInternalBehavior/GetFaultDetectionCounter, operation=Event_SAS_message_Steering_Wheel_Angle_Invalid_Serial_Data_Received.GetFaultDetectionCounter
        OpEventGetFaultDetectionCounter_GetFaultDetectionCounter_EvtInfo_AT_AMT_ETC2_message_Transcurrent_gear_Invalid_Serial_D_17ddc8c4: start-on-event=DemSatellite_Invalid_OsApplicationInternalBehavior/GetFaultDetectionCounter, operation=EvtInfo_AT_AMT_ETC2_message_Transcurrent_gear_Invalid_Serial_Data_Received.GetFaultDetectionCounter
        OpEventGetFaultDetectionCounter_GetFaultDetectionCounter_Event_AT_AMT_ETC2_message_Transcurrent_gear_Invalid_Serial_Dat_0c36eec9: start-on-event=DemSatellite_Invalid_OsApplicationInternalBehavior/GetFaultDetectionCounter, operation=Event_AT_AMT_ETC2_message_Transcurrent_gear_Invalid_Serial_Data_Received.GetFaultDetectionCounter
        OpEventGetFaultDetectionCounter_GetFaultDetectionCounter_EvtInfo_Radar_AutoAlignment_Algorithm_Signal_Calculation_Failure: start-on-event=DemSatellite_Invalid_OsApplicationInternalBehavior/GetFaultDetectionCounter, operation=EvtInfo_Radar_AutoAlignment_Algorithm_Signal_Calculation_Failure.GetFaultDetectionCounter
        OpEventGetFaultDetectionCounter_GetFaultDetectionCounter_Event_Radar_AutoAlignment_Algorithm_Signal_Calculation_Failure: start-on-event=DemSatellite_Invalid_OsApplicationInternalBehavior/GetFaultDetectionCounter, operation=Event_Radar_AutoAlignment_Algorithm_Signal_Calculation_Failure.GetFaultDetectionCounter
        OpEventGetFaultDetectionCounter_GetFaultDetectionCounter_EvtInfo_Vehicle_DataSet_Not_Configured: start-on-event=DemSatellite_Invalid_OsApplicationInternalBehavior/GetFaultDetectionCounter, operation=EvtInfo_Vehicle_DataSet_Not_Configured.GetFaultDetectionCounter
        OpEventGetFaultDetectionCounter_GetFaultDetectionCounter_Event_Vehicle_DataSet_Not_Configured: start-on-event=DemSatellite_Invalid_OsApplicationInternalBehavior/GetFaultDetectionCounter, operation=Event_Vehicle_DataSet_Not_Configured.GetFaultDetectionCounter
        OpEventGetFaultDetectionCounter_GetFaultDetectionCounter_EvtInfo_Radar_Module_System_Internal_Failure: start-on-event=DemSatellite_Invalid_OsApplicationInternalBehavior/GetFaultDetectionCounter, operation=EvtInfo_Radar_Module_System_Internal_Failure.GetFaultDetectionCounter
        OpEventGetFaultDetectionCounter_GetFaultDetectionCounter_Event_Radar_Module_System_Internal_Failure: start-on-event=DemSatellite_Invalid_OsApplicationInternalBehavior/GetFaultDetectionCounter, operation=Event_Radar_Module_System_Internal_Failure.GetFaultDetectionCounter
        OpEventGetFaultDetectionCounter_GetFaultDetectionCounter_EvtInfo_Radar_MMIC_Component_Failure: start-on-event=DemSatellite_Invalid_OsApplicationInternalBehavior/GetFaultDetectionCounter, operation=EvtInfo_Radar_MMIC_Component_Failure.GetFaultDetectionCounter
        OpEventGetFaultDetectionCounter_GetFaultDetectionCounter_Event_Radar_MMIC_Component_Failure: start-on-event=DemSatellite_Invalid_OsApplicationInternalBehavior/GetFaultDetectionCounter, operation=Event_Radar_MMIC_Component_Failure.GetFaultDetectionCounter
        OpEventGetFaultDetectionCounter_GetFaultDetectionCounter_EvtInfo_Radar_Module_General_Memory_Failure: start-on-event=DemSatellite_Invalid_OsApplicationInternalBehavior/GetFaultDetectionCounter, operation=EvtInfo_Radar_Module_General_Memory_Failure.GetFaultDetectionCounter
        OpEventGetFaultDetectionCounter_GetFaultDetectionCounter_Event_Radar_Module_General_Memory_Failure: start-on-event=DemSatellite_Invalid_OsApplicationInternalBehavior/GetFaultDetectionCounter, operation=Event_Radar_Module_General_Memory_Failure.GetFaultDetectionCounter
        OpEventGetFaultDetectionCounter_GetFaultDetectionCounter_EvtInfo_Radar_System_Battery_High_Voltage_System_Voltage_High: start-on-event=DemSatellite_Invalid_OsApplicationInternalBehavior/GetFaultDetectionCounter, operation=EvtInfo_Radar_System_Battery_High_Voltage_System_Voltage_High.GetFaultDetectionCounter
        OpEventGetFaultDetectionCounter_GetFaultDetectionCounter_Event_Radar_System_Battery_High_Voltage_System_Voltage_High: start-on-event=DemSatellite_Invalid_OsApplicationInternalBehavior/GetFaultDetectionCounter, operation=Event_Radar_System_Battery_High_Voltage_System_Voltage_High.GetFaultDetectionCounter
        OpEventGetFaultDetectionCounter_GetFaultDetectionCounter_EvtInfo_CCVS1_message_Vehicle_Speed_Invalid_Serial_Data_Received: start-on-event=DemSatellite_Invalid_OsApplicationInternalBehavior/GetFaultDetectionCounter, operation=EvtInfo_CCVS1_message_Vehicle_Speed_Invalid_Serial_Data_Received.GetFaultDetectionCounter
        OpEventGetFaultDetectionCounter_GetFaultDetectionCounter_Event_CCVS1_message_Vehicle_Speed_Invalid_Serial_Data_Received: start-on-event=DemSatellite_Invalid_OsApplicationInternalBehavior/GetFaultDetectionCounter, operation=Event_CCVS1_message_Vehicle_Speed_Invalid_Serial_Data_Received.GetFaultDetectionCounter
        OpEventGetFaultDetectionCounter_GetFaultDetectionCounter_EvtInfo_EMS_ECU_VD_erratic_communication_Erratic: start-on-event=DemSatellite_Invalid_OsApplicationInternalBehavior/GetFaultDetectionCounter, operation=EvtInfo_EMS_ECU_VD_erratic_communication_Erratic.GetFaultDetectionCounter
        OpEventGetFaultDetectionCounter_GetFaultDetectionCounter_Event_EMS_ECU_VD_erratic_communication_Erratic: start-on-event=DemSatellite_Invalid_OsApplicationInternalBehavior/GetFaultDetectionCounter, operation=Event_EMS_ECU_VD_erratic_communication_Erratic.GetFaultDetectionCounter
        OpEventGetFaultDetectionCounter_GetFaultDetectionCounter_EvtInfo_EMS_ECU_ETC2_00_message_Missing_Message: start-on-event=DemSatellite_Invalid_OsApplicationInternalBehavior/GetFaultDetectionCounter, operation=EvtInfo_EMS_ECU_ETC2_00_message_Missing_Message.GetFaultDetectionCounter
        OpEventGetFaultDetectionCounter_GetFaultDetectionCounter_Event_EMS_ECU_ETC2_00_message_Missing_Message: start-on-event=DemSatellite_Invalid_OsApplicationInternalBehavior/GetFaultDetectionCounter, operation=Event_EMS_ECU_ETC2_00_message_Missing_Message.GetFaultDetectionCounter
        OpEventGetFaultDetectionCounter_GetFaultDetectionCounter_EvtInfo_Cluster_ECU_CLS_Tx_16_message_Missing_Message: start-on-event=DemSatellite_Invalid_OsApplicationInternalBehavior/GetFaultDetectionCounter, operation=EvtInfo_Cluster_ECU_CLS_Tx_16_message_Missing_Message.GetFaultDetectionCounter
        OpEventGetFaultDetectionCounter_GetFaultDetectionCounter_Event_Cluster_ECU_CLS_Tx_16_message_Missing_Message: start-on-event=DemSatellite_Invalid_OsApplicationInternalBehavior/GetFaultDetectionCounter, operation=Event_Cluster_ECU_CLS_Tx_16_message_Missing_Message.GetFaultDetectionCounter
        OpEventGetFaultDetectionCounter_GetFaultDetectionCounter_EvtInfo_Exceeded_Security_Access_0x27_Attempt_Threshold_Authen_fd88cf9f: start-on-event=DemSatellite_Invalid_OsApplicationInternalBehavior/GetFaultDetectionCounter, operation=EvtInfo_Exceeded_Security_Access_0x27_Attempt_Threshold_Authentication_Failure.GetFaultDetectionCounter
        OpEventGetFaultDetectionCounter_GetFaultDetectionCounter_Event_Exceeded_Security_Access_0x27_Attempt_Threshold_Authenti_04cdcedb: start-on-event=DemSatellite_Invalid_OsApplicationInternalBehavior/GetFaultDetectionCounter, operation=Event_Exceeded_Security_Access_0x27_Attempt_Threshold_Authentication_Failure.GetFaultDetectionCounter
        OpEventGetFaultDetectionCounter_GetFaultDetectionCounter_EvtInfo_Front_Left_Side_Radar_value_of_signal_protection_calcu_b7111bd7: start-on-event=DemSatellite_Invalid_OsApplicationInternalBehavior/GetFaultDetectionCounter, operation=EvtInfo_Front_Left_Side_Radar_value_of_signal_protection_calculation_Incorrect.GetFaultDetectionCounter
        OpEventGetFaultDetectionCounter_GetFaultDetectionCounter_Event_Front_Left_Side_Radar_value_of_signal_protection_calcula_4e541a93: start-on-event=DemSatellite_Invalid_OsApplicationInternalBehavior/GetFaultDetectionCounter, operation=Event_Front_Left_Side_Radar_value_of_signal_protection_calculation_Incorrect.GetFaultDetectionCounter
        OpEventGetFaultDetectionCounter_GetFaultDetectionCounter_EvtInfo_AT_AMT_ETC2_erratic_communication_Erratic: start-on-event=DemSatellite_Invalid_OsApplicationInternalBehavior/GetFaultDetectionCounter, operation=EvtInfo_AT_AMT_ETC2_erratic_communication_Erratic.GetFaultDetectionCounter
        OpEventGetFaultDetectionCounter_GetFaultDetectionCounter_Event_AT_AMT_ETC2_erratic_communication_Erratic: start-on-event=DemSatellite_Invalid_OsApplicationInternalBehavior/GetFaultDetectionCounter, operation=Event_AT_AMT_ETC2_erratic_communication_Erratic.GetFaultDetectionCounter
        OpEventGetFaultDetectionCounter_GetFaultDetectionCounter_EvtInfo_VCAN_Communication_Bus_Off: start-on-event=DemSatellite_Invalid_OsApplicationInternalBehavior/GetFaultDetectionCounter, operation=EvtInfo_VCAN_Communication_Bus_Off.GetFaultDetectionCounter
        OpEventGetFaultDetectionCounter_GetFaultDetectionCounter_Event_VCAN_Communication_Bus_Off: start-on-event=DemSatellite_Invalid_OsApplicationInternalBehavior/GetFaultDetectionCounter, operation=Event_VCAN_Communication_Bus_Off.GetFaultDetectionCounter
        OpEventGetFaultDetectionCounter_GetFaultDetectionCounter_EvtInfo_VDC2_message_LongitudinalAcceleration_Invalid_Serial_D_9731926b: start-on-event=DemSatellite_Invalid_OsApplicationInternalBehavior/GetFaultDetectionCounter, operation=EvtInfo_VDC2_message_LongitudinalAcceleration_Invalid_Serial_Data_Received.GetFaultDetectionCounter
        OpEventGetFaultDetectionCounter_GetFaultDetectionCounter_Event_VDC2_message_LongitudinalAcceleration_Invalid_Serial_Dat_8cdab466: start-on-event=DemSatellite_Invalid_OsApplicationInternalBehavior/GetFaultDetectionCounter, operation=Event_VDC2_message_LongitudinalAcceleration_Invalid_Serial_Data_Received.GetFaultDetectionCounter
        OpEventGetFaultDetectionCounter_GetFaultDetectionCounter_EvtInfo_Radar_MMIC_RFBIST_Component_Internal_Failure: start-on-event=DemSatellite_Invalid_OsApplicationInternalBehavior/GetFaultDetectionCounter, operation=EvtInfo_Radar_MMIC_RFBIST_Component_Internal_Failure.GetFaultDetectionCounter
        OpEventGetFaultDetectionCounter_GetFaultDetectionCounter_Event_Radar_MMIC_RFBIST_Component_Internal_Failure: start-on-event=DemSatellite_Invalid_OsApplicationInternalBehavior/GetFaultDetectionCounter, operation=Event_Radar_MMIC_RFBIST_Component_Internal_Failure.GetFaultDetectionCounter
        OpEventGetFaultDetectionCounter_GetFaultDetectionCounter_EvtInfo_Radar_Initial_Alignment_Missing_Calibration: start-on-event=DemSatellite_Invalid_OsApplicationInternalBehavior/GetFaultDetectionCounter, operation=EvtInfo_Radar_Initial_Alignment_Missing_Calibration.GetFaultDetectionCounter
        OpEventGetFaultDetectionCounter_GetFaultDetectionCounter_Event_Radar_Initial_Alignment_Missing_Calibration: start-on-event=DemSatellite_Invalid_OsApplicationInternalBehavior/GetFaultDetectionCounter, operation=Event_Radar_Initial_Alignment_Missing_Calibration.GetFaultDetectionCounter
        OpEventGetFaultDetectionCounter_GetFaultDetectionCounter_EvtInfo_Cluster_ECU_OEL_message_Missing_Message: start-on-event=DemSatellite_Invalid_OsApplicationInternalBehavior/GetFaultDetectionCounter, operation=EvtInfo_Cluster_ECU_OEL_message_Missing_Message.GetFaultDetectionCounter
        OpEventGetFaultDetectionCounter_GetFaultDetectionCounter_Event_Cluster_ECU_OEL_message_Missing_Message: start-on-event=DemSatellite_Invalid_OsApplicationInternalBehavior/GetFaultDetectionCounter, operation=Event_Cluster_ECU_OEL_message_Missing_Message.GetFaultDetectionCounter
        OpEventGetFaultDetectionCounter_GetFaultDetectionCounter_EvtInfo_AT_AMT_ECU_ETC2_03_message_Missing_Message: start-on-event=DemSatellite_Invalid_OsApplicationInternalBehavior/GetFaultDetectionCounter, operation=EvtInfo_AT_AMT_ECU_ETC2_03_message_Missing_Message.GetFaultDetectionCounter
        OpEventGetFaultDetectionCounter_GetFaultDetectionCounter_Event_AT_AMT_ECU_ETC2_03_message_Missing_Message: start-on-event=DemSatellite_Invalid_OsApplicationInternalBehavior/GetFaultDetectionCounter, operation=Event_AT_AMT_ECU_ETC2_03_message_Missing_Message.GetFaultDetectionCounter
        OpEventGetFaultDetectionCounter_GetFaultDetectionCounter_EvtInfo_ADAS_FN_STS_message_MOIS_FN_Switch_STS_Invalid_Serial_af6eb68e: start-on-event=DemSatellite_Invalid_OsApplicationInternalBehavior/GetFaultDetectionCounter, operation=EvtInfo_ADAS_FN_STS_message_MOIS_FN_Switch_STS_Invalid_Serial_Data_Received.GetFaultDetectionCounter
        OpEventGetFaultDetectionCounter_GetFaultDetectionCounter_Event_ADAS_FN_STS_message_MOIS_FN_Switch_STS_Invalid_Serial_Da_d1c42115: start-on-event=DemSatellite_Invalid_OsApplicationInternalBehavior/GetFaultDetectionCounter, operation=Event_ADAS_FN_STS_message_MOIS_FN_Switch_STS_Invalid_Serial_Data_Received.GetFaultDetectionCounter
        OpEventGetFaultDetectionCounter_GetFaultDetectionCounter_EvtInfo_Radar_Module_Over_Temperature: start-on-event=DemSatellite_Invalid_OsApplicationInternalBehavior/GetFaultDetectionCounter, operation=EvtInfo_Radar_Module_Over_Temperature.GetFaultDetectionCounter
        OpEventGetFaultDetectionCounter_GetFaultDetectionCounter_Event_Radar_Module_Over_Temperature: start-on-event=DemSatellite_Invalid_OsApplicationInternalBehavior/GetFaultDetectionCounter, operation=Event_Radar_Module_Over_Temperature.GetFaultDetectionCounter
        OpEventGetFaultDetectionCounter_GetFaultDetectionCounter_EvtInfo_PCAN_TimeSync_Missing_Message: start-on-event=DemSatellite_Invalid_OsApplicationInternalBehavior/GetFaultDetectionCounter, operation=EvtInfo_PCAN_TimeSync_Missing_Message.GetFaultDetectionCounter
        OpEventGetFaultDetectionCounter_GetFaultDetectionCounter_Event_PCAN_TimeSync_Missing_Message: start-on-event=DemSatellite_Invalid_OsApplicationInternalBehavior/GetFaultDetectionCounter, operation=Event_PCAN_TimeSync_Missing_Message.GetFaultDetectionCounter
        OpEventGetFaultDetectionCounter_GetFaultDetectionCounter_EvtInfo_Radar_Module_Watchdog_Failure: start-on-event=DemSatellite_Invalid_OsApplicationInternalBehavior/GetFaultDetectionCounter, operation=EvtInfo_Radar_Module_Watchdog_Failure.GetFaultDetectionCounter
        OpEventGetFaultDetectionCounter_GetFaultDetectionCounter_Event_Radar_Module_Watchdog_Failure: start-on-event=DemSatellite_Invalid_OsApplicationInternalBehavior/GetFaultDetectionCounter, operation=Event_Radar_Module_Watchdog_Failure.GetFaultDetectionCounter
        OpEventGetFaultDetectionCounter_GetFaultDetectionCounter_EvtInfo_SAS_ECU_SAS_message_Missing_Message: start-on-event=DemSatellite_Invalid_OsApplicationInternalBehavior/GetFaultDetectionCounter, operation=EvtInfo_SAS_ECU_SAS_message_Missing_Message.GetFaultDetectionCounter
        OpEventGetFaultDetectionCounter_GetFaultDetectionCounter_Event_SAS_ECU_SAS_message_Missing_Message: start-on-event=DemSatellite_Invalid_OsApplicationInternalBehavior/GetFaultDetectionCounter, operation=Event_SAS_ECU_SAS_message_Missing_Message.GetFaultDetectionCounter
        OpEventGetFaultDetectionCounter_GetFaultDetectionCounter_EvtInfo_ECU_NVM_Corruption_Program_memory_Failure: start-on-event=DemSatellite_Invalid_OsApplicationInternalBehavior/GetFaultDetectionCounter, operation=EvtInfo_ECU_NVM_Corruption_Program_memory_Failure.GetFaultDetectionCounter
        OpEventGetFaultDetectionCounter_GetFaultDetectionCounter_Event_ECU_NVM_Corruption_Program_memory_Failure: start-on-event=DemSatellite_Invalid_OsApplicationInternalBehavior/GetFaultDetectionCounter, operation=Event_ECU_NVM_Corruption_Program_memory_Failure.GetFaultDetectionCounter
        OpEventGetFaultDetectionCounter_GetFaultDetectionCounter_EvtInfo_Cluster_ECU_TD_message_Missing_Message: start-on-event=DemSatellite_Invalid_OsApplicationInternalBehavior/GetFaultDetectionCounter, operation=EvtInfo_Cluster_ECU_TD_message_Missing_Message.GetFaultDetectionCounter
        OpEventGetFaultDetectionCounter_GetFaultDetectionCounter_Event_Cluster_ECU_TD_message_Missing_Message: start-on-event=DemSatellite_Invalid_OsApplicationInternalBehavior/GetFaultDetectionCounter, operation=Event_Cluster_ECU_TD_message_Missing_Message.GetFaultDetectionCounter
        OpEventGetFaultDetectionCounter_GetFaultDetectionCounter_EvtInfo_PCAN_Communication_Bus_Off: start-on-event=DemSatellite_Invalid_OsApplicationInternalBehavior/GetFaultDetectionCounter, operation=EvtInfo_PCAN_Communication_Bus_Off.GetFaultDetectionCounter
        OpEventGetFaultDetectionCounter_GetFaultDetectionCounter_Event_PCAN_Communication_Bus_Off: start-on-event=DemSatellite_Invalid_OsApplicationInternalBehavior/GetFaultDetectionCounter, operation=Event_PCAN_Communication_Bus_Off.GetFaultDetectionCounter
        OpEventGetFaultDetectionCounter_GetFaultDetectionCounter_EvtInfo_Front_Left_Side_Radar_Missing_Message: start-on-event=DemSatellite_Invalid_OsApplicationInternalBehavior/GetFaultDetectionCounter, operation=EvtInfo_Front_Left_Side_Radar_Missing_Message.GetFaultDetectionCounter
        OpEventGetFaultDetectionCounter_GetFaultDetectionCounter_Event_Front_Left_Side_Radar_Missing_Message: start-on-event=DemSatellite_Invalid_OsApplicationInternalBehavior/GetFaultDetectionCounter, operation=Event_Front_Left_Side_Radar_Missing_Message.GetFaultDetectionCounter
        OpEventGetFaultDetectionCounter_GetFaultDetectionCounter_EvtInfo_Manual_ETC2_message_Transcurrent_gear_Invalid_Serial_D_0b49ba7f: start-on-event=DemSatellite_Invalid_OsApplicationInternalBehavior/GetFaultDetectionCounter, operation=EvtInfo_Manual_ETC2_message_Transcurrent_gear_Invalid_Serial_Data_Received.GetFaultDetectionCounter
        OpEventGetFaultDetectionCounter_GetFaultDetectionCounter_Event_Manual_ETC2_message_Transcurrent_gear_Invalid_Serial_Dat_10a29c72: start-on-event=DemSatellite_Invalid_OsApplicationInternalBehavior/GetFaultDetectionCounter, operation=Event_Manual_ETC2_message_Transcurrent_gear_Invalid_Serial_Data_Received.GetFaultDetectionCounter
        OpEventGetFaultDetectionCounter_GetFaultDetectionCounter_EvtInfo_SAS_ECU_erratic_communication_Erratic: start-on-event=DemSatellite_Invalid_OsApplicationInternalBehavior/GetFaultDetectionCounter, operation=EvtInfo_SAS_ECU_erratic_communication_Erratic.GetFaultDetectionCounter
        OpEventGetFaultDetectionCounter_GetFaultDetectionCounter_Event_SAS_ECU_erratic_communication_Erratic: start-on-event=DemSatellite_Invalid_OsApplicationInternalBehavior/GetFaultDetectionCounter, operation=Event_SAS_ECU_erratic_communication_Erratic.GetFaultDetectionCounter
        OpEventGetFaultDetectionCounter_GetFaultDetectionCounter_EvtInfo_VDC2_message_Yaw_rate_Invalid_Serial_Data_Received: start-on-event=DemSatellite_Invalid_OsApplicationInternalBehavior/GetFaultDetectionCounter, operation=EvtInfo_VDC2_message_Yaw_rate_Invalid_Serial_Data_Received.GetFaultDetectionCounter
        OpEventGetFaultDetectionCounter_GetFaultDetectionCounter_Event_VDC2_message_Yaw_rate_Invalid_Serial_Data_Received: start-on-event=DemSatellite_Invalid_OsApplicationInternalBehavior/GetFaultDetectionCounter, operation=Event_VDC2_message_Yaw_rate_Invalid_Serial_Data_Received.GetFaultDetectionCounter
        OpEventGetFaultDetectionCounter_GetFaultDetectionCounter_EvtInfo_Cluster_ECU_TD_erratic_communication_Erratic: start-on-event=DemSatellite_Invalid_OsApplicationInternalBehavior/GetFaultDetectionCounter, operation=EvtInfo_Cluster_ECU_TD_erratic_communication_Erratic.GetFaultDetectionCounter
        OpEventGetFaultDetectionCounter_GetFaultDetectionCounter_Event_Cluster_ECU_TD_erratic_communication_Erratic: start-on-event=DemSatellite_Invalid_OsApplicationInternalBehavior/GetFaultDetectionCounter, operation=Event_Cluster_ECU_TD_erratic_communication_Erratic.GetFaultDetectionCounter
        OpEventGetFaultDetectionCounter_GetFaultDetectionCounter_EvtInfo_EMS_ECU_CCVS1_message_Missing_Message: start-on-event=DemSatellite_Invalid_OsApplicationInternalBehavior/GetFaultDetectionCounter, operation=EvtInfo_EMS_ECU_CCVS1_message_Missing_Message.GetFaultDetectionCounter
        OpEventGetFaultDetectionCounter_GetFaultDetectionCounter_Event_EMS_ECU_CCVS1_message_Missing_Message: start-on-event=DemSatellite_Invalid_OsApplicationInternalBehavior/GetFaultDetectionCounter, operation=Event_EMS_ECU_CCVS1_message_Missing_Message.GetFaultDetectionCounter
        OpEventGetFaultDetectionCounter_GetFaultDetectionCounter_EvtInfo_Radar_Mounting_Orientation_Incorrect_Assembly: start-on-event=DemSatellite_Invalid_OsApplicationInternalBehavior/GetFaultDetectionCounter, operation=EvtInfo_Radar_Mounting_Orientation_Incorrect_Assembly.GetFaultDetectionCounter
        OpEventGetFaultDetectionCounter_GetFaultDetectionCounter_Event_Radar_Mounting_Orientation_Incorrect_Assembly: start-on-event=DemSatellite_Invalid_OsApplicationInternalBehavior/GetFaultDetectionCounter, operation=Event_Radar_Mounting_Orientation_Incorrect_Assembly.GetFaultDetectionCounter
        OpEventGetFaultDetectionCounter_GetFaultDetectionCounter_EvtInfo_EMS_ECU_ETC2_erratic_communication_Erractic: start-on-event=DemSatellite_Invalid_OsApplicationInternalBehavior/GetFaultDetectionCounter, operation=EvtInfo_EMS_ECU_ETC2_erratic_communication_Erractic.GetFaultDetectionCounter
        OpEventGetFaultDetectionCounter_GetFaultDetectionCounter_Event_EMS_ECU_ETC2_erratic_communication_Erractic: start-on-event=DemSatellite_Invalid_OsApplicationInternalBehavior/GetFaultDetectionCounter, operation=Event_EMS_ECU_ETC2_erratic_communication_Erractic.GetFaultDetectionCounter
        OpEventGetFaultDetectionCounter_GetFaultDetectionCounter_EvtInfo_Cluster_ECU_ADAS_FN_STS_erratic_communication_Erratic: start-on-event=DemSatellite_Invalid_OsApplicationInternalBehavior/GetFaultDetectionCounter, operation=EvtInfo_Cluster_ECU_ADAS_FN_STS_erratic_communication_Erratic.GetFaultDetectionCounter
        OpEventGetFaultDetectionCounter_GetFaultDetectionCounter_Event_Cluster_ECU_ADAS_FN_STS_erratic_communication_Erratic: start-on-event=DemSatellite_Invalid_OsApplicationInternalBehavior/GetFaultDetectionCounter, operation=Event_Cluster_ECU_ADAS_FN_STS_erratic_communication_Erratic.GetFaultDetectionCounter
        OpEventGetFaultDetectionCounter_GetFaultDetectionCounter_EvtInfo_ESC_ECU_VDC2_message_Missing_Message: start-on-event=DemSatellite_Invalid_OsApplicationInternalBehavior/GetFaultDetectionCounter, operation=EvtInfo_ESC_ECU_VDC2_message_Missing_Message.GetFaultDetectionCounter
        OpEventGetFaultDetectionCounter_GetFaultDetectionCounter_Event_ESC_ECU_VDC2_message_Missing_Message: start-on-event=DemSatellite_Invalid_OsApplicationInternalBehavior/GetFaultDetectionCounter, operation=Event_ESC_ECU_VDC2_message_Missing_Message.GetFaultDetectionCounter
        OpEventGetFaultDetectionCounter_GetFaultDetectionCounter_EvtInfo_CLS_TX_16_message_Transmission_Type_info_Invalid_Seria_9cf5fcaa: start-on-event=DemSatellite_Invalid_OsApplicationInternalBehavior/GetFaultDetectionCounter, operation=EvtInfo_CLS_TX_16_message_Transmission_Type_info_Invalid_Serial_Data_Received.GetFaultDetectionCounter
        OpEventGetFaultDetectionCounter_GetFaultDetectionCounter_Event_CLS_TX_16_message_Transmission_Type_info_Invalid_Serial_602bd736: start-on-event=DemSatellite_Invalid_OsApplicationInternalBehavior/GetFaultDetectionCounter, operation=Event_CLS_TX_16_message_Transmission_Type_info_Invalid_Serial_Data_Received.GetFaultDetectionCounter
        OpEventGetFaultDetectionCounter_GetFaultDetectionCounter_EvtInfo_Cluster_ECU_CLS_Tx_4_erratic_communication_Erratic: start-on-event=DemSatellite_Invalid_OsApplicationInternalBehavior/GetFaultDetectionCounter, operation=EvtInfo_Cluster_ECU_CLS_Tx_4_erratic_communication_Erratic.GetFaultDetectionCounter
        OpEventGetFaultDetectionCounter_GetFaultDetectionCounter_Event_Cluster_ECU_CLS_Tx_4_erratic_communication_Erratic: start-on-event=DemSatellite_Invalid_OsApplicationInternalBehavior/GetFaultDetectionCounter, operation=Event_Cluster_ECU_CLS_Tx_4_erratic_communication_Erratic.GetFaultDetectionCounter
        OpEventGetFaultDetectionCounter_GetFaultDetectionCounter_EvtInfo_Cluster_ECU_ADAS_FN_STS_message_Missing_Message: start-on-event=DemSatellite_Invalid_OsApplicationInternalBehavior/GetFaultDetectionCounter, operation=EvtInfo_Cluster_ECU_ADAS_FN_STS_message_Missing_Message.GetFaultDetectionCounter
        OpEventGetFaultDetectionCounter_GetFaultDetectionCounter_Event_Cluster_ECU_ADAS_FN_STS_message_Missing_Message: start-on-event=DemSatellite_Invalid_OsApplicationInternalBehavior/GetFaultDetectionCounter, operation=Event_Cluster_ECU_ADAS_FN_STS_message_Missing_Message.GetFaultDetectionCounter
        OpEventGetFaultDetectionCounter_GetFaultDetectionCounter_EvtInfo_Vehicle_Dataset_value_of_signal_protection_calculation_7f6e193d: start-on-event=DemSatellite_Invalid_OsApplicationInternalBehavior/GetFaultDetectionCounter, operation=EvtInfo_Vehicle_Dataset_value_of_signal_protection_calculation_Incorrect.GetFaultDetectionCounter
        OpEventGetFaultDetectionCounter_GetFaultDetectionCounter_Event_Vehicle_Dataset_value_of_signal_protection_calculation_Incorrect: start-on-event=DemSatellite_Invalid_OsApplicationInternalBehavior/GetFaultDetectionCounter, operation=Event_Vehicle_Dataset_value_of_signal_protection_calculation_Incorrect.GetFaultDetectionCounter
        OpEventGetFaultDetectionCounter_GetFaultDetectionCounter_EvtInfo_Cluster_ECU_CLS_Tx_16_erratic_communication_Erratic: start-on-event=DemSatellite_Invalid_OsApplicationInternalBehavior/GetFaultDetectionCounter, operation=EvtInfo_Cluster_ECU_CLS_Tx_16_erratic_communication_Erratic.GetFaultDetectionCounter
        OpEventGetFaultDetectionCounter_GetFaultDetectionCounter_Event_Cluster_ECU_CLS_Tx_16_erratic_communication_Erratic: start-on-event=DemSatellite_Invalid_OsApplicationInternalBehavior/GetFaultDetectionCounter, operation=Event_Cluster_ECU_CLS_Tx_16_erratic_communication_Erratic.GetFaultDetectionCounter
        OpEventGetFaultDetectionCounter_GetFaultDetectionCounter_EvtInfo_Cluster_ECU_OEL_erratic_communication_Erratic: start-on-event=DemSatellite_Invalid_OsApplicationInternalBehavior/GetFaultDetectionCounter, operation=EvtInfo_Cluster_ECU_OEL_erratic_communication_Erratic.GetFaultDetectionCounter
        OpEventGetFaultDetectionCounter_GetFaultDetectionCounter_Event_Cluster_ECU_OEL_erratic_communication_Erratic: start-on-event=DemSatellite_Invalid_OsApplicationInternalBehavior/GetFaultDetectionCounter, operation=Event_Cluster_ECU_OEL_erratic_communication_Erratic.GetFaultDetectionCounter
        OpEventGetFaultDetectionCounter_GetFaultDetectionCounter_EvtInfo_Cluster_ECU_CLS_Tx_4_message_Missing_Message: start-on-event=DemSatellite_Invalid_OsApplicationInternalBehavior/GetFaultDetectionCounter, operation=EvtInfo_Cluster_ECU_CLS_Tx_4_message_Missing_Message.GetFaultDetectionCounter
        OpEventGetFaultDetectionCounter_GetFaultDetectionCounter_Event_Cluster_ECU_CLS_Tx_4_message_Missing_Message: start-on-event=DemSatellite_Invalid_OsApplicationInternalBehavior/GetFaultDetectionCounter, operation=Event_Cluster_ECU_CLS_Tx_4_message_Missing_Message.GetFaultDetectionCounter
        OpEventGetFaultDetectionCounter_GetFaultDetectionCounter_EvtInfo_Radar_Performance_Capability_Algorithm_Based_Failure: start-on-event=DemSatellite_Invalid_OsApplicationInternalBehavior/GetFaultDetectionCounter, operation=EvtInfo_Radar_Performance_Capability_Algorithm_Based_Failure.GetFaultDetectionCounter
        OpEventGetFaultDetectionCounter_GetFaultDetectionCounter_Event_Radar_Performance_Capability_Algorithm_Based_Failure: start-on-event=DemSatellite_Invalid_OsApplicationInternalBehavior/GetFaultDetectionCounter, operation=Event_Radar_Performance_Capability_Algorithm_Based_Failure.GetFaultDetectionCounter
        OpEventGetFaultDetectionCounter_GetFaultDetectionCounter_EvtInfo_Radar_AutoAlignment_Range_Alignment_or_Adjustement_Incorrect: start-on-event=DemSatellite_Invalid_OsApplicationInternalBehavior/GetFaultDetectionCounter, operation=EvtInfo_Radar_AutoAlignment_Range_Alignment_or_Adjustement_Incorrect.GetFaultDetectionCounter
        OpEventGetFaultDetectionCounter_GetFaultDetectionCounter_Event_Radar_AutoAlignment_Range_Alignment_or_Adjustement_Incorrect: start-on-event=DemSatellite_Invalid_OsApplicationInternalBehavior/GetFaultDetectionCounter, operation=Event_Radar_AutoAlignment_Range_Alignment_or_Adjustement_Incorrect.GetFaultDetectionCounter
        OpEventGetFaultDetectionCounter_GetFaultDetectionCounter_EvtInfo_EMS_ECU_CCVS1_erratic_communication_Erractic: start-on-event=DemSatellite_Invalid_OsApplicationInternalBehavior/GetFaultDetectionCounter, operation=EvtInfo_EMS_ECU_CCVS1_erratic_communication_Erractic.GetFaultDetectionCounter
        OpEventGetFaultDetectionCounter_GetFaultDetectionCounter_Event_EMS_ECU_CCVS1_erratic_communication_Erractic: start-on-event=DemSatellite_Invalid_OsApplicationInternalBehavior/GetFaultDetectionCounter, operation=Event_EMS_ECU_CCVS1_erratic_communication_Erractic.GetFaultDetectionCounter
        OpEventGetFaultDetectionCounter_GetFaultDetectionCounter_EvtInfo_Radar_System_Battery_Low_Voltage_System_Voltage_Low: start-on-event=DemSatellite_Invalid_OsApplicationInternalBehavior/GetFaultDetectionCounter, operation=EvtInfo_Radar_System_Battery_Low_Voltage_System_Voltage_Low.GetFaultDetectionCounter
        OpEventGetFaultDetectionCounter_GetFaultDetectionCounter_Event_Radar_System_Battery_Low_Voltage_System_Voltage_Low: start-on-event=DemSatellite_Invalid_OsApplicationInternalBehavior/GetFaultDetectionCounter, operation=Event_Radar_System_Battery_Low_Voltage_System_Voltage_Low.GetFaultDetectionCounter
        OpEventGetFaultDetectionCounter_GetFaultDetectionCounter_EvtInfo_Radar_SMC_General_Checksum_Failure: start-on-event=DemSatellite_Invalid_OsApplicationInternalBehavior/GetFaultDetectionCounter, operation=EvtInfo_Radar_SMC_General_Checksum_Failure.GetFaultDetectionCounter
        OpEventGetFaultDetectionCounter_GetFaultDetectionCounter_Event_Radar_SMC_General_Checksum_Failure: start-on-event=DemSatellite_Invalid_OsApplicationInternalBehavior/GetFaultDetectionCounter, operation=Event_Radar_SMC_General_Checksum_Failure.GetFaultDetectionCounter
        OpEventGetFaultDetectionCounter_GetFaultDetectionCounter_EvtInfo_Radar_Pin_Position_Wrong_Mounting_Position: start-on-event=DemSatellite_Invalid_OsApplicationInternalBehavior/GetFaultDetectionCounter, operation=EvtInfo_Radar_Pin_Position_Wrong_Mounting_Position.GetFaultDetectionCounter
        OpEventGetFaultDetectionCounter_GetFaultDetectionCounter_Event_Radar_Pin_Position_Wrong_Mounting_Position: start-on-event=DemSatellite_Invalid_OsApplicationInternalBehavior/GetFaultDetectionCounter, operation=Event_Radar_Pin_Position_Wrong_Mounting_Position.GetFaultDetectionCounter
        OpEventGetFaultDetectionCounter_GetFaultDetectionCounter_EvtInfo_VDC2_message_Lateral_Accleration_Invalid_Serial_Data_Received: start-on-event=DemSatellite_Invalid_OsApplicationInternalBehavior/GetFaultDetectionCounter, operation=EvtInfo_VDC2_message_Lateral_Accleration_Invalid_Serial_Data_Received.GetFaultDetectionCounter
        OpEventGetFaultDetectionCounter_GetFaultDetectionCounter_Event_VDC2_message_Lateral_Accleration_Invalid_Serial_Data_Received: start-on-event=DemSatellite_Invalid_OsApplicationInternalBehavior/GetFaultDetectionCounter, operation=Event_VDC2_message_Lateral_Accleration_Invalid_Serial_Data_Received.GetFaultDetectionCounter
        OpEventGetFaultDetectionCounter_GetFaultDetectionCounter_EvtInfo_ADAS_FN_STS_message_BSIS_FN_Switch_STS_Invalid_Serial_6afecf7d: start-on-event=DemSatellite_Invalid_OsApplicationInternalBehavior/GetFaultDetectionCounter, operation=EvtInfo_ADAS_FN_STS_message_BSIS_FN_Switch_STS_Invalid_Serial_Data_Received.GetFaultDetectionCounter
        OpEventGetFaultDetectionCounter_GetFaultDetectionCounter_Event_ADAS_FN_STS_message_BSIS_FN_Switch_STS_Invalid_Serial_Da_145458e6: start-on-event=DemSatellite_Invalid_OsApplicationInternalBehavior/GetFaultDetectionCounter, operation=Event_ADAS_FN_STS_message_BSIS_FN_Switch_STS_Invalid_Serial_Data_Received.GetFaultDetectionCounter
        OpEventGetFaultDetectionCounter_GetFaultDetectionCounter_EvtInfo_Radar_AutoAlignment_Misalignment_Performance_or_Incorr_3ca767d4: start-on-event=DemSatellite_Invalid_OsApplicationInternalBehavior/GetFaultDetectionCounter, operation=EvtInfo_Radar_AutoAlignment_Misalignment_Performance_or_Incorrect_Operation.GetFaultDetectionCounter
        OpEventGetFaultDetectionCounter_GetFaultDetectionCounter_Event_Radar_AutoAlignment_Misalignment_Performance_or_Incorrec_420df04f: start-on-event=DemSatellite_Invalid_OsApplicationInternalBehavior/GetFaultDetectionCounter, operation=Event_Radar_AutoAlignment_Misalignment_Performance_or_Incorrect_Operation.GetFaultDetectionCounter
        OpEventGetFaultDetectionCounter_GetFaultDetectionCounter_EvtInfo_ESC_ECU_VDC2_erratic_communication_Erratic: start-on-event=DemSatellite_Invalid_OsApplicationInternalBehavior/GetFaultDetectionCounter, operation=EvtInfo_ESC_ECU_VDC2_erratic_communication_Erratic.GetFaultDetectionCounter
        OpEventGetFaultDetectionCounter_GetFaultDetectionCounter_Event_ESC_ECU_VDC2_erratic_communication_Erratic: start-on-event=DemSatellite_Invalid_OsApplicationInternalBehavior/GetFaultDetectionCounter, operation=Event_ESC_ECU_VDC2_erratic_communication_Erratic.GetFaultDetectionCounter
        OpEventGetFaultDetectionCounter_GetFaultDetectionCounter_EvtInfo_Application_Interface_Lookup_Performance_or_Incorrect_Operation: start-on-event=DemSatellite_Invalid_OsApplicationInternalBehavior/GetFaultDetectionCounter, operation=EvtInfo_Application_Interface_Lookup_Performance_or_Incorrect_Operation.GetFaultDetectionCounter
        OpEventGetFaultDetectionCounter_GetFaultDetectionCounter_Event_Application_Interface_Lookup_Performance_or_Incorrect_Operation: start-on-event=DemSatellite_Invalid_OsApplicationInternalBehavior/GetFaultDetectionCounter, operation=Event_Application_Interface_Lookup_Performance_or_Incorrect_Operation.GetFaultDetectionCounter
        OpEventGetFaultDetectionCounter_GetFaultDetectionCounter_EvtInfo_EMS_ECU_VD_message_Missing_Message: start-on-event=DemSatellite_Invalid_OsApplicationInternalBehavior/GetFaultDetectionCounter, operation=EvtInfo_EMS_ECU_VD_message_Missing_Message.GetFaultDetectionCounter
        OpEventGetFaultDetectionCounter_GetFaultDetectionCounter_Event_EMS_ECU_VD_message_Missing_Message: start-on-event=DemSatellite_Invalid_OsApplicationInternalBehavior/GetFaultDetectionCounter, operation=Event_EMS_ECU_VD_message_Missing_Message.GetFaultDetectionCounter
        OpEventGetFaultDetectionCounter_GetFaultDetectionCounter_EvtInfo_Radar_Platform_Time_System_Programming_Failure: start-on-event=DemSatellite_Invalid_OsApplicationInternalBehavior/GetFaultDetectionCounter, operation=EvtInfo_Radar_Platform_Time_System_Programming_Failure.GetFaultDetectionCounter
        OpEventGetFaultDetectionCounter_GetFaultDetectionCounter_Event_Radar_Platform_Time_System_Programming_Failure: start-on-event=DemSatellite_Invalid_OsApplicationInternalBehavior/GetFaultDetectionCounter, operation=Event_Radar_Platform_Time_System_Programming_Failure.GetFaultDetectionCounter
        OpEventGetFaultDetectionCounter_GetFaultDetectionCounter_EvtInfo_OEL_message_Turn_Signal_Switch_Invalid_Serial_Data_Received: start-on-event=DemSatellite_Invalid_OsApplicationInternalBehavior/GetFaultDetectionCounter, operation=EvtInfo_OEL_message_Turn_Signal_Switch_Invalid_Serial_Data_Received.GetFaultDetectionCounter
        OpEventGetFaultDetectionCounter_GetFaultDetectionCounter_Event_OEL_message_Turn_Signal_Switch_Invalid_Serial_Data_Received: start-on-event=DemSatellite_Invalid_OsApplicationInternalBehavior/GetFaultDetectionCounter, operation=Event_OEL_message_Turn_Signal_Switch_Invalid_Serial_Data_Received.GetFaultDetectionCounter
        OpEventGetFaultDetectionCounter_GetFaultDetectionCounter_EvtInfo_Radar_calibration_Calibration_or_Paramater_Memory_Failure: start-on-event=DemSatellite_Invalid_OsApplicationInternalBehavior/GetFaultDetectionCounter, operation=EvtInfo_Radar_calibration_Calibration_or_Paramater_Memory_Failure.GetFaultDetectionCounter
        OpEventGetFaultDetectionCounter_GetFaultDetectionCounter_Event_Radar_calibration_Calibration_or_Paramater_Memory_Failure: start-on-event=DemSatellite_Invalid_OsApplicationInternalBehavior/GetFaultDetectionCounter, operation=Event_Radar_calibration_Calibration_or_Paramater_Memory_Failure.GetFaultDetectionCounter
        OpEventGetFaultDetectionCounter_GetFaultDetectionCounter_GeneralEvtInfo: start-on-event=DemSatellite_Invalid_OsApplicationInternalBehavior/GetFaultDetectionCounter, operation=GeneralEvtInfo.GetFaultDetectionCounter
        OpEventGetEventFreezeFrameDataEx_GetEventFreezeFrameDataEx_EvtInfo_SAS_message_Steering_Wheel_Angle_Invalid_Serial_Data_Received: start-on-event=DemSatellite_Invalid_OsApplicationInternalBehavior/GetEventFreezeFrameDataEx, operation=EvtInfo_SAS_message_Steering_Wheel_Angle_Invalid_Serial_Data_Received.GetEventFreezeFrameDataEx
        OpEventGetEventFreezeFrameDataEx_GetEventFreezeFrameDataEx_Event_SAS_message_Steering_Wheel_Angle_Invalid_Serial_Data_Received: start-on-event=DemSatellite_Invalid_OsApplicationInternalBehavior/GetEventFreezeFrameDataEx, operation=Event_SAS_message_Steering_Wheel_Angle_Invalid_Serial_Data_Received.GetEventFreezeFrameDataEx
        OpEventGetEventFreezeFrameDataEx_GetEventFreezeFrameDataEx_EvtInfo_AT_AMT_ETC2_message_Transcurrent_gear_Invalid_Serial_f330cc86: start-on-event=DemSatellite_Invalid_OsApplicationInternalBehavior/GetEventFreezeFrameDataEx, operation=EvtInfo_AT_AMT_ETC2_message_Transcurrent_gear_Invalid_Serial_Data_Received.GetEventFreezeFrameDataEx
        OpEventGetEventFreezeFrameDataEx_GetEventFreezeFrameDataEx_Event_AT_AMT_ETC2_message_Transcurrent_gear_Invalid_Serial_D_a4747041: start-on-event=DemSatellite_Invalid_OsApplicationInternalBehavior/GetEventFreezeFrameDataEx, operation=Event_AT_AMT_ETC2_message_Transcurrent_gear_Invalid_Serial_Data_Received.GetEventFreezeFrameDataEx
        OpEventGetEventFreezeFrameDataEx_GetEventFreezeFrameDataEx_EvtInfo_Radar_AutoAlignment_Algorithm_Signal_Calculation_Failure: start-on-event=DemSatellite_Invalid_OsApplicationInternalBehavior/GetEventFreezeFrameDataEx, operation=EvtInfo_Radar_AutoAlignment_Algorithm_Signal_Calculation_Failure.GetEventFreezeFrameDataEx
        OpEventGetEventFreezeFrameDataEx_GetEventFreezeFrameDataEx_Event_Radar_AutoAlignment_Algorithm_Signal_Calculation_Failure: start-on-event=DemSatellite_Invalid_OsApplicationInternalBehavior/GetEventFreezeFrameDataEx, operation=Event_Radar_AutoAlignment_Algorithm_Signal_Calculation_Failure.GetEventFreezeFrameDataEx
        OpEventGetEventFreezeFrameDataEx_GetEventFreezeFrameDataEx_EvtInfo_Vehicle_DataSet_Not_Configured: start-on-event=DemSatellite_Invalid_OsApplicationInternalBehavior/GetEventFreezeFrameDataEx, operation=EvtInfo_Vehicle_DataSet_Not_Configured.GetEventFreezeFrameDataEx
        OpEventGetEventFreezeFrameDataEx_GetEventFreezeFrameDataEx_Event_Vehicle_DataSet_Not_Configured: start-on-event=DemSatellite_Invalid_OsApplicationInternalBehavior/GetEventFreezeFrameDataEx, operation=Event_Vehicle_DataSet_Not_Configured.GetEventFreezeFrameDataEx
        OpEventGetEventFreezeFrameDataEx_GetEventFreezeFrameDataEx_EvtInfo_Radar_Module_System_Internal_Failure: start-on-event=DemSatellite_Invalid_OsApplicationInternalBehavior/GetEventFreezeFrameDataEx, operation=EvtInfo_Radar_Module_System_Internal_Failure.GetEventFreezeFrameDataEx
        OpEventGetEventFreezeFrameDataEx_GetEventFreezeFrameDataEx_Event_Radar_Module_System_Internal_Failure: start-on-event=DemSatellite_Invalid_OsApplicationInternalBehavior/GetEventFreezeFrameDataEx, operation=Event_Radar_Module_System_Internal_Failure.GetEventFreezeFrameDataEx
        OpEventGetEventFreezeFrameDataEx_GetEventFreezeFrameDataEx_EvtInfo_Radar_MMIC_Component_Failure: start-on-event=DemSatellite_Invalid_OsApplicationInternalBehavior/GetEventFreezeFrameDataEx, operation=EvtInfo_Radar_MMIC_Component_Failure.GetEventFreezeFrameDataEx
        OpEventGetEventFreezeFrameDataEx_GetEventFreezeFrameDataEx_Event_Radar_MMIC_Component_Failure: start-on-event=DemSatellite_Invalid_OsApplicationInternalBehavior/GetEventFreezeFrameDataEx, operation=Event_Radar_MMIC_Component_Failure.GetEventFreezeFrameDataEx
        OpEventGetEventFreezeFrameDataEx_GetEventFreezeFrameDataEx_EvtInfo_Radar_Module_General_Memory_Failure: start-on-event=DemSatellite_Invalid_OsApplicationInternalBehavior/GetEventFreezeFrameDataEx, operation=EvtInfo_Radar_Module_General_Memory_Failure.GetEventFreezeFrameDataEx
        OpEventGetEventFreezeFrameDataEx_GetEventFreezeFrameDataEx_Event_Radar_Module_General_Memory_Failure: start-on-event=DemSatellite_Invalid_OsApplicationInternalBehavior/GetEventFreezeFrameDataEx, operation=Event_Radar_Module_General_Memory_Failure.GetEventFreezeFrameDataEx
        OpEventGetEventFreezeFrameDataEx_GetEventFreezeFrameDataEx_EvtInfo_Radar_System_Battery_High_Voltage_System_Voltage_High: start-on-event=DemSatellite_Invalid_OsApplicationInternalBehavior/GetEventFreezeFrameDataEx, operation=EvtInfo_Radar_System_Battery_High_Voltage_System_Voltage_High.GetEventFreezeFrameDataEx
        OpEventGetEventFreezeFrameDataEx_GetEventFreezeFrameDataEx_Event_Radar_System_Battery_High_Voltage_System_Voltage_High: start-on-event=DemSatellite_Invalid_OsApplicationInternalBehavior/GetEventFreezeFrameDataEx, operation=Event_Radar_System_Battery_High_Voltage_System_Voltage_High.GetEventFreezeFrameDataEx
        OpEventGetEventFreezeFrameDataEx_GetEventFreezeFrameDataEx_EvtInfo_CCVS1_message_Vehicle_Speed_Invalid_Serial_Data_Received: start-on-event=DemSatellite_Invalid_OsApplicationInternalBehavior/GetEventFreezeFrameDataEx, operation=EvtInfo_CCVS1_message_Vehicle_Speed_Invalid_Serial_Data_Received.GetEventFreezeFrameDataEx
        OpEventGetEventFreezeFrameDataEx_GetEventFreezeFrameDataEx_Event_CCVS1_message_Vehicle_Speed_Invalid_Serial_Data_Received: start-on-event=DemSatellite_Invalid_OsApplicationInternalBehavior/GetEventFreezeFrameDataEx, operation=Event_CCVS1_message_Vehicle_Speed_Invalid_Serial_Data_Received.GetEventFreezeFrameDataEx
        OpEventGetEventFreezeFrameDataEx_GetEventFreezeFrameDataEx_EvtInfo_EMS_ECU_VD_erratic_communication_Erratic: start-on-event=DemSatellite_Invalid_OsApplicationInternalBehavior/GetEventFreezeFrameDataEx, operation=EvtInfo_EMS_ECU_VD_erratic_communication_Erratic.GetEventFreezeFrameDataEx
        OpEventGetEventFreezeFrameDataEx_GetEventFreezeFrameDataEx_Event_EMS_ECU_VD_erratic_communication_Erratic: start-on-event=DemSatellite_Invalid_OsApplicationInternalBehavior/GetEventFreezeFrameDataEx, operation=Event_EMS_ECU_VD_erratic_communication_Erratic.GetEventFreezeFrameDataEx
        OpEventGetEventFreezeFrameDataEx_GetEventFreezeFrameDataEx_EvtInfo_EMS_ECU_ETC2_00_message_Missing_Message: start-on-event=DemSatellite_Invalid_OsApplicationInternalBehavior/GetEventFreezeFrameDataEx, operation=EvtInfo_EMS_ECU_ETC2_00_message_Missing_Message.GetEventFreezeFrameDataEx
        OpEventGetEventFreezeFrameDataEx_GetEventFreezeFrameDataEx_Event_EMS_ECU_ETC2_00_message_Missing_Message: start-on-event=DemSatellite_Invalid_OsApplicationInternalBehavior/GetEventFreezeFrameDataEx, operation=Event_EMS_ECU_ETC2_00_message_Missing_Message.GetEventFreezeFrameDataEx
        OpEventGetEventFreezeFrameDataEx_GetEventFreezeFrameDataEx_EvtInfo_Cluster_ECU_CLS_Tx_16_message_Missing_Message: start-on-event=DemSatellite_Invalid_OsApplicationInternalBehavior/GetEventFreezeFrameDataEx, operation=EvtInfo_Cluster_ECU_CLS_Tx_16_message_Missing_Message.GetEventFreezeFrameDataEx
        OpEventGetEventFreezeFrameDataEx_GetEventFreezeFrameDataEx_Event_Cluster_ECU_CLS_Tx_16_message_Missing_Message: start-on-event=DemSatellite_Invalid_OsApplicationInternalBehavior/GetEventFreezeFrameDataEx, operation=Event_Cluster_ECU_CLS_Tx_16_message_Missing_Message.GetEventFreezeFrameDataEx
        OpEventGetEventFreezeFrameDataEx_GetEventFreezeFrameDataEx_EvtInfo_Exceeded_Security_Access_0x27_Attempt_Threshold_Auth_872b5c35: start-on-event=DemSatellite_Invalid_OsApplicationInternalBehavior/GetEventFreezeFrameDataEx, operation=EvtInfo_Exceeded_Security_Access_0x27_Attempt_Threshold_Authentication_Failure.GetEventFreezeFrameDataEx
        OpEventGetEventFreezeFrameDataEx_GetEventFreezeFrameDataEx_Event_Exceeded_Security_Access_0x27_Attempt_Threshold_Authen_c1efc3a8: start-on-event=DemSatellite_Invalid_OsApplicationInternalBehavior/GetEventFreezeFrameDataEx, operation=Event_Exceeded_Security_Access_0x27_Attempt_Threshold_Authentication_Failure.GetEventFreezeFrameDataEx
        OpEventGetEventFreezeFrameDataEx_GetEventFreezeFrameDataEx_EvtInfo_Front_Left_Side_Radar_value_of_signal_protection_cal_cdb2887d: start-on-event=DemSatellite_Invalid_OsApplicationInternalBehavior/GetEventFreezeFrameDataEx, operation=EvtInfo_Front_Left_Side_Radar_value_of_signal_protection_calculation_Incorrect.GetEventFreezeFrameDataEx
        OpEventGetEventFreezeFrameDataEx_GetEventFreezeFrameDataEx_Event_Front_Left_Side_Radar_value_of_signal_protection_calcu_8b7617e0: start-on-event=DemSatellite_Invalid_OsApplicationInternalBehavior/GetEventFreezeFrameDataEx, operation=Event_Front_Left_Side_Radar_value_of_signal_protection_calculation_Incorrect.GetEventFreezeFrameDataEx
        OpEventGetEventFreezeFrameDataEx_GetEventFreezeFrameDataEx_EvtInfo_AT_AMT_ETC2_erratic_communication_Erratic: start-on-event=DemSatellite_Invalid_OsApplicationInternalBehavior/GetEventFreezeFrameDataEx, operation=EvtInfo_AT_AMT_ETC2_erratic_communication_Erratic.GetEventFreezeFrameDataEx
        OpEventGetEventFreezeFrameDataEx_GetEventFreezeFrameDataEx_Event_AT_AMT_ETC2_erratic_communication_Erratic: start-on-event=DemSatellite_Invalid_OsApplicationInternalBehavior/GetEventFreezeFrameDataEx, operation=Event_AT_AMT_ETC2_erratic_communication_Erratic.GetEventFreezeFrameDataEx
        OpEventGetEventFreezeFrameDataEx_GetEventFreezeFrameDataEx_EvtInfo_VCAN_Communication_Bus_Off: start-on-event=DemSatellite_Invalid_OsApplicationInternalBehavior/GetEventFreezeFrameDataEx, operation=EvtInfo_VCAN_Communication_Bus_Off.GetEventFreezeFrameDataEx
        OpEventGetEventFreezeFrameDataEx_GetEventFreezeFrameDataEx_Event_VCAN_Communication_Bus_Off: start-on-event=DemSatellite_Invalid_OsApplicationInternalBehavior/GetEventFreezeFrameDataEx, operation=Event_VCAN_Communication_Bus_Off.GetEventFreezeFrameDataEx
        OpEventGetEventFreezeFrameDataEx_GetEventFreezeFrameDataEx_EvtInfo_VDC2_message_LongitudinalAcceleration_Invalid_Serial_73dc9629: start-on-event=DemSatellite_Invalid_OsApplicationInternalBehavior/GetEventFreezeFrameDataEx, operation=EvtInfo_VDC2_message_LongitudinalAcceleration_Invalid_Serial_Data_Received.GetEventFreezeFrameDataEx
        OpEventGetEventFreezeFrameDataEx_GetEventFreezeFrameDataEx_Event_VDC2_message_LongitudinalAcceleration_Invalid_Serial_D_24982aee: start-on-event=DemSatellite_Invalid_OsApplicationInternalBehavior/GetEventFreezeFrameDataEx, operation=Event_VDC2_message_LongitudinalAcceleration_Invalid_Serial_Data_Received.GetEventFreezeFrameDataEx
        OpEventGetEventFreezeFrameDataEx_GetEventFreezeFrameDataEx_EvtInfo_Radar_MMIC_RFBIST_Component_Internal_Failure: start-on-event=DemSatellite_Invalid_OsApplicationInternalBehavior/GetEventFreezeFrameDataEx, operation=EvtInfo_Radar_MMIC_RFBIST_Component_Internal_Failure.GetEventFreezeFrameDataEx
        OpEventGetEventFreezeFrameDataEx_GetEventFreezeFrameDataEx_Event_Radar_MMIC_RFBIST_Component_Internal_Failure: start-on-event=DemSatellite_Invalid_OsApplicationInternalBehavior/GetEventFreezeFrameDataEx, operation=Event_Radar_MMIC_RFBIST_Component_Internal_Failure.GetEventFreezeFrameDataEx
        OpEventGetEventFreezeFrameDataEx_GetEventFreezeFrameDataEx_EvtInfo_Radar_Initial_Alignment_Missing_Calibration: start-on-event=DemSatellite_Invalid_OsApplicationInternalBehavior/GetEventFreezeFrameDataEx, operation=EvtInfo_Radar_Initial_Alignment_Missing_Calibration.GetEventFreezeFrameDataEx
        OpEventGetEventFreezeFrameDataEx_GetEventFreezeFrameDataEx_Event_Radar_Initial_Alignment_Missing_Calibration: start-on-event=DemSatellite_Invalid_OsApplicationInternalBehavior/GetEventFreezeFrameDataEx, operation=Event_Radar_Initial_Alignment_Missing_Calibration.GetEventFreezeFrameDataEx
        OpEventGetEventFreezeFrameDataEx_GetEventFreezeFrameDataEx_EvtInfo_Cluster_ECU_OEL_message_Missing_Message: start-on-event=DemSatellite_Invalid_OsApplicationInternalBehavior/GetEventFreezeFrameDataEx, operation=EvtInfo_Cluster_ECU_OEL_message_Missing_Message.GetEventFreezeFrameDataEx
        OpEventGetEventFreezeFrameDataEx_GetEventFreezeFrameDataEx_Event_Cluster_ECU_OEL_message_Missing_Message: start-on-event=DemSatellite_Invalid_OsApplicationInternalBehavior/GetEventFreezeFrameDataEx, operation=Event_Cluster_ECU_OEL_message_Missing_Message.GetEventFreezeFrameDataEx
        OpEventGetEventFreezeFrameDataEx_GetEventFreezeFrameDataEx_EvtInfo_AT_AMT_ECU_ETC2_03_message_Missing_Message: start-on-event=DemSatellite_Invalid_OsApplicationInternalBehavior/GetEventFreezeFrameDataEx, operation=EvtInfo_AT_AMT_ECU_ETC2_03_message_Missing_Message.GetEventFreezeFrameDataEx
        OpEventGetEventFreezeFrameDataEx_GetEventFreezeFrameDataEx_Event_AT_AMT_ECU_ETC2_03_message_Missing_Message: start-on-event=DemSatellite_Invalid_OsApplicationInternalBehavior/GetEventFreezeFrameDataEx, operation=Event_AT_AMT_ECU_ETC2_03_message_Missing_Message.GetEventFreezeFrameDataEx
        OpEventGetEventFreezeFrameDataEx_GetEventFreezeFrameDataEx_EvtInfo_ADAS_FN_STS_message_MOIS_FN_Switch_STS_Invalid_Seria_37587b36: start-on-event=DemSatellite_Invalid_OsApplicationInternalBehavior/GetEventFreezeFrameDataEx, operation=EvtInfo_ADAS_FN_STS_message_MOIS_FN_Switch_STS_Invalid_Serial_Data_Received.GetEventFreezeFrameDataEx
        OpEventGetEventFreezeFrameDataEx_GetEventFreezeFrameDataEx_Event_ADAS_FN_STS_message_MOIS_FN_Switch_STS_Invalid_Serial_320f6899: start-on-event=DemSatellite_Invalid_OsApplicationInternalBehavior/GetEventFreezeFrameDataEx, operation=Event_ADAS_FN_STS_message_MOIS_FN_Switch_STS_Invalid_Serial_Data_Received.GetEventFreezeFrameDataEx
        OpEventGetEventFreezeFrameDataEx_GetEventFreezeFrameDataEx_EvtInfo_Radar_Module_Over_Temperature: start-on-event=DemSatellite_Invalid_OsApplicationInternalBehavior/GetEventFreezeFrameDataEx, operation=EvtInfo_Radar_Module_Over_Temperature.GetEventFreezeFrameDataEx
        OpEventGetEventFreezeFrameDataEx_GetEventFreezeFrameDataEx_Event_Radar_Module_Over_Temperature: start-on-event=DemSatellite_Invalid_OsApplicationInternalBehavior/GetEventFreezeFrameDataEx, operation=Event_Radar_Module_Over_Temperature.GetEventFreezeFrameDataEx
        OpEventGetEventFreezeFrameDataEx_GetEventFreezeFrameDataEx_EvtInfo_PCAN_TimeSync_Missing_Message: start-on-event=DemSatellite_Invalid_OsApplicationInternalBehavior/GetEventFreezeFrameDataEx, operation=EvtInfo_PCAN_TimeSync_Missing_Message.GetEventFreezeFrameDataEx
        OpEventGetEventFreezeFrameDataEx_GetEventFreezeFrameDataEx_Event_PCAN_TimeSync_Missing_Message: start-on-event=DemSatellite_Invalid_OsApplicationInternalBehavior/GetEventFreezeFrameDataEx, operation=Event_PCAN_TimeSync_Missing_Message.GetEventFreezeFrameDataEx
        OpEventGetEventFreezeFrameDataEx_GetEventFreezeFrameDataEx_EvtInfo_Radar_Module_Watchdog_Failure: start-on-event=DemSatellite_Invalid_OsApplicationInternalBehavior/GetEventFreezeFrameDataEx, operation=EvtInfo_Radar_Module_Watchdog_Failure.GetEventFreezeFrameDataEx
        OpEventGetEventFreezeFrameDataEx_GetEventFreezeFrameDataEx_Event_Radar_Module_Watchdog_Failure: start-on-event=DemSatellite_Invalid_OsApplicationInternalBehavior/GetEventFreezeFrameDataEx, operation=Event_Radar_Module_Watchdog_Failure.GetEventFreezeFrameDataEx
        OpEventGetEventFreezeFrameDataEx_GetEventFreezeFrameDataEx_EvtInfo_SAS_ECU_SAS_message_Missing_Message: start-on-event=DemSatellite_Invalid_OsApplicationInternalBehavior/GetEventFreezeFrameDataEx, operation=EvtInfo_SAS_ECU_SAS_message_Missing_Message.GetEventFreezeFrameDataEx
        OpEventGetEventFreezeFrameDataEx_GetEventFreezeFrameDataEx_Event_SAS_ECU_SAS_message_Missing_Message: start-on-event=DemSatellite_Invalid_OsApplicationInternalBehavior/GetEventFreezeFrameDataEx, operation=Event_SAS_ECU_SAS_message_Missing_Message.GetEventFreezeFrameDataEx
        OpEventGetEventFreezeFrameDataEx_GetEventFreezeFrameDataEx_EvtInfo_ECU_NVM_Corruption_Program_memory_Failure: start-on-event=DemSatellite_Invalid_OsApplicationInternalBehavior/GetEventFreezeFrameDataEx, operation=EvtInfo_ECU_NVM_Corruption_Program_memory_Failure.GetEventFreezeFrameDataEx
        OpEventGetEventFreezeFrameDataEx_GetEventFreezeFrameDataEx_Event_ECU_NVM_Corruption_Program_memory_Failure: start-on-event=DemSatellite_Invalid_OsApplicationInternalBehavior/GetEventFreezeFrameDataEx, operation=Event_ECU_NVM_Corruption_Program_memory_Failure.GetEventFreezeFrameDataEx
        OpEventGetEventFreezeFrameDataEx_GetEventFreezeFrameDataEx_EvtInfo_Cluster_ECU_TD_message_Missing_Message: start-on-event=DemSatellite_Invalid_OsApplicationInternalBehavior/GetEventFreezeFrameDataEx, operation=EvtInfo_Cluster_ECU_TD_message_Missing_Message.GetEventFreezeFrameDataEx
        OpEventGetEventFreezeFrameDataEx_GetEventFreezeFrameDataEx_Event_Cluster_ECU_TD_message_Missing_Message: start-on-event=DemSatellite_Invalid_OsApplicationInternalBehavior/GetEventFreezeFrameDataEx, operation=Event_Cluster_ECU_TD_message_Missing_Message.GetEventFreezeFrameDataEx
        OpEventGetEventFreezeFrameDataEx_GetEventFreezeFrameDataEx_EvtInfo_PCAN_Communication_Bus_Off: start-on-event=DemSatellite_Invalid_OsApplicationInternalBehavior/GetEventFreezeFrameDataEx, operation=EvtInfo_PCAN_Communication_Bus_Off.GetEventFreezeFrameDataEx
        OpEventGetEventFreezeFrameDataEx_GetEventFreezeFrameDataEx_Event_PCAN_Communication_Bus_Off: start-on-event=DemSatellite_Invalid_OsApplicationInternalBehavior/GetEventFreezeFrameDataEx, operation=Event_PCAN_Communication_Bus_Off.GetEventFreezeFrameDataEx
        OpEventGetEventFreezeFrameDataEx_GetEventFreezeFrameDataEx_EvtInfo_Front_Left_Side_Radar_Missing_Message: start-on-event=DemSatellite_Invalid_OsApplicationInternalBehavior/GetEventFreezeFrameDataEx, operation=EvtInfo_Front_Left_Side_Radar_Missing_Message.GetEventFreezeFrameDataEx
        OpEventGetEventFreezeFrameDataEx_GetEventFreezeFrameDataEx_Event_Front_Left_Side_Radar_Missing_Message: start-on-event=DemSatellite_Invalid_OsApplicationInternalBehavior/GetEventFreezeFrameDataEx, operation=Event_Front_Left_Side_Radar_Missing_Message.GetEventFreezeFrameDataEx
        OpEventGetEventFreezeFrameDataEx_GetEventFreezeFrameDataEx_EvtInfo_Manual_ETC2_message_Transcurrent_gear_Invalid_Serial_efa4be3d: start-on-event=DemSatellite_Invalid_OsApplicationInternalBehavior/GetEventFreezeFrameDataEx, operation=EvtInfo_Manual_ETC2_message_Transcurrent_gear_Invalid_Serial_Data_Received.GetEventFreezeFrameDataEx
        OpEventGetEventFreezeFrameDataEx_GetEventFreezeFrameDataEx_Event_Manual_ETC2_message_Transcurrent_gear_Invalid_Serial_D_b8e002fa: start-on-event=DemSatellite_Invalid_OsApplicationInternalBehavior/GetEventFreezeFrameDataEx, operation=Event_Manual_ETC2_message_Transcurrent_gear_Invalid_Serial_Data_Received.GetEventFreezeFrameDataEx
        OpEventGetEventFreezeFrameDataEx_GetEventFreezeFrameDataEx_EvtInfo_SAS_ECU_erratic_communication_Erratic: start-on-event=DemSatellite_Invalid_OsApplicationInternalBehavior/GetEventFreezeFrameDataEx, operation=EvtInfo_SAS_ECU_erratic_communication_Erratic.GetEventFreezeFrameDataEx
        OpEventGetEventFreezeFrameDataEx_GetEventFreezeFrameDataEx_Event_SAS_ECU_erratic_communication_Erratic: start-on-event=DemSatellite_Invalid_OsApplicationInternalBehavior/GetEventFreezeFrameDataEx, operation=Event_SAS_ECU_erratic_communication_Erratic.GetEventFreezeFrameDataEx
        OpEventGetEventFreezeFrameDataEx_GetEventFreezeFrameDataEx_EvtInfo_VDC2_message_Yaw_rate_Invalid_Serial_Data_Received: start-on-event=DemSatellite_Invalid_OsApplicationInternalBehavior/GetEventFreezeFrameDataEx, operation=EvtInfo_VDC2_message_Yaw_rate_Invalid_Serial_Data_Received.GetEventFreezeFrameDataEx
        OpEventGetEventFreezeFrameDataEx_GetEventFreezeFrameDataEx_Event_VDC2_message_Yaw_rate_Invalid_Serial_Data_Received: start-on-event=DemSatellite_Invalid_OsApplicationInternalBehavior/GetEventFreezeFrameDataEx, operation=Event_VDC2_message_Yaw_rate_Invalid_Serial_Data_Received.GetEventFreezeFrameDataEx
        OpEventGetEventFreezeFrameDataEx_GetEventFreezeFrameDataEx_EvtInfo_Cluster_ECU_TD_erratic_communication_Erratic: start-on-event=DemSatellite_Invalid_OsApplicationInternalBehavior/GetEventFreezeFrameDataEx, operation=EvtInfo_Cluster_ECU_TD_erratic_communication_Erratic.GetEventFreezeFrameDataEx
        OpEventGetEventFreezeFrameDataEx_GetEventFreezeFrameDataEx_Event_Cluster_ECU_TD_erratic_communication_Erratic: start-on-event=DemSatellite_Invalid_OsApplicationInternalBehavior/GetEventFreezeFrameDataEx, operation=Event_Cluster_ECU_TD_erratic_communication_Erratic.GetEventFreezeFrameDataEx
        OpEventGetEventFreezeFrameDataEx_GetEventFreezeFrameDataEx_EvtInfo_EMS_ECU_CCVS1_message_Missing_Message: start-on-event=DemSatellite_Invalid_OsApplicationInternalBehavior/GetEventFreezeFrameDataEx, operation=EvtInfo_EMS_ECU_CCVS1_message_Missing_Message.GetEventFreezeFrameDataEx
        OpEventGetEventFreezeFrameDataEx_GetEventFreezeFrameDataEx_Event_EMS_ECU_CCVS1_message_Missing_Message: start-on-event=DemSatellite_Invalid_OsApplicationInternalBehavior/GetEventFreezeFrameDataEx, operation=Event_EMS_ECU_CCVS1_message_Missing_Message.GetEventFreezeFrameDataEx
        OpEventGetEventFreezeFrameDataEx_GetEventFreezeFrameDataEx_EvtInfo_Radar_Mounting_Orientation_Incorrect_Assembly: start-on-event=DemSatellite_Invalid_OsApplicationInternalBehavior/GetEventFreezeFrameDataEx, operation=EvtInfo_Radar_Mounting_Orientation_Incorrect_Assembly.GetEventFreezeFrameDataEx
        OpEventGetEventFreezeFrameDataEx_GetEventFreezeFrameDataEx_Event_Radar_Mounting_Orientation_Incorrect_Assembly: start-on-event=DemSatellite_Invalid_OsApplicationInternalBehavior/GetEventFreezeFrameDataEx, operation=Event_Radar_Mounting_Orientation_Incorrect_Assembly.GetEventFreezeFrameDataEx
        OpEventGetEventFreezeFrameDataEx_GetEventFreezeFrameDataEx_EvtInfo_EMS_ECU_ETC2_erratic_communication_Erractic: start-on-event=DemSatellite_Invalid_OsApplicationInternalBehavior/GetEventFreezeFrameDataEx, operation=EvtInfo_EMS_ECU_ETC2_erratic_communication_Erractic.GetEventFreezeFrameDataEx
        OpEventGetEventFreezeFrameDataEx_GetEventFreezeFrameDataEx_Event_EMS_ECU_ETC2_erratic_communication_Erractic: start-on-event=DemSatellite_Invalid_OsApplicationInternalBehavior/GetEventFreezeFrameDataEx, operation=Event_EMS_ECU_ETC2_erratic_communication_Erractic.GetEventFreezeFrameDataEx
        OpEventGetEventFreezeFrameDataEx_GetEventFreezeFrameDataEx_EvtInfo_Cluster_ECU_ADAS_FN_STS_erratic_communication_Erratic: start-on-event=DemSatellite_Invalid_OsApplicationInternalBehavior/GetEventFreezeFrameDataEx, operation=EvtInfo_Cluster_ECU_ADAS_FN_STS_erratic_communication_Erratic.GetEventFreezeFrameDataEx
        OpEventGetEventFreezeFrameDataEx_GetEventFreezeFrameDataEx_Event_Cluster_ECU_ADAS_FN_STS_erratic_communication_Erratic: start-on-event=DemSatellite_Invalid_OsApplicationInternalBehavior/GetEventFreezeFrameDataEx, operation=Event_Cluster_ECU_ADAS_FN_STS_erratic_communication_Erratic.GetEventFreezeFrameDataEx
        OpEventGetEventFreezeFrameDataEx_GetEventFreezeFrameDataEx_EvtInfo_ESC_ECU_VDC2_message_Missing_Message: start-on-event=DemSatellite_Invalid_OsApplicationInternalBehavior/GetEventFreezeFrameDataEx, operation=EvtInfo_ESC_ECU_VDC2_message_Missing_Message.GetEventFreezeFrameDataEx
        OpEventGetEventFreezeFrameDataEx_GetEventFreezeFrameDataEx_Event_ESC_ECU_VDC2_message_Missing_Message: start-on-event=DemSatellite_Invalid_OsApplicationInternalBehavior/GetEventFreezeFrameDataEx, operation=Event_ESC_ECU_VDC2_message_Missing_Message.GetEventFreezeFrameDataEx
        OpEventGetEventFreezeFrameDataEx_GetEventFreezeFrameDataEx_EvtInfo_CLS_TX_16_message_Transmission_Type_info_Invalid_Ser_553cfe21: start-on-event=DemSatellite_Invalid_OsApplicationInternalBehavior/GetEventFreezeFrameDataEx, operation=EvtInfo_CLS_TX_16_message_Transmission_Type_info_Invalid_Serial_Data_Received.GetEventFreezeFrameDataEx
        OpEventGetEventFreezeFrameDataEx_GetEventFreezeFrameDataEx_Event_CLS_TX_16_message_Transmission_Type_info_Invalid_Seria_f81d1a8e: start-on-event=DemSatellite_Invalid_OsApplicationInternalBehavior/GetEventFreezeFrameDataEx, operation=Event_CLS_TX_16_message_Transmission_Type_info_Invalid_Serial_Data_Received.GetEventFreezeFrameDataEx
        OpEventGetEventFreezeFrameDataEx_GetEventFreezeFrameDataEx_EvtInfo_Cluster_ECU_CLS_Tx_4_erratic_communication_Erratic: start-on-event=DemSatellite_Invalid_OsApplicationInternalBehavior/GetEventFreezeFrameDataEx, operation=EvtInfo_Cluster_ECU_CLS_Tx_4_erratic_communication_Erratic.GetEventFreezeFrameDataEx
        OpEventGetEventFreezeFrameDataEx_GetEventFreezeFrameDataEx_Event_Cluster_ECU_CLS_Tx_4_erratic_communication_Erratic: start-on-event=DemSatellite_Invalid_OsApplicationInternalBehavior/GetEventFreezeFrameDataEx, operation=Event_Cluster_ECU_CLS_Tx_4_erratic_communication_Erratic.GetEventFreezeFrameDataEx
        OpEventGetEventFreezeFrameDataEx_GetEventFreezeFrameDataEx_EvtInfo_Cluster_ECU_ADAS_FN_STS_message_Missing_Message: start-on-event=DemSatellite_Invalid_OsApplicationInternalBehavior/GetEventFreezeFrameDataEx, operation=EvtInfo_Cluster_ECU_ADAS_FN_STS_message_Missing_Message.GetEventFreezeFrameDataEx
        OpEventGetEventFreezeFrameDataEx_GetEventFreezeFrameDataEx_Event_Cluster_ECU_ADAS_FN_STS_message_Missing_Message: start-on-event=DemSatellite_Invalid_OsApplicationInternalBehavior/GetEventFreezeFrameDataEx, operation=Event_Cluster_ECU_ADAS_FN_STS_message_Missing_Message.GetEventFreezeFrameDataEx
        OpEventGetEventFreezeFrameDataEx_GetEventFreezeFrameDataEx_EvtInfo_Vehicle_Dataset_value_of_signal_protection_calculati_d72c87b5: start-on-event=DemSatellite_Invalid_OsApplicationInternalBehavior/GetEventFreezeFrameDataEx, operation=EvtInfo_Vehicle_Dataset_value_of_signal_protection_calculation_Incorrect.GetEventFreezeFrameDataEx
        OpEventGetEventFreezeFrameDataEx_GetEventFreezeFrameDataEx_Event_Vehicle_Dataset_value_of_signal_protection_calculation_0750780b: start-on-event=DemSatellite_Invalid_OsApplicationInternalBehavior/GetEventFreezeFrameDataEx, operation=Event_Vehicle_Dataset_value_of_signal_protection_calculation_Incorrect.GetEventFreezeFrameDataEx
        OpEventGetEventFreezeFrameDataEx_GetEventFreezeFrameDataEx_EvtInfo_Cluster_ECU_CLS_Tx_16_erratic_communication_Erratic: start-on-event=DemSatellite_Invalid_OsApplicationInternalBehavior/GetEventFreezeFrameDataEx, operation=EvtInfo_Cluster_ECU_CLS_Tx_16_erratic_communication_Erratic.GetEventFreezeFrameDataEx
        OpEventGetEventFreezeFrameDataEx_GetEventFreezeFrameDataEx_Event_Cluster_ECU_CLS_Tx_16_erratic_communication_Erratic: start-on-event=DemSatellite_Invalid_OsApplicationInternalBehavior/GetEventFreezeFrameDataEx, operation=Event_Cluster_ECU_CLS_Tx_16_erratic_communication_Erratic.GetEventFreezeFrameDataEx
        OpEventGetEventFreezeFrameDataEx_GetEventFreezeFrameDataEx_EvtInfo_Cluster_ECU_OEL_erratic_communication_Erratic: start-on-event=DemSatellite_Invalid_OsApplicationInternalBehavior/GetEventFreezeFrameDataEx, operation=EvtInfo_Cluster_ECU_OEL_erratic_communication_Erratic.GetEventFreezeFrameDataEx
        OpEventGetEventFreezeFrameDataEx_GetEventFreezeFrameDataEx_Event_Cluster_ECU_OEL_erratic_communication_Erratic: start-on-event=DemSatellite_Invalid_OsApplicationInternalBehavior/GetEventFreezeFrameDataEx, operation=Event_Cluster_ECU_OEL_erratic_communication_Erratic.GetEventFreezeFrameDataEx
        OpEventGetEventFreezeFrameDataEx_GetEventFreezeFrameDataEx_EvtInfo_Cluster_ECU_CLS_Tx_4_message_Missing_Message: start-on-event=DemSatellite_Invalid_OsApplicationInternalBehavior/GetEventFreezeFrameDataEx, operation=EvtInfo_Cluster_ECU_CLS_Tx_4_message_Missing_Message.GetEventFreezeFrameDataEx
        OpEventGetEventFreezeFrameDataEx_GetEventFreezeFrameDataEx_Event_Cluster_ECU_CLS_Tx_4_message_Missing_Message: start-on-event=DemSatellite_Invalid_OsApplicationInternalBehavior/GetEventFreezeFrameDataEx, operation=Event_Cluster_ECU_CLS_Tx_4_message_Missing_Message.GetEventFreezeFrameDataEx
        OpEventGetEventFreezeFrameDataEx_GetEventFreezeFrameDataEx_EvtInfo_Radar_Performance_Capability_Algorithm_Based_Failure: start-on-event=DemSatellite_Invalid_OsApplicationInternalBehavior/GetEventFreezeFrameDataEx, operation=EvtInfo_Radar_Performance_Capability_Algorithm_Based_Failure.GetEventFreezeFrameDataEx
        OpEventGetEventFreezeFrameDataEx_GetEventFreezeFrameDataEx_Event_Radar_Performance_Capability_Algorithm_Based_Failure: start-on-event=DemSatellite_Invalid_OsApplicationInternalBehavior/GetEventFreezeFrameDataEx, operation=Event_Radar_Performance_Capability_Algorithm_Based_Failure.GetEventFreezeFrameDataEx
        OpEventGetEventFreezeFrameDataEx_GetEventFreezeFrameDataEx_EvtInfo_Radar_AutoAlignment_Range_Alignment_or_Adjustement_Incorrect: start-on-event=DemSatellite_Invalid_OsApplicationInternalBehavior/GetEventFreezeFrameDataEx, operation=EvtInfo_Radar_AutoAlignment_Range_Alignment_or_Adjustement_Incorrect.GetEventFreezeFrameDataEx
        OpEventGetEventFreezeFrameDataEx_GetEventFreezeFrameDataEx_Event_Radar_AutoAlignment_Range_Alignment_or_Adjustement_Incorrect: start-on-event=DemSatellite_Invalid_OsApplicationInternalBehavior/GetEventFreezeFrameDataEx, operation=Event_Radar_AutoAlignment_Range_Alignment_or_Adjustement_Incorrect.GetEventFreezeFrameDataEx
        OpEventGetEventFreezeFrameDataEx_GetEventFreezeFrameDataEx_EvtInfo_EMS_ECU_CCVS1_erratic_communication_Erractic: start-on-event=DemSatellite_Invalid_OsApplicationInternalBehavior/GetEventFreezeFrameDataEx, operation=EvtInfo_EMS_ECU_CCVS1_erratic_communication_Erractic.GetEventFreezeFrameDataEx
        OpEventGetEventFreezeFrameDataEx_GetEventFreezeFrameDataEx_Event_EMS_ECU_CCVS1_erratic_communication_Erractic: start-on-event=DemSatellite_Invalid_OsApplicationInternalBehavior/GetEventFreezeFrameDataEx, operation=Event_EMS_ECU_CCVS1_erratic_communication_Erractic.GetEventFreezeFrameDataEx
        OpEventGetEventFreezeFrameDataEx_GetEventFreezeFrameDataEx_EvtInfo_Radar_System_Battery_Low_Voltage_System_Voltage_Low: start-on-event=DemSatellite_Invalid_OsApplicationInternalBehavior/GetEventFreezeFrameDataEx, operation=EvtInfo_Radar_System_Battery_Low_Voltage_System_Voltage_Low.GetEventFreezeFrameDataEx
        OpEventGetEventFreezeFrameDataEx_GetEventFreezeFrameDataEx_Event_Radar_System_Battery_Low_Voltage_System_Voltage_Low: start-on-event=DemSatellite_Invalid_OsApplicationInternalBehavior/GetEventFreezeFrameDataEx, operation=Event_Radar_System_Battery_Low_Voltage_System_Voltage_Low.GetEventFreezeFrameDataEx
        OpEventGetEventFreezeFrameDataEx_GetEventFreezeFrameDataEx_EvtInfo_Radar_SMC_General_Checksum_Failure: start-on-event=DemSatellite_Invalid_OsApplicationInternalBehavior/GetEventFreezeFrameDataEx, operation=EvtInfo_Radar_SMC_General_Checksum_Failure.GetEventFreezeFrameDataEx
        OpEventGetEventFreezeFrameDataEx_GetEventFreezeFrameDataEx_Event_Radar_SMC_General_Checksum_Failure: start-on-event=DemSatellite_Invalid_OsApplicationInternalBehavior/GetEventFreezeFrameDataEx, operation=Event_Radar_SMC_General_Checksum_Failure.GetEventFreezeFrameDataEx
        OpEventGetEventFreezeFrameDataEx_GetEventFreezeFrameDataEx_EvtInfo_Radar_Pin_Position_Wrong_Mounting_Position: start-on-event=DemSatellite_Invalid_OsApplicationInternalBehavior/GetEventFreezeFrameDataEx, operation=EvtInfo_Radar_Pin_Position_Wrong_Mounting_Position.GetEventFreezeFrameDataEx
        OpEventGetEventFreezeFrameDataEx_GetEventFreezeFrameDataEx_Event_Radar_Pin_Position_Wrong_Mounting_Position: start-on-event=DemSatellite_Invalid_OsApplicationInternalBehavior/GetEventFreezeFrameDataEx, operation=Event_Radar_Pin_Position_Wrong_Mounting_Position.GetEventFreezeFrameDataEx
        OpEventGetEventFreezeFrameDataEx_GetEventFreezeFrameDataEx_EvtInfo_VDC2_message_Lateral_Accleration_Invalid_Serial_Data_Received: start-on-event=DemSatellite_Invalid_OsApplicationInternalBehavior/GetEventFreezeFrameDataEx, operation=EvtInfo_VDC2_message_Lateral_Accleration_Invalid_Serial_Data_Received.GetEventFreezeFrameDataEx
        OpEventGetEventFreezeFrameDataEx_GetEventFreezeFrameDataEx_Event_VDC2_message_Lateral_Accleration_Invalid_Serial_Data_Received: start-on-event=DemSatellite_Invalid_OsApplicationInternalBehavior/GetEventFreezeFrameDataEx, operation=Event_VDC2_message_Lateral_Accleration_Invalid_Serial_Data_Received.GetEventFreezeFrameDataEx
        OpEventGetEventFreezeFrameDataEx_GetEventFreezeFrameDataEx_EvtInfo_ADAS_FN_STS_message_BSIS_FN_Switch_STS_Invalid_Seria_f2c802c5: start-on-event=DemSatellite_Invalid_OsApplicationInternalBehavior/GetEventFreezeFrameDataEx, operation=EvtInfo_ADAS_FN_STS_message_BSIS_FN_Switch_STS_Invalid_Serial_Data_Received.GetEventFreezeFrameDataEx
        OpEventGetEventFreezeFrameDataEx_GetEventFreezeFrameDataEx_Event_ADAS_FN_STS_message_BSIS_FN_Switch_STS_Invalid_Serial_f79f116a: start-on-event=DemSatellite_Invalid_OsApplicationInternalBehavior/GetEventFreezeFrameDataEx, operation=Event_ADAS_FN_STS_message_BSIS_FN_Switch_STS_Invalid_Serial_Data_Received.GetEventFreezeFrameDataEx
        OpEventGetEventFreezeFrameDataEx_GetEventFreezeFrameDataEx_EvtInfo_Radar_AutoAlignment_Misalignment_Performance_or_Inco_a491aa6c: start-on-event=DemSatellite_Invalid_OsApplicationInternalBehavior/GetEventFreezeFrameDataEx, operation=EvtInfo_Radar_AutoAlignment_Misalignment_Performance_or_Incorrect_Operation.GetEventFreezeFrameDataEx
        OpEventGetEventFreezeFrameDataEx_GetEventFreezeFrameDataEx_Event_Radar_AutoAlignment_Misalignment_Performance_or_Incorr_a1c6b9c3: start-on-event=DemSatellite_Invalid_OsApplicationInternalBehavior/GetEventFreezeFrameDataEx, operation=Event_Radar_AutoAlignment_Misalignment_Performance_or_Incorrect_Operation.GetEventFreezeFrameDataEx
        OpEventGetEventFreezeFrameDataEx_GetEventFreezeFrameDataEx_EvtInfo_ESC_ECU_VDC2_erratic_communication_Erratic: start-on-event=DemSatellite_Invalid_OsApplicationInternalBehavior/GetEventFreezeFrameDataEx, operation=EvtInfo_ESC_ECU_VDC2_erratic_communication_Erratic.GetEventFreezeFrameDataEx
        OpEventGetEventFreezeFrameDataEx_GetEventFreezeFrameDataEx_Event_ESC_ECU_VDC2_erratic_communication_Erratic: start-on-event=DemSatellite_Invalid_OsApplicationInternalBehavior/GetEventFreezeFrameDataEx, operation=Event_ESC_ECU_VDC2_erratic_communication_Erratic.GetEventFreezeFrameDataEx
        OpEventGetEventFreezeFrameDataEx_GetEventFreezeFrameDataEx_EvtInfo_Application_Interface_Lookup_Performance_or_Incorrec_c1c0384c: start-on-event=DemSatellite_Invalid_OsApplicationInternalBehavior/GetEventFreezeFrameDataEx, operation=EvtInfo_Application_Interface_Lookup_Performance_or_Incorrect_Operation.GetEventFreezeFrameDataEx
        OpEventGetEventFreezeFrameDataEx_GetEventFreezeFrameDataEx_Event_Application_Interface_Lookup_Performance_or_Incorrect_Operation: start-on-event=DemSatellite_Invalid_OsApplicationInternalBehavior/GetEventFreezeFrameDataEx, operation=Event_Application_Interface_Lookup_Performance_or_Incorrect_Operation.GetEventFreezeFrameDataEx
        OpEventGetEventFreezeFrameDataEx_GetEventFreezeFrameDataEx_EvtInfo_EMS_ECU_VD_message_Missing_Message: start-on-event=DemSatellite_Invalid_OsApplicationInternalBehavior/GetEventFreezeFrameDataEx, operation=EvtInfo_EMS_ECU_VD_message_Missing_Message.GetEventFreezeFrameDataEx
        OpEventGetEventFreezeFrameDataEx_GetEventFreezeFrameDataEx_Event_EMS_ECU_VD_message_Missing_Message: start-on-event=DemSatellite_Invalid_OsApplicationInternalBehavior/GetEventFreezeFrameDataEx, operation=Event_EMS_ECU_VD_message_Missing_Message.GetEventFreezeFrameDataEx
        OpEventGetEventFreezeFrameDataEx_GetEventFreezeFrameDataEx_EvtInfo_Radar_Platform_Time_System_Programming_Failure: start-on-event=DemSatellite_Invalid_OsApplicationInternalBehavior/GetEventFreezeFrameDataEx, operation=EvtInfo_Radar_Platform_Time_System_Programming_Failure.GetEventFreezeFrameDataEx
        OpEventGetEventFreezeFrameDataEx_GetEventFreezeFrameDataEx_Event_Radar_Platform_Time_System_Programming_Failure: start-on-event=DemSatellite_Invalid_OsApplicationInternalBehavior/GetEventFreezeFrameDataEx, operation=Event_Radar_Platform_Time_System_Programming_Failure.GetEventFreezeFrameDataEx
        OpEventGetEventFreezeFrameDataEx_GetEventFreezeFrameDataEx_EvtInfo_OEL_message_Turn_Signal_Switch_Invalid_Serial_Data_Received: start-on-event=DemSatellite_Invalid_OsApplicationInternalBehavior/GetEventFreezeFrameDataEx, operation=EvtInfo_OEL_message_Turn_Signal_Switch_Invalid_Serial_Data_Received.GetEventFreezeFrameDataEx
        OpEventGetEventFreezeFrameDataEx_GetEventFreezeFrameDataEx_Event_OEL_message_Turn_Signal_Switch_Invalid_Serial_Data_Received: start-on-event=DemSatellite_Invalid_OsApplicationInternalBehavior/GetEventFreezeFrameDataEx, operation=Event_OEL_message_Turn_Signal_Switch_Invalid_Serial_Data_Received.GetEventFreezeFrameDataEx
        OpEventGetEventFreezeFrameDataEx_GetEventFreezeFrameDataEx_EvtInfo_Radar_calibration_Calibration_or_Paramater_Memory_Failure: start-on-event=DemSatellite_Invalid_OsApplicationInternalBehavior/GetEventFreezeFrameDataEx, operation=EvtInfo_Radar_calibration_Calibration_or_Paramater_Memory_Failure.GetEventFreezeFrameDataEx
        OpEventGetEventFreezeFrameDataEx_GetEventFreezeFrameDataEx_Event_Radar_calibration_Calibration_or_Paramater_Memory_Failure: start-on-event=DemSatellite_Invalid_OsApplicationInternalBehavior/GetEventFreezeFrameDataEx, operation=Event_Radar_calibration_Calibration_or_Paramater_Memory_Failure.GetEventFreezeFrameDataEx
        OpEventGetEventFreezeFrameDataEx_GetEventFreezeFrameDataEx_GeneralEvtInfo: start-on-event=DemSatellite_Invalid_OsApplicationInternalBehavior/GetEventFreezeFrameDataEx, operation=GeneralEvtInfo.GetEventFreezeFrameDataEx
        OpEventGetEventExtendedDataRecordEx_GetEventExtendedDataRecordEx_EvtInfo_SAS_message_Steering_Wheel_Angle_Invalid_Seria_f6ef6b8e: start-on-event=DemSatellite_Invalid_OsApplicationInternalBehavior/GetEventExtendedDataRecordEx, operation=EvtInfo_SAS_message_Steering_Wheel_Angle_Invalid_Serial_Data_Received.GetEventExtendedDataRecordEx
        OpEventGetEventExtendedDataRecordEx_GetEventExtendedDataRecordEx_Event_SAS_message_Steering_Wheel_Angle_Invalid_Serial_3dd17937: start-on-event=DemSatellite_Invalid_OsApplicationInternalBehavior/GetEventExtendedDataRecordEx, operation=Event_SAS_message_Steering_Wheel_Angle_Invalid_Serial_Data_Received.GetEventExtendedDataRecordEx
        OpEventGetEventExtendedDataRecordEx_GetEventExtendedDataRecordEx_EvtInfo_AT_AMT_ETC2_message_Transcurrent_gear_Invalid_040ddf16: start-on-event=DemSatellite_Invalid_OsApplicationInternalBehavior/GetEventExtendedDataRecordEx, operation=EvtInfo_AT_AMT_ETC2_message_Transcurrent_gear_Invalid_Serial_Data_Received.GetEventExtendedDataRecordEx
        OpEventGetEventExtendedDataRecordEx_GetEventExtendedDataRecordEx_Event_AT_AMT_ETC2_message_Transcurrent_gear_Invalid_Se_e531ec78: start-on-event=DemSatellite_Invalid_OsApplicationInternalBehavior/GetEventExtendedDataRecordEx, operation=Event_AT_AMT_ETC2_message_Transcurrent_gear_Invalid_Serial_Data_Received.GetEventExtendedDataRecordEx
        OpEventGetEventExtendedDataRecordEx_GetEventExtendedDataRecordEx_EvtInfo_Radar_AutoAlignment_Algorithm_Signal_Calculati_cadbd56c: start-on-event=DemSatellite_Invalid_OsApplicationInternalBehavior/GetEventExtendedDataRecordEx, operation=EvtInfo_Radar_AutoAlignment_Algorithm_Signal_Calculation_Failure.GetEventExtendedDataRecordEx
        OpEventGetEventExtendedDataRecordEx_GetEventExtendedDataRecordEx_Event_Radar_AutoAlignment_Algorithm_Signal_Calculation_Failure: start-on-event=DemSatellite_Invalid_OsApplicationInternalBehavior/GetEventExtendedDataRecordEx, operation=Event_Radar_AutoAlignment_Algorithm_Signal_Calculation_Failure.GetEventExtendedDataRecordEx
        OpEventGetEventExtendedDataRecordEx_GetEventExtendedDataRecordEx_EvtInfo_Vehicle_DataSet_Not_Configured: start-on-event=DemSatellite_Invalid_OsApplicationInternalBehavior/GetEventExtendedDataRecordEx, operation=EvtInfo_Vehicle_DataSet_Not_Configured.GetEventExtendedDataRecordEx
        OpEventGetEventExtendedDataRecordEx_GetEventExtendedDataRecordEx_Event_Vehicle_DataSet_Not_Configured: start-on-event=DemSatellite_Invalid_OsApplicationInternalBehavior/GetEventExtendedDataRecordEx, operation=Event_Vehicle_DataSet_Not_Configured.GetEventExtendedDataRecordEx
        OpEventGetEventExtendedDataRecordEx_GetEventExtendedDataRecordEx_EvtInfo_Radar_Module_System_Internal_Failure: start-on-event=DemSatellite_Invalid_OsApplicationInternalBehavior/GetEventExtendedDataRecordEx, operation=EvtInfo_Radar_Module_System_Internal_Failure.GetEventExtendedDataRecordEx
        OpEventGetEventExtendedDataRecordEx_GetEventExtendedDataRecordEx_Event_Radar_Module_System_Internal_Failure: start-on-event=DemSatellite_Invalid_OsApplicationInternalBehavior/GetEventExtendedDataRecordEx, operation=Event_Radar_Module_System_Internal_Failure.GetEventExtendedDataRecordEx
        OpEventGetEventExtendedDataRecordEx_GetEventExtendedDataRecordEx_EvtInfo_Radar_MMIC_Component_Failure: start-on-event=DemSatellite_Invalid_OsApplicationInternalBehavior/GetEventExtendedDataRecordEx, operation=EvtInfo_Radar_MMIC_Component_Failure.GetEventExtendedDataRecordEx
        OpEventGetEventExtendedDataRecordEx_GetEventExtendedDataRecordEx_Event_Radar_MMIC_Component_Failure: start-on-event=DemSatellite_Invalid_OsApplicationInternalBehavior/GetEventExtendedDataRecordEx, operation=Event_Radar_MMIC_Component_Failure.GetEventExtendedDataRecordEx
        OpEventGetEventExtendedDataRecordEx_GetEventExtendedDataRecordEx_EvtInfo_Radar_Module_General_Memory_Failure: start-on-event=DemSatellite_Invalid_OsApplicationInternalBehavior/GetEventExtendedDataRecordEx, operation=EvtInfo_Radar_Module_General_Memory_Failure.GetEventExtendedDataRecordEx
        OpEventGetEventExtendedDataRecordEx_GetEventExtendedDataRecordEx_Event_Radar_Module_General_Memory_Failure: start-on-event=DemSatellite_Invalid_OsApplicationInternalBehavior/GetEventExtendedDataRecordEx, operation=Event_Radar_Module_General_Memory_Failure.GetEventExtendedDataRecordEx
        OpEventGetEventExtendedDataRecordEx_GetEventExtendedDataRecordEx_EvtInfo_Radar_System_Battery_High_Voltage_System_Voltage_High: start-on-event=DemSatellite_Invalid_OsApplicationInternalBehavior/GetEventExtendedDataRecordEx, operation=EvtInfo_Radar_System_Battery_High_Voltage_System_Voltage_High.GetEventExtendedDataRecordEx
        OpEventGetEventExtendedDataRecordEx_GetEventExtendedDataRecordEx_Event_Radar_System_Battery_High_Voltage_System_Voltage_High: start-on-event=DemSatellite_Invalid_OsApplicationInternalBehavior/GetEventExtendedDataRecordEx, operation=Event_Radar_System_Battery_High_Voltage_System_Voltage_High.GetEventExtendedDataRecordEx
        OpEventGetEventExtendedDataRecordEx_GetEventExtendedDataRecordEx_EvtInfo_CCVS1_message_Vehicle_Speed_Invalid_Serial_Dat_90bf66b5: start-on-event=DemSatellite_Invalid_OsApplicationInternalBehavior/GetEventExtendedDataRecordEx, operation=EvtInfo_CCVS1_message_Vehicle_Speed_Invalid_Serial_Data_Received.GetEventExtendedDataRecordEx
        OpEventGetEventExtendedDataRecordEx_GetEventExtendedDataRecordEx_Event_CCVS1_message_Vehicle_Speed_Invalid_Serial_Data_Received: start-on-event=DemSatellite_Invalid_OsApplicationInternalBehavior/GetEventExtendedDataRecordEx, operation=Event_CCVS1_message_Vehicle_Speed_Invalid_Serial_Data_Received.GetEventExtendedDataRecordEx
        OpEventGetEventExtendedDataRecordEx_GetEventExtendedDataRecordEx_EvtInfo_EMS_ECU_VD_erratic_communication_Erratic: start-on-event=DemSatellite_Invalid_OsApplicationInternalBehavior/GetEventExtendedDataRecordEx, operation=EvtInfo_EMS_ECU_VD_erratic_communication_Erratic.GetEventExtendedDataRecordEx
        OpEventGetEventExtendedDataRecordEx_GetEventExtendedDataRecordEx_Event_EMS_ECU_VD_erratic_communication_Erratic: start-on-event=DemSatellite_Invalid_OsApplicationInternalBehavior/GetEventExtendedDataRecordEx, operation=Event_EMS_ECU_VD_erratic_communication_Erratic.GetEventExtendedDataRecordEx
        OpEventGetEventExtendedDataRecordEx_GetEventExtendedDataRecordEx_EvtInfo_EMS_ECU_ETC2_00_message_Missing_Message: start-on-event=DemSatellite_Invalid_OsApplicationInternalBehavior/GetEventExtendedDataRecordEx, operation=EvtInfo_EMS_ECU_ETC2_00_message_Missing_Message.GetEventExtendedDataRecordEx
        OpEventGetEventExtendedDataRecordEx_GetEventExtendedDataRecordEx_Event_EMS_ECU_ETC2_00_message_Missing_Message: start-on-event=DemSatellite_Invalid_OsApplicationInternalBehavior/GetEventExtendedDataRecordEx, operation=Event_EMS_ECU_ETC2_00_message_Missing_Message.GetEventExtendedDataRecordEx
        OpEventGetEventExtendedDataRecordEx_GetEventExtendedDataRecordEx_EvtInfo_Cluster_ECU_CLS_Tx_16_message_Missing_Message: start-on-event=DemSatellite_Invalid_OsApplicationInternalBehavior/GetEventExtendedDataRecordEx, operation=EvtInfo_Cluster_ECU_CLS_Tx_16_message_Missing_Message.GetEventExtendedDataRecordEx
        OpEventGetEventExtendedDataRecordEx_GetEventExtendedDataRecordEx_Event_Cluster_ECU_CLS_Tx_16_message_Missing_Message: start-on-event=DemSatellite_Invalid_OsApplicationInternalBehavior/GetEventExtendedDataRecordEx, operation=Event_Cluster_ECU_CLS_Tx_16_message_Missing_Message.GetEventExtendedDataRecordEx
        OpEventGetEventExtendedDataRecordEx_GetEventExtendedDataRecordEx_EvtInfo_Exceeded_Security_Access_0x27_Attempt_Threshol_6d3a8fb9: start-on-event=DemSatellite_Invalid_OsApplicationInternalBehavior/GetEventExtendedDataRecordEx, operation=EvtInfo_Exceeded_Security_Access_0x27_Attempt_Threshold_Authentication_Failure.GetEventExtendedDataRecordEx
        OpEventGetEventExtendedDataRecordEx_GetEventExtendedDataRecordEx_Event_Exceeded_Security_Access_0x27_Attempt_Threshold_3410ff51: start-on-event=DemSatellite_Invalid_OsApplicationInternalBehavior/GetEventExtendedDataRecordEx, operation=Event_Exceeded_Security_Access_0x27_Attempt_Threshold_Authentication_Failure.GetEventExtendedDataRecordEx
        OpEventGetEventExtendedDataRecordEx_GetEventExtendedDataRecordEx_EvtInfo_Front_Left_Side_Radar_value_of_signal_protecti_27a35bf1: start-on-event=DemSatellite_Invalid_OsApplicationInternalBehavior/GetEventExtendedDataRecordEx, operation=EvtInfo_Front_Left_Side_Radar_value_of_signal_protection_calculation_Incorrect.GetEventExtendedDataRecordEx
        OpEventGetEventExtendedDataRecordEx_GetEventExtendedDataRecordEx_Event_Front_Left_Side_Radar_value_of_signal_protection_7e892b19: start-on-event=DemSatellite_Invalid_OsApplicationInternalBehavior/GetEventExtendedDataRecordEx, operation=Event_Front_Left_Side_Radar_value_of_signal_protection_calculation_Incorrect.GetEventExtendedDataRecordEx
        OpEventGetEventExtendedDataRecordEx_GetEventExtendedDataRecordEx_EvtInfo_AT_AMT_ETC2_erratic_communication_Erratic: start-on-event=DemSatellite_Invalid_OsApplicationInternalBehavior/GetEventExtendedDataRecordEx, operation=EvtInfo_AT_AMT_ETC2_erratic_communication_Erratic.GetEventExtendedDataRecordEx
        OpEventGetEventExtendedDataRecordEx_GetEventExtendedDataRecordEx_Event_AT_AMT_ETC2_erratic_communication_Erratic: start-on-event=DemSatellite_Invalid_OsApplicationInternalBehavior/GetEventExtendedDataRecordEx, operation=Event_AT_AMT_ETC2_erratic_communication_Erratic.GetEventExtendedDataRecordEx
        OpEventGetEventExtendedDataRecordEx_GetEventExtendedDataRecordEx_EvtInfo_VCAN_Communication_Bus_Off: start-on-event=DemSatellite_Invalid_OsApplicationInternalBehavior/GetEventExtendedDataRecordEx, operation=EvtInfo_VCAN_Communication_Bus_Off.GetEventExtendedDataRecordEx
        OpEventGetEventExtendedDataRecordEx_GetEventExtendedDataRecordEx_Event_VCAN_Communication_Bus_Off: start-on-event=DemSatellite_Invalid_OsApplicationInternalBehavior/GetEventExtendedDataRecordEx, operation=Event_VCAN_Communication_Bus_Off.GetEventExtendedDataRecordEx
        OpEventGetEventExtendedDataRecordEx_GetEventExtendedDataRecordEx_EvtInfo_VDC2_message_LongitudinalAcceleration_Invalid_84e185b9: start-on-event=DemSatellite_Invalid_OsApplicationInternalBehavior/GetEventExtendedDataRecordEx, operation=EvtInfo_VDC2_message_LongitudinalAcceleration_Invalid_Serial_Data_Received.GetEventExtendedDataRecordEx
        OpEventGetEventExtendedDataRecordEx_GetEventExtendedDataRecordEx_Event_VDC2_message_LongitudinalAcceleration_Invalid_Se_65ddb6d7: start-on-event=DemSatellite_Invalid_OsApplicationInternalBehavior/GetEventExtendedDataRecordEx, operation=Event_VDC2_message_LongitudinalAcceleration_Invalid_Serial_Data_Received.GetEventExtendedDataRecordEx
        OpEventGetEventExtendedDataRecordEx_GetEventExtendedDataRecordEx_EvtInfo_Radar_MMIC_RFBIST_Component_Internal_Failure: start-on-event=DemSatellite_Invalid_OsApplicationInternalBehavior/GetEventExtendedDataRecordEx, operation=EvtInfo_Radar_MMIC_RFBIST_Component_Internal_Failure.GetEventExtendedDataRecordEx
        OpEventGetEventExtendedDataRecordEx_GetEventExtendedDataRecordEx_Event_Radar_MMIC_RFBIST_Component_Internal_Failure: start-on-event=DemSatellite_Invalid_OsApplicationInternalBehavior/GetEventExtendedDataRecordEx, operation=Event_Radar_MMIC_RFBIST_Component_Internal_Failure.GetEventExtendedDataRecordEx
        OpEventGetEventExtendedDataRecordEx_GetEventExtendedDataRecordEx_EvtInfo_Radar_Initial_Alignment_Missing_Calibration: start-on-event=DemSatellite_Invalid_OsApplicationInternalBehavior/GetEventExtendedDataRecordEx, operation=EvtInfo_Radar_Initial_Alignment_Missing_Calibration.GetEventExtendedDataRecordEx
        OpEventGetEventExtendedDataRecordEx_GetEventExtendedDataRecordEx_Event_Radar_Initial_Alignment_Missing_Calibration: start-on-event=DemSatellite_Invalid_OsApplicationInternalBehavior/GetEventExtendedDataRecordEx, operation=Event_Radar_Initial_Alignment_Missing_Calibration.GetEventExtendedDataRecordEx
        OpEventGetEventExtendedDataRecordEx_GetEventExtendedDataRecordEx_EvtInfo_Cluster_ECU_OEL_message_Missing_Message: start-on-event=DemSatellite_Invalid_OsApplicationInternalBehavior/GetEventExtendedDataRecordEx, operation=EvtInfo_Cluster_ECU_OEL_message_Missing_Message.GetEventExtendedDataRecordEx
        OpEventGetEventExtendedDataRecordEx_GetEventExtendedDataRecordEx_Event_Cluster_ECU_OEL_message_Missing_Message: start-on-event=DemSatellite_Invalid_OsApplicationInternalBehavior/GetEventExtendedDataRecordEx, operation=Event_Cluster_ECU_OEL_message_Missing_Message.GetEventExtendedDataRecordEx
        OpEventGetEventExtendedDataRecordEx_GetEventExtendedDataRecordEx_EvtInfo_AT_AMT_ECU_ETC2_03_message_Missing_Message: start-on-event=DemSatellite_Invalid_OsApplicationInternalBehavior/GetEventExtendedDataRecordEx, operation=EvtInfo_AT_AMT_ECU_ETC2_03_message_Missing_Message.GetEventExtendedDataRecordEx
        OpEventGetEventExtendedDataRecordEx_GetEventExtendedDataRecordEx_Event_AT_AMT_ECU_ETC2_03_message_Missing_Message: start-on-event=DemSatellite_Invalid_OsApplicationInternalBehavior/GetEventExtendedDataRecordEx, operation=Event_AT_AMT_ECU_ETC2_03_message_Missing_Message.GetEventExtendedDataRecordEx
        OpEventGetEventExtendedDataRecordEx_GetEventExtendedDataRecordEx_EvtInfo_ADAS_FN_STS_message_MOIS_FN_Switch_STS_Invalid_c7a0d561: start-on-event=DemSatellite_Invalid_OsApplicationInternalBehavior/GetEventExtendedDataRecordEx, operation=EvtInfo_ADAS_FN_STS_message_MOIS_FN_Switch_STS_Invalid_Serial_Data_Received.GetEventExtendedDataRecordEx
        OpEventGetEventExtendedDataRecordEx_GetEventExtendedDataRecordEx_Event_ADAS_FN_STS_message_MOIS_FN_Switch_STS_Invalid_S_6d4ba50d: start-on-event=DemSatellite_Invalid_OsApplicationInternalBehavior/GetEventExtendedDataRecordEx, operation=Event_ADAS_FN_STS_message_MOIS_FN_Switch_STS_Invalid_Serial_Data_Received.GetEventExtendedDataRecordEx
        OpEventGetEventExtendedDataRecordEx_GetEventExtendedDataRecordEx_EvtInfo_Radar_Module_Over_Temperature: start-on-event=DemSatellite_Invalid_OsApplicationInternalBehavior/GetEventExtendedDataRecordEx, operation=EvtInfo_Radar_Module_Over_Temperature.GetEventExtendedDataRecordEx
        OpEventGetEventExtendedDataRecordEx_GetEventExtendedDataRecordEx_Event_Radar_Module_Over_Temperature: start-on-event=DemSatellite_Invalid_OsApplicationInternalBehavior/GetEventExtendedDataRecordEx, operation=Event_Radar_Module_Over_Temperature.GetEventExtendedDataRecordEx
        OpEventGetEventExtendedDataRecordEx_GetEventExtendedDataRecordEx_EvtInfo_PCAN_TimeSync_Missing_Message: start-on-event=DemSatellite_Invalid_OsApplicationInternalBehavior/GetEventExtendedDataRecordEx, operation=EvtInfo_PCAN_TimeSync_Missing_Message.GetEventExtendedDataRecordEx
        OpEventGetEventExtendedDataRecordEx_GetEventExtendedDataRecordEx_Event_PCAN_TimeSync_Missing_Message: start-on-event=DemSatellite_Invalid_OsApplicationInternalBehavior/GetEventExtendedDataRecordEx, operation=Event_PCAN_TimeSync_Missing_Message.GetEventExtendedDataRecordEx
        OpEventGetEventExtendedDataRecordEx_GetEventExtendedDataRecordEx_EvtInfo_Radar_Module_Watchdog_Failure: start-on-event=DemSatellite_Invalid_OsApplicationInternalBehavior/GetEventExtendedDataRecordEx, operation=EvtInfo_Radar_Module_Watchdog_Failure.GetEventExtendedDataRecordEx
        OpEventGetEventExtendedDataRecordEx_GetEventExtendedDataRecordEx_Event_Radar_Module_Watchdog_Failure: start-on-event=DemSatellite_Invalid_OsApplicationInternalBehavior/GetEventExtendedDataRecordEx, operation=Event_Radar_Module_Watchdog_Failure.GetEventExtendedDataRecordEx
        OpEventGetEventExtendedDataRecordEx_GetEventExtendedDataRecordEx_EvtInfo_SAS_ECU_SAS_message_Missing_Message: start-on-event=DemSatellite_Invalid_OsApplicationInternalBehavior/GetEventExtendedDataRecordEx, operation=EvtInfo_SAS_ECU_SAS_message_Missing_Message.GetEventExtendedDataRecordEx
        OpEventGetEventExtendedDataRecordEx_GetEventExtendedDataRecordEx_Event_SAS_ECU_SAS_message_Missing_Message: start-on-event=DemSatellite_Invalid_OsApplicationInternalBehavior/GetEventExtendedDataRecordEx, operation=Event_SAS_ECU_SAS_message_Missing_Message.GetEventExtendedDataRecordEx
        OpEventGetEventExtendedDataRecordEx_GetEventExtendedDataRecordEx_EvtInfo_ECU_NVM_Corruption_Program_memory_Failure: start-on-event=DemSatellite_Invalid_OsApplicationInternalBehavior/GetEventExtendedDataRecordEx, operation=EvtInfo_ECU_NVM_Corruption_Program_memory_Failure.GetEventExtendedDataRecordEx
