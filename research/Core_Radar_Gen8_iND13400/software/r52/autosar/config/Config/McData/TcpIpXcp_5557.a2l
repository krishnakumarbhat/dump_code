/**********************************************************************************************************************
* COPYRIGHT
* \verbatim
* This software is copyright protected and proprietary to Vector Informatik GmbH.
* Vector Informatik GmbH grants to you only those rights as set out in the license conditions.
* All other rights remain with Vector Informatik GmbH.
* \endverbatim
* LICENSE
* Module: Xcp
* Program:
* Customer:
* Expiry Date: Not restricted
* License Scope : The usage is restricted to PAI19494
* FILE DESCRIPTION
* File: TcpIpXcp_5557.a2l
* Generation Time: 2026-08-05 12:38:44
* Project: Gen8_iND13400 - Version 1.0
* Delivery: PAI19494
* Tool Version: DaVinci Configurator Classic (beta) 5.31.55 SP5
*********************************************************************************************************************/
/**********************************************************************************************************************
! BETA VERSION !
! This version of DaVinci Configurator Classic and/or the related Basic Software Package is BETA software. !
! BETA Software is basically operable, but not sufficiently tested, verified and/or qualified for use in series !
! production and/or in vehicles operating on public or non-public roads. !
! In particular, without limitation, BETA Software may cause unpredictable ECU behavior, may not provide all !
! functions necessary for use in series production and/or may not comply with quality requirements which are !
! necessary according to the state of the art. BETA Software must not be used in series production. !
**********************************************************************************************************************/
/begin XCP_ON_UDP_IP 0x0104 /* XCP on UDP_IP version */ 5557 /* PORT */ ADDRESS "192.168.1.71" /* ADDRESS */ /end XCP_ON_UDP_IP
