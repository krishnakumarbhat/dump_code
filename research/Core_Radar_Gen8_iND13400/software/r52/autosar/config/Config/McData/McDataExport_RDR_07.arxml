AUTOSAR XML (schema 00052)
standard types defined: sint32, uint32, uint8
package /MICROSAR
  bsw implementation Com_Impl: programming-language=C, sw-version=25.02.01, used-code-generator=DaVinci Configurator, vendor-id=30, ar-release-version=4.00.03, behavior=ComBehavior
  bsw implementation EcuM_Impl: programming-language=C, sw-version=15.00.03, used-code-generator=DaVinci Configurator, vendor-id=30, ar-release-version=4.00.03, behavior=EcuMBehavior
  bsw implementation Rtm_Impl: programming-language=C, sw-version=11.00.00, used-code-generator=DaVinci Configurator, vendor-id=30, ar-release-version=4.02.02, behavior=RtmBehavior
    mc-parameter-instances:
      mc data instance Rtm_Cmd: category=VALUE, resulting-properties={base-type=uint32, sw-calibration-access=READ-WRITE, range raw 0..4294967295}
      mc data instance Rtm_MeasurementConfig: category=ARRAY, array-size=6, resulting-properties={base-type=uint8, sw-calibration-access=READ-WRITE, range raw 0..255}, variation-point=post-build-variant-condition{matching-criterion=RDR_POS, value=6}
    mc-variable-instances:
      6 x mc data instance, all with variation-point=post-build-variant-condition{matching-criterion=RDR_POS, value=6}:
        Rtm_MeasTimeCorrection: category=VALUE, resulting-properties={base-type=sint32, sw-calibration-access=READ-ONLY, range raw -2147483648..2147483647}
        Rtm_Resp: category=VALUE, resulting-properties={base-type=uint32, sw-calibration-access=READ-WRITE, range raw 0..4294967295}
        Rtm_AverageMainFunctionCycleTime: category=VALUE, resulting-properties={base-type=uint32, sw-calibration-access=READ-ONLY, range raw 0..4294967295}
        Rtm_MainFunctionCounter: category=VALUE, resulting-properties={base-type=uint32, sw-calibration-access=READ-ONLY, range raw 0..4294967295}
        Rtm_CpuLoadTime: category=VALUE, resulting-properties={base-type=uint32, sw-calibration-access=READ-ONLY, range raw 0..4294967295}
        Rtm_Results: category=ARRAY, array-size=47
          47 x mc data instance, all with category=STRUCTURE:
            Element_0: symbol=[0]
              4 x mc data instance, all with category=VALUE, resulting-properties={base-type=uint32, sw-calibration-access=READ-ONLY, range raw 0..4294967295}:
                time
                count
                max
                min
            Element_1: symbol=[1]
              4 x mc data instance, all with category=VALUE, resulting-properties={base-type=uint32, sw-calibration-access=READ-ONLY, range raw 0..4294967295}:
                time
                count
                max
                min
            Element_2: symbol=[2]
              4 x mc data instance, all with category=VALUE, resulting-properties={base-type=uint32, sw-calibration-access=READ-ONLY, range raw 0..4294967295}:
                time
                count
                max
                min
            Element_3: symbol=[3]
              4 x mc data instance, all with category=VALUE, resulting-properties={base-type=uint32, sw-calibration-access=READ-ONLY, range raw 0..4294967295}:
                time
                count
                max
                min
            Element_4: symbol=[4]
              4 x mc data instance, all with category=VALUE, resulting-properties={base-type=uint32, sw-calibration-access=READ-ONLY, range raw 0..4294967295}:
                time
                count
                max
                min
            Element_5: symbol=[5]
              4 x mc data instance, all with category=VALUE, resulting-properties={base-type=uint32, sw-calibration-access=READ-ONLY, range raw 0..4294967295}:
                time
                count
                max
                min
            Element_6: symbol=[6]
              4 x mc data instance, all with category=VALUE, resulting-properties={base-type=uint32, sw-calibration-access=READ-ONLY, range raw 0..4294967295}:
                time
                count
                max
                min
            Element_7: symbol=[7]
              4 x mc data instance, all with category=VALUE, resulting-properties={base-type=uint32, sw-calibration-access=READ-ONLY, range raw 0..4294967295}:
                time
                count
                max
                min
            Element_8: symbol=[8]
              4 x mc data instance, all with category=VALUE, resulting-properties={base-type=uint32, sw-calibration-access=READ-ONLY, range raw 0..4294967295}:
                time
                count
                max
                min
            Element_9: symbol=[9]
              4 x mc data instance, all with category=VALUE, resulting-properties={base-type=uint32, sw-calibration-access=READ-ONLY, range raw 0..4294967295}:
                time
                count
                max
                min
            Element_10: symbol=[10]
              4 x mc data instance, all with category=VALUE, resulting-properties={base-type=uint32, sw-calibration-access=READ-ONLY, range raw 0..4294967295}:
                time
                count
                max
                min
            Element_11: symbol=[11]
              4 x mc data instance, all with category=VALUE, resulting-properties={base-type=uint32, sw-calibration-access=READ-ONLY, range raw 0..4294967295}:
                time
                count
                max
                min
            Element_12: symbol=[12]
              4 x mc data instance, all with category=VALUE, resulting-properties={base-type=uint32, sw-calibration-access=READ-ONLY, range raw 0..4294967295}:
                time
                count
                max
                min
            Element_13: symbol=[13]
              4 x mc data instance, all with category=VALUE, resulting-properties={base-type=uint32, sw-calibration-access=READ-ONLY, range raw 0..4294967295}:
                time
                count
                max
                min
            Element_14: symbol=[14]
              4 x mc data instance, all with category=VALUE, resulting-properties={base-type=uint32, sw-calibration-access=READ-ONLY, range raw 0..4294967295}:
                time
                count
                max
                min
            Element_15: symbol=[15]
              4 x mc data instance, all with category=VALUE, resulting-properties={base-type=uint32, sw-calibration-access=READ-ONLY, range raw 0..4294967295}:
                time
                count
                max
                min
            Element_16: symbol=[16]
              4 x mc data instance, all with category=VALUE, resulting-properties={base-type=uint32, sw-calibration-access=READ-ONLY, range raw 0..4294967295}:
                time
                count
                max
                min
            Element_17: symbol=[17]
              4 x mc data instance, all with category=VALUE, resulting-properties={base-type=uint32, sw-calibration-access=READ-ONLY, range raw 0..4294967295}:
                time
                count
                max
                min
            Element_18: symbol=[18]
              4 x mc data instance, all with category=VALUE, resulting-properties={base-type=uint32, sw-calibration-access=READ-ONLY, range raw 0..4294967295}:
                time
                count
                max
                min
            Element_19: symbol=[19]
              4 x mc data instance, all with category=VALUE, resulting-properties={base-type=uint32, sw-calibration-access=READ-ONLY, range raw 0..4294967295}:
                time
                count
                max
                min
            Element_20: symbol=[20]
              4 x mc data instance, all with category=VALUE, resulting-properties={base-type=uint32, sw-calibration-access=READ-ONLY, range raw 0..4294967295}:
                time
                count
                max
                min
            Element_21: symbol=[21]
              4 x mc data instance, all with category=VALUE, resulting-properties={base-type=uint32, sw-calibration-access=READ-ONLY, range raw 0..4294967295}:
                time
                count
                max
                min
            Element_22: symbol=[22]
              4 x mc data instance, all with category=VALUE, resulting-properties={base-type=uint32, sw-calibration-access=READ-ONLY, range raw 0..4294967295}:
                time
                count
                max
                min
            Element_23: symbol=[23]
              4 x mc data instance, all with category=VALUE, resulting-properties={base-type=uint32, sw-calibration-access=READ-ONLY, range raw 0..4294967295}:
                time
                count
                max
                min
            Element_24: symbol=[24]
              4 x mc data instance, all with category=VALUE, resulting-properties={base-type=uint32, sw-calibration-access=READ-ONLY, range raw 0..4294967295}:
                time
                count
                max
                min
            Element_25: symbol=[25]
              4 x mc data instance, all with category=VALUE, resulting-properties={base-type=uint32, sw-calibration-access=READ-ONLY, range raw 0..4294967295}:
                time
                count
                max
                min
            Element_26: symbol=[26]
              4 x mc data instance, all with category=VALUE, resulting-properties={base-type=uint32, sw-calibration-access=READ-ONLY, range raw 0..4294967295}:
                time
                count
                max
                min
            Element_27: symbol=[27]
              4 x mc data instance, all with category=VALUE, resulting-properties={base-type=uint32, sw-calibration-access=READ-ONLY, range raw 0..4294967295}:
                time
                count
                max
                min
            Element_28: symbol=[28]
              4 x mc data instance, all with category=VALUE, resulting-properties={base-type=uint32, sw-calibration-access=READ-ONLY, range raw 0..4294967295}:
                time
                count
                max
                min
            Element_29: symbol=[29]
              4 x mc data instance, all with category=VALUE, resulting-properties={base-type=uint32, sw-calibration-access=READ-ONLY, range raw 0..4294967295}:
                time
                count
                max
                min
            Element_30: symbol=[30]
              4 x mc data instance, all with category=VALUE, resulting-properties={base-type=uint32, sw-calibration-access=READ-ONLY, range raw 0..4294967295}:
                time
                count
                max
                min
            Element_31: symbol=[31]
              4 x mc data instance, all with category=VALUE, resulting-properties={base-type=uint32, sw-calibration-access=READ-ONLY, range raw 0..4294967295}:
                time
                count
                max
                min
            Element_32: symbol=[32]
              4 x mc data instance, all with category=VALUE, resulting-properties={base-type=uint32, sw-calibration-access=READ-ONLY, range raw 0..4294967295}:
                time
                count
                max
                min
            Element_33: symbol=[33]
              4 x mc data instance, all with category=VALUE, resulting-properties={base-type=uint32, sw-calibration-access=READ-ONLY, range raw 0..4294967295}:
                time
                count
                max
                min
            Element_34: symbol=[34]
              4 x mc data instance, all with category=VALUE, resulting-properties={base-type=uint32, sw-calibration-access=READ-ONLY, range raw 0..4294967295}:
                time
                count
                max
                min
            Element_35: symbol=[35]
              4 x mc data instance, all with category=VALUE, resulting-properties={base-type=uint32, sw-calibration-access=READ-ONLY, range raw 0..4294967295}:
                time
                count
                max
                min
            Element_36: symbol=[36]
              4 x mc data instance, all with category=VALUE, resulting-properties={base-type=uint32, sw-calibration-access=READ-ONLY, range raw 0..4294967295}:
                time
                count
                max
                min
            Element_37: symbol=[37]
              4 x mc data instance, all with category=VALUE, resulting-properties={base-type=uint32, sw-calibration-access=READ-ONLY, range raw 0..4294967295}:
                time
                count
                max
                min
            Element_38: symbol=[38]
              4 x mc data instance, all with category=VALUE, resulting-properties={base-type=uint32, sw-calibration-access=READ-ONLY, range raw 0..4294967295}:
                time
                count
                max
                min
            Element_39: symbol=[39]
              4 x mc data instance, all with category=VALUE, resulting-properties={base-type=uint32, sw-calibration-access=READ-ONLY, range raw 0..4294967295}:
                time
                count
                max
                min
            Element_40: symbol=[40]
              4 x mc data instance, all with category=VALUE, resulting-properties={base-type=uint32, sw-calibration-access=READ-ONLY, range raw 0..4294967295}:
                time
                count
                max
                min
            Element_41: symbol=[41]
              4 x mc data instance, all with category=VALUE, resulting-properties={base-type=uint32, sw-calibration-access=READ-ONLY, range raw 0..4294967295}:
                time
                count
                max
                min
            Element_42: symbol=[42]
              4 x mc data instance, all with category=VALUE, resulting-properties={base-type=uint32, sw-calibration-access=READ-ONLY, range raw 0..4294967295}:
                time
                count
                max
                min
            Element_43: symbol=[43]
              4 x mc data instance, all with category=VALUE, resulting-properties={base-type=uint32, sw-calibration-access=READ-ONLY, range raw 0..4294967295}:
                time
                count
                max
                min
            Element_44: symbol=[44]
              4 x mc data instance, all with category=VALUE, resulting-properties={base-type=uint32, sw-calibration-access=READ-ONLY, range raw 0..4294967295}:
                time
                count
                max
                min
            Element_45: symbol=[45]
              4 x mc data instance, all with category=VALUE, resulting-properties={base-type=uint32, sw-calibration-access=READ-ONLY, range raw 0..4294967295}:
                time
                count
                max
                min
            Element_46: symbol=[46]
              4 x mc data instance, all with category=VALUE, resulting-properties={base-type=uint32, sw-calibration-access=READ-ONLY, range raw 0..4294967295}:
                time
                count
                max
                min
package /MICROSAR/Com_ib_bswmd/BswModuleDescriptions
  bsw module description Com
    bsw internal behavior ComBehavior
      exclusive area COM_EXCLUSIVE_AREA_TX  # This critical section protects Tx ressources that can be accessed from various contexts. Therefore the critical section enclosed with COM_EXCLUSIVE_AREA_TX should never be interrupted by any Com API which accesses Tx ressources. For more details, see DocTechRef.
      exclusive area COM_EXCLUSIVE_AREA_RX  # This critical section protects Rx ressources that can be accessed from various contexts.Therefore the critical section enclosed with COM_EXCLUSIVE_AREA_RX should never be interrupted by any Com API which accesses Rx ressources. For more details, see DocTechRef.
      exclusive area COM_EXCLUSIVE_AREA_BOTH  # This critical section protects Rx and Tx ressources that are being accessed in context of Com_MainFunctionRouteSignals for signal gateway routings or description routings with configured deferred description source. For more details, see DocTechRef.
      bsw schedulable entity Com_MainFunctionRx_ComMainFunctionRx: can-enter-exclusive-area=[COM_EXCLUSIVE_AREA_TX, COM_EXCLUSIVE_AREA_RX, COM_EXCLUSIVE_AREA_BOTH], implemented-entry=Com_MainFunctionRx_ComMainFunctionRx
      bsw schedulable entity Com_MainFunctionTx_ComMainFunctionTx_Event: can-enter-exclusive-area=[COM_EXCLUSIVE_AREA_TX, COM_EXCLUSIVE_AREA_RX, COM_EXCLUSIVE_AREA_BOTH], implemented-entry=Com_MainFunctionTx_ComMainFunctionTx_Event
      bsw schedulable entity Com_MainFunctionTx_ComMainFunctionTx_Periodic: can-enter-exclusive-area=[COM_EXCLUSIVE_AREA_TX, COM_EXCLUSIVE_AREA_RX, COM_EXCLUSIVE_AREA_BOTH], implemented-entry=Com_MainFunctionTx_ComMainFunctionTx_Periodic
      bsw timing event Com_MainFunctionRx_ComMainFunctionRxTimingEvent0: starts-on-event=Com_MainFunctionRx_ComMainFunctionRx, period=0.01
      bsw timing event Com_MainFunctionTx_ComMainFunctionTx_EventTimingEvent0: starts-on-event=Com_MainFunctionTx_ComMainFunctionTx_Event, period=0.01
      bsw timing event Com_MainFunctionTx_ComMainFunctionTx_PeriodicTimingEvent0: starts-on-event=Com_MainFunctionTx_ComMainFunctionTx_Periodic, period=0.025
  bsw module entry Com_MainFunctionRx_ComMainFunctionRx: call-type=SCHEDULED, execution-context=TASK
  bsw module entry Com_MainFunctionTx_ComMainFunctionTx_Event: call-type=SCHEDULED, execution-context=TASK
  bsw module entry Com_MainFunctionTx_ComMainFunctionTx_Periodic: call-type=SCHEDULED, execution-context=TASK
package /MICROSAR/EcuM_ib_bswmd/BswModuleDescriptions
  bsw module description EcuM
    bsw internal behavior EcuMBehavior
      4 x exclusive area:
        ECUM_EXCLUSIVE_AREA_0  # This exclusive area shall disable all wake up interrupts to prevent overwriting of some global variables.
        ECUM_EXCLUSIVE_AREA_1  # This exclusive area is only used in case of multi core and if the the EcuM is configured to handle also the slave cores. It must be configured as a spinlock to allow access to some variables simultaneously from multiple cores.
        ECUM_EXCLUSIVE_AREA_2  # This exclusive area is used for accessing the clock variable. It shall disable GPT interrupts and task changes. Only necessary if 32 Bit access is not atomic and Alarm Clock is present.
        ECUM_EXCLUSIVE_AREA_3  # This exclusive area is used in multi-core use cases to protect variables from concurrent access (configured as spinlock) and in single-core use cases to protect non-atomic access on the same variables (configured as interrupt blocking).
      bsw schedulable entity EcuM_MainFunction: can-enter-exclusive-area=[ECUM_EXCLUSIVE_AREA_0, ECUM_EXCLUSIVE_AREA_1, ECUM_EXCLUSIVE_AREA_2, ECUM_EXCLUSIVE_AREA_3], implemented-entry=EcuM_MainFunction
      bsw timing event EcuM_MainFunctionTimingEvent0: starts-on-event=EcuM_MainFunction, period=0.01
  bsw module entry EcuM_MainFunction: call-type=SCHEDULED, execution-context=TASK
package /MICROSAR/Rtm_ib_bswmd/BswModuleDescriptions
  bsw module description Rtm
    bsw internal behavior RtmBehavior
      exclusive area RTM_EXCLUSIVE_AREA_{0..2}
      bsw schedulable entity Rtm_MainFunction: can-enter-exclusive-area=[RTM_EXCLUSIVE_AREA_0, RTM_EXCLUSIVE_AREA_1, RTM_EXCLUSIVE_AREA_2], implemented-entry=Rtm_MainFunction
      bsw timing event Rtm_MainFunctionTimingEvent0: starts-on-event=Rtm_MainFunction, period=0.01
  bsw module entry Rtm_MainFunction: call-type=SCHEDULED, execution-context=TASK
package /VariantDefinition/Criterion
  post build variant criterion RDR_POS: compu {0..7=RDR_01..RDR_08}
