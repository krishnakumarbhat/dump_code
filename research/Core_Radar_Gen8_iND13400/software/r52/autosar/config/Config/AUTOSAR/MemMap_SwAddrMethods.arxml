AUTOSAR XML (schema 00048)
package /MICROSAR_MemMap/SwAddrMethods
  310 x sw addr method:
    CALLOUT_CODE: section-type=CODE
    CALLOUT_CODE_QM: options=safetyQM, section-type=CODE
    CALLOUT_CODE_ASIL_A: options=safetyAsilA, section-type=CODE
    CALLOUT_CODE_ASIL_B: options=safetyAsilB, section-type=CODE
    CALLOUT_CODE_ASIL_C: options=safetyAsilC, section-type=CODE
    CALLOUT_CODE_ASIL_D: options=safetyAsilD, section-type=CODE
    CODE: section-type=CODE
    CODE_QM: options=safetyQM, section-type=CODE
    CODE_ASIL_A: options=safetyAsilA, section-type=CODE
    CODE_ASIL_B: options=safetyAsilB, section-type=CODE
    CODE_ASIL_C: options=safetyAsilC, section-type=CODE
    CODE_ASIL_D: options=safetyAsilD, section-type=CODE
    CODE_FAST: section-type=CODE
    CODE_FAST_QM: options=safetyQM, section-type=CODE
    CODE_FAST_ASIL_A: options=safetyAsilA, section-type=CODE
    CODE_FAST_ASIL_B: options=safetyAsilB, section-type=CODE
    CODE_FAST_ASIL_C: options=safetyAsilC, section-type=CODE
    CODE_FAST_ASIL_D: options=safetyAsilD, section-type=CODE
    CODE_ISR: section-type=CODE
    CODE_ISR_QM: options=safetyQM, section-type=CODE
    CODE_ISR_ASIL_A: options=safetyAsilA, section-type=CODE
    CODE_ISR_ASIL_B: options=safetyAsilB, section-type=CODE
    CODE_ISR_ASIL_C: options=safetyAsilC, section-type=CODE
    CODE_ISR_ASIL_D: options=safetyAsilD, section-type=CODE
    CODE_SLOW: section-type=CODE
    CODE_SLOW_QM: options=safetyQM, section-type=CODE
    CODE_SLOW_ASIL_A: options=safetyAsilA, section-type=CODE
    CODE_SLOW_ASIL_B: options=safetyAsilB, section-type=CODE
    CODE_SLOW_ASIL_C: options=safetyAsilC, section-type=CODE
    CODE_SLOW_ASIL_D: options=safetyAsilD, section-type=CODE
    CONFIG_DATA_PREBUILD: options=configClassPreBuild, section-type=CONFIG-DATA
    CONFIG_DATA_PREBUILD_QM: options=[configClassPreBuild, safetyQM], section-type=CONFIG-DATA
    CONFIG_DATA_PREBUILD_ASIL_A: options=[configClassPreBuild, safetyAsilA], section-type=CONFIG-DATA
    CONFIG_DATA_PREBUILD_ASIL_B: options=[configClassPreBuild, safetyAsilB], section-type=CONFIG-DATA
    CONFIG_DATA_PREBUILD_ASIL_C: options=[configClassPreBuild, safetyAsilC], section-type=CONFIG-DATA
    CONFIG_DATA_PREBUILD_ASIL_D: options=[configClassPreBuild, safetyAsilD], section-type=CONFIG-DATA
    CONFIG_DATA_POSTBUILD: options=configClassPostBuild, section-type=CONFIG-DATA
    CONFIG_DATA_POSTBUILD_QM: options=[configClassPostBuild, safetyQM], section-type=CONFIG-DATA
    CONFIG_DATA_POSTBUILD_ASIL_A: options=[configClassPostBuild, safetyAsilA], section-type=CONFIG-DATA
    CONFIG_DATA_POSTBUILD_ASIL_B: options=[configClassPostBuild, safetyAsilB], section-type=CONFIG-DATA
    CONFIG_DATA_POSTBUILD_ASIL_C: options=[configClassPostBuild, safetyAsilC], section-type=CONFIG-DATA
    CONFIG_DATA_POSTBUILD_ASIL_D: options=[configClassPostBuild, safetyAsilD], section-type=CONFIG-DATA
    CONST: section-type=CONST
    CONST_QM: options=safetyQM, section-type=CONST
    CONST_ASIL_A: options=safetyAsilA, section-type=CONST
    CONST_ASIL_B: options=safetyAsilB, section-type=CONST
    CONST_ASIL_C: options=safetyAsilC, section-type=CONST
    CONST_ASIL_D: options=safetyAsilD, section-type=CONST
    CONST_SAVED_RECOVERY_ZONE: section-type=CONST
    CONST_SAVED_RECOVERY_ZONE_QM: options=safetyQM, section-type=CONST
    CONST_SAVED_RECOVERY_ZONE_ASIL_A: options=safetyAsilA, section-type=CONST
    CONST_SAVED_RECOVERY_ZONE_ASIL_B: options=safetyAsilB, section-type=CONST
    CONST_SAVED_RECOVERY_ZONE_ASIL_C: options=safetyAsilC, section-type=CONST
    CONST_SAVED_RECOVERY_ZONE_ASIL_D: options=safetyAsilD, section-type=CONST
    CONST_FAST: section-type=CONST
    CONST_FAST_QM: options=safetyQM, section-type=CONST
    CONST_FAST_ASIL_A: options=safetyAsilA, section-type=CONST
    CONST_FAST_ASIL_B: options=safetyAsilB, section-type=CONST
    CONST_FAST_ASIL_C: options=safetyAsilC, section-type=CONST
    CONST_FAST_ASIL_D: options=safetyAsilD, section-type=CONST
    VAR_INIT: section-type=VAR
    VAR_INIT_QM: options=safetyQM, section-type=VAR
    VAR_INIT_ASIL_A: options=safetyAsilA, section-type=VAR
    VAR_INIT_ASIL_B: options=safetyAsilB, section-type=VAR
    VAR_INIT_ASIL_C: options=safetyAsilC, section-type=VAR
    VAR_INIT_ASIL_D: options=safetyAsilD, section-type=VAR
    VAR_NO_INIT: section-initialization-policy=NO-INIT, section-type=VAR
    VAR_NO_INIT_QM: options=safetyQM, section-initialization-policy=NO-INIT, section-type=VAR
    VAR_NO_INIT_ASIL_A: options=safetyAsilA, section-initialization-policy=NO-INIT, section-type=VAR
    VAR_NO_INIT_ASIL_B: options=safetyAsilB, section-initialization-policy=NO-INIT, section-type=VAR
    VAR_NO_INIT_ASIL_C: options=safetyAsilC, section-initialization-policy=NO-INIT, section-type=VAR
    VAR_NO_INIT_ASIL_D: options=safetyAsilD, section-initialization-policy=NO-INIT, section-type=VAR
    VAR_CLEARED: section-initialization-policy=CLEARED, section-type=VAR
    VAR_CLEARED_QM: options=safetyQM, section-initialization-policy=CLEARED, section-type=VAR
    VAR_CLEARED_ASIL_A: options=safetyAsilA, section-initialization-policy=CLEARED, section-type=VAR
    VAR_CLEARED_ASIL_B: options=safetyAsilB, section-initialization-policy=CLEARED, section-type=VAR
    VAR_CLEARED_ASIL_C: options=safetyAsilC, section-initialization-policy=CLEARED, section-type=VAR
    VAR_CLEARED_ASIL_D: options=safetyAsilD, section-initialization-policy=CLEARED, section-type=VAR
    VAR_POWER_ON_INIT: section-initialization-policy=POWER-ON-INIT, section-type=VAR
    VAR_POWER_ON_INIT_QM: options=safetyQM, section-initialization-policy=POWER-ON-INIT, section-type=VAR
    VAR_POWER_ON_INIT_ASIL_A: options=safetyAsilA, section-initialization-policy=POWER-ON-INIT, section-type=VAR
    VAR_POWER_ON_INIT_ASIL_B: options=safetyAsilB, section-initialization-policy=POWER-ON-INIT, section-type=VAR
    VAR_POWER_ON_INIT_ASIL_C: options=safetyAsilC, section-initialization-policy=POWER-ON-INIT, section-type=VAR
    VAR_POWER_ON_INIT_ASIL_D: options=safetyAsilD, section-initialization-policy=POWER-ON-INIT, section-type=VAR
    VAR_POWER_ON_CLEARED: section-initialization-policy=POWER-ON-CLEARED, section-type=VAR
    VAR_POWER_ON_CLEARED_QM: options=safetyQM, section-initialization-policy=POWER-ON-CLEARED, section-type=VAR
    VAR_POWER_ON_CLEARED_ASIL_A: options=safetyAsilA, section-initialization-policy=POWER-ON-CLEARED, section-type=VAR
    VAR_POWER_ON_CLEARED_ASIL_B: options=safetyAsilB, section-initialization-policy=POWER-ON-CLEARED, section-type=VAR
    VAR_POWER_ON_CLEARED_ASIL_C: options=safetyAsilC, section-initialization-policy=POWER-ON-CLEARED, section-type=VAR
    VAR_POWER_ON_CLEARED_ASIL_D: options=safetyAsilD, section-initialization-policy=POWER-ON-CLEARED, section-type=VAR
    VAR_FAST_INIT: section-type=VAR-FAST
    VAR_FAST_INIT_QM: options=safetyQM, section-type=VAR-FAST
    VAR_FAST_INIT_ASIL_A: options=safetyAsilA, section-type=VAR-FAST
    VAR_FAST_INIT_ASIL_B: options=safetyAsilB, section-type=VAR-FAST
    VAR_FAST_INIT_ASIL_C: options=safetyAsilC, section-type=VAR-FAST
    VAR_FAST_INIT_ASIL_D: options=safetyAsilD, section-type=VAR-FAST
    VAR_FAST_NO_INIT: section-initialization-policy=NO-INIT, section-type=VAR-FAST
    VAR_FAST_NO_INIT_QM: options=safetyQM, section-initialization-policy=NO-INIT, section-type=VAR-FAST
    VAR_FAST_NO_INIT_ASIL_A: options=safetyAsilA, section-initialization-policy=NO-INIT, section-type=VAR-FAST
    VAR_FAST_NO_INIT_ASIL_B: options=safetyAsilB, section-initialization-policy=NO-INIT, section-type=VAR-FAST
    VAR_FAST_NO_INIT_ASIL_C: options=safetyAsilC, section-initialization-policy=NO-INIT, section-type=VAR-FAST
    VAR_FAST_NO_INIT_ASIL_D: options=safetyAsilD, section-initialization-policy=NO-INIT, section-type=VAR-FAST
    VAR_FAST_CLEARED: section-initialization-policy=CLEARED, section-type=VAR-FAST
    VAR_FAST_CLEARED_QM: options=safetyQM, section-initialization-policy=CLEARED, section-type=VAR-FAST
    VAR_FAST_CLEARED_ASIL_A: options=safetyAsilA, section-initialization-policy=CLEARED, section-type=VAR-FAST
    VAR_FAST_CLEARED_ASIL_B: options=safetyAsilB, section-initialization-policy=CLEARED, section-type=VAR-FAST
    VAR_FAST_CLEARED_ASIL_C: options=safetyAsilC, section-initialization-policy=CLEARED, section-type=VAR-FAST
    VAR_FAST_CLEARED_ASIL_D: options=safetyAsilD, section-initialization-policy=CLEARED, section-type=VAR-FAST
    VAR_FAST_POWER_ON_INIT: section-initialization-policy=POWER-ON-INIT, section-type=VAR-FAST
    VAR_FAST_POWER_ON_INIT_QM: options=safetyQM, section-initialization-policy=POWER-ON-INIT, section-type=VAR-FAST
    VAR_FAST_POWER_ON_INIT_ASIL_A: options=safetyAsilA, section-initialization-policy=POWER-ON-INIT, section-type=VAR-FAST
    VAR_FAST_POWER_ON_INIT_ASIL_B: options=safetyAsilB, section-initialization-policy=POWER-ON-INIT, section-type=VAR-FAST
    VAR_FAST_POWER_ON_INIT_ASIL_C: options=safetyAsilC, section-initialization-policy=POWER-ON-INIT, section-type=VAR-FAST
    VAR_FAST_POWER_ON_INIT_ASIL_D: options=safetyAsilD, section-initialization-policy=POWER-ON-INIT, section-type=VAR-FAST
    VAR_FAST_POWER_ON_CLEARED: section-initialization-policy=POWER-ON-CLEARED, section-type=VAR-FAST
    VAR_FAST_POWER_ON_CLEARED_QM: options=safetyQM, section-initialization-policy=POWER-ON-CLEARED, section-type=VAR-FAST
    VAR_FAST_POWER_ON_CLEARED_ASIL_A: options=safetyAsilA, section-initialization-policy=POWER-ON-CLEARED, section-type=VAR-FAST
    VAR_FAST_POWER_ON_CLEARED_ASIL_B: options=safetyAsilB, section-initialization-policy=POWER-ON-CLEARED, section-type=VAR-FAST
    VAR_FAST_POWER_ON_CLEARED_ASIL_C: options=safetyAsilC, section-initialization-policy=POWER-ON-CLEARED, section-type=VAR-FAST
    VAR_FAST_POWER_ON_CLEARED_ASIL_D: options=safetyAsilD, section-initialization-policy=POWER-ON-CLEARED, section-type=VAR-FAST
    VAR_SAVED_ZONE: section-initialization-policy=POWER-ON-CLEARED, section-type=VAR
    VAR_SAVED_ZONE_QM: options=safetyQM, section-initialization-policy=POWER-ON-CLEARED, section-type=VAR
    VAR_SAVED_ZONE_ASIL_A: options=safetyAsilA, section-initialization-policy=POWER-ON-CLEARED, section-type=VAR
    VAR_SAVED_ZONE_ASIL_B: options=safetyAsilB, section-initialization-policy=POWER-ON-CLEARED, section-type=VAR
    VAR_SAVED_ZONE_ASIL_C: options=safetyAsilC, section-initialization-policy=POWER-ON-CLEARED, section-type=VAR
    VAR_SAVED_ZONE_ASIL_D: options=safetyAsilD, section-initialization-policy=POWER-ON-CLEARED, section-type=VAR
    VAR_SLOW_INIT: section-initialization-policy=INIT, section-type=VAR
    VAR_SLOW_INIT_QM: options=safetyQM, section-initialization-policy=INIT, section-type=VAR
    VAR_SLOW_INIT_ASIL_A: options=safetyAsilA, section-initialization-policy=INIT, section-type=VAR
    VAR_SLOW_INIT_ASIL_B: options=safetyAsilB, section-initialization-policy=INIT, section-type=VAR
    VAR_SLOW_INIT_ASIL_C: options=safetyAsilC, section-initialization-policy=INIT, section-type=VAR
    VAR_SLOW_INIT_ASIL_D: options=safetyAsilD, section-initialization-policy=INIT, section-type=VAR
    VAR_SLOW_NO_INIT: section-initialization-policy=NO-INIT, section-type=VAR
    VAR_SLOW_NO_INIT_QM: options=safetyQM, section-initialization-policy=NO-INIT, section-type=VAR
    VAR_SLOW_NO_INIT_ASIL_A: options=safetyAsilA, section-initialization-policy=NO-INIT, section-type=VAR
    VAR_SLOW_NO_INIT_ASIL_B: options=safetyAsilB, section-initialization-policy=NO-INIT, section-type=VAR
    VAR_SLOW_NO_INIT_ASIL_C: options=safetyAsilC, section-initialization-policy=NO-INIT, section-type=VAR
    VAR_SLOW_NO_INIT_ASIL_D: options=safetyAsilD, section-initialization-policy=NO-INIT, section-type=VAR
    VAR_SLOW_CLEARED: section-initialization-policy=CLEARED, section-type=VAR
    VAR_SLOW_CLEARED_QM: options=safetyQM, section-initialization-policy=CLEARED, section-type=VAR
    VAR_SLOW_CLEARED_ASIL_A: options=safetyAsilA, section-initialization-policy=CLEARED, section-type=VAR
    VAR_SLOW_CLEARED_ASIL_B: options=safetyAsilB, section-initialization-policy=CLEARED, section-type=VAR
    VAR_SLOW_CLEARED_ASIL_C: options=safetyAsilC, section-initialization-policy=CLEARED, section-type=VAR
    VAR_SLOW_CLEARED_ASIL_D: options=safetyAsilD, section-initialization-policy=CLEARED, section-type=VAR
    VAR_SLOW_POWER_ON_INIT: section-initialization-policy=POWER-ON-INIT, section-type=VAR
    VAR_SLOW_POWER_ON_INIT_QM: options=safetyQM, section-initialization-policy=POWER-ON-INIT, section-type=VAR
    VAR_SLOW_POWER_ON_INIT_ASIL_A: options=safetyAsilA, section-initialization-policy=POWER-ON-INIT, section-type=VAR
    VAR_SLOW_POWER_ON_INIT_ASIL_B: options=safetyAsilB, section-initialization-policy=POWER-ON-INIT, section-type=VAR
    VAR_SLOW_POWER_ON_INIT_ASIL_C: options=safetyAsilC, section-initialization-policy=POWER-ON-INIT, section-type=VAR
    VAR_SLOW_POWER_ON_INIT_ASIL_D: options=safetyAsilD, section-initialization-policy=POWER-ON-INIT, section-type=VAR
    VAR_SLOW_POWER_ON_CLEARED: section-initialization-policy=POWER-ON-CLEARED, section-type=VAR
    VAR_SLOW_POWER_ON_CLEARED_QM: options=safetyQM, section-initialization-policy=POWER-ON-CLEARED, section-type=VAR
    VAR_SLOW_POWER_ON_CLEARED_ASIL_A: options=safetyAsilA, section-initialization-policy=POWER-ON-CLEARED, section-type=VAR
    VAR_SLOW_POWER_ON_CLEARED_ASIL_B: options=safetyAsilB, section-initialization-policy=POWER-ON-CLEARED, section-type=VAR
    VAR_SLOW_POWER_ON_CLEARED_ASIL_C: options=safetyAsilC, section-initialization-policy=POWER-ON-CLEARED, section-type=VAR
    VAR_SLOW_POWER_ON_CLEARED_ASIL_D: options=safetyAsilD, section-initialization-policy=POWER-ON-CLEARED, section-type=VAR
    INTERNAL_VAR_INIT: section-initialization-policy=INIT, section-type=VAR
    INTERNAL_VAR_INIT_QM: options=safetyQM, section-initialization-policy=INIT, section-type=VAR
    INTERNAL_VAR_INIT_ASIL_A: options=safetyAsilA, section-initialization-policy=INIT, section-type=VAR
    INTERNAL_VAR_INIT_ASIL_B: options=safetyAsilB, section-initialization-policy=INIT, section-type=VAR
    INTERNAL_VAR_INIT_ASIL_C: options=safetyAsilC, section-initialization-policy=INIT, section-type=VAR
    INTERNAL_VAR_INIT_ASIL_D: options=safetyAsilD, section-initialization-policy=INIT, section-type=VAR
    INTERNAL_VAR_NO_INIT: section-initialization-policy=NO-INIT, section-type=VAR
    INTERNAL_VAR_NO_INIT_QM: options=safetyQM, section-initialization-policy=NO-INIT, section-type=VAR
    INTERNAL_VAR_NO_INIT_ASIL_A: options=safetyAsilA, section-initialization-policy=NO-INIT, section-type=VAR
    INTERNAL_VAR_NO_INIT_ASIL_B: options=safetyAsilB, section-initialization-policy=NO-INIT, section-type=VAR
    INTERNAL_VAR_NO_INIT_ASIL_C: options=safetyAsilC, section-initialization-policy=NO-INIT, section-type=VAR
    INTERNAL_VAR_NO_INIT_ASIL_D: options=safetyAsilD, section-initialization-policy=NO-INIT, section-type=VAR
    INTERNAL_VAR_CLEARED: section-initialization-policy=CLEARED, section-type=VAR
    INTERNAL_VAR_CLEARED_QM: options=safetyQM, section-initialization-policy=CLEARED, section-type=VAR
    INTERNAL_VAR_CLEARED_ASIL_A: options=safetyAsilA, section-initialization-policy=CLEARED, section-type=VAR
    INTERNAL_VAR_CLEARED_ASIL_B: options=safetyAsilB, section-initialization-policy=CLEARED, section-type=VAR
    INTERNAL_VAR_CLEARED_ASIL_C: options=safetyAsilC, section-initialization-policy=CLEARED, section-type=VAR
    INTERNAL_VAR_CLEARED_ASIL_D: options=safetyAsilD, section-initialization-policy=CLEARED, section-type=VAR
    INTERNAL_VAR_POWER_ON_INIT: section-initialization-policy=POWER-ON-INIT, section-type=VAR
    INTERNAL_VAR_POWER_ON_INIT_QM: options=safetyQM, section-initialization-policy=POWER-ON-INIT, section-type=VAR
    INTERNAL_VAR_POWER_ON_INIT_ASIL_A: options=safetyAsilA, section-initialization-policy=POWER-ON-INIT, section-type=VAR
    INTERNAL_VAR_POWER_ON_INIT_ASIL_B: options=safetyAsilB, section-initialization-policy=POWER-ON-INIT, section-type=VAR
    INTERNAL_VAR_POWER_ON_INIT_ASIL_C: options=safetyAsilC, section-initialization-policy=POWER-ON-INIT, section-type=VAR
    INTERNAL_VAR_POWER_ON_INIT_ASIL_D: options=safetyAsilD, section-initialization-policy=POWER-ON-INIT, section-type=VAR
    INTERNAL_VAR_POWER_ON_CLEARED: section-initialization-policy=POWER-ON-CLEARED, section-type=VAR
    INTERNAL_VAR_POWER_ON_CLEARED_QM: options=safetyQM, section-initialization-policy=POWER-ON-CLEARED, section-type=VAR
    INTERNAL_VAR_POWER_ON_CLEARED_ASIL_A: options=safetyAsilA, section-initialization-policy=POWER-ON-CLEARED, section-type=VAR
    INTERNAL_VAR_POWER_ON_CLEARED_ASIL_B: options=safetyAsilB, section-initialization-policy=POWER-ON-CLEARED, section-type=VAR
    INTERNAL_VAR_POWER_ON_CLEARED_ASIL_C: options=safetyAsilC, section-initialization-policy=POWER-ON-CLEARED, section-type=VAR
    INTERNAL_VAR_POWER_ON_CLEARED_ASIL_D: options=safetyAsilD, section-initialization-policy=POWER-ON-CLEARED, section-type=VAR
    CALIB: section-type=CALPRM
    CALIB_QM: options=safetyQM, section-type=CALPRM
    CALIB_ASIL_A: options=safetyAsilA, section-type=CALPRM
    CALIB_ASIL_B: options=safetyAsilB, section-type=CALPRM
    CALIB_ASIL_C: options=safetyAsilC, section-type=CALPRM
    CALIB_ASIL_D: options=safetyAsilD, section-type=CALPRM
    CONST_BOOLEAN: section-type=CONST
    CONST_8: section-type=CONST
    CONST_16: section-type=CONST
    CONST_32: section-type=CONST
    CONST_64: section-type=CONST
    CONST_UNSPECIFIED: section-type=CONST
    CONST_FAST_BOOLEAN: section-type=CONST
    CONST_FAST_8: section-type=CONST
    CONST_FAST_16: section-type=CONST
    CONST_FAST_32: section-type=CONST
    CONST_FAST_64: section-type=CONST
    CONST_FAST_UNSPECIFIED: section-type=CONST
    CONST_PBCFG: section-type=CONST
    PBCFG_GLOBALROOT: section-type=CONST
    CONFIG_DATA: section-type=CONFIG-DATA
    VAR_PBCFG: section-type=VAR
    VAR_SLOW: section-initialization-policy=INIT, section-type=VAR
    INTERNAL_VAR: section-initialization-policy=INIT, section-type=VAR
    VAR_INIT_BOOLEAN: section-type=VAR
    VAR_INIT_8: section-type=VAR
    VAR_INIT_16: section-type=VAR
    VAR_INIT_32: section-type=VAR
    VAR_INIT_64: section-type=VAR
    VAR_INIT_UNSPECIFIED: section-type=VAR
    VAR_NO_INIT_BOOLEAN: section-initialization-policy=NO-INIT, section-type=VAR
    VAR_NO_INIT_8: section-initialization-policy=NO-INIT, section-type=VAR
    VAR_NO_INIT_16: section-initialization-policy=NO-INIT, section-type=VAR
    VAR_NO_INIT_32: section-initialization-policy=NO-INIT, section-type=VAR
    VAR_NO_INIT_64: section-initialization-policy=NO-INIT, section-type=VAR
    VAR_NO_INIT_UNSPECIFIED: section-initialization-policy=NO-INIT, section-type=VAR
    VAR_NOINIT_BOOLEAN: section-initialization-policy=NO-INIT, section-type=VAR
    VAR_NOINIT_8: section-initialization-policy=NO-INIT, section-type=VAR
    VAR_NOINIT_16: section-initialization-policy=NO-INIT, section-type=VAR
    VAR_NOINIT_32: section-initialization-policy=NO-INIT, section-type=VAR
    VAR_NOINIT_64: section-initialization-policy=NO-INIT, section-type=VAR
    VAR_NOINIT_UNSPECIFIED: section-initialization-policy=NO-INIT, section-type=VAR
    VAR_CLEARED_BOOLEAN: section-initialization-policy=CLEARED, section-type=VAR
    VAR_CLEARED_8: section-initialization-policy=CLEARED, section-type=VAR
    VAR_CLEARED_16: section-initialization-policy=CLEARED, section-type=VAR
    VAR_CLEARED_32: section-initialization-policy=CLEARED, section-type=VAR
    VAR_CLEARED_64: section-initialization-policy=CLEARED, section-type=VAR
    VAR_CLEARED_UNSPECIFIED: section-initialization-policy=CLEARED, section-type=VAR
    VAR_ZERO_INIT: section-initialization-policy=CLEARED, section-type=VAR
    VAR_ZERO_INIT_BOOLEAN: section-initialization-policy=CLEARED, section-type=VAR
    VAR_ZERO_INIT_8: section-initialization-policy=CLEARED, section-type=VAR
    VAR_ZERO_INIT_16: section-initialization-policy=CLEARED, section-type=VAR
    VAR_ZERO_INIT_32: section-initialization-policy=CLEARED, section-type=VAR
    VAR_ZERO_INIT_64: section-initialization-policy=CLEARED, section-type=VAR
    VAR_ZERO_INIT_UNSPECIFIED: section-initialization-policy=CLEARED, section-type=VAR
    VAR_FAST_INIT_BOOLEAN: section-type=VAR-FAST
    VAR_FAST_INIT_8: section-type=VAR-FAST
    VAR_FAST_INIT_16: section-type=VAR-FAST
    VAR_FAST_INIT_32: section-type=VAR-FAST
    VAR_FAST_INIT_64: section-type=VAR-FAST
    VAR_FAST_INIT_UNSPECIFIED: section-type=VAR-FAST
    VAR_FAST_NO_INIT_BOOLEAN: section-initialization-policy=NO-INIT, section-type=VAR-FAST
    VAR_FAST_NO_INIT_8: section-initialization-policy=NO-INIT, section-type=VAR-FAST
    VAR_FAST_NO_INIT_16: section-initialization-policy=NO-INIT, section-type=VAR-FAST
    VAR_FAST_NO_INIT_32: section-initialization-policy=NO-INIT, section-type=VAR-FAST
    VAR_FAST_NO_INIT_64: section-initialization-policy=NO-INIT, section-type=VAR-FAST
    VAR_FAST_NO_INIT_UNSPECIFIED: section-initialization-policy=NO-INIT, section-type=VAR-FAST
    VAR_FAST_NOINIT_BOOLEAN: section-initialization-policy=NO-INIT, section-type=VAR-FAST
    VAR_FAST_NOINIT_8: section-initialization-policy=NO-INIT, section-type=VAR-FAST
    VAR_FAST_NOINIT_16: section-initialization-policy=NO-INIT, section-type=VAR-FAST
    VAR_FAST_NOINIT_32: section-initialization-policy=NO-INIT, section-type=VAR-FAST
    VAR_FAST_NOINIT_64: section-initialization-policy=NO-INIT, section-type=VAR-FAST
    VAR_FAST_NOINIT_UNSPECIFIED: section-initialization-policy=NO-INIT, section-type=VAR-FAST
    VAR_FAST_CLEARED_BOOLEAN: section-initialization-policy=CLEARED, section-type=VAR-FAST
    VAR_FAST_CLEARED_8: section-initialization-policy=CLEARED, section-type=VAR-FAST
    VAR_FAST_CLEARED_16: section-initialization-policy=CLEARED, section-type=VAR-FAST
    VAR_FAST_CLEARED_32: section-initialization-policy=CLEARED, section-type=VAR-FAST
    VAR_FAST_CLEARED_64: section-initialization-policy=CLEARED, section-type=VAR-FAST
    VAR_FAST_CLEARED_UNSPECIFIED: section-initialization-policy=CLEARED, section-type=VAR-FAST
    VAR_FAST_ZERO_INIT_BOOLEAN: section-initialization-policy=CLEARED, section-type=VAR-FAST
    VAR_FAST_ZERO_INIT_8: section-initialization-policy=CLEARED, section-type=VAR-FAST
    VAR_FAST_ZERO_INIT_16: section-initialization-policy=CLEARED, section-type=VAR-FAST
    VAR_FAST_ZERO_INIT_32: section-initialization-policy=CLEARED, section-type=VAR-FAST
    VAR_FAST_ZERO_INIT_64: section-initialization-policy=CLEARED, section-type=VAR-FAST
    VAR_FAST_ZERO_INIT_UNSPECIFIED: section-initialization-policy=CLEARED, section-type=VAR-FAST
    VAR_NOCACHE_INIT_BOOLEAN: section-type=VAR
    VAR_NOCACHE_INIT_8: section-type=VAR
    VAR_NOCACHE_INIT_16: section-type=VAR
    VAR_NOCACHE_INIT_32: section-type=VAR
    VAR_NOCACHE_INIT_64: section-type=VAR
    VAR_NOCACHE_INIT_UNSPECIFIED: section-type=VAR
    VAR_NOCACHE_NO_INIT_BOOLEAN: section-initialization-policy=NO-INIT, section-type=VAR
    VAR_NOCACHE_NO_INIT_8: section-initialization-policy=NO-INIT, section-type=VAR
    VAR_NOCACHE_NO_INIT_16: section-initialization-policy=NO-INIT, section-type=VAR
    VAR_NOCACHE_NO_INIT_32: section-initialization-policy=NO-INIT, section-type=VAR
    VAR_NOCACHE_NO_INIT_64: section-initialization-policy=NO-INIT, section-type=VAR
    VAR_NOCACHE_NO_INIT_UNSPECIFIED: section-initialization-policy=NO-INIT, section-type=VAR
    VAR_NOCACHE_NOINIT_BOOLEAN: section-initialization-policy=NO-INIT, section-type=VAR
    VAR_NOCACHE_NOINIT_8: section-initialization-policy=NO-INIT, section-type=VAR
    VAR_NOCACHE_NOINIT_16: section-initialization-policy=NO-INIT, section-type=VAR
    VAR_NOCACHE_NOINIT_32: section-initialization-policy=NO-INIT, section-type=VAR
    VAR_NOCACHE_NOINIT_64: section-initialization-policy=NO-INIT, section-type=VAR
    VAR_NOCACHE_NOINIT_UNSPECIFIED: section-initialization-policy=NO-INIT, section-type=VAR
    VAR_NOCACHE_CLEARED_BOOLEAN: section-initialization-policy=CLEARED, section-type=VAR
    VAR_NOCACHE_CLEARED_8: section-initialization-policy=CLEARED, section-type=VAR
    VAR_NOCACHE_CLEARED_16: section-initialization-policy=CLEARED, section-type=VAR
    VAR_NOCACHE_CLEARED_32: section-initialization-policy=CLEARED, section-type=VAR
    VAR_NOCACHE_CLEARED_64: section-initialization-policy=CLEARED, section-type=VAR
    VAR_NOCACHE_CLEARED_UNSPECIFIED: section-initialization-policy=CLEARED, section-type=VAR
    VAR_NOCACHE_ZERO_INIT_BOOLEAN: section-initialization-policy=CLEARED, section-type=VAR
    VAR_NOCACHE_ZERO_INIT_8: section-initialization-policy=CLEARED, section-type=VAR
    VAR_NOCACHE_ZERO_INIT_16: section-initialization-policy=CLEARED, section-type=VAR
    VAR_NOCACHE_ZERO_INIT_32: section-initialization-policy=CLEARED, section-type=VAR
    VAR_NOCACHE_ZERO_INIT_64: section-initialization-policy=CLEARED, section-type=VAR
    VAR_NOCACHE_ZERO_INIT_UNSPECIFIED: section-initialization-policy=CLEARED, section-type=VAR
    VAR_SAVED_ZONE_BOOLEAN: section-initialization-policy=POWER-ON-CLEARED, section-type=VAR
    VAR_SAVED_ZONE_8: section-initialization-policy=POWER-ON-CLEARED, section-type=VAR
    VAR_SAVED_ZONE_16: section-initialization-policy=POWER-ON-CLEARED, section-type=VAR
    VAR_SAVED_ZONE_32: section-initialization-policy=POWER-ON-CLEARED, section-type=VAR
    VAR_SAVED_ZONE_64: section-initialization-policy=POWER-ON-CLEARED, section-type=VAR
    VAR_SAVED_ZONE_UNSPECIFIED: section-initialization-policy=POWER-ON-CLEARED, section-type=VAR
    VAR_NOCACHE_INIT: section-type=VAR
    VAR_NOCACHE_NO_INIT: section-initialization-policy=NO-INIT, section-type=VAR
    VAR_NOCACHE_CLEARED: section-initialization-policy=CLEARED, section-type=VAR
