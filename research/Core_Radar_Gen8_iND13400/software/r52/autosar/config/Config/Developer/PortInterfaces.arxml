AUTOSAR XML (schema 00053)
package /MICROSAR/Dcm_swc
  mode declaration group DcmControlDtcSetting: category=EXPLICIT_ORDER, initial-mode=ENABLEDTCSETTING, on-transition-value=2
    mode ENABLEDTCSETTING: value=0
    mode DISABLEDTCSETTING: value=1
package /MICROSAR/Dcm_swc/Interfaces
  mode switch interface DcmControlDtcSetting: is-service=true, service-kind=DIAGNOSTIC-COMMUNICATION-MANAGER
    mode group DcmControlDtcSetting: type=DcmControlDtcSetting
package /Predefined_DEV/PortInterfaces
  43 x client server interface:
    NvMAdministration: is-service=true
      operation SetBlockProtection: possible-error=NvMAdministration/E_NOT_OK
        arg ProtectionEnabled: type=boolean, direction=IN, server-argument-impl-policy=USE-ARGUMENT-TYPE
      error E_NOT_OK: error-code=1
    NvMNotifyInitBlock: is-service=true
      operation InitBlock
    NvMNotifyJobFinished: is-service=true
      operation JobFinished
        arg ServiceId: type=NvM_ServiceIdType, direction=IN, server-argument-impl-policy=USE-ARGUMENT-TYPE
        arg JobResult: type=NvM_RequestResultType, direction=IN, server-argument-impl-policy=USE-ARGUMENT-TYPE
    NvMService: is-service=true
      operation GetErrorStatus: possible-error=NvMService/E_NOT_OK
        arg ErrorStatus: type=NvM_RequestResultType, direction=OUT, server-argument-impl-policy=USE-ARGUMENT-TYPE
      error E_NOT_OK: error-code=1
    NvMService_AC2: is-service=true
      operation GetErrorStatus: possible-error=NvMService_AC2/E_NOT_OK
        arg ErrorStatus: type=NvM_RequestResultType, direction=OUT, server-argument-impl-policy=USE-ARGUMENT-TYPE
      operation ReadBlock: possible-error=NvMService_AC2/E_NOT_OK
        arg DstPtr: type=dtRef_VOID, direction=IN, server-argument-impl-policy=USE-ARGUMENT-TYPE
      operation WriteBlock: possible-error=NvMService_AC2/E_NOT_OK
        arg SrcPtr: type=dtRef_const_VOID, direction=IN, server-argument-impl-policy=USE-ARGUMENT-TYPE
      error E_NOT_OK: error-code=1
    NvMService_AC2_Defs: is-service=true
      4 x operation, all with possible-error=NvMService_AC2_Defs/E_NOT_OK:
        GetErrorStatus
          arg ErrorStatus: type=NvM_RequestResultType, direction=OUT, server-argument-impl-policy=USE-ARGUMENT-TYPE
        ReadBlock
          arg DstPtr: type=dtRef_VOID, direction=IN, server-argument-impl-policy=USE-ARGUMENT-TYPE
        RestoreBlockDefaults
          arg DstPtr: type=dtRef_VOID, direction=IN, server-argument-impl-policy=USE-ARGUMENT-TYPE
        WriteBlock
          arg SrcPtr: type=dtRef_const_VOID, direction=IN, server-argument-impl-policy=USE-ARGUMENT-TYPE
      error E_NOT_OK: error-code=1
    NvMService_AC2_DS: is-service=true
      5 x operation, all with possible-error=NvMService_AC2_DS/E_NOT_OK:
        GetDataIndex
          arg DataIndex: type=uint8, direction=OUT, server-argument-impl-policy=USE-ARGUMENT-TYPE
        GetErrorStatus
          arg ErrorStatus: type=NvM_RequestResultType, direction=OUT, server-argument-impl-policy=USE-ARGUMENT-TYPE
        ReadBlock
          arg DstPtr: type=dtRef_VOID, direction=IN, server-argument-impl-policy=USE-ARGUMENT-TYPE
        SetDataIndex
          arg DataIndex: type=uint8, direction=IN, server-argument-impl-policy=USE-ARGUMENT-TYPE
        WriteBlock
          arg SrcPtr: type=dtRef_const_VOID, direction=IN, server-argument-impl-policy=USE-ARGUMENT-TYPE
      error E_NOT_OK: error-code=1
    NvMService_AC2_DS_Defs: is-service=true
      6 x operation, all with possible-error=NvMService_AC2_DS_Defs/E_NOT_OK:
        GetDataIndex
          arg DataIndex: type=uint8, direction=OUT, server-argument-impl-policy=USE-ARGUMENT-TYPE
        GetErrorStatus
          arg ErrorStatus: type=NvM_RequestResultType, direction=OUT, server-argument-impl-policy=USE-ARGUMENT-TYPE
        ReadBlock
          arg DstPtr: type=dtRef_VOID, direction=IN, server-argument-impl-policy=USE-ARGUMENT-TYPE
        RestoreBlockDefaults
          arg DstPtr: type=dtRef_VOID, direction=IN, server-argument-impl-policy=USE-ARGUMENT-TYPE
        SetDataIndex
          arg DataIndex: type=uint8, direction=IN, server-argument-impl-policy=USE-ARGUMENT-TYPE
        WriteBlock
          arg SrcPtr: type=dtRef_const_VOID, direction=IN, server-argument-impl-policy=USE-ARGUMENT-TYPE
      error E_NOT_OK: error-code=1
    NvMService_AC2_SRBS: is-service=true
      4 x operation, all with possible-error=NvMService_AC2_SRBS/E_NOT_OK:
        GetErrorStatus
          arg ErrorStatus: type=NvM_RequestResultType, direction=OUT, server-argument-impl-policy=USE-ARGUMENT-TYPE
        ReadBlock
          arg DstPtr: type=dtRef_VOID, direction=IN, server-argument-impl-policy=USE-ARGUMENT-TYPE
        SetRamBlockStatus
          arg RamBlockStatus: type=boolean, direction=IN, server-argument-impl-policy=USE-ARGUMENT-TYPE
        WriteBlock
          arg SrcPtr: type=dtRef_const_VOID, direction=IN, server-argument-impl-policy=USE-ARGUMENT-TYPE
      error E_NOT_OK: error-code=1
    NvMService_AC2_SRBS_Defs: is-service=true
      5 x operation, all with possible-error=NvMService_AC2_SRBS_Defs/E_NOT_OK:
        GetErrorStatus
          arg ErrorStatus: type=NvM_RequestResultType, direction=OUT, server-argument-impl-policy=USE-ARGUMENT-TYPE
        ReadBlock
          arg DstPtr: type=dtRef_VOID, direction=IN, server-argument-impl-policy=USE-ARGUMENT-TYPE
        RestoreBlockDefaults
          arg DstPtr: type=dtRef_VOID, direction=IN, server-argument-impl-policy=USE-ARGUMENT-TYPE
        SetRamBlockStatus
          arg RamBlockStatus: type=boolean, direction=IN, server-argument-impl-policy=USE-ARGUMENT-TYPE
        WriteBlock
          arg SrcPtr: type=dtRef_const_VOID, direction=IN, server-argument-impl-policy=USE-ARGUMENT-TYPE
      error E_NOT_OK: error-code=1
    NvMService_AC2_SRBS_DS: is-service=true
      6 x operation, all with possible-error=NvMService_AC2_SRBS_DS/E_NOT_OK:
        GetDataIndex
          arg DataIndex: type=uint8, direction=OUT, server-argument-impl-policy=USE-ARGUMENT-TYPE
        GetErrorStatus
          arg ErrorStatus: type=NvM_RequestResultType, direction=OUT, server-argument-impl-policy=USE-ARGUMENT-TYPE
        ReadBlock
          arg DstPtr: type=dtRef_VOID, direction=IN, server-argument-impl-policy=USE-ARGUMENT-TYPE
        SetDataIndex
          arg DataIndex: type=uint8, direction=IN, server-argument-impl-policy=USE-ARGUMENT-TYPE
        SetRamBlockStatus
          arg RamBlockStatus: type=boolean, direction=IN, server-argument-impl-policy=USE-ARGUMENT-TYPE
        WriteBlock
          arg SrcPtr: type=dtRef_const_VOID, direction=IN, server-argument-impl-policy=USE-ARGUMENT-TYPE
      error E_NOT_OK: error-code=1
    NvMService_AC2_SRBS_DS_Defs: is-service=true
      7 x operation, all with possible-error=NvMService_AC2_SRBS_DS_Defs/E_NOT_OK:
        GetDataIndex
          arg DataIndex: type=uint8, direction=OUT, server-argument-impl-policy=USE-ARGUMENT-TYPE
        GetErrorStatus
          arg ErrorStatus: type=NvM_RequestResultType, direction=OUT, server-argument-impl-policy=USE-ARGUMENT-TYPE
        ReadBlock
          arg DstPtr: type=dtRef_VOID, direction=IN, server-argument-impl-policy=USE-ARGUMENT-TYPE
        RestoreBlockDefaults
          arg DstPtr: type=dtRef_VOID, direction=IN, server-argument-impl-policy=USE-ARGUMENT-TYPE
        SetDataIndex
          arg DataIndex: type=uint8, direction=IN, server-argument-impl-policy=USE-ARGUMENT-TYPE
        SetRamBlockStatus
          arg RamBlockStatus: type=boolean, direction=IN, server-argument-impl-policy=USE-ARGUMENT-TYPE
        WriteBlock
          arg SrcPtr: type=dtRef_const_VOID, direction=IN, server-argument-impl-policy=USE-ARGUMENT-TYPE
      error E_NOT_OK: error-code=1
    NvMService_AC3: is-service=true
      5 x operation, all with possible-error=NvMService_AC3/E_NOT_OK:
        EraseBlock
        GetErrorStatus
          arg ErrorStatus: type=NvM_RequestResultType, direction=OUT, server-argument-impl-policy=USE-ARGUMENT-TYPE
        InvalidateNvBlock
        ReadBlock
          arg DstPtr: type=dtRef_VOID, direction=IN, server-argument-impl-policy=USE-ARGUMENT-TYPE
        WriteBlock
          arg SrcPtr: type=dtRef_const_VOID, direction=IN, server-argument-impl-policy=USE-ARGUMENT-TYPE
      error E_NOT_OK: error-code=1
    NvMService_AC3_Defs: is-service=true
      6 x operation, all with possible-error=NvMService_AC3_Defs/E_NOT_OK:
        EraseBlock
        GetErrorStatus
          arg ErrorStatus: type=NvM_RequestResultType, direction=OUT, server-argument-impl-policy=USE-ARGUMENT-TYPE
        InvalidateNvBlock
        ReadBlock
          arg DstPtr: type=dtRef_VOID, direction=IN, server-argument-impl-policy=USE-ARGUMENT-TYPE
        RestoreBlockDefaults
          arg DstPtr: type=dtRef_VOID, direction=IN, server-argument-impl-policy=USE-ARGUMENT-TYPE
        WriteBlock
          arg SrcPtr: type=dtRef_const_VOID, direction=IN, server-argument-impl-policy=USE-ARGUMENT-TYPE
      error E_NOT_OK: error-code=1
    NvMService_AC3_DS: is-service=true
      7 x operation, all with possible-error=NvMService_AC3_DS/E_NOT_OK:
        EraseBlock
        GetDataIndex
          arg DataIndex: type=uint8, direction=OUT, server-argument-impl-policy=USE-ARGUMENT-TYPE
        GetErrorStatus
          arg ErrorStatus: type=NvM_RequestResultType, direction=OUT, server-argument-impl-policy=USE-ARGUMENT-TYPE
        InvalidateNvBlock
        ReadBlock
          arg DstPtr: type=dtRef_VOID, direction=IN, server-argument-impl-policy=USE-ARGUMENT-TYPE
        SetDataIndex
          arg DataIndex: type=uint8, direction=IN, server-argument-impl-policy=USE-ARGUMENT-TYPE
        WriteBlock
          arg SrcPtr: type=dtRef_const_VOID, direction=IN, server-argument-impl-policy=USE-ARGUMENT-TYPE
      error E_NOT_OK: error-code=1
    NvMService_AC3_DS_Defs: is-service=true
      8 x operation, all with possible-error=NvMService_AC3_DS_Defs/E_NOT_OK:
        EraseBlock
        GetDataIndex
          arg DataIndex: type=uint8, direction=OUT, server-argument-impl-policy=USE-ARGUMENT-TYPE
        GetErrorStatus
          arg ErrorStatus: type=NvM_RequestResultType, direction=OUT, server-argument-impl-policy=USE-ARGUMENT-TYPE
        InvalidateNvBlock
        ReadBlock
          arg DstPtr: type=dtRef_VOID, direction=IN, server-argument-impl-policy=USE-ARGUMENT-TYPE
        RestoreBlockDefaults
          arg DstPtr: type=dtRef_VOID, direction=IN, server-argument-impl-policy=USE-ARGUMENT-TYPE
        SetDataIndex
          arg DataIndex: type=uint8, direction=IN, server-argument-impl-policy=USE-ARGUMENT-TYPE
        WriteBlock
          arg SrcPtr: type=dtRef_const_VOID, direction=IN, server-argument-impl-policy=USE-ARGUMENT-TYPE
      error E_NOT_OK: error-code=1
    NvMService_AC3_SRBS: is-service=true
      6 x operation, all with possible-error=NvMService_AC3_SRBS/E_NOT_OK:
        EraseBlock
        GetErrorStatus
          arg ErrorStatus: type=NvM_RequestResultType, direction=OUT, server-argument-impl-policy=USE-ARGUMENT-TYPE
        InvalidateNvBlock
        ReadBlock
          arg DstPtr: type=dtRef_VOID, direction=IN, server-argument-impl-policy=USE-ARGUMENT-TYPE
        SetRamBlockStatus
          arg RamBlockStatus: type=boolean, direction=IN, server-argument-impl-policy=USE-ARGUMENT-TYPE
        WriteBlock
          arg SrcPtr: type=dtRef_const_VOID, direction=IN, server-argument-impl-policy=USE-ARGUMENT-TYPE
      error E_NOT_OK: error-code=1
    NvMService_AC3_SRBS_Defs: is-service=true
      7 x operation, all with possible-error=NvMService_AC3_SRBS_Defs/E_NOT_OK:
        EraseBlock
        GetErrorStatus
          arg ErrorStatus: type=NvM_RequestResultType, direction=OUT, server-argument-impl-policy=USE-ARGUMENT-TYPE
        InvalidateNvBlock
        ReadBlock
          arg DstPtr: type=dtRef_VOID, direction=IN, server-argument-impl-policy=USE-ARGUMENT-TYPE
        RestoreBlockDefaults
          arg DstPtr: type=dtRef_VOID, direction=IN, server-argument-impl-policy=USE-ARGUMENT-TYPE
        SetRamBlockStatus
          arg RamBlockStatus: type=boolean, direction=IN, server-argument-impl-policy=USE-ARGUMENT-TYPE
        WriteBlock
          arg SrcPtr: type=dtRef_const_VOID, direction=IN, server-argument-impl-policy=USE-ARGUMENT-TYPE
      error E_NOT_OK: error-code=1
    NvMService_AC3_SRBS_DS: is-service=true
      8 x operation, all with possible-error=NvMService_AC3_SRBS_DS/E_NOT_OK:
        EraseBlock
        GetDataIndex
          arg DataIndex: type=uint8, direction=OUT, server-argument-impl-policy=USE-ARGUMENT-TYPE
        GetErrorStatus
          arg ErrorStatus: type=NvM_RequestResultType, direction=OUT, server-argument-impl-policy=USE-ARGUMENT-TYPE
        InvalidateNvBlock
        ReadBlock
          arg DstPtr: type=dtRef_VOID, direction=IN, server-argument-impl-policy=USE-ARGUMENT-TYPE
        SetDataIndex
          arg DataIndex: type=uint8, direction=IN, server-argument-impl-policy=USE-ARGUMENT-TYPE
        SetRamBlockStatus
          arg RamBlockStatus: type=boolean, direction=IN, server-argument-impl-policy=USE-ARGUMENT-TYPE
        WriteBlock
          arg SrcPtr: type=dtRef_const_VOID, direction=IN, server-argument-impl-policy=USE-ARGUMENT-TYPE
      error E_NOT_OK: error-code=1
    NvMService_AC3_SRBS_DS_Defs: is-service=true
      9 x operation, all with possible-error=NvMService_AC3_SRBS_DS_Defs/E_NOT_OK:
        EraseBlock
        GetDataIndex
          arg DataIndex: type=uint8, direction=OUT, server-argument-impl-policy=USE-ARGUMENT-TYPE
        GetErrorStatus
          arg ErrorStatus: type=NvM_RequestResultType, direction=OUT, server-argument-impl-policy=USE-ARGUMENT-TYPE
        InvalidateNvBlock
        ReadBlock
          arg DstPtr: type=dtRef_VOID, direction=IN, server-argument-impl-policy=USE-ARGUMENT-TYPE
        RestoreBlockDefaults
          arg DstPtr: type=dtRef_VOID, direction=IN, server-argument-impl-policy=USE-ARGUMENT-TYPE
        SetDataIndex
          arg DataIndex: type=uint8, direction=IN, server-argument-impl-policy=USE-ARGUMENT-TYPE
        SetRamBlockStatus
          arg RamBlockStatus: type=boolean, direction=IN, server-argument-impl-policy=USE-ARGUMENT-TYPE
        WriteBlock
          arg SrcPtr: type=dtRef_const_VOID, direction=IN, server-argument-impl-policy=USE-ARGUMENT-TYPE
      error E_NOT_OK: error-code=1
    NvMService_SRBS: is-service=true
      operation GetErrorStatus: possible-error=NvMService_SRBS/E_NOT_OK
        arg ErrorStatus: type=NvM_RequestResultType, direction=OUT, server-argument-impl-policy=USE-ARGUMENT-TYPE
      operation SetRamBlockStatus: possible-error=NvMService_SRBS/E_NOT_OK
        arg RamBlockStatus: type=boolean, direction=IN, server-argument-impl-policy=USE-ARGUMENT-TYPE
      error E_NOT_OK: error-code=1
    CallbackDTCStatusChange: is-service=true, service-kind=DIAGNOSTIC-EVENT-MANAGER
      operation DTCStatusChanged: possible-error=CallbackDTCStatusChange/E_NOT_OK
        arg DTC: type=uint32, direction=IN, server-argument-impl-policy=USE-ARGUMENT-TYPE
        arg DTCStatusOld: type=Dem_UdsStatusByteType, direction=IN, server-argument-impl-policy=USE-ARGUMENT-TYPE
        arg DTCStatusNew: type=Dem_UdsStatusByteType, direction=IN, server-argument-impl-policy=USE-ARGUMENT-TYPE
      error E_NOT_OK: error-code=1
    NvSWC_NvMAdministration
      operation SetBlockProtection: possible-error=NvSWC_NvMAdministration/E_NOT_OK
        arg ProtectionEnabled: type=boolean, direction=IN, server-argument-impl-policy=USE-ARGUMENT-TYPE
      error E_NOT_OK: error-code=1
    NvSWC_NvMNotifyInitBlock
      operation InitBlock
    NvSWC_NvMNotifyJobFinished
      operation JobFinished
        arg ServiceId: type=NvM_ServiceIdType, direction=IN, server-argument-impl-policy=USE-ARGUMENT-TYPE
        arg JobResult: type=NvM_RequestResultType, direction=IN, server-argument-impl-policy=USE-ARGUMENT-TYPE
    NvSWC_NvMService
      operation GetErrorStatus: possible-error=NvSWC_NvMService/E_NOT_OK
        arg ErrorStatus: type=NvM_RequestResultType, direction=OUT, server-argument-impl-policy=USE-ARGUMENT-TYPE
      error E_NOT_OK: error-code=1
    NvSWC_NvMService_AC2
      operation GetErrorStatus: possible-error=NvSWC_NvMService_AC2/E_NOT_OK
        arg ErrorStatus: type=NvM_RequestResultType, direction=OUT, server-argument-impl-policy=USE-ARGUMENT-TYPE
      operation ReadBlock: possible-error=NvSWC_NvMService_AC2/E_NOT_OK
        arg DstPtr: type=dtRef_VOID, direction=IN, server-argument-impl-policy=USE-ARGUMENT-TYPE
      operation WriteBlock: possible-error=NvSWC_NvMService_AC2/E_NOT_OK
        arg SrcPtr: type=dtRef_const_VOID, direction=IN, server-argument-impl-policy=USE-ARGUMENT-TYPE
      error E_NOT_OK: error-code=1
    NvSWC_NvMService_AC2_Defs
      4 x operation, all with possible-error=NvSWC_NvMService_AC2_Defs/E_NOT_OK:
        GetErrorStatus
          arg ErrorStatus: type=NvM_RequestResultType, direction=OUT, server-argument-impl-policy=USE-ARGUMENT-TYPE
        ReadBlock
          arg DstPtr: type=dtRef_VOID, direction=IN, server-argument-impl-policy=USE-ARGUMENT-TYPE
        RestoreBlockDefaults
          arg DstPtr: type=dtRef_VOID, direction=IN, server-argument-impl-policy=USE-ARGUMENT-TYPE
        WriteBlock
          arg SrcPtr: type=dtRef_const_VOID, direction=IN, server-argument-impl-policy=USE-ARGUMENT-TYPE
      error E_NOT_OK: error-code=1
    NvSWC_NvMService_AC2_DS
      5 x operation, all with possible-error=NvSWC_NvMService_AC2_DS/E_NOT_OK:
        GetDataIndex
          arg DataIndex: type=uint8, direction=OUT, server-argument-impl-policy=USE-ARGUMENT-TYPE
        GetErrorStatus
          arg ErrorStatus: type=NvM_RequestResultType, direction=OUT, server-argument-impl-policy=USE-ARGUMENT-TYPE
        ReadBlock
          arg DstPtr: type=dtRef_VOID, direction=IN, server-argument-impl-policy=USE-ARGUMENT-TYPE
        SetDataIndex
          arg DataIndex: type=uint8, direction=IN, server-argument-impl-policy=USE-ARGUMENT-TYPE
        WriteBlock
          arg SrcPtr: type=dtRef_const_VOID, direction=IN, server-argument-impl-policy=USE-ARGUMENT-TYPE
      error E_NOT_OK: error-code=1
    NvSWC_NvMService_AC2_DS_Defs
      6 x operation, all with possible-error=NvSWC_NvMService_AC2_DS_Defs/E_NOT_OK:
        GetDataIndex
          arg DataIndex: type=uint8, direction=OUT, server-argument-impl-policy=USE-ARGUMENT-TYPE
        GetErrorStatus
          arg ErrorStatus: type=NvM_RequestResultType, direction=OUT, server-argument-impl-policy=USE-ARGUMENT-TYPE
        ReadBlock
          arg DstPtr: type=dtRef_VOID, direction=IN, server-argument-impl-policy=USE-ARGUMENT-TYPE
        RestoreBlockDefaults
          arg DstPtr: type=dtRef_VOID, direction=IN, server-argument-impl-policy=USE-ARGUMENT-TYPE
        SetDataIndex
          arg DataIndex: type=uint8, direction=IN, server-argument-impl-policy=USE-ARGUMENT-TYPE
        WriteBlock
          arg SrcPtr: type=dtRef_const_VOID, direction=IN, server-argument-impl-policy=USE-ARGUMENT-TYPE
      error E_NOT_OK: error-code=1
    NvSWC_NvMService_AC2_SRBS
      4 x operation, all with possible-error=NvSWC_NvMService_AC2_SRBS/E_NOT_OK:
        GetErrorStatus
          arg ErrorStatus: type=NvM_RequestResultType, direction=OUT, server-argument-impl-policy=USE-ARGUMENT-TYPE
        ReadBlock
          arg DstPtr: type=dtRef_VOID, direction=IN, server-argument-impl-policy=USE-ARGUMENT-TYPE
        SetRamBlockStatus
          arg RamBlockStatus: type=boolean, direction=IN, server-argument-impl-policy=USE-ARGUMENT-TYPE
        WriteBlock
          arg SrcPtr: type=dtRef_const_VOID, direction=IN, server-argument-impl-policy=USE-ARGUMENT-TYPE
      error E_NOT_OK: error-code=1
    NvSWC_NvMService_AC2_SRBS_Defs
      5 x operation, all with possible-error=NvSWC_NvMService_AC2_SRBS_Defs/E_NOT_OK:
        GetErrorStatus
          arg ErrorStatus: type=NvM_RequestResultType, direction=OUT, server-argument-impl-policy=USE-ARGUMENT-TYPE
        ReadBlock
          arg DstPtr: type=dtRef_VOID, direction=IN, server-argument-impl-policy=USE-ARGUMENT-TYPE
        RestoreBlockDefaults
          arg DstPtr: type=dtRef_VOID, direction=IN, server-argument-impl-policy=USE-ARGUMENT-TYPE
        SetRamBlockStatus
          arg RamBlockStatus: type=boolean, direction=IN, server-argument-impl-policy=USE-ARGUMENT-TYPE
        WriteBlock
          arg SrcPtr: type=dtRef_const_VOID, direction=IN, server-argument-impl-policy=USE-ARGUMENT-TYPE
      error E_NOT_OK: error-code=1
    NvSWC_NvMService_AC2_SRBS_DS
      6 x operation, all with possible-error=NvSWC_NvMService_AC2_SRBS_DS/E_NOT_OK:
        GetDataIndex
          arg DataIndex: type=uint8, direction=OUT, server-argument-impl-policy=USE-ARGUMENT-TYPE
        GetErrorStatus
          arg ErrorStatus: type=NvM_RequestResultType, direction=OUT, server-argument-impl-policy=USE-ARGUMENT-TYPE
        ReadBlock
          arg DstPtr: type=dtRef_VOID, direction=IN, server-argument-impl-policy=USE-ARGUMENT-TYPE
        SetDataIndex
          arg DataIndex: type=uint8, direction=IN, server-argument-impl-policy=USE-ARGUMENT-TYPE
        SetRamBlockStatus
          arg RamBlockStatus: type=boolean, direction=IN, server-argument-impl-policy=USE-ARGUMENT-TYPE
        WriteBlock
          arg SrcPtr: type=dtRef_const_VOID, direction=IN, server-argument-impl-policy=USE-ARGUMENT-TYPE
      error E_NOT_OK: error-code=1
    NvSWC_NvMService_AC2_SRBS_DS_Defs
      7 x operation, all with possible-error=NvSWC_NvMService_AC2_SRBS_DS_Defs/E_NOT_OK:
        GetDataIndex
          arg DataIndex: type=uint8, direction=OUT, server-argument-impl-policy=USE-ARGUMENT-TYPE
        GetErrorStatus
          arg ErrorStatus: type=NvM_RequestResultType, direction=OUT, server-argument-impl-policy=USE-ARGUMENT-TYPE
        ReadBlock
          arg DstPtr: type=dtRef_VOID, direction=IN, server-argument-impl-policy=USE-ARGUMENT-TYPE
        RestoreBlockDefaults
          arg DstPtr: type=dtRef_VOID, direction=IN, server-argument-impl-policy=USE-ARGUMENT-TYPE
        SetDataIndex
          arg DataIndex: type=uint8, direction=IN, server-argument-impl-policy=USE-ARGUMENT-TYPE
        SetRamBlockStatus
          arg RamBlockStatus: type=boolean, direction=IN, server-argument-impl-policy=USE-ARGUMENT-TYPE
        WriteBlock
          arg SrcPtr: type=dtRef_const_VOID, direction=IN, server-argument-impl-policy=USE-ARGUMENT-TYPE
      error E_NOT_OK: error-code=1
    NvSWC_NvMService_AC3
      5 x operation, all with possible-error=NvSWC_NvMService_AC3/E_NOT_OK:
        EraseBlock
        GetErrorStatus
          arg ErrorStatus: type=NvM_RequestResultType, direction=OUT, server-argument-impl-policy=USE-ARGUMENT-TYPE
        InvalidateNvBlock
        ReadBlock
          arg DstPtr: type=dtRef_VOID, direction=IN, server-argument-impl-policy=USE-ARGUMENT-TYPE
        WriteBlock
          arg SrcPtr: type=dtRef_const_VOID, direction=IN, server-argument-impl-policy=USE-ARGUMENT-TYPE
      error E_NOT_OK: error-code=1
    NvSWC_NvMService_AC3_Defs
      6 x operation, all with possible-error=NvSWC_NvMService_AC3_Defs/E_NOT_OK:
        EraseBlock
        GetErrorStatus
          arg ErrorStatus: type=NvM_RequestResultType, direction=OUT, server-argument-impl-policy=USE-ARGUMENT-TYPE
        InvalidateNvBlock
        ReadBlock
          arg DstPtr: type=dtRef_VOID, direction=IN, server-argument-impl-policy=USE-ARGUMENT-TYPE
        RestoreBlockDefaults
          arg DstPtr: type=dtRef_VOID, direction=IN, server-argument-impl-policy=USE-ARGUMENT-TYPE
        WriteBlock
          arg SrcPtr: type=dtRef_const_VOID, direction=IN, server-argument-impl-policy=USE-ARGUMENT-TYPE
      error E_NOT_OK: error-code=1
    NvSWC_NvMService_AC3_DS
      7 x operation, all with possible-error=NvSWC_NvMService_AC3_DS/E_NOT_OK:
        EraseBlock
        GetDataIndex
          arg DataIndex: type=uint8, direction=OUT, server-argument-impl-policy=USE-ARGUMENT-TYPE
        GetErrorStatus
          arg ErrorStatus: type=NvM_RequestResultType, direction=OUT, server-argument-impl-policy=USE-ARGUMENT-TYPE
        InvalidateNvBlock
        ReadBlock
          arg DstPtr: type=dtRef_VOID, direction=IN, server-argument-impl-policy=USE-ARGUMENT-TYPE
        SetDataIndex
          arg DataIndex: type=uint8, direction=IN, server-argument-impl-policy=USE-ARGUMENT-TYPE
        WriteBlock
          arg SrcPtr: type=dtRef_const_VOID, direction=IN, server-argument-impl-policy=USE-ARGUMENT-TYPE
      error E_NOT_OK: error-code=1
    NvSWC_NvMService_AC3_DS_Defs
      8 x operation, all with possible-error=NvSWC_NvMService_AC3_DS_Defs/E_NOT_OK:
        EraseBlock
        GetDataIndex
          arg DataIndex: type=uint8, direction=OUT, server-argument-impl-policy=USE-ARGUMENT-TYPE
        GetErrorStatus
          arg ErrorStatus: type=NvM_RequestResultType, direction=OUT, server-argument-impl-policy=USE-ARGUMENT-TYPE
        InvalidateNvBlock
        ReadBlock
          arg DstPtr: type=dtRef_VOID, direction=IN, server-argument-impl-policy=USE-ARGUMENT-TYPE
        RestoreBlockDefaults
          arg DstPtr: type=dtRef_VOID, direction=IN, server-argument-impl-policy=USE-ARGUMENT-TYPE
        SetDataIndex
          arg DataIndex: type=uint8, direction=IN, server-argument-impl-policy=USE-ARGUMENT-TYPE
        WriteBlock
          arg SrcPtr: type=dtRef_const_VOID, direction=IN, server-argument-impl-policy=USE-ARGUMENT-TYPE
      error E_NOT_OK: error-code=1
    NvSWC_NvMService_AC3_SRBS
      6 x operation, all with possible-error=NvSWC_NvMService_AC3_SRBS/E_NOT_OK:
        EraseBlock
        GetErrorStatus
          arg ErrorStatus: type=NvM_RequestResultType, direction=OUT, server-argument-impl-policy=USE-ARGUMENT-TYPE
        InvalidateNvBlock
        ReadBlock
          arg DstPtr: type=dtRef_VOID, direction=IN, server-argument-impl-policy=USE-ARGUMENT-TYPE
        SetRamBlockStatus
          arg RamBlockStatus: type=boolean, direction=IN, server-argument-impl-policy=USE-ARGUMENT-TYPE
        WriteBlock
          arg SrcPtr: type=dtRef_const_VOID, direction=IN, server-argument-impl-policy=USE-ARGUMENT-TYPE
      error E_NOT_OK: error-code=1
    NvSWC_NvMService_AC3_SRBS_Defs
      7 x operation, all with possible-error=NvSWC_NvMService_AC3_SRBS_Defs/E_NOT_OK:
        EraseBlock
        GetErrorStatus
          arg ErrorStatus: type=NvM_RequestResultType, direction=OUT, server-argument-impl-policy=USE-ARGUMENT-TYPE
        InvalidateNvBlock
        ReadBlock
          arg DstPtr: type=dtRef_VOID, direction=IN, server-argument-impl-policy=USE-ARGUMENT-TYPE
        RestoreBlockDefaults
          arg DstPtr: type=dtRef_VOID, direction=IN, server-argument-impl-policy=USE-ARGUMENT-TYPE
        SetRamBlockStatus
          arg RamBlockStatus: type=boolean, direction=IN, server-argument-impl-policy=USE-ARGUMENT-TYPE
        WriteBlock
          arg SrcPtr: type=dtRef_const_VOID, direction=IN, server-argument-impl-policy=USE-ARGUMENT-TYPE
      error E_NOT_OK: error-code=1
    NvSWC_NvMService_AC3_SRBS_DS
      8 x operation, all with possible-error=NvSWC_NvMService_AC3_SRBS_DS/E_NOT_OK:
        EraseBlock
        GetDataIndex
          arg DataIndex: type=uint8, direction=OUT, server-argument-impl-policy=USE-ARGUMENT-TYPE
        GetErrorStatus
          arg ErrorStatus: type=NvM_RequestResultType, direction=OUT, server-argument-impl-policy=USE-ARGUMENT-TYPE
        InvalidateNvBlock
        ReadBlock
          arg DstPtr: type=dtRef_VOID, direction=IN, server-argument-impl-policy=USE-ARGUMENT-TYPE
        SetDataIndex
          arg DataIndex: type=uint8, direction=IN, server-argument-impl-policy=USE-ARGUMENT-TYPE
        SetRamBlockStatus
          arg RamBlockStatus: type=boolean, direction=IN, server-argument-impl-policy=USE-ARGUMENT-TYPE
        WriteBlock
          arg SrcPtr: type=dtRef_const_VOID, direction=IN, server-argument-impl-policy=USE-ARGUMENT-TYPE
      error E_NOT_OK: error-code=1
    NvSWC_NvMService_AC3_SRBS_DS_Defs
      9 x operation, all with possible-error=NvSWC_NvMService_AC3_SRBS_DS_Defs/E_NOT_OK:
        EraseBlock
        GetDataIndex
          arg DataIndex: type=uint8, direction=OUT, server-argument-impl-policy=USE-ARGUMENT-TYPE
        GetErrorStatus
          arg ErrorStatus: type=NvM_RequestResultType, direction=OUT, server-argument-impl-policy=USE-ARGUMENT-TYPE
        InvalidateNvBlock
        ReadBlock
          arg DstPtr: type=dtRef_VOID, direction=IN, server-argument-impl-policy=USE-ARGUMENT-TYPE
        RestoreBlockDefaults
          arg DstPtr: type=dtRef_VOID, direction=IN, server-argument-impl-policy=USE-ARGUMENT-TYPE
        SetDataIndex
          arg DataIndex: type=uint8, direction=IN, server-argument-impl-policy=USE-ARGUMENT-TYPE
        SetRamBlockStatus
          arg RamBlockStatus: type=boolean, direction=IN, server-argument-impl-policy=USE-ARGUMENT-TYPE
        WriteBlock
          arg SrcPtr: type=dtRef_const_VOID, direction=IN, server-argument-impl-policy=USE-ARGUMENT-TYPE
      error E_NOT_OK: error-code=1
    NvSWC_NvMService_SRBS
      operation GetErrorStatus: possible-error=NvSWC_NvMService_SRBS/E_NOT_OK
        arg ErrorStatus: type=NvM_RequestResultType, direction=OUT, server-argument-impl-policy=USE-ARGUMENT-TYPE
      operation SetRamBlockStatus: possible-error=NvSWC_NvMService_SRBS/E_NOT_OK
        arg RamBlockStatus: type=boolean, direction=IN, server-argument-impl-policy=USE-ARGUMENT-TYPE
      error E_NOT_OK: error-code=1
package /ModeDclrGroups
  mode declaration group DcmSessionPrecondition_Mode: category=EXPLICIT_ORDER, initial-mode=PowerON, on-transition-value=14
    14 x mode:
      HI_V1: value=3
      HI_V1_TONORM: value=11
      HI_V2: value=5
      HI_V2_TONORM: value=12
      HI_VTEMP_TONORM: value=10
      HI_Vtemp: value=13
      LO_V1: value=2
      LO_V1_TONORM: value=8
      LO_V2: value=4
      LO_V2_TONORM: value=9
      LO_VTEMP_TONORM: value=7
      LO_Vtemp: value=6
      NORMV: value=1
      PowerON: value=0
package /PortInterfaces
  94 x sender receiver interface:
    Pi_Diag_Req_Func
      data Diag_Req_Func: type=Diag_Req_Func
    Pi_TSYN_OVS
      data TSYN_OVS: type=TSYN_OVS
    Pi_SSTS_MH_VS_CRC16
      data SSTS_MH_VS_CRC16: type=SSTS_MH_VS_CRC16_impdt
    Pi_TSYN_PDU
      data TSYN_PDU: type=TSYN_PDU
    Pi_TSYN_RESERVED
      data TSYN_RESERVED: type=TSYN_RESERVED
    Pi_SSTS_MH_VS_CYCLE_COUNTER
      data SSTS_MH_VS_CYCLE_COUNTER: type=SSTS_MH_VS_CYCLE_COUNTER_impdt
    Pi_TSYN_SYNCTIME_NANOSEC
      data TSYN_SYNCTIME_NANOSEC: type=TSYN_SYNCTIME_NANOSEC
    Pi_TSYN_SYNCTIME_SEC
      data TSYN_SYNCTIME_SEC: type=TSYN_SYNCTIME_SEC
    Pi_TSYN_TIMEDOMAIN
      data TSYN_TIMEDOMAIN: type=TSYN_TIMEDOMAIN
    Pi_TSYN_USERBYTE
      data TSYN_USERBYTE: type=TSYN_USERBYTE
    Pi_TSYNC_CRC
      data TSYNC_CRC: type=TSYNC_CRC
    Pi_STC_MH_001_CRC16
      data STC_MH_001_CRC16: type=STC_MH_001_CRC16_impdt
    Pi_TSYN_SGW
      data TSYN_SGW: type=TSYN_SGW
    Pi_TSYN_SEQUENCE_COUNTER
      data TSYN_SEQUENCE_COUNTER: type=TSYN_SEQUENCE_COUNTER
    Pi_STC_MH_001_CYCLE_COUNTER
      data STC_MH_001_CYCLE_COUNTER: type=STC_MH_001_CYCLE_COUNTER_impdt
    Pi_STC_MIPI1_ERR_COUNTER
      data STC_MIPI1_ERR_COUNTER: type=STC_MIPI1_ERR_COUNTER_impdt
    Pi_STC_MIPI0_ERR_COUNTER
      data STC_MIPI0_ERR_COUNTER: type=STC_MIPI0_ERR_COUNTER_impdt
    Pi_STC_MMIC0_DRIVER_ERR_COUNTER
      data STC_MMIC0_DRIVER_ERR_COUNTER: type=STC_MMIC0_DRIVER_ERR_COUNTER_impdt
    Pi_STC_MMIC0_DRIVER_ERR_FLAG1
      data STC_MMIC0_DRIVER_ERR_FLAG1: type=STC_MMIC0_DRIVER_ERR_FLAG1_impdt
    Pi_STC_MMIC_SELECT
      data STC_MMIC_SELECT: type=STC_MMIC_SELECT_impdt
    Pi_STC_MMIC0_DRIVER_ERR_FLAG2
      data STC_MMIC0_DRIVER_ERR_FLAG2: type=STC_MMIC0_DRIVER_ERR_FLAG2_impdt
    Pi_STC_MMIC0_ISM_MODULE_ERR_REG
      data STC_MMIC0_ISM_MODULE_ERR_REG: type=STC_MMIC0_ISM_MODULE_ERR_REG_impdt
    Pi_STC_MMIC0_ERR_CODE
      data STC_MMIC0_ERR_CODE: type=STC_MMIC0_ERR_CODE_impdt
    Pi_STC_MMIC0_T_K_UNUSED_7
      data STC_MMIC0_T_K_UNUSED_7: type=STC_MMIC0_T_K_UNUSED_7_impdt
    Pi_STC_MMIC1_DRIVER_ERR_COUNTER
      data STC_MMIC1_DRIVER_ERR_COUNTER: type=STC_MMIC1_DRIVER_ERR_COUNTER_impdt
    Pi_STC_MMIC0_ISM_WARN_COUNTER
      data STC_MMIC0_ISM_WARN_COUNTER: type=STC_MMIC0_ISM_WARN_COUNTER_impdt
    Pi_STC_MMIC0_ISM_ERR_COUNTER
      data STC_MMIC0_ISM_ERR_COUNTER: type=STC_MMIC0_ISM_ERR_COUNTER_impdt
    Pi_STC_MMIC1_DRIVER_ERR_FLAG1
      data STC_MMIC1_DRIVER_ERR_FLAG1: type=STC_MMIC1_DRIVER_ERR_FLAG1_impdt
    Pi_STC_MMIC1_DRIVER_ERR_FLAG2
      data STC_MMIC1_DRIVER_ERR_FLAG2: type=STC_MMIC1_DRIVER_ERR_FLAG2_impdt
    Pi_STC_MMIC1_ERR_CODE
      data STC_MMIC1_ERR_CODE: type=STC_MMIC1_ERR_CODE_impdt
    Pi_STC_MMIC1_ISM_ERR_COUNTER
      data STC_MMIC1_ISM_ERR_COUNTER: type=STC_MMIC1_ISM_ERR_COUNTER_impdt
    Pi_STC_MMIC0_ISM_ERR_STATUS_REG
      data STC_MMIC0_ISM_ERR_STATUS_REG: type=STC_MMIC0_ISM_ERR_STATUS_REG_impdt
    Pi_STC_MMIC0_ISM_WARN_REG
      data STC_MMIC0_ISM_WARN_REG: type=STC_MMIC0_ISM_WARN_REG_impdt
    Pi_STC_MMIC1_ISM_ERR_STATUS_REG
      data STC_MMIC1_ISM_ERR_STATUS_REG: type=STC_MMIC1_ISM_ERR_STATUS_REG_impdt
    Pi_STC_MMIC0_T_K_UNUSED_6
      data STC_MMIC0_T_K_UNUSED_6: type=STC_MMIC0_T_K_UNUSED_6_impdt
    Pi_STC_MMIC1_ISM_WARN_COUNTER
      data STC_MMIC1_ISM_WARN_COUNTER: type=STC_MMIC1_ISM_WARN_COUNTER_impdt
    Pi_STC_MMIC1_ISM_MODULE_ERR_REG
      data STC_MMIC1_ISM_MODULE_ERR_REG: type=STC_MMIC1_ISM_MODULE_ERR_REG_impdt
    Pi_STS_MH_002_CRC16
      data STS_MH_002_CRC16: type=STS_MH_002_CRC16_impdt
    Pi_STC_MMIC1_ISM_WARN_REG
      data STC_MMIC1_ISM_WARN_REG: type=STC_MMIC1_ISM_WARN_REG_impdt
    Pi_STS_MMIC_MAX_TEMP
      data STS_MMIC_MAX_TEMP: type=STS_MMIC_MAX_TEMP_impdt
    Pi_STS_MH_002_CYCLE_COUNTER
      data STS_MH_002_CYCLE_COUNTER: type=STS_MH_002_CYCLE_COUNTER_impdt
    Pi_STC_MMIC1_T_K_UNUSED_6
      data STC_MMIC1_T_K_UNUSED_6: type=STC_MMIC1_T_K_UNUSED_6_impdt
    Pi_STS_MMIC_SELECT
      data STS_MMIC_SELECT: type=STS_MMIC_SELECT_impdt
    Pi_STS_MH_003_CRC16
      data STS_MH_003_CRC16: type=STS_MH_003_CRC16_impdt
    Pi_STC_MMIC1_T_K_UNUSED_7
      data STC_MMIC1_T_K_UNUSED_7: type=STC_MMIC1_T_K_UNUSED_7_impdt
    Pi_STS_MMIC0_TEMP_CHIRP
      data STS_MMIC0_TEMP_CHIRP: type=STS_MMIC0_TEMP_CHIRP_impdt
    Pi_STS_MH_003_CYCLE_COUNTER
      data STS_MH_003_CYCLE_COUNTER: type=STS_MH_003_CYCLE_COUNTER_impdt
    Pi_STS_MMIC0_TEMP_TX1
      data STS_MMIC0_TEMP_TX1: type=STS_MMIC0_TEMP_TX1_impdt
    Pi_STS_MMIC0_TEMP_TX2
      data STS_MMIC0_TEMP_TX2: type=STS_MMIC0_TEMP_TX2_impdt
    Pi_STS_MMIC0_TEMP_TX3
      data STS_MMIC0_TEMP_TX3: type=STS_MMIC0_TEMP_TX3_impdt
    Pi_STS_MMIC1_TEMP_CHIRP
      data STS_MMIC1_TEMP_CHIRP: type=STS_MMIC1_TEMP_CHIRP_impdt
    Pi_STS_MMIC1_TEMP_TX1
      data STS_MMIC1_TEMP_TX1: type=STS_MMIC1_TEMP_TX1_impdt
    Pi_STS_PROCESSOR_Temp3
      data STS_PROCESSOR_Temp3: type=STS_PROCESSOR_Temp3_impdt
    Pi_STS_MMIC1_TEMP_TX2
      data STS_MMIC1_TEMP_TX2: type=STS_MMIC1_TEMP_TX2_impdt
    Pi_STS_MMIC1_TEMP_TX3
      data STS_MMIC1_TEMP_TX3: type=STS_MMIC1_TEMP_TX3_impdt
    Pi_STC_SCAN_INDEX
      data STC_SCAN_INDEX: type=STC_SCAN_INDEX_impdt
    Pi_STS_PROCESSOR_Temp1
      data STS_PROCESSOR_Temp1: type=STS_PROCESSOR_Temp1_impdt
    Pi_STS_BOARD_THERMISTOR
      data STS_BOARD_THERMISTOR: type=STS_BOARD_THERMISTOR_impdt
    Pi_STS_PROCESSOR_Temp2
      data STS_PROCESSOR_Temp2: type=STS_PROCESSOR_Temp2_impdt
    Pi_STS_MH_001_CRC16
      data STS_MH_001_CRC16: type=STS_MH_001_CRC16_impdt
    Pi_STS_MH_001_CYCLE_COUNTER
      data STS_MH_001_CYCLE_COUNTER: type=STS_MH_001_CYCLE_COUNTER_impdt
    Pi_Diag_Req_Phys
      data Diag_Req_Phys: type=Diag_Req_Phys
    Pi_Diag_Resp_Phys
      data Diag_Resp_Phys: type=Diag_Resp_Phys
    Pi_Customer_Domain_Faults
      data De_Customer_Domain_Faults: type=Dt_Customer_Domain_Errors
    Pi_Diag_D2H_ErrorFlags
      data De_D2H_ErrorFlags: type=Dt_D2H_ErrorFlags
    Pi_Diag_MMIC_ErrorFlags
      data De_MMIC_ErrorFlags: type=Dt_MMIC_ErrorFlags
    Pi_Platform_Battery_Tst
      data De_Platform_Battery_Tst: type=Dt_Battery_Tst_T
    Pi_PltToFltMgr_MMIC_B_Diag
      data De_PltToFltMgr_MMIC_B_Diag_T: type=Dt_PltToFltMgr_MMIC_B_Diag_T
    Pi_PltToFltMgr_Ftr_Fn_Calib_Flt_Sts
      data PltToFltMgr_Ftr_Fn_Calib_Flt_Sts: type=uint8
    Pi_PltToFltMgr_InterProcessor_Commn
      data De_PltToFltMgr_InterProcessor_Commn_T: type=Dt_PltToFltMgr_InterProcessor_Commn_T
    Pi_Radar_Blockage_Flt_Sts
      data De_Radar_Blockage_Flt_Sts: type=Dt_PltToFltMgr_Blockage_Detection_T
    Pi_PltToFltMgr_Host_Micro_Diag
      data De_PltToFltMgr_Host_Micro_Diag: type=Dt_PltToFltMgr_Host_Micro_Diag_T
    Pi_PlatformInitializationStatus
      data De_MCU_InitializationStatus: type=Dt_InitializationStatus
    Pi_RawAdc_Data_Filtered
      data De_RawAdcData: type=Dt_RawAdcDataFilt_T
    Pi_PltToFltMgr_Memory_Diagnostics
      data De_PltToFltMgr_Memory_Diagnostics: type=Dt_PltToFltMgr_Memory_Diagnostics_T
    Pi_Diag_MMIC_B_ErrorFlags
      data De_MMIC_B_ErrorFlags: type=Dt_MMIC_B_ErrorFlags
    Pi_PltToFltMgr_Micro_Temp_Fault_Status
      data De_PltToFltMgr_Micro_Temp_Fault_Status: type=Dt_PltToFltMgr_Micro_Temp_Fault_Status_T
    Pi_TR_Platfromtime
      data De_TR_Platfromtime: type=uint8
    Pi_Watchdog_Fault_Reset
      data De_Watchdog_Fault_Reset: type=uint8
    Pi_PltToFltMgr_Can_Bus_Off_Fault_Status
      data De_PltToFltMgr_Can_Bus_Off_Fault_Status: type=uint8
    Pi_PltToFltMgr_Trkr_Calib_Chksm_Flt_Sts
      data PltToFltMgr_Trkr_Calib_Chksm_Flt_Sts: type=uint8
    Pi_Radar_Interference_Flt_Sts
      data De_Radar_Interference_Flt_Sts: type=uint8
    Pi_PltToFltMgr_Mirror_Ram_Int_Flt_Sts
      data PltToFltMgr_Mirror_Ram_Int_Flt_Sts: type=uint8
    Pi_Rdr_Hw_Tst
      data De_Rdr_Hw_Tst: type=Dt_Rdr_Hw_Tst_T
    Pi_PltToFltMgr_Can_Controller_Fault_Status
      data De_PltToFltMgr_Can_Controller_Fault_Status: type=uint8
    Pi_Trkr_Calib_Chksm_Flt_Sts
      data Trkr_Calib_Chksm_Flt_Sts: type=uint8
    Pi_PltToFltMgr_Vtg_Regulator
      data De_PltToFltMgr_Vtg_Regulator_T: type=Dt_PltToFltMgr_Vtg_Regulator_T
    Pi_TR_initMCU_Fail
      data De_TR_InitMCU_fail: type=uint8
    Pi_RadarCoreStatusInterface
      data De_RadarCoreStatus: type=Dt_RadarCoreStatus
    Pi_PltToFltMgr_MMIC_A_MMIC_Diag
      data De_PltToFltMgr_MMIC_A_MMIC_Diag_T: type=Dt_PltToFltMgr_MMIC_A_MMIC_Diag_T
    Pi_Vbatt_State
      data De_Vbatt_State: type=Dt_VBattState_T
    Pi_XCP_ADC_MCU_Temp_Override
      data De_XCP_ADC_MCU_Temp_Override: type=uint8
    Pi_ModeManagerNVM_Interface
      data ModeManager_NVM: type=uint8
    Pi_RawAdc_Data_UnFiltered
      data RawAdcDataUnfiltered: type=Dt_RawAdcData_T
  client server interface Pi_FailSafe_Log_ResetReason
    operation FailSafe_Log_ResetReason
      arg reset_reason: type=Dt_ECU_ResetReasonType, direction=IN, server-argument-impl-policy=USE-ARGUMENT-TYPE
  client server interface Pi_Update_Thermal_Mon_Temps: is-service=true
    operation Read: possible-error=Pi_Update_Thermal_Mon_Temps/E_NOT_OK
      arg therm_temp_results: type=DT_Thermal_mon_mes_results_T, direction=OUT, server-argument-impl-policy=USE-ARGUMENT-TYPE
    error E_NOT_OK: error-code=1
  sender receiver interface Pi_OpModeInterface
    data De_OpModeShutdown: type=Dt_OpModeShutdown
  sender receiver interface Pi_SubState
    data De_SubState: type=Dt_SubState_T
  client server interface Pi_Get_PlatfromTime_us
    operation read
      arg instant_ustime: type=uint64, direction=OUT, server-argument-impl-policy=USE-ARGUMENT-TYPE
  sender receiver interface Pi_Analog_Channel_Count
    data De_Analog_Channel_Count: type=uint16
  sender receiver interface Pi_RadarRadiateInterface
    data De_CommandRadiate_Final: type=uint8
  sender receiver interface Pi_ECUPos_Value
    data De_ECUPos_Value: data-constr=uint8_DataConstr, type=Dt_ECUPosition_Value
  client server interface Pi_ECU_Reset
    operation ECU_Soft_Reset
  client server interface Pi_PltToFltMgr
    operation PltToFltMgr_NvM_FeeCriticalError_Diagnostics
  4 x sender receiver interface:
    Pi_Repetitive_Reset_Status
      data De_Repetitive_Reset_Status: type=uint8
    Pi_IoHwAb_VRM_State
      data De_VBattState_T: type=Dt_VBattState_T
    Pi_XCP_ForceRadiateInterface
      data De_XCPForceRadiate: type=Dt_ForceRadiate
    Pi_CustDegradation
      data De_CustDegradation: type=Dt_CustDegradation
  client server interface Pi_ThermMonTemp
    operation Read: possible-error=Pi_ThermMonTemp/E_NOT_OK
      arg temp_option: type=Dt_Therm_Mon_Temp_Opt_T, direction=IN, server-argument-impl-policy=USE-ARGUMENT-TYPE
      arg reqValue: type=DT_Thermal_Monitor_Temperatures_T, direction=OUT, server-argument-impl-policy=USE-ARGUMENT-TYPE
    error E_NOT_OK: error-code=1
    error E_OK: error-code=0
  client server interface Pi_Radar_Ctl_Look_Trigger
    operation Operation
  sender receiver interface Pi_MCU_Sensor_Count
    data De_MCU_Sensor_Count: type=uint8
  sender receiver interface Pi_CustForceRadiateInterface
    data CustForceRadiate: type=Dt_ForceRadiate
  client server interface Pi_Get_STM_TimeStamp: is-service=true
    operation Get_STM_TimeStamp
      arg arg: type=uint32, direction=OUT, server-argument-impl-policy=USE-ARGUMENT-TYPE
  client server interface Pi_Get_FloatingPinPosition: is-service=true
    operation FaultStatus
      arg Status: type=uint8, direction=OUT, server-argument-impl-policy=USE-ARGUMENT-TYPE
  sender receiver interface Pi_ID_data
    data De_ID_data: type=Dt_ID_data
  client server interface Pi_Trigger_NvM_Erase
    operation Operation
  client server interface Pi_PWMDutyCycle
    operation PWMDutyCycle
      arg DutyCycle: type=uint8, direction=IN, server-argument-impl-policy=USE-ARGUMENT-TYPE
  sender receiver interface Pi_A2H_ErrorFlags
    data De_A2H_ErrorFlags: type=Dt_A2H_ErrorFlags
  client server interface Pi_Set_DIO_LED_SRC_PULL: is-service=true
    operation Write: possible-error=Pi_Set_DIO_LED_SRC_PULL/E_NOT_OK
      arg Data: type=uint8, direction=IN, server-argument-impl-policy=USE-ARGUMENT-TYPE
    error E_NOT_OK: error-code=1
  7 x sender receiver interface:
    Pi_IsRadiateForced
      data De_IsRadiateForced: type=uint8
    Pi_ActiveFaultTable
      data De_ActiveFaultTable: type=Dt_Fault_T
    Pi_ShutdownTask
      data De_shutdownTask: type=uint8
    Pi_Appl_Get_Radar_Position
      data De_ECUPosition: type=Dt_ECUPosition
    Pi_Alignment_NvM_Data
      data Alignment_NvM_Data: type=Dt_Write_Alignment_NvM_Data_T
    Pi_platform_Time
      data De_platform_time: type=uint8
    Pi_Codding_Position_Pins_error
      data Codding_Position_Pins_error: type=uint8
  client server interface Ecu_Shutdown_Request
    operation Ecu_Shutdown_Request: possible-error=Ecu_Shutdown_Request/E_NOT_OK
      arg ShutdownTarget: type=EcuM_StateType, direction=IN, server-argument-impl-policy=USE-ARGUMENT-TYPE
      arg ReqStatus: type=Dt_Appl_ShutdownReqStatus, direction=OUT, server-argument-impl-policy=USE-ARGUMENT-TYPE
    error E_NOT_OK: error-code=1
  client server interface Pi_Get_PlatformTime_ms
    operation read
      arg instant_mstime: type=uint32, direction=OUT, server-argument-impl-policy=USE-ARGUMENT-TYPE
  11 x sender receiver interface:
    Pi_D2H_ErrorFlags
      data De_D2H_ErrorFlags: type=Dt_D2H_ErrorFlags
    Pi_Align_Write_XCP_Nvm_Record
      data Alignment_Record: type=Dt_Write_Alignment_NvM_Data_T
    Pi_TR_PlatformTime
      data De_PlatformTime: type=uint8
    Pi_ECU_Config
      data Dt_ECU_Config: type=Dt_Dataset_ECU_Config_T
    Pi_Alignment_NvM_Read_Record
      data De_Write_Alignment_NvM_Data: type=Dt_Write_Alignment_NvM_Data_T
    Pi_CPU_Load
      data De_CPU_Load: type=Dt_CPU_Load
    Pi_EcuIncompleteConfig_Status
      data De_EcuIncompleteConfig_Status: type=uint8
    Pi_Customer_SW_Version_Info
      data De_Customer_SW_Version_Info: type=Dt_Customer_SW_Version
    Pi_FailSafe_ResetReason
      data De_FailSafe_ResetReason: type=Dt_FailSafe_ResetReason_T
    Pi_FaultTestCompleteTable
      data De_FaultTestCompleteTable: type=Dt_Fault_T
    Pi_NvM_flag_status
      data Pim_write_status: type=uint8
  client server interface Pi_NvHandler_Trigger_Write
    operation NvHandler_Trigger_Write_To_NVM
      arg u8_ImmidieteWrite: type=uint8, direction=IN, server-argument-impl-policy=USE-ARGUMENT-TYPE
      arg dt_Nv_Caller_Id: type=Dt_Nv_Caller_ID, direction=IN, server-argument-impl-policy=USE-ARGUMENT-TYPE
  sender receiver interface Pi_FCCU_HW_State
    data FCCU_HW_State: data-constr=uint8_DataConstr, type=uint8
  client server interface Pi_ExtWdg_Disable
    operation Operation
  client server interface Pi_Alignment_Fault_Injection
    operation read
      arg Injection_control: type=uint8, direction=IN, server-argument-impl-policy=USE-ARGUMENT-TYPE
  sender receiver interface Pi_Forced_WDI_Disable_Diag
    data Forced_WDI_Disable: type=uint8
  client server interface Pi_ExtWdg_Enable
    operation Operation
  4 x sender receiver interface:
    Pi_Alignment_faults
      data De_Alignment_Faults: type=Dt_Alignment_Faults_T
    Pi_Frame_TimeoutStatus_Group2
      data TimeoutStatus_Group2: type=Dt_SignalTimeoutStatus_Group2_T
    Pi_RadarCapability_Faults
      data De_RadarCapability_Faults: type=Dt_RadarCapability_Faults
    Pi_Alignment_Type
      data Alignment_Type: type=Dt_AlignmentModeIn_T
  client server interface Pi_Trigger_Clear_Faults_PLT
    operation Operation
  4 x sender receiver interface:
    Pi_Alignment_flt_sts
      data De_PltToFltMgr_Alignment_Faults: type=Dt_PltToFltMgr_Alignment_Faults_T
    Pi_Alignment_Write_NvM_Data
      data Write_Alignment_NvM: type=Dt_Write_Alignment_NvM_Data_T
    Pi_RadarDiagRequestInterface
      data De_RadarDiagRequest: type=Dt_RadarDiagRequest
    Pi_Auto_Alignment_Data
      data Auto_Alignment_Data: type=Dt_Auto_Alignment_Result_T
  client server interface PostRadarProcessing_Debug
    operation Populate_Debug_Stream: possible-error=[PostRadarProcessing_Debug/E_OK, PostRadarProcessing_Debug/E_NOT_OK, PostRadarProcessing_Debug/E_OK, PostRadarProcessing_Debug/E_NOT_OK]
    error E_OK: error-code=0
    error E_NOT_OK: error-code=1
  sender receiver interface Pi_XCP_Fault_Override
    data De_XCP_Fault_Override: type=Idt_XCP_Fault_Override_T
  sender receiver interface Pi_initial_Alignment_Perform_Result
    data initial_Alignment_Perform: type=Dt_Initial_Alignment_Performance_Result_T
  client server interface PostRadarProcessing_MMIC
    operation Populate_MMIC_Stream: possible-error=[PostRadarProcessing_MMIC/E_OK, PostRadarProcessing_MMIC/E_NOT_OK, PostRadarProcessing_MMIC/E_OK, PostRadarProcessing_MMIC/E_NOT_OK]
    error E_OK: error-code=0
    error E_NOT_OK: error-code=1
  sender receiver interface Pi_Initial_Alignment_Result
    data Initial_Alignment_Result: type=Dt_Initial_Alignment_Result_T
  sender receiver interface Pi_RMID_Status
    data RMID_Status: type=uint8
  client server interface PostRadarProcessing_Detection
    operation Populate_Detection_Stream: possible-error=[PostRadarProcessing_Detection/E_OK, PostRadarProcessing_Detection/E_NOT_OK, PostRadarProcessing_Detection/E_OK, PostRadarProcessing_Detection/E_NOT_OK]
    error E_OK: error-code=0
    error E_NOT_OK: error-code=1
  sender receiver interface Pi_IPC_SWC_AutoAlignment
    data De_AutoAlignment: type=Dt_Alignment_NVM_T
  sender receiver interface Pi_SignalTimeout_Status
    data De_Status: type=uint8
  client server interface PostRadarProcessing_Header
    operation Populate_Header_Stream: possible-error=[PostRadarProcessing_Header/E_OK, PostRadarProcessing_Header/E_NOT_OK, PostRadarProcessing_Header/E_OK, PostRadarProcessing_Header/E_NOT_OK]
    error E_OK: error-code=0
    error E_NOT_OK: error-code=1
  sender receiver interface Pi_Snapshot_ALIGNMENT_STATUS
    data De_Snapshot_ALIGNMENT_STATUS: type=Dt_ALIGNMENT_STATUS
  sender receiver interface Pi_XCP_Alignment_Flag
    data De_XCP_Alignment_Flag: type=uint8
  client server interface PostRadarProcessing_RDD
    operation Populate_RDD_Stream: possible-error=[PostRadarProcessing_RDD/E_OK, PostRadarProcessing_RDD/E_NOT_OK, PostRadarProcessing_RDD/E_OK, PostRadarProcessing_RDD/E_NOT_OK]
    error E_OK: error-code=0
    error E_NOT_OK: error-code=1
  sender receiver interface Pi_Snapshot_Received_signal
    data De_SnapshotReceivedSignal: type=Dt_Snapshot_received_signal_T
  client server interface PostRadarProcessing_Radar_Capability
    operation Populate_Radar_Capability_Stream: possible-error=[PostRadarProcessing_Radar_Capability/E_OK, PostRadarProcessing_Radar_Capability/E_NOT_OK, PostRadarProcessing_Radar_Capability/E_OK, PostRadarProcessing_Radar_Capability/E_NOT_OK]
    error E_OK: error-code=0
    error E_NOT_OK: error-code=1
  client server interface PostRadarProcessing_Status
    operation Populate_Status_Stream: possible-error=[PostRadarProcessing_Status/E_OK, PostRadarProcessing_Status/E_NOT_OK, PostRadarProcessing_Status/E_OK, PostRadarProcessing_Status/E_NOT_OK]
    error E_OK: error-code=0
    error E_NOT_OK: error-code=1
  4 x sender receiver interface:
    Pi_SPI_Failure_Failt
      data SPI_Failure_Fault: type=uint8
    Pi_Fault_name_For_FHTI_Testing
      data De_Fault_name_FHTI: type=Dt_Fault_name_FHTI
    Pi_Internal_Wdg_Fail_Status
      data Internal_Wdg_Fail_Status: type=uint8
    Pi_RADAR_SensorMisaligned
      data RADAR_SensorMisaligned: type=uint8
  client server interface Pi_FCCU_Fault_Injection
    operation Read
      arg Injection_control: type=uint8, direction=IN, server-argument-impl-policy=USE-ARGUMENT-TYPE
      arg Failure_Type: type=uint8, direction=IN, server-argument-impl-policy=USE-ARGUMENT-TYPE
  sender receiver interface Pi_Wdg_Fault_Injection_Request
    data De_Wdg_Fault_Injection_Request: type=uint8
  sender receiver interface Pi_RADAR_SensorNotAligned
    data RADAR_SensorNotAligned: type=uint8
  client server interface Pi_FailSafe_Fault_Injection
    operation Read
      arg Injection_control: type=uint8, direction=IN, server-argument-impl-policy=USE-ARGUMENT-TYPE
      arg Failure_Type: type=uint8, direction=IN, server-argument-impl-policy=USE-ARGUMENT-TYPE
  client server interface Pi_IPC_Fault_Injection
    operation Read
      arg Injection_control: type=uint8, direction=IN, server-argument-impl-policy=USE-ARGUMENT-TYPE
      arg Failure_Type: type=uint8, direction=IN, server-argument-impl-policy=USE-ARGUMENT-TYPE
  sender receiver interface Pi_ModeManagerTestResultInterface
    data De_TR_ModeManager: type=Dt_TR_ModeManager
  4 x client server interface:
    Pi_Wdg_Disable
      operation Read
        arg Wdg_Type: type=Dt_Wdg_Type, direction=IN, server-argument-impl-policy=USE-ARGUMENT-TYPE
    Pi_MCU_Safety_Fault_Injection
      operation Read
        arg Injection_control: type=uint8, direction=IN, server-argument-impl-policy=USE-ARGUMENT-TYPE
        arg Failure_Type: type=uint8, direction=IN, server-argument-impl-policy=USE-ARGUMENT-TYPE
    Pi_PlatformTime_Fault_Injection
      operation Read
        arg Injection_control: type=uint8, direction=IN, server-argument-impl-policy=USE-ARGUMENT-TYPE
        arg Failure_Type: type=uint8, direction=IN, server-argument-impl-policy=USE-ARGUMENT-TYPE
    Pi_Radar_control_Fault_Injection
      operation Read
        arg Injection_control: type=uint8, direction=IN, server-argument-impl-policy=USE-ARGUMENT-TYPE
        arg Failure_Type: type=uint8, direction=IN, server-argument-impl-policy=USE-ARGUMENT-TYPE
  sender receiver interface Pi_Board_Revision
    data De_Board_Revision: type=uint8
  client server interface Pi_plt_time_register_set
    operation fault_type
      arg fault_type: type=uint8, direction=IN, server-argument-impl-policy=USE-ARGUMENT-TYPE
  5 x sender receiver interface:
    Pi_BoardRevision_Xcp
      data De_BoardRevision_Xcp: type=uint8
    Pi_IPC_Faults
      data De_IPC_Faults: type=Dt_IPC_Faults
    Pi_Time_Stamp
      data De_StbM_TimeStampType: type=StbM_TimeStampType
    Pi_Dinamo_Enable_Flag
      data De_Dinamo_Enable_Flag: type=uint8
    Pi_EcuSync_Offset_ms
      data De_EcuSync_Offset_ms: type=float32
  client server interface Pi_Get_Platform_Elapsed_ustime
    operation read
      arg inst_us_time: type=uint32, direction=OUT, server-argument-impl-policy=USE-ARGUMENT-TYPE
      arg start_time: type=uint64, direction=IN, server-argument-impl-policy=USE-ARGUMENT-TYPE
  sender receiver interface Pi_Diag_A2H_ErrorFlags
    data De_A2H_ErrorFlags: type=Dt_A2H_ErrorFlags
  client server interface Pi_WdgHandler_Fault_Injection
    operation Read
      arg Injection_control: type=uint8, direction=IN, server-argument-impl-policy=USE-ARGUMENT-TYPE
      arg Failure_Type: type=uint8, direction=IN, server-argument-impl-policy=USE-ARGUMENT-TYPE
  14 x sender receiver interface:
    Pi_DTC_Status
      data De_DTC_Status: type=Dt_DTC_Status_Type
    Pi_ECU_TemperatureInterface
      data ECUTemperature: type=Dt_ECUTemperature
    Pi_exception_reset_flt
      data exception_reset_flt: type=uint8
    Pi_Ftr_Fn_Calib_Flt_Sts
      data Ftr_Fn_Calib_Flt_Sts: type=uint8
    Pi_Intigrity_Status_DataSet
      data Intigrity_Status_DataSet: type=uint8
    Pi_Intigrity_Status_T
      data Dt_Intigrity_Status_T: type=uint8
    Pi_ipc_arm_host
      data ipc_arm_host: type=uint8
    Pi_ipc_dsp_host
      data ipc_dsp_host: type=uint8
    Pi_MCU_Startup_Fault_Status
      data MCU_Startup_Fault_Status: type=Dt_Mcu_Startup_Fault
    Pi_MicroTemp_Low_Deb_Reset
      data De_MicroTemp_Low_Deb_Reset: type=uint8
    Pi_ADC_Measurement_interface
      data Element: type=TR_AdcMeasurement_T
    Pi_OperationModeType
      data De_OperationMode_System: type=Dt_SystemOperationMode
    Pi_PCAN_Bus_Off_Fault_Flag
      data De_PCAN_Busoff_Fault_Flag: type=boolean
    Pi_PhysicalAdcData
      data De_PhysicalAdcData: type=Dt_AdcData_T
  mode switch interface Pi_DcmSessionPrecondition_Mode: is-service=true
    mode group De_DcmSessionPrecondition_Mode: type=DcmSessionPrecondition_Mode
  sender receiver interface Pi_TimeLeft_To_NextState
    data De_TimeLeft_To_NextState: type=uint16
  client server interface Pi_RawAdcCount: is-service=true
    operation Read: possible-error=Pi_RawAdcCount/E_NOT_OK
      arg RawAdcData: type=Dt_RawAdcData_T, direction=OUT, server-argument-impl-policy=USE-ARGUMENT-TYPE
    error E_NOT_OK: error-code=1
  trigger interface Pi_Radar_Ctl_Look_Complete
    trigger Trigger
  sender receiver interface Pi_Time_Stamp_Delta
    data De_Time_Stamp_Delta: type=Dt_Time_Stamp_Delta
  sender receiver interface Pi_STS_No_TSyn_Error
    data De_STS_No_TSyn_Error: type=Dt_STS_No_TSyn_Error
  client server interface Pi_Trigger_Clear_Faults_Operation
    operation Operation
  client server interface Pi_XCP_JTAG_Lock_Completed_State
    operation GetStatus: possible-error=Pi_XCP_JTAG_Lock_Completed_State/E_NOT_OK
      arg JTAG_PWD_Info: type=Dt_Struct_XCP_JTAG_PWD_T, direction=IN, server-argument-impl-policy=USE-ARGUMENT-TYPE
      arg JTAG_Lock_Status: type=Idt_JTAG_PWD_ReturnStatus_Enum_T, direction=OUT, server-argument-impl-policy=USE-ARGUMENT-TYPE
    error E_NOT_OK: error-code=1
  client server interface Pi_XCP_JTAG_Password
    operation Read: possible-error=[CRYPTO_E_KEY_EMPTY, CRYPTO_E_KEY_NOT_AVAILABLE, CRYPTO_E_KEY_READ_FAIL, Pi_XCP_JTAG_Password/E_NOT_OK]
      arg JTAG_PWD_Info: type=Dt_Struct_XCP_JTAG_PWD_T, direction=OUT, server-argument-impl-policy=USE-ARGUMENT-TYPE
    operation Write: possible-error=[CRYPTO_E_KEY_NOT_VALID, CRYPTO_E_KEY_WRITE_FAIL, Pi_XCP_JTAG_Password/E_NOT_OK]
      arg JTAG_PWD_Info: type=Dt_Struct_XCP_JTAG_PWD_T, direction=IN, server-argument-impl-policy=USE-ARGUMENT-TYPE
    6 x error:
      CRYPTO_E_KEY_EMPTY: error-code=13
      CRYPTO_E_KEY_NOT_AVAILABLE: error-code=8
      CRYPTO_E_KEY_NOT_VALID: error-code=9
      CRYPTO_E_KEY_READ_FAIL: error-code=6
      CRYPTO_E_KEY_WRITE_FAIL: error-code=7
      E_NOT_OK: error-code=1
  sender receiver interface Pi_ActiveFaultLatchTable
    data De_ActiveFaultLatchTable: type=Dt_Fault_T
  sender receiver interface Pi_FaultEnableTable
    data De_FaultEnableTable: type=Dt_Fault_T
  sender receiver interface Pi_HistoryFaultTable
    data De_HistoryFaultTable: type=Dt_Fault_T
  client server interface Pi_PltFCCU_TestFlashMemECCPath
    operation FCCU_TestFlashMemECCPath
      arg FLS_MemTestResult: type=uint8, direction=OUT, server-argument-impl-policy=USE-ARGUMENT-TYPE
  client server interface Pi_PltRRUFS_SafetyReq
    6 x operation:
      ECC_CacheMemory_SafetyCore_Disable
        arg ECC_CacheMemory_Status: type=Dt_PltRRUFS_SafetyReq_Status_T, direction=OUT, server-argument-impl-policy=USE-ARGUMENT-TYPE
      ECC_CacheMemory_SafetyCore_Enable
        arg ECC_CacheMemory_Status: type=Dt_PltRRUFS_SafetyReq_Status_T, direction=OUT, server-argument-impl-policy=USE-ARGUMENT-TYPE
      ECC_CacheMemory_SafetyCore_Status
        arg ECC_CacheMemory_Status: type=Dt_PltRRUFS_SafetyReq_Status_T, direction=OUT, server-argument-impl-policy=USE-ARGUMENT-TYPE
      ECC_FlashMemory_Fault_Report_Check
        arg ECC_FlashMemory_Status: type=Dt_PltRRUFS_SafetyReq_Status_T, direction=OUT, server-argument-impl-policy=USE-ARGUMENT-TYPE
      RCCU_CheckerCore_Status
        arg CheckerCore_Status: type=Dt_PltRRUFS_SafetyReq_Status_T, direction=OUT, server-argument-impl-policy=USE-ARGUMENT-TYPE
      RRU_FS_InitTest
        arg SafetyReq_Status: type=Dt_PltRRUFS_SafetyReq_Status_T, direction=OUT, server-argument-impl-policy=USE-ARGUMENT-TYPE
  4 x sender receiver interface:
    Pi_EOUT_PinIntegrity
      data De_EOUT_PinIntegrityStat: type=uint8
    Pi_MCU_Ram_Fault_Test_Status
      data De_MCU_Ram_Fault_Test_Status: type=uint8
    Pi_Plt_timer_start_ustime
      data De_Plt_timer_start_ustime: type=uint32
    Pi_XCP_Op_Mode
      data De_XCP_Op_Mode: type=Idt_XCP_Op_Mode_T
  client server interface Pi_PCAN_Srv_EnableAppTx
    operation Operation
  client server interface Pi_PCAN_Srv_DisableAppTx
    operation Operation
  client server interface Pi_NCFFchannel_IC
    operation Read: possible-error=[Pi_NCFFchannel_IC/E_NOT_OK, Pi_NCFFchannel_IC/E_NOT_OK]
      arg NCFF_Channel: type=NCFF_Channel_Number, direction=IN, server-argument-impl-policy=USE-ARGUMENT-TYPE
      arg Injection_control: type=Injection_Control, direction=IN, server-argument-impl-policy=USE-ARGUMENT-TYPE
      arg Return: type=Return, direction=OUT, server-argument-impl-policy=USE-ARGUMENT-TYPE
    error E_NOT_OK: error-code=1
  sender receiver interface Pi_FCCU_Init_Status
    data De_Init_Status: type=uint8
  sender receiver interface Pi_FCCU_Config_State
    data FCCU_Config_State: type=uint8
  7 x client server interface:
    Pi_ethernet_platform_stop_periodic_interface_control
      operation ethernet_platform_stop_periodic_interface_control
        arg Ethernet_plt_stop_periodic: type=uint8, direction=INOUT, server-argument-impl-policy=USE-ARGUMENT-TYPE
    Pi_ethernet_project_stop_periodic_interface_control
      operation Operation
    Pi_PCAN_stop_periodic_interface_control
      operation stop_periodic_interface_control
        arg Pcan_stop_periodic: type=uint8, direction=INOUT, server-argument-impl-policy=USE-ARGUMENT-TYPE
    Pi_Trigger_Clear_Faults
      operation Operation
    Pi_XCP_Enable_Disable
      operation Status
        arg XCP_Status: type=XCP_Status_T, direction=IN, server-argument-impl-policy=USE-ARGUMENT-TYPE
    Pi_VCAN_stop_periodic_interface_control
      operation Operation
    PostRadarProcessing_XCP_Event_Trigger
      operation Trigger_Look_Based_XCP_Event: possible-error=[PostRadarProcessing_XCP_Event_Trigger/E_NOT_OK, PostRadarProcessing_XCP_Event_Trigger/E_NOT_OK, PostRadarProcessing_XCP_Event_Trigger/E_OK, PostRadarProcessing_XCP_Event_Trigger/E_OK]
      error E_NOT_OK: error-code=1
      error E_OK: error-code=0
  36 x sender receiver interface:
    Aptiv_EN_DIS_T
      data EN_DIS: type=boolean
    Pi_Application_Checksum
      data De_Application_Checksum: type=uint32
    Pi_DSP_Read_Sensitivity_Factor
      data De_DSP_Read_Sensitivity_Factor: type=uint16
    Pi_DSP_Wr_Sensitivity_Factor
      data De_DSP_Wr_Read_Sensitivity_Factor: type=uint16
    Pi_DSP_XCP_Target_Select
      data De_DSP_XCP_Target_Select: type=Idt_XCP_Target_Select_T
    Pi_Calibration_Version_Info
      data De_Calibration_Version_Info: type=Idt_Cal_Version_Info_Type
    Pi_Keep_Alive_Checksum
      data De_Keep_Alive_Checksum: type=uint32
    Pi_MMIC_Count
      data De_MMIC_Count: type=uint8
    Pi_MMIC_Temperature
      data De_MMIC_Temperature: type=Idt_Type_MMIC_Temperature
    Pi_Primary_Bootloader_Checksum
      data De_Primary_Bootloader_Checksum: type=uint32
    Pi_Radar_CMD_Radiate
      data De_Radar_CMD_Radiate: type=uint8
    Pi_Radar_Init_Status
      data De_Radar_Init_Status: type=uint8
    Pi_Radar_RFBIST_Calib_Status
      data De_Radar_RFBIST_Calib_Status: type=Idt_XCP_RFBIST_Status_T
    Pi_UDP_Logging_Enabled_Flag
      data De_UDP_Logging_Enabled_Flag: type=boolean
    Pi_USC_Checksum
      data De_USC_Checksum: type=uint32
    Pi_XCP_DID_RESP
      data De_XCP_DID_RESP: type=Dt_Xcp_Read_Write_Did_T
    Pi_XCP_Ethernet_En_Dis
      data De_XCP_Ethernet_En_Dis: type=uint8
    Pi_XCP_Fault_Injection
      data De_Xcp_Fault_Injection: type=Dt_Fault_Injection
    Pi_XCP_HIL_Mode
      data De_XCP_HIL_Mode: type=uint8
    Pi_XCP_Hw_Interface_Cntrl
      data De_Hw_Interface_Cntrl: type=Dt_XCP_Hw_Interface_Cntrl
    Pi_XCP_Itv_IPC_Event_State
      data De_ITV_EVENT: type=Dt_ITV_EVENT
    Pi_XCP_Itv_IPC_State
      data De_XCP_SIM_MODE: type=Dt_XCP_SIM_MODE
    Pi_XCP_Itv_IPC_Value_State
      data De_ITV_VALUE: type=Dt_ITV_VALUE
    Pi_XCP_LED_OP_Cntrl
      data De_XCP_LED_OP_Cntrl: type=Idt_XCP_LED_Output_Cntrl_T
    Pi_XCP_NvM_Control
      data De_XCP_NvM_Control: type=Dt_XCP_NvM_Control_T
    Pi_XCP_PCAN_En_Dis
      data De_XCP_PCAN_En_Dis: type=uint8
    Pi_XCP_Program_Mode
      data De_XCP_Program_Mode: type=boolean
    Pi_XCP_RFBIST_Calib_Trigger
      data De_XCP_RFBIST_Calib_Trigger: type=uint8
    Pi_XCP_Single_Look_Enable
      data De_XCP_Single_Look_Enable: type=Idt_XCP_Single_Look_T
    Pi_XCP_VCAN_En_Dis
      data De_XCP_VCAN_En_Dis: type=uint8
    Pi_ADC_XCP_Req: is-service=true
      data De_ADC_XCP_Req: type=uint8
    Pi_XCP_CW_Mode
      data De_XCP_CW_Mode: type=uint8
    Pi_XCP_Data_Flash_Process
      data De_Data_Flash_Process: type=Idt_XCP_Data_Flash_Process_T
    Pi_XCP_DID_CMD
      data De_XCP_DID_CMD: type=Dt_Xcp_Read_Write_Did_T
    Pi_SMC_Checksum
      data De_SMC_Checksum: type=uint32
    Pi_SW_Version_Info
      data De_SW_Version_Info: type=Idt_SW_Version_Info_T
  client server interface PostRadarProcessing_ADC
    operation Populate_ADC_Stream: possible-error=[PostRadarProcessing_ADC/E_OK, PostRadarProcessing_ADC/E_NOT_OK, PostRadarProcessing_ADC/E_OK, PostRadarProcessing_ADC/E_NOT_OK]
    error E_OK: error-code=0
    error E_NOT_OK: error-code=1
  40 x sender receiver interface:
    Pi_SSTS_MH_VS_CRC16_1
      data Vdp_SSTS_MH_VS_CRC16: type=SSTS_MH_VS_CRC16_impdt
    Pi_SSTS_MH_VS_CYCLE_COUNTER_1
      data Vdp_SSTS_MH_VS_CYCLE_COUNTER: type=SSTS_MH_VS_CYCLE_COUNTER_impdt
    Pi_Alignment_IPC_Data
      data De_Alignment_IPC_Data: type=Dt_Alignment_IPC_Data
    Pi_Alignment_M2D_Data
      data De_Alignment_M2D_Data: type=Dt_Alignment_M2D_Data
    pi_externalwdg_init_status
      data de_wdginit_status: type=uint8
    Pi_FailSafe_Verify_ResetReason
      data FailSafe_Verify_ResetReason: type=uint8
    Pi_MemExceptionInfo
      data De_MemExceptionInfo: type=Dt_Memory_Exception_Info_T
    Pi_R1_NCF_Count
      data R1_NCF_Count: type=uint16
    Pi_RFE_NvM_Data
      data De_RFE_NvM_Data: type=Dt_Rfe_REC_NREC_Fault
    Pi_RFE_Repetitive_Fault_Status
      data De_RFE_Repetitive_Fault_Status: type=uint8
    Pi_RFE_Repetitive_Reset_Status
      data De_RFE_Repetitive_Reset_Status: type=uint8
    Pi_externalwatchdogstatus
      data de_externalwatchdogstatus: type=uint8
    Pi_AL_STS_001_CYCLE_COUNTER
      data Vdp_AL_STS_001_CYCLE_COUNTER: type=AL_STS_001_CYCLE_COUNTER_impdt
    Pi_AL_STS_001_MH_CRC16
      data Vdp_AL_STS_001_MH_CRC16: type=AL_STS_001_MH_CRC16_impdt
    Pi_AL_STS_002_CYCLE_COUNTER
      data Vdp_AL_STS_002_CYCLE_COUNTER: type=AL_STS_002_CYCLE_COUNTER_impdt
    Pi_AL_STS_002_MH_CRC16
      data Vdp_AL_STS_002_MH_CRC16: type=AL_STS_002_MH_CRC16_impdt
    Pi_CAP_CYCLE_COUNTER
      data Vdp_CAP_CYCLE_COUNTER: type=CAP_CYCLE_COUNTER_impdt
    Pi_CAP_MH_CRC16
      data Vdp_CAP_MH_CRC16: type=CAP_MH_CRC16_impdt
    Pi_DET_MH_CRC16
      data Vdp_DET_MH_CRC16: type=DET_MH_CRC16_impdt
    Pi_DET_MH_CYCLE_COUNTER
      data Vdp_DET_MH_CYCLE_COUNTER: type=DET_MH_CYCLE_COUNTER_impdt
    Pi_HED_MH_002_CRC16
      data Vdp_HED_MH_002_CRC16: type=HED_MH_002_CRC16_impdt
    Pi_HED_MH_002_CYCLE_COUNTER
      data Vdp_HED_MH_002_CYCLE_COUNTER: type=HED_MH_002_CYCLE_COUNTER_impdt
    Pi_HED_MH_CRC16
      data Vdp_HED_MH_CRC16: type=HED_MH_CRC16_impdt
    Pi_HED_MH_CYCLE_COUNTER
      data Vdp_HED_MH_CYCLE_COUNTER: type=HED_MH_CYCLE_COUNTER_impdt
    Pi_OBJ_MH_CRC16
      data Vdp_OBJ_MH_CRC16: type=OBJ_MH_CRC16_impdt
    Pi_OBJ_MH_CYCLE_COUNTER
      data Vdp_OBJ_MH_CYCLE_COUNTER: type=OBJ_MH_CYCLE_COUNTER_impdt
    Pi_STS_MH_001_CRC16_1
      data Vdp_STS_MH_001_CRC16: type=STS_MH_001_CRC16_impdt
    Pi_STS_MH_001_CYCLE_COUNTER_1
      data Vdp_STS_MH_001_CYCLE_COUNTER: type=STS_MH_001_CYCLE_COUNTER_impdt
    Pi_STS_MH_002_CRC16_1
      data Vdp_STS_MH_002_CRC16: type=STS_MH_002_CRC16_impdt
    Pi_STS_MH_002_CYCLE_COUNTER_1
      data Vdp_STS_MH_002_CYCLE_COUNTER: type=STS_MH_002_CYCLE_COUNTER_impdt
    Pi_STS_MH_003_CRC16_1
      data Vdp_STS_MH_003_CRC16: type=STS_MH_003_CRC16_impdt
    Pi_STS_MH_003_CYCLE_COUNTER_1
      data Vdp_STS_MH_003_CYCLE_COUNTER: type=STS_MH_003_CYCLE_COUNTER_impdt
    Pi_SSTS_MH_VS_CRC16_2
      data Vdp_SSTS_MH_VS_CRC16: type=SSTS_MH_VS_CRC16_impdt
    Pi_SSTS_MH_VS_CYCLE_COUNTER_2
      data Vdp_SSTS_MH_VS_CYCLE_COUNTER: type=SSTS_MH_VS_CYCLE_COUNTER_impdt
    Pi_NvM_Bringup
      data Bringup_NvM_Data: type=Dt_Write_Alignment_NvM_Data_T
    Pi_AlignmentAuto
      data De_AlignmentAuto: type=Dt_AlignmentAuto
    Pi_AlignmentService
      data De_AlignmentService: type=Dt_AlignmentService
    Pi_AlignmentShortTrack
      data De_AlignmentShortTrack: type=Dt_AlignmentShortTrack
    Pi_AlignmentStatic
      data De_AlignmentStatic: type=Dt_AlignmentStatic
    Pi_Alignment_Handler
      data De_Alignment_Handler: type=Dt_Alignment_Handler
  4 x client server interface:
    Pi_External_Watchdog_Fault_Injection
      operation Read
        arg Injection_control: type=uint8, direction=IN, server-argument-impl-policy=USE-ARGUMENT-TYPE
        arg Failure_Type: type=uint8, direction=IN, server-argument-impl-policy=USE-ARGUMENT-TYPE
    Pi_Modemanager_Fault_Injection
      operation Read
        arg Injection_Control: type=uint8, direction=IN, server-argument-impl-policy=USE-ARGUMENT-TYPE
        arg Failure_Type: type=uint8, direction=IN, server-argument-impl-policy=USE-ARGUMENT-TYPE
    Pi_Diag_Fault_Injection
      operation Read
        arg Injection_Control: type=uint8, direction=IN, server-argument-impl-policy=USE-ARGUMENT-TYPE
        arg Failure_Type: type=uint8, direction=IN, server-argument-impl-policy=USE-ARGUMENT-TYPE
    Pi_Signal_Integrity_Fault_Injection
      operation Read
        arg Injection_Control: type=uint8, direction=IN, server-argument-impl-policy=USE-ARGUMENT-TYPE
        arg Failure_Type: type=uint8, direction=IN, server-argument-impl-policy=USE-ARGUMENT-TYPE
  228 x sender receiver interface:
    Pi_XCP_Set_Output_State
      data De_XCP_Set_Output: type=Dt_XCP_Set_Output
    Pi_RDR_NM_CAN_NM_State
      data Vdp_RDR_NM_CAN_NM_State: type=RDR_NM_CAN_NM_State_impdt
    Pi_RDR_NM_CBV_ActWakeBit_4
      data Vdp_RDR_NM_CBV_ActWakeBit_4: type=RDR_NM_CBV_ActWakeBit_4_impdt
    Pi_RDR_NM_CBV_NMCoordBit_3
      data Vdp_RDR_NM_CBV_NMCoordBit_3: type=RDR_NM_CBV_NMCoordBit_3_impdt
    Pi_RDR_NM_CBV_PNIBit_6
      data Vdp_RDR_NM_CBV_PNIBit_6: type=RDR_NM_CBV_PNIBit_6_impdt
    Pi_RDR_NM_CBV_ReptMsgBit0
      data Vdp_RDR_NM_CBV_ReptMsgBit0: type=RDR_NM_CBV_ReptMsgBit0_impdt
    Pi_RDR_NM_CBV_ResdBit_1
      data Vdp_RDR_NM_CBV_ResdBit_1: type=RDR_NM_CBV_ResdBit_1_impdt
    Pi_RDR_NM_CBV_ResdBit_2
      data Vdp_RDR_NM_CBV_ResdBit_2: type=RDR_NM_CBV_ResdBit_2_impdt
    Pi_RDR_NM_CBV_ResdBit_5
      data Vdp_RDR_NM_CBV_ResdBit_5: type=RDR_NM_CBV_ResdBit_5_impdt
    Pi_RDR_NM_CBV_ResdBit_7
      data Vdp_RDR_NM_CBV_ResdBit_7: type=RDR_NM_CBV_ResdBit_7_impdt
    Pi_RDR_NM_PN_User_Data
      data Vdp_RDR_NM_PN_User_Data: type=RDR_NM_PN_User_Data_impdt
    Pi_RDR_NM_PNC_Reserved1
      data Vdp_RDR_NM_PNC_Reserved1: type=RDR_NM_PNC_Reserved1_impdt
    Pi_RDR_NM_PNC_Reserved2
      data Vdp_RDR_NM_PNC_Reserved2: type=RDR_NM_PNC_Reserved2_impdt
    Pi_RDR_NM_PNC_Reserved3
      data Vdp_RDR_NM_PNC_Reserved3: type=RDR_NM_PNC_Reserved3_impdt
    Pi_RDR_NM_Wakeup_And_Reason
      data Vdp_RDR_NM_Wakeup_And_Reason: type=RDR_NM_Wakeup_And_Reason_impdt
    Pi_TSYN_OVS_1
      data Vdp_TSYN_OVS: type=TSYN_OVS_impdt
    Pi_TSYN_PDU_1
      data Vdp_TSYN_PDU: type=TSYN_PDU_impdt
    Pi_TSYN_RESERVED_1
      data Vdp_TSYN_RESERVED: type=TSYN_RESERVED_impdt
    Pi_TSYN_SEQUENCE_COUNTER_1
      data Vdp_TSYN_SEQUENCE_COUNTER: type=TSYN_SEQUENCE_COUNTER_impdt
    Pi_TSYN_SGW_1
      data Vdp_TSYN_SGW: type=TSYN_SGW_impdt
    Pi_TSYN_SYNCTIME_NANOSEC_1
      data Vdp_TSYN_SYNCTIME_NANOSEC: type=TSYN_SYNCTIME_NANOSEC_impdt
    Pi_TSYN_SYNCTIME_SEC_1
      data Vdp_TSYN_SYNCTIME_SEC: type=TSYN_SYNCTIME_SEC_impdt
    Pi_TSYN_TIMEDOMAIN_1
      data Vdp_TSYN_TIMEDOMAIN: type=TSYN_TIMEDOMAIN_impdt
    Pi_TSYN_USERBYTE_1
      data Vdp_TSYN_USERBYTE: type=TSYN_USERBYTE_impdt
    Pi_TSYNC_CRC_1
      data Vdp_TSYNC_CRC: type=TSYNC_CRC_impdt
    Pi_RDR_NM_CAN_NM_State_1
      data Vdp_RDR_NM_CAN_NM_State: type=RDR_NM_CAN_NM_State_impdt
    Pi_RDR_NM_CBV_ActWakeBit_5
      data Vdp_RDR_NM_CBV_ActWakeBit_4: type=RDR_NM_CBV_ActWakeBit_4_impdt
    Pi_RDR_NM_CBV_NMCoordBit_4
      data Vdp_RDR_NM_CBV_NMCoordBit_3: type=RDR_NM_CBV_NMCoordBit_3_impdt
    Pi_RDR_NM_CBV_PNIBit_7
      data Vdp_RDR_NM_CBV_PNIBit_6: type=RDR_NM_CBV_PNIBit_6_impdt
    Pi_RDR_NM_CBV_ReptMsgBit0_1
      data Vdp_RDR_NM_CBV_ReptMsgBit0: type=RDR_NM_CBV_ReptMsgBit0_impdt
    Pi_RDR_NM_CBV_ResdBit_3
      data Vdp_RDR_NM_CBV_ResdBit_1: type=RDR_NM_CBV_ResdBit_1_impdt
    Pi_RDR_NM_CBV_ResdBit_4
      data Vdp_RDR_NM_CBV_ResdBit_2: type=RDR_NM_CBV_ResdBit_2_impdt
    Pi_RDR_NM_CBV_ResdBit_6
      data Vdp_RDR_NM_CBV_ResdBit_5: type=RDR_NM_CBV_ResdBit_5_impdt
    Pi_RDR_NM_CBV_ResdBit_8
      data Vdp_RDR_NM_CBV_ResdBit_7: type=RDR_NM_CBV_ResdBit_7_impdt
    Pi_RDR_NM_PN_User_Data_1
      data Vdp_RDR_NM_PN_User_Data: type=RDR_NM_PN_User_Data_impdt
    Pi_RDR_NM_PNC_Reserved1_1
      data Vdp_RDR_NM_PNC_Reserved1: type=RDR_NM_PNC_Reserved1_impdt
    Pi_RDR_NM_PNC_Reserved2_1
      data Vdp_RDR_NM_PNC_Reserved2: type=RDR_NM_PNC_Reserved2_impdt
    Pi_RDR_NM_PNC_Reserved3_1
      data Vdp_RDR_NM_PNC_Reserved3: type=RDR_NM_PNC_Reserved3_impdt
    Pi_RDR_NM_Wakeup_And_Reason_1
      data Vdp_RDR_NM_Wakeup_And_Reason: type=RDR_NM_Wakeup_And_Reason_impdt
    Pi_SG_AlignmentStatus1
      data Vdp_SG_AlignmentStatus1: type=SG_AlignmentStatus1_impdt
    Pi_SG_AlignmentStatus2
      data Vdp_SG_AlignmentStatus2: type=SG_AlignmentStatus2_impdt
    Pi_SG_Detections_001_004
      data Vdp_SG_Detections_001_004: type=SG_Detections_001_004_impdt
    Pi_SG_Detections_005_008
      data Vdp_SG_Detections_005_008: type=SG_Detections_001_004_impdt
    Pi_SG_Detections_009_012
      data Vdp_SG_Detections_009_012: type=SG_Detections_001_004_impdt
    Pi_SG_Detections_013_016
      data Vdp_SG_Detections_013_016: type=SG_Detections_001_004_impdt
    Pi_SG_Detections_017_020
      data Vdp_SG_Detections_017_020: type=SG_Detections_001_004_impdt
    Pi_SG_Detections_021_024
      data Vdp_SG_Detections_021_024: type=SG_Detections_001_004_impdt
    Pi_SG_Detections_025_028
      data Vdp_SG_Detections_025_028: type=SG_Detections_001_004_impdt
    Pi_SG_Detections_029_032
      data Vdp_SG_Detections_029_032: type=SG_Detections_001_004_impdt
    Pi_SG_Detections_033_036
      data Vdp_SG_Detections_033_036: type=SG_Detections_001_004_impdt
    Pi_SG_Detections_037_040
      data Vdp_SG_Detections_037_040: type=SG_Detections_001_004_impdt
    Pi_SG_Detections_041_044
      data Vdp_SG_Detections_041_044: type=SG_Detections_001_004_impdt
    Pi_SG_Detections_045_048
      data Vdp_SG_Detections_045_048: type=SG_Detections_001_004_impdt
    Pi_SG_Detections_049_052
      data Vdp_SG_Detections_049_052: type=SG_Detections_001_004_impdt
    Pi_SG_Detections_053_056
      data Vdp_SG_Detections_053_056: type=SG_Detections_001_004_impdt
    Pi_SG_Detections_057_060
      data Vdp_SG_Detections_057_060: type=SG_Detections_001_004_impdt
    Pi_SG_Detections_061_064
      data Vdp_SG_Detections_061_064: type=SG_Detections_001_004_impdt
    Pi_SG_Detections_065_068
      data Vdp_SG_Detections_065_068: type=SG_Detections_001_004_impdt
    Pi_SG_Detections_069_072
      data Vdp_SG_Detections_069_072: type=SG_Detections_001_004_impdt
    Pi_SG_Detections_073_076
      data Vdp_SG_Detections_073_076: type=SG_Detections_001_004_impdt
    Pi_SG_Detections_077_080
      data Vdp_SG_Detections_077_080: type=SG_Detections_001_004_impdt
    Pi_SG_Detections_081_084
      data Vdp_SG_Detections_081_084: type=SG_Detections_001_004_impdt
    Pi_SG_Detections_085_088
      data Vdp_SG_Detections_085_088: type=SG_Detections_001_004_impdt
    Pi_SG_Detections_089_092
      data Vdp_SG_Detections_089_092: type=SG_Detections_001_004_impdt
    Pi_SG_Detections_093_096
      data Vdp_SG_Detections_093_096: type=SG_Detections_001_004_impdt
    Pi_SG_Detections_097_100
      data Vdp_SG_Detections_097_100: type=SG_Detections_001_004_impdt
    Pi_SG_Detections_101_104
      data Vdp_SG_Detections_101_104: type=SG_Detections_001_004_impdt
    Pi_SG_Detections_105_108
      data Vdp_SG_Detections_105_108: type=SG_Detections_001_004_impdt
    Pi_SG_Detections_109_112
      data Vdp_SG_Detections_109_112: type=SG_Detections_001_004_impdt
    Pi_SG_Detections_113_116
      data Vdp_SG_Detections_113_116: type=SG_Detections_001_004_impdt
    Pi_SG_Detections_117_120
      data Vdp_SG_Detections_117_120: type=SG_Detections_001_004_impdt
    Pi_SG_Detections_121_124
      data Vdp_SG_Detections_121_124: type=SG_Detections_001_004_impdt
    Pi_SG_Detections_125_128
      data Vdp_SG_Detections_125_128: type=SG_Detections_001_004_impdt
    Pi_SG_Detections_129_132
      data Vdp_SG_Detections_129_132: type=SG_Detections_001_004_impdt
    Pi_SG_Detections_133_136
      data Vdp_SG_Detections_133_136: type=SG_Detections_001_004_impdt
    Pi_SG_Detections_137_140
      data Vdp_SG_Detections_137_140: type=SG_Detections_001_004_impdt
    Pi_SG_Detections_141_144
      data Vdp_SG_Detections_141_144: type=SG_Detections_001_004_impdt
    Pi_SG_Detections_145_148
      data Vdp_SG_Detections_145_148: type=SG_Detections_001_004_impdt
    Pi_SG_Detections_149_152
      data Vdp_SG_Detections_149_152: type=SG_Detections_001_004_impdt
    Pi_SG_Detections_153_156
      data Vdp_SG_Detections_153_156: type=SG_Detections_001_004_impdt
    Pi_SG_Detections_157_160
      data Vdp_SG_Detections_157_160: type=SG_Detections_001_004_impdt
    Pi_SG_Detections_161_164
      data Vdp_SG_Detections_161_164: type=SG_Detections_001_004_impdt
    Pi_SG_Detections_165_168
      data Vdp_SG_Detections_165_168: type=SG_Detections_001_004_impdt
    Pi_SG_Detections_169_172
      data Vdp_SG_Detections_169_172: type=SG_Detections_001_004_impdt
    Pi_SG_Detections_173_176
      data Vdp_SG_Detections_173_176: type=SG_Detections_001_004_impdt
    Pi_SG_Detections_177_180
      data Vdp_SG_Detections_177_180: type=SG_Detections_001_004_impdt
    Pi_SG_Detections_181_184
      data Vdp_SG_Detections_181_184: type=SG_Detections_001_004_impdt
    Pi_SG_Detections_185_188
      data Vdp_SG_Detections_185_188: type=SG_Detections_001_004_impdt
    Pi_SG_Detections_189_192
      data Vdp_SG_Detections_189_192: type=SG_Detections_001_004_impdt
    Pi_SG_Detections_193_196
      data Vdp_SG_Detections_193_196: type=SG_Detections_001_004_impdt
    Pi_SG_Detections_197_200
      data Vdp_SG_Detections_197_200: type=SG_Detections_001_004_impdt
    Pi_SG_Detections_201_204
      data Vdp_SG_Detections_201_204: type=SG_Detections_001_004_impdt
    Pi_SG_Detections_205_208
      data Vdp_SG_Detections_205_208: type=SG_Detections_001_004_impdt
    Pi_SG_Detections_209_212
      data Vdp_SG_Detections_209_212: type=SG_Detections_001_004_impdt
    Pi_SG_Detections_213_216
      data Vdp_SG_Detections_213_216: type=SG_Detections_001_004_impdt
    Pi_SG_Detections_217_220
      data Vdp_SG_Detections_217_220: type=SG_Detections_001_004_impdt
    Pi_SG_Detections_221_224
      data Vdp_SG_Detections_221_224: type=SG_Detections_001_004_impdt
    Pi_SG_Detections_225_228
      data Vdp_SG_Detections_225_228: type=SG_Detections_001_004_impdt
    Pi_SG_Detections_229_232
      data Vdp_SG_Detections_229_232: type=SG_Detections_001_004_impdt
    Pi_SG_Detections_233_236
      data Vdp_SG_Detections_233_236: type=SG_Detections_001_004_impdt
    Pi_SG_Detections_237_240
      data Vdp_SG_Detections_237_240: type=SG_Detections_001_004_impdt
    Pi_SG_Detections_241_244
      data Vdp_SG_Detections_241_244: type=SG_Detections_001_004_impdt
    Pi_SG_Detections_245_248
      data Vdp_SG_Detections_245_248: type=SG_Detections_001_004_impdt
    Pi_SG_Detections_249_252
      data Vdp_SG_Detections_249_252: type=SG_Detections_001_004_impdt
    Pi_SG_Detections_253_256
      data Vdp_SG_Detections_253_256: type=SG_Detections_001_004_impdt
    Pi_SG_Detections_257_260
      data Vdp_SG_Detections_257_260: type=SG_Detections_001_004_impdt
    Pi_SG_Detections_261_264
      data Vdp_SG_Detections_261_264: type=SG_Detections_001_004_impdt
    Pi_SG_Detections_265_268
      data Vdp_SG_Detections_265_268: type=SG_Detections_001_004_impdt
    Pi_SG_Detections_269_272
      data Vdp_SG_Detections_269_272: type=SG_Detections_001_004_impdt
    Pi_SG_Detections_273_276
      data Vdp_SG_Detections_273_276: type=SG_Detections_001_004_impdt
    Pi_SG_Detections_277_280
      data Vdp_SG_Detections_277_280: type=SG_Detections_001_004_impdt
    Pi_SG_Detections_281_284
      data Vdp_SG_Detections_281_284: type=SG_Detections_001_004_impdt
    Pi_SG_Detections_285_288
      data Vdp_SG_Detections_285_288: type=SG_Detections_001_004_impdt
    Pi_SG_Detections_289_292
      data Vdp_SG_Detections_289_292: type=SG_Detections_001_004_impdt
    Pi_SG_Detections_293_296
      data Vdp_SG_Detections_293_296: type=SG_Detections_001_004_impdt
    Pi_SG_Detections_297_300
      data Vdp_SG_Detections_297_300: type=SG_Detections_001_004_impdt
    Pi_SG_Detections_301_304
      data Vdp_SG_Detections_301_304: type=SG_Detections_001_004_impdt
    Pi_SG_Detections_305_308
      data Vdp_SG_Detections_305_308: type=SG_Detections_001_004_impdt
    Pi_SG_Detections_309_312
      data Vdp_SG_Detections_309_312: type=SG_Detections_001_004_impdt
    Pi_SG_Detections_313_316
      data Vdp_SG_Detections_313_316: type=SG_Detections_001_004_impdt
    Pi_SG_Detections_317_320
      data Vdp_SG_Detections_317_320: type=SG_Detections_001_004_impdt
    Pi_SG_Detections_321_324
      data Vdp_SG_Detections_321_324: type=SG_Detections_001_004_impdt
    Pi_SG_Detections_325_328
      data Vdp_SG_Detections_325_328: type=SG_Detections_001_004_impdt
    Pi_SG_Detections_329_332
      data Vdp_SG_Detections_329_332: type=SG_Detections_001_004_impdt
    Pi_SG_Detections_333_336
      data Vdp_SG_Detections_333_336: type=SG_Detections_001_004_impdt
    Pi_SG_Detections_337_340
      data Vdp_SG_Detections_337_340: type=SG_Detections_001_004_impdt
    Pi_SG_Detections_341_344
      data Vdp_SG_Detections_341_344: type=SG_Detections_001_004_impdt
    Pi_SG_Detections_345_348
      data Vdp_SG_Detections_345_348: type=SG_Detections_001_004_impdt
    Pi_SG_Detections_349_352
      data Vdp_SG_Detections_349_352: type=SG_Detections_001_004_impdt
    Pi_SG_Detections_353_356
      data Vdp_SG_Detections_353_356: type=SG_Detections_001_004_impdt
    Pi_SG_Detections_357_360
      data Vdp_SG_Detections_357_360: type=SG_Detections_001_004_impdt
    Pi_SG_Detections_361_364
      data Vdp_SG_Detections_361_364: type=SG_Detections_001_004_impdt
    Pi_SG_Detections_365_368
      data Vdp_SG_Detections_365_368: type=SG_Detections_001_004_impdt
    Pi_SG_Detections_369_372
      data Vdp_SG_Detections_369_372: type=SG_Detections_001_004_impdt
    Pi_SG_Detections_373_376
      data Vdp_SG_Detections_373_376: type=SG_Detections_001_004_impdt
    Pi_SG_Detections_377_380
      data Vdp_SG_Detections_377_380: type=SG_Detections_001_004_impdt
    Pi_SG_Detections_381_384
      data Vdp_SG_Detections_381_384: type=SG_Detections_001_004_impdt
    Pi_SG_Detections_385_388
      data Vdp_SG_Detections_385_388: type=SG_Detections_001_004_impdt
    Pi_SG_Detections_389_392
      data Vdp_SG_Detections_389_392: type=SG_Detections_001_004_impdt
    Pi_SG_Detections_393_396
      data Vdp_SG_Detections_393_396: type=SG_Detections_001_004_impdt
    Pi_SG_Detections_397_400
      data Vdp_SG_Detections_397_400: type=SG_Detections_001_004_impdt
    Pi_SG_RadarCapability
      data Vdp_SG_RadarCapability: type=SG_RadarCapability_impdt
    Pi_SG_RadarHeader
      data Vdp_SG_RadarHeader: type=SG_RadarHeader_impdt
    Pi_SG_RadarStatus1
      data Vdp_SG_RadarStatus1: type=SG_RadarStatus1_impdt
    Pi_SG_RadarStatus2
      data Vdp_SG_RadarStatus2: type=SG_RadarStatus2_impdt
    Pi_SG_TrackerHeader
      data Vdp_SG_TrackerHeader: type=SG_TrackerHeader_impdt
    Pi_SG_TrackerObject001
      data Vdp_SG_TrackerObject001: type=SG_TrackerObject001_impdt
    Pi_SG_TrackerObject002
      data Vdp_SG_TrackerObject002: type=SG_TrackerObject001_impdt
    Pi_SG_TrackerObject003
      data Vdp_SG_TrackerObject003: type=SG_TrackerObject001_impdt
    Pi_SG_TrackerObject004
      data Vdp_SG_TrackerObject004: type=SG_TrackerObject001_impdt
    Pi_SG_TrackerObject005
      data Vdp_SG_TrackerObject005: type=SG_TrackerObject001_impdt
    Pi_SG_TrackerObject006
      data Vdp_SG_TrackerObject006: type=SG_TrackerObject001_impdt
    Pi_SG_TrackerObject007
      data Vdp_SG_TrackerObject007: type=SG_TrackerObject001_impdt
    Pi_SG_TrackerObject008
      data Vdp_SG_TrackerObject008: type=SG_TrackerObject001_impdt
    Pi_SG_TrackerObject009
      data Vdp_SG_TrackerObject009: type=SG_TrackerObject001_impdt
    Pi_SG_TrackerObject010
      data Vdp_SG_TrackerObject010: type=SG_TrackerObject001_impdt
    Pi_SG_TrackerObject011
      data Vdp_SG_TrackerObject011: type=SG_TrackerObject001_impdt
    Pi_SG_TrackerObject012
      data Vdp_SG_TrackerObject012: type=SG_TrackerObject001_impdt
    Pi_SG_TrackerObject013
      data Vdp_SG_TrackerObject013: type=SG_TrackerObject001_impdt
    Pi_SG_TrackerObject014
      data Vdp_SG_TrackerObject014: type=SG_TrackerObject001_impdt
    Pi_SG_TrackerObject015
      data Vdp_SG_TrackerObject015: type=SG_TrackerObject001_impdt
    Pi_SG_TrackerObject016
      data Vdp_SG_TrackerObject016: type=SG_TrackerObject001_impdt
    Pi_SG_TrackerObject017
      data Vdp_SG_TrackerObject017: type=SG_TrackerObject001_impdt
    Pi_SG_TrackerObject018
      data Vdp_SG_TrackerObject018: type=SG_TrackerObject001_impdt
    Pi_SG_TrackerObject019
      data Vdp_SG_TrackerObject019: type=SG_TrackerObject001_impdt
    Pi_SG_TrackerObject020
      data Vdp_SG_TrackerObject020: type=SG_TrackerObject001_impdt
    Pi_SG_TrackerObject021
      data Vdp_SG_TrackerObject021: type=SG_TrackerObject001_impdt
    Pi_SG_TrackerObject022
      data Vdp_SG_TrackerObject022: type=SG_TrackerObject001_impdt
    Pi_SG_TrackerObject023
      data Vdp_SG_TrackerObject023: type=SG_TrackerObject001_impdt
    Pi_SG_TrackerObject024
      data Vdp_SG_TrackerObject024: type=SG_TrackerObject001_impdt
    Pi_SG_TrackerObject025
      data Vdp_SG_TrackerObject025: type=SG_TrackerObject001_impdt
    Pi_SG_TrackerObject026
      data Vdp_SG_TrackerObject026: type=SG_TrackerObject001_impdt
    Pi_SG_TrackerObject027
      data Vdp_SG_TrackerObject027: type=SG_TrackerObject001_impdt
    Pi_SG_TrackerObject028
      data Vdp_SG_TrackerObject028: type=SG_TrackerObject001_impdt
    Pi_SG_TrackerObject029
      data Vdp_SG_TrackerObject029: type=SG_TrackerObject001_impdt
    Pi_SG_TrackerObject030
      data Vdp_SG_TrackerObject030: type=SG_TrackerObject001_impdt
    Pi_SG_TrackerObject031
      data Vdp_SG_TrackerObject031: type=SG_TrackerObject001_impdt
    Pi_SG_TrackerObject032
      data Vdp_SG_TrackerObject032: type=SG_TrackerObject001_impdt
    Pi_SG_TrackerObject033
      data Vdp_SG_TrackerObject033: type=SG_TrackerObject001_impdt
    Pi_SG_TrackerObject034
      data Vdp_SG_TrackerObject034: type=SG_TrackerObject001_impdt
    Pi_SG_TrackerObject035
      data Vdp_SG_TrackerObject035: type=SG_TrackerObject001_impdt
    Pi_SG_TrackerObject036
      data Vdp_SG_TrackerObject036: type=SG_TrackerObject001_impdt
    Pi_SG_TrackerObject037
      data Vdp_SG_TrackerObject037: type=SG_TrackerObject001_impdt
    Pi_SG_TrackerObject038
      data Vdp_SG_TrackerObject038: type=SG_TrackerObject001_impdt
    Pi_SG_TrackerObject039
      data Vdp_SG_TrackerObject039: type=SG_TrackerObject001_impdt
    Pi_SG_TrackerObject040
      data Vdp_SG_TrackerObject040: type=SG_TrackerObject001_impdt
    Pi_SG_TrackerObject041
      data Vdp_SG_TrackerObject041: type=SG_TrackerObject001_impdt
    Pi_SG_TrackerObject042
      data Vdp_SG_TrackerObject042: type=SG_TrackerObject001_impdt
    Pi_SG_TrackerObject043
      data Vdp_SG_TrackerObject043: type=SG_TrackerObject001_impdt
    Pi_SG_TrackerObject044
      data Vdp_SG_TrackerObject044: type=SG_TrackerObject001_impdt
    Pi_SG_TrackerObject045
      data Vdp_SG_TrackerObject045: type=SG_TrackerObject001_impdt
    Pi_SG_TrackerObject046
      data Vdp_SG_TrackerObject046: type=SG_TrackerObject001_impdt
    Pi_SG_TrackerObject047
      data Vdp_SG_TrackerObject047: type=SG_TrackerObject001_impdt
    Pi_SG_TrackerObject048
      data Vdp_SG_TrackerObject048: type=SG_TrackerObject001_impdt
    Pi_SG_TrackerObject049
      data Vdp_SG_TrackerObject049: type=SG_TrackerObject001_impdt
    Pi_SG_TrackerObject050
      data Vdp_SG_TrackerObject050: type=SG_TrackerObject001_impdt
    Pi_SG_TrackerObject051
      data Vdp_SG_TrackerObject051: type=SG_TrackerObject001_impdt
    Pi_SG_TrackerObject052
      data Vdp_SG_TrackerObject052: type=SG_TrackerObject001_impdt
    Pi_SG_TrackerObject053
      data Vdp_SG_TrackerObject053: type=SG_TrackerObject001_impdt
    Pi_SG_TrackerObject054
      data Vdp_SG_TrackerObject054: type=SG_TrackerObject001_impdt
    Pi_SG_TrackerObject055
      data Vdp_SG_TrackerObject055: type=SG_TrackerObject001_impdt
    Pi_SG_TrackerObject056
      data Vdp_SG_TrackerObject056: type=SG_TrackerObject001_impdt
    Pi_SG_TrackerObject057
      data Vdp_SG_TrackerObject057: type=SG_TrackerObject001_impdt
    Pi_SG_TrackerObject058
      data Vdp_SG_TrackerObject058: type=SG_TrackerObject001_impdt
    Pi_SG_TrackerObject059
      data Vdp_SG_TrackerObject059: type=SG_TrackerObject001_impdt
    Pi_SG_TrackerObject060
      data Vdp_SG_TrackerObject060: type=SG_TrackerObject001_impdt
    Pi_SG_TrackerObject061
      data Vdp_SG_TrackerObject061: type=SG_TrackerObject001_impdt
    Pi_SG_TrackerObject062
      data Vdp_SG_TrackerObject062: type=SG_TrackerObject001_impdt
    Pi_SG_TrackerObject063
      data Vdp_SG_TrackerObject063: type=SG_TrackerObject001_impdt
    Pi_SG_TrackerObject064
      data Vdp_SG_TrackerObject064: type=SG_TrackerObject001_impdt
    Pi_SG_TrackerStatus
      data Vdp_SG_TrackerStatus: type=SG_TrackerStatus_impdt
    Pi_SG_XcpCTOResp
      data Vdp_SG_XcpCTOResp: type=SG_XcpCTOResp_impdt
    Pi_SG_XcpDAQResp
      data Vdp_SG_XcpDAQResp: type=SG_XcpDAQResp_impdt
    Pi_SG_VehicleStatus
      data Vdp_SG_VehicleStatus: type=SG_VehicleStatus_impdt
    Pi_SG_XcpCTOReq
      data Vdp_SG_XcpCTOReq: type=SG_XcpCTOReq_impdt
    Pi_TSYN_OVS_2
      data Vdp_TSYN_OVS: type=TSYN_OVS_impdt
    Pi_TSYN_PDU_2
      data Vdp_TSYN_PDU: type=TSYN_PDU_impdt
    Pi_TSYN_RESERVED_2
      data Vdp_TSYN_RESERVED: type=TSYN_RESERVED_impdt
    Pi_TSYN_SEQUENCE_COUNTER_2
      data Vdp_TSYN_SEQUENCE_COUNTER: type=TSYN_SEQUENCE_COUNTER_impdt
    Pi_TSYN_SGW_2
      data Vdp_TSYN_SGW: type=TSYN_SGW_impdt
    Pi_TSYN_SYNCTIME_NANOSEC_2
      data Vdp_TSYN_SYNCTIME_NANOSEC: type=TSYN_SYNCTIME_NANOSEC_impdt
    Pi_TSYN_SYNCTIME_SEC_2
      data Vdp_TSYN_SYNCTIME_SEC: type=TSYN_SYNCTIME_SEC_impdt
    Pi_TSYN_TIMEDOMAIN_2
      data Vdp_TSYN_TIMEDOMAIN: type=TSYN_TIMEDOMAIN_impdt
    Pi_TSYN_USERBYTE_2
      data Vdp_TSYN_USERBYTE: type=TSYN_USERBYTE_impdt
    Pi_TSYNC_CRC_2
      data Vdp_TSYNC_CRC: type=TSYNC_CRC_impdt
    Pi_PMU_FaultB_PinIntegrity
      data De_PMU_FaultB_PinIntegrityStat: type=uint8
    Pi_Hil_Activation
      data De_Hil_Activation: type=uint8
    Pi_MPU_lock_sts
      data De_MPU_lock_sts: type=uint8
  trigger interface Pi_HIL_Periodic_Handler
    trigger Trigger
  sender receiver interface Pi_StaticRegCheckFailureInfo
    data De_StaticRegCheckFailureInfo: type=Dt_StaticRegCheckFailureInfo
  client server interface Pi_Disable_Wdg_Supervised_Entites
    operation Operation
      arg disable_SE_Flag: type=uint8, direction=IN, server-argument-impl-policy=USE-ARGUMENT-TYPE
  sender receiver interface Pi_SG_RadarStatus1_2ndCAN
    data Vdp_SG_RadarStatus1_2ndCAN: type=SG_RadarStatus1_2ndCAN_impdt
  client server interface Pi_FCRU_Fault_Injection
    operation Read
      arg Injection_control: type=uint8, direction=IN, server-argument-impl-policy=USE-ARGUMENT-TYPE
      arg Failure_Type: type=uint8, direction=IN, server-argument-impl-policy=USE-ARGUMENT-TYPE
  client server interface Pi_Failsafe_Log_ResetReason_at_Startup
    operation fcru_reset_reason
      arg reset_reason: type=uint8, direction=IN, server-argument-impl-policy=USE-ARGUMENT-TYPE
  7 x sender receiver interface:
    Pi_History_Fault_Table
      data De_HistoryFaultTable: type=Dt_Fault_T
    Pi_Fault_Test_Complete_Table
      data De_FaultTestCompleteTable: type=Dt_Fault_T
    Pi_Active_Fault_Table
      data De_ActiveFaultTable: type=Dt_Fault_T
    Pi_Active_Fault_Latch_Table
      data De_ActiveFaultLatchTable: type=Dt_Fault_T
    Pi_XCP_Phase_Rotator_Calibration
      data De_XCP_Phase_Rotator_Calibration: type=boolean
    Pi_Timesync_Status
      data De_Timesync_Status: type=uint8
    Pi_Global_Seconds
      data De_Global_Seconds_Cnt: type=uint32
  client server interface PostRadarProcessing_CAN_Tx
    operation RE_Communication_Tx: possible-error=[PostRadarProcessing_CAN_Tx/E_NOT_OK, PostRadarProcessing_CAN_Tx/E_OK]
    error E_OK: error-code=0
    error E_NOT_OK: error-code=1
  client server interface Pi_Rtm_task_measurement
    operation Operation
      arg destination: type=Dt_RTM_parameters_T, direction=OUT, server-argument-impl-policy=USE-ARGUMENT-TYPE
  222 x sender receiver interface:
    Pi_Hardware_Fault_Status
      data De_Hardware_Fault_Status: type=Dt_Hardware_Fault_Error_Status
    Pi_SG_AlignmentStatus1_AL
      data Vdp_SG_AlignmentStatus1_AL: type=Ap_SG_AlignmentStatus1_adt_AL
    Pi_SG_AlignmentStatus2_AL
      data Vdp_SG_AlignmentStatus2_AL: type=Ap_SG_AlignmentStatus2_adt_AL
    Pi_SG_Detections_001_004_AL
      data Vdp_SG_Detections_001_004_AL: type=Ap_SG_Detections_001_004_adt_AL
    Pi_SG_Detections_005_008_AL
      data Vdp_SG_Detections_005_008_AL: type=Ap_SG_Detections_005_008_adt_AL
    Pi_SG_Detections_009_012_AL
      data Vdp_SG_Detections_009_012_AL: type=Ap_SG_Detections_009_012_adt_AL
    Pi_SG_Detections_013_016_AL
      data Vdp_SG_Detections_013_016_AL: type=Ap_SG_Detections_013_016_adt_AL
    Pi_SG_Detections_017_020_AL
      data Vdp_SG_Detections_017_020_AL: type=Ap_SG_Detections_017_020_adt_AL
    Pi_SG_Detections_021_024_AL
      data Vdp_SG_Detections_021_024_AL: type=Ap_SG_Detections_021_024_adt_AL
    Pi_SG_Detections_025_028_AL
      data Vdp_SG_Detections_025_028_AL: type=Ap_SG_Detections_025_028_adt_AL
    Pi_SG_Detections_045_048_AL
      data Vdp_SG_Detections_045_048_AL: type=Ap_SG_Detections_045_048_adt_AL
    Pi_SG_Detections_029_032_AL
      data Vdp_SG_Detections_029_032_AL: type=Ap_SG_Detections_029_032_adt_AL
    Pi_SG_Detections_033_036_AL
      data Vdp_SG_Detections_033_036_AL: type=Ap_SG_Detections_033_036_adt_AL
    Pi_SG_Detections_037_040_AL
      data Vdp_SG_Detections_037_040_AL: type=Ap_SG_Detections_037_040_adt_AL
    Pi_SG_Detections_041_044_AL
      data Vdp_SG_Detections_041_044_AL: type=Ap_SG_Detections_041_044_adt_AL
    Pi_SG_Detections_097_100_AL
      data Vdp_SG_Detections_097_100_AL: type=Ap_SG_Detections_097_100_adt_AL
    Pi_SG_Detections_049_052_AL
      data Vdp_SG_Detections_049_052_AL: type=Ap_SG_Detections_049_052_adt_AL
    Pi_SG_Detections_053_056_AL
      data Vdp_SG_Detections_053_056_AL: type=Ap_SG_Detections_053_056_adt_AL
    Pi_SG_Detections_057_060_AL
      data Vdp_SG_Detections_057_060_AL: type=Ap_SG_Detections_057_060_adt_AL
    Pi_SG_Detections_061_064_AL
      data Vdp_SG_Detections_061_064_AL: type=Ap_SG_Detections_061_064_adt_AL
    Pi_SG_Detections_065_068_AL
      data Vdp_SG_Detections_065_068_AL: type=Ap_SG_Detections_065_068_adt_AL
    Pi_SG_Detections_069_072_AL
      data Vdp_SG_Detections_069_072_AL: type=Ap_SG_Detections_069_072_adt_AL
    Pi_SG_Detections_073_076_AL
      data Vdp_SG_Detections_073_076_AL: type=Ap_SG_Detections_073_076_adt_AL
    Pi_SG_Detections_077_080_AL
      data Vdp_SG_Detections_077_080_AL: type=Ap_SG_Detections_077_080_adt_AL
    Pi_SG_Detections_081_084_AL
      data Vdp_SG_Detections_081_084_AL: type=Ap_SG_Detections_081_084_adt_AL
    Pi_SG_Detections_085_088_AL
      data Vdp_SG_Detections_085_088_AL: type=Ap_SG_Detections_085_088_adt_AL
    Pi_SG_Detections_089_092_AL
      data Vdp_SG_Detections_089_092_AL: type=Ap_SG_Detections_089_092_adt_AL
    Pi_SG_Detections_093_096_AL
      data Vdp_SG_Detections_093_096_AL: type=Ap_SG_Detections_093_096_adt_AL
    Pi_SG_Detections_101_104_AL
      data Vdp_SG_Detections_101_104_AL: type=Ap_SG_Detections_101_104_adt_AL
    Pi_SG_Detections_105_108_AL
      data Vdp_SG_Detections_105_108_AL: type=Ap_SG_Detections_105_108_adt_AL
    Pi_SG_Detections_109_112_AL
      data Vdp_SG_Detections_109_112_AL: type=Ap_SG_Detections_109_112_adt_AL
    Pi_SG_Detections_113_116_AL
      data Vdp_SG_Detections_113_116_AL: type=Ap_SG_Detections_113_116_adt_AL
    Pi_SG_Detections_117_120_AL
      data Vdp_SG_Detections_117_120_AL: type=Ap_SG_Detections_117_120_adt_AL
    Pi_SG_Detections_121_124_AL
      data Vdp_SG_Detections_121_124_AL: type=Ap_SG_Detections_121_124_adt_AL
    Pi_SG_Detections_125_128_AL
      data Vdp_SG_Detections_125_128_AL: type=Ap_SG_Detections_125_128_adt_AL
    Pi_SG_Detections_129_132_AL
      data Vdp_SG_Detections_129_132_AL: type=Ap_SG_Detections_129_132_adt_AL
    Pi_SG_Detections_133_136_AL
      data Vdp_SG_Detections_133_136_AL: type=Ap_SG_Detections_133_136_adt_AL
    Pi_SG_Detections_137_140_AL
      data Vdp_SG_Detections_137_140_AL: type=Ap_SG_Detections_137_140_adt_AL
    Pi_SG_Detections_141_144_AL
      data Vdp_SG_Detections_141_144_AL: type=Ap_SG_Detections_141_144_adt_AL
    Pi_SG_Detections_145_148_AL
      data Vdp_SG_Detections_145_148_AL: type=Ap_SG_Detections_145_148_adt_AL
    Pi_SG_Detections_149_152_AL
      data Vdp_SG_Detections_149_152_AL: type=Ap_SG_Detections_149_152_adt_AL
    Pi_SG_Detections_153_156_AL
      data Vdp_SG_Detections_153_156_AL: type=Ap_SG_Detections_153_156_adt_AL
    Pi_SG_Detections_157_160_AL
      data Vdp_SG_Detections_157_160_AL: type=Ap_SG_Detections_157_160_adt_AL
    Pi_SG_Detections_161_164_AL
      data Vdp_SG_Detections_161_164_AL: type=Ap_SG_Detections_161_164_adt_AL
    Pi_SG_Detections_165_168_AL
      data Vdp_SG_Detections_165_168_AL: type=Ap_SG_Detections_165_168_adt_AL
    Pi_SG_Detections_169_172_AL
      data Vdp_SG_Detections_169_172_AL: type=Ap_SG_Detections_169_172_adt_AL
    Pi_SG_Detections_173_176_AL
      data Vdp_SG_Detections_173_176_AL: type=Ap_SG_Detections_173_176_adt_AL
    Pi_SG_Detections_177_180_AL
      data Vdp_SG_Detections_177_180_AL: type=Ap_SG_Detections_177_180_adt_AL
    Pi_SG_Detections_181_184_AL
      data Vdp_SG_Detections_181_184_AL: type=Ap_SG_Detections_181_184_adt_AL
    Pi_SG_Detections_185_188_AL
      data Vdp_SG_Detections_185_188_AL: type=Ap_SG_Detections_185_188_adt_AL
    Pi_SG_Detections_189_192_AL
      data Vdp_SG_Detections_189_192_AL: type=Ap_SG_Detections_189_192_adt_AL
    Pi_SG_Detections_193_196_AL
      data Vdp_SG_Detections_193_196_AL: type=Ap_SG_Detections_193_196_adt_AL
    Pi_SG_Detections_197_200_AL
      data Vdp_SG_Detections_197_200_AL: type=Ap_SG_Detections_197_200_adt_AL
    Pi_SG_Detections_201_204_AL
      data Vdp_SG_Detections_201_204_AL: type=Ap_SG_Detections_201_204_adt_AL
    Pi_SG_Detections_205_208_AL
      data Vdp_SG_Detections_205_208_AL: type=Ap_SG_Detections_205_208_adt_AL
    Pi_SG_Detections_209_212_AL
      data Vdp_SG_Detections_209_212_AL: type=Ap_SG_Detections_209_212_adt_AL
    Pi_SG_Detections_213_216_AL
      data Vdp_SG_Detections_213_216_AL: type=Ap_SG_Detections_213_216_adt_AL
    Pi_SG_Detections_217_220_AL
      data Vdp_SG_Detections_217_220_AL: type=Ap_SG_Detections_217_220_adt_AL
    Pi_SG_Detections_221_224_AL
      data Vdp_SG_Detections_221_224_AL: type=Ap_SG_Detections_221_224_adt_AL
    Pi_SG_Detections_225_228_AL
      data Vdp_SG_Detections_225_228_AL: type=Ap_SG_Detections_225_228_adt_AL
    Pi_SG_Detections_229_232_AL
      data Vdp_SG_Detections_229_232_AL: type=Ap_SG_Detections_229_232_adt_AL
    Pi_SG_Detections_233_236_AL
      data Vdp_SG_Detections_233_236_AL: type=Ap_SG_Detections_233_236_adt_AL
    Pi_SG_Detections_237_240_AL
      data Vdp_SG_Detections_237_240_AL: type=Ap_SG_Detections_237_240_adt_AL
    Pi_SG_Detections_241_244_AL
      data Vdp_SG_Detections_241_244_AL: type=Ap_SG_Detections_241_244_adt_AL
    Pi_SG_Detections_245_248_AL
      data Vdp_SG_Detections_245_248_AL: type=Ap_SG_Detections_245_248_adt_AL
    Pi_SG_Detections_249_252_AL
      data Vdp_SG_Detections_249_252_AL: type=Ap_SG_Detections_249_252_adt_AL
    Pi_SG_Detections_253_256_AL
      data Vdp_SG_Detections_253_256_AL: type=Ap_SG_Detections_253_256_adt_AL
    Pi_SG_Detections_257_260_AL
      data Vdp_SG_Detections_257_260_AL: type=Ap_SG_Detections_257_260_adt_AL
    Pi_SG_Detections_261_264_AL
      data Vdp_SG_Detections_261_264_AL: type=Ap_SG_Detections_261_264_adt_AL
    Pi_SG_Detections_265_268_AL
      data Vdp_SG_Detections_265_268_AL: type=Ap_SG_Detections_265_268_adt_AL
    Pi_SG_Detections_269_272_AL
      data Vdp_SG_Detections_269_272_AL: type=Ap_SG_Detections_269_272_adt_AL
    Pi_SG_Detections_273_276_AL
      data Vdp_SG_Detections_273_276_AL: type=Ap_SG_Detections_273_276_adt_AL
    Pi_SG_Detections_277_280_AL
      data Vdp_SG_Detections_277_280_AL: type=Ap_SG_Detections_277_280_adt_AL
    Pi_SG_Detections_281_284_AL
      data Vdp_SG_Detections_281_284_AL: type=Ap_SG_Detections_281_284_adt_AL
    Pi_SG_Detections_285_288_AL
      data Vdp_SG_Detections_285_288_AL: type=Ap_SG_Detections_285_288_adt_AL
    Pi_SG_Detections_289_292_AL
      data Vdp_SG_Detections_289_292_AL: type=Ap_SG_Detections_289_292_adt_AL
    Pi_SG_Detections_293_296_AL
      data Vdp_SG_Detections_293_296_AL: type=Ap_SG_Detections_293_296_adt_AL
    Pi_SG_Detections_297_300_AL
      data Vdp_SG_Detections_297_300_AL: type=Ap_SG_Detections_297_300_adt_AL
    Pi_SG_Detections_301_304_AL
      data Vdp_SG_Detections_301_304_AL: type=Ap_SG_Detections_301_304_adt_AL
    Pi_SG_Detections_305_308_AL
      data Vdp_SG_Detections_305_308_AL: type=Ap_SG_Detections_305_308_adt_AL
    Pi_SG_Detections_309_312_AL
      data Vdp_SG_Detections_309_312_AL: type=Ap_SG_Detections_309_312_adt_AL
    Pi_SG_Detections_313_316_AL
      data Vdp_SG_Detections_313_316_AL: type=Ap_SG_Detections_313_316_adt_AL
    Pi_SG_Detections_317_320_AL
      data Vdp_SG_Detections_317_320_AL: type=Ap_SG_Detections_317_320_adt_AL
    Pi_SG_Detections_321_324_AL
      data Vdp_SG_Detections_321_324_AL: type=Ap_SG_Detections_321_324_adt_AL
    Pi_SG_Detections_325_328_AL
      data Vdp_SG_Detections_325_328_AL: type=Ap_SG_Detections_325_328_adt_AL
    Pi_SG_Detections_329_332_AL
      data Vdp_SG_Detections_329_332_AL: type=Ap_SG_Detections_329_332_adt_AL
    Pi_SG_Detections_333_336_AL
      data Vdp_SG_Detections_333_336_AL: type=Ap_SG_Detections_333_336_adt_AL
    Pi_SG_Detections_337_340_AL
      data Vdp_SG_Detections_337_340_AL: type=Ap_SG_Detections_337_340_adt_AL
    Pi_SG_Detections_341_344_AL
      data Vdp_SG_Detections_341_344_AL: type=Ap_SG_Detections_341_344_adt_AL
    Pi_SG_Detections_345_348_AL
      data Vdp_SG_Detections_345_348_AL: type=Ap_SG_Detections_345_348_adt_AL
    Pi_SG_Detections_349_352_AL
      data Vdp_SG_Detections_349_352_AL: type=Ap_SG_Detections_349_352_adt_AL
    Pi_SG_Detections_353_356_AL
      data Vdp_SG_Detections_353_356_AL: type=Ap_SG_Detections_353_356_adt_AL
    Pi_SG_Detections_357_360_AL
      data Vdp_SG_Detections_357_360_AL: type=Ap_SG_Detections_357_360_adt_AL
    Pi_SG_Detections_361_364_AL
      data Vdp_SG_Detections_361_364_AL: type=Ap_SG_Detections_361_364_adt_AL
    Pi_SG_Detections_365_368_AL
      data Vdp_SG_Detections_365_368_AL: type=Ap_SG_Detections_365_368_adt_AL
    Pi_SG_Detections_369_372_AL
      data Vdp_SG_Detections_369_372_AL: type=Ap_SG_Detections_369_372_adt_AL
    Pi_SG_Detections_373_376_AL
      data Vdp_SG_Detections_373_376_AL: type=Ap_SG_Detections_373_376_adt_AL
    Pi_SG_Detections_377_380_AL
      data Vdp_SG_Detections_377_380_AL: type=Ap_SG_Detections_377_380_adt_AL
    Pi_SG_Detections_381_384_AL
      data Vdp_SG_Detections_381_384_AL: type=Ap_SG_Detections_381_384_adt_AL
    Pi_SG_Detections_385_388_AL
      data Vdp_SG_Detections_385_388_AL: type=Ap_SG_Detections_385_388_adt_AL
    Pi_SG_Detections_389_392_AL
      data Vdp_SG_Detections_389_392_AL: type=Ap_SG_Detections_389_392_adt_AL
    Pi_SG_Detections_393_396_AL
      data Vdp_SG_Detections_393_396_AL: type=Ap_SG_Detections_393_396_adt_AL
    Pi_SG_Detections_397_400_AL
      data Vdp_SG_Detections_397_400_AL: type=Ap_SG_Detections_397_400_adt_AL
    Pi_SG_Fusion_Detections_001_004_AL
      data Vdp_SG_Fusion_Detections_001_004_AL: type=Ap_SG_Fusion_Detections_001_004_adt_AL
    Pi_SG_Fusion_Detections_005_008_AL
      data Vdp_SG_Fusion_Detections_005_008_AL: type=Ap_SG_Fusion_Detections_005_008_adt_AL
    Pi_SG_Fusion_Detections_009_012_AL
      data Vdp_SG_Fusion_Detections_009_012_AL: type=Ap_SG_Fusion_Detections_009_012_adt_AL
    Pi_SG_Fusion_Detections_013_016_AL
      data Vdp_SG_Fusion_Detections_013_016_AL: type=Ap_SG_Fusion_Detections_013_016_adt_AL
    Pi_SG_Fusion_Detections_017_020_AL
      data Vdp_SG_Fusion_Detections_017_020_AL: type=Ap_SG_Fusion_Detections_017_020_adt_AL
    Pi_SG_Fusion_Detections_021_024_AL
      data Vdp_SG_Fusion_Detections_021_024_AL: type=Ap_SG_Fusion_Detections_021_024_adt_AL
    Pi_SG_Fusion_Detections_025_028_AL
      data Vdp_SG_Fusion_Detections_025_028_AL: type=Ap_SG_Fusion_Detections_025_028_adt_AL
    Pi_SG_Fusion_Detections_029_032_AL
      data Vdp_SG_Fusion_Detections_029_032_AL: type=Ap_SG_Fusion_Detections_029_032_adt_AL
    Pi_SG_Fusion_Detections_033_036_AL
      data Vdp_SG_Fusion_Detections_033_036_AL: type=Ap_SG_Fusion_Detections_033_036_adt_AL
    Pi_SG_Fusion_Detections_037_040_AL
      data Vdp_SG_Fusion_Detections_037_040_AL: type=Ap_SG_Fusion_Detections_037_040_adt_AL
    Pi_SG_Fusion_Detections_041_044_AL
      data Vdp_SG_Fusion_Detections_041_044_AL: type=Ap_SG_Fusion_Detections_041_044_adt_AL
    Pi_SG_Fusion_Detections_045_048_AL
      data Vdp_SG_Fusion_Detections_045_048_AL: type=Ap_SG_Fusion_Detections_045_048_adt_AL
    Pi_SG_Fusion_Detections_049_052_AL
      data Vdp_SG_Fusion_Detections_049_052_AL: type=Ap_SG_Fusion_Detections_049_052_adt_AL
    Pi_SG_Fusion_Detections_053_056_AL
      data Vdp_SG_Fusion_Detections_053_056_AL: type=Ap_SG_Fusion_Detections_053_056_adt_AL
    Pi_SG_Fusion_Detections_057_060_AL
      data Vdp_SG_Fusion_Detections_057_060_AL: type=Ap_SG_Fusion_Detections_057_060_adt_AL
    Pi_SG_Fusion_Detections_061_064_AL
      data Vdp_SG_Fusion_Detections_061_064_AL: type=Ap_SG_Fusion_Detections_061_064_adt_AL
    Pi_SG_Fusion_Detections_065_068_AL
      data Vdp_SG_Fusion_Detections_065_068_AL: type=Ap_SG_Fusion_Detections_065_068_adt_AL
    Pi_SG_Fusion_Detections_069_072_AL
      data Vdp_SG_Fusion_Detections_069_072_AL: type=Ap_SG_Fusion_Detections_069_072_adt_AL
    Pi_SG_Fusion_Detections_073_076_AL
      data Vdp_SG_Fusion_Detections_073_076_AL: type=Ap_SG_Fusion_Detections_073_076_adt_AL
    Pi_SG_Fusion_Detections_077_080_AL
      data Vdp_SG_Fusion_Detections_077_080_AL: type=Ap_SG_Fusion_Detections_077_080_adt_AL
    Pi_SG_Fusion_Detections_081_084_AL
      data Vdp_SG_Fusion_Detections_081_084_AL: type=Ap_SG_Fusion_Detections_081_084_adt_AL
    Pi_SG_Fusion_Detections_085_088_AL
      data Vdp_SG_Fusion_Detections_085_088_AL: type=Ap_SG_Fusion_Detections_085_088_adt_AL
    Pi_SG_Fusion_Detections_089_092_AL
      data Vdp_SG_Fusion_Detections_089_092_AL: type=Ap_SG_Fusion_Detections_089_092_adt_AL
    Pi_SG_Fusion_Detections_093_096_AL
      data Vdp_SG_Fusion_Detections_093_096_AL: type=Ap_SG_Fusion_Detections_093_096_adt_AL
    Pi_SG_Fusion_Detections_097_100_AL
      data Vdp_SG_Fusion_Detections_097_100_AL: type=Ap_SG_Fusion_Detections_097_100_adt_AL
    Pi_SG_Fusion_Detections_101_104_AL
      data Vdp_SG_Fusion_Detections_101_104_AL: type=Ap_SG_Fusion_Detections_101_104_adt_AL
    Pi_SG_Fusion_Detections_105_108_AL
      data Vdp_SG_Fusion_Detections_105_108_AL: type=Ap_SG_Fusion_Detections_105_108_adt_AL
    Pi_SG_Fusion_Detections_109_112_AL
      data Vdp_SG_Fusion_Detections_109_112_AL: type=Ap_SG_Fusion_Detections_109_112_adt_AL
    Pi_SG_Fusion_Detections_113_116_AL
      data Vdp_SG_Fusion_Detections_113_116_AL: type=Ap_SG_Fusion_Detections_113_116_adt_AL
    Pi_SG_Fusion_Detections_117_120_AL
      data Vdp_SG_Fusion_Detections_117_120_AL: type=Ap_SG_Fusion_Detections_117_120_adt_AL
    Pi_SG_Fusion_Detections_121_124_AL
      data Vdp_SG_Fusion_Detections_121_124_AL: type=Ap_SG_Fusion_Detections_121_124_adt_AL
    Pi_SG_Fusion_Detections_125_128_AL
      data Vdp_SG_Fusion_Detections_125_128_AL: type=Ap_SG_Fusion_Detections_125_128_adt_AL
    Pi_SG_Fusion_RadarHeader_AL
      data Vdp_SG_Fusion_RadarHeader_AL: type=Ap_SG_Fusion_RadarHeader_adt_AL
    Pi_SG_Fusion_RadarStatus_AL
      data Vdp_SG_Fusion_RadarStatus_AL: type=Ap_SG_Fusion_RadarStatus_adt_AL
    Pi_SG_RadarCapability_AL
      data Vdp_SG_RadarCapability_AL: type=Ap_SG_RadarCapability_adt_AL
    Pi_SG_RadarHeader_AL
      data Vdp_SG_RadarHeader_AL: type=Ap_SG_RadarHeader_adt_AL
    Pi_SG_RadarStatus1_AL
      data Vdp_SG_RadarStatus1_AL: type=Ap_SG_RadarStatus1_adt_AL
    Pi_SG_RadarStatus2_AL
      data Vdp_SG_RadarStatus2_AL: type=Ap_SG_RadarStatus2_adt_AL
    Pi_SG_VehicleStatus_AL
      data Vdp_SG_VehicleStatus_AL: type=Ap_SG_VehicleStatus_adt_AL
    Pi_SG_XcpCTOReq_AL
      data Vdp_SG_XcpCTOReq_AL: type=I_SG_XcpCTOReq_AL
    Pi_SG_XcpCTOResp_AL
      data Vdp_SG_XcpCTOResp_AL: type=I_SG_XcpCTOResp_AL
    Pi_SG_XcpDAQResp_AL
      data Vdp_SG_XcpDAQResp_AL: type=I_SG_XcpDAQResp_AL
    Pi_ECC_Correctable_Fault
      data De_ECC_Correctable_Fault: type=Dt_ECC_Correctable_Error_Counters
    Pi
    Pi_Pmic_Mcu_Com_Fault
      data De_Pmic_Mcu_Com_Fault: type=uint8
    Pi_ABS_EBSAmberWarningSignal_AL
      data Vdp_ABS_EBSAmberWarningSignal_AL: type=I_ABS_EBSAmberWarningSignal_AL
    Pi_ABSFullyOperational_AL
      data Vdp_ABSFullyOperational_AL: type=I_ABSFullyOperational_AL
    Pi_ActiveMode_AL
      data Vdp_ActiveMode_AL: type=I_ActiveMode_AL
    Pi_AEBSReadinessState_AL
      data Vdp_AEBSReadinessState_AL: type=I_AEBSReadinessState_AL
    Pi_AntiLockBrakingActive_AL
      data Vdp_AntiLockBrakingActive_AL: type=I_AntiLockBrakingActive_AL
    Pi_ASROffRoadSwitch_AL
      data Vdp_ASROffRoadSwitch_AL: type=I_ASROffRoadSwitch_AL
    Pi_ATC_ASRInformationSignal_AL
      data Vdp_ATC_ASRInformationSignal_AL: type=I_ATC_ASRInformationSignal_AL
    Pi_BrakePedalPos_AL
      data Vdp_BrakePedalPos_AL: type=Ap_BrakePedalPos_adt_AL
    Pi_BrakeSwitch_AL
      data Vdp_BrakeSwitch_AL: type=I_BrakeSwitch_AL
    Pi_BSIS_fn_Switch_Sts_AL
      data Vdp_BSIS_fn_Switch_Sts_AL: type=I_BSIS_fn_Switch_Sts_AL
    Pi_Crawler_confi_status_info_AL
      data Vdp_Crawler_confi_status_info_AL: type=I_Crawler_confi_status_info_AL
    Pi_Day_AL
      data Vdp_Day_AL: type=Ap_Day_adt_AL
    Pi_Engine_Operating_Mode_AL
      data Vdp_Engine_Operating_Mode_AL: type=I_Engine_Operating_Mode_AL
    Pi_FoundationBrakeUse_AL
      data Vdp_FoundationBrakeUse_AL: type=I_FoundationBrakeUse_AL
    Pi_FrontAxleLeftWheelSpeed_AL
      data Vdp_FrontAxleLeftWheelSpeed_AL: type=Ap_FrontAxleLeftWheelSpeed_adt_AL
    Pi_FrontAxleRightWheelSpeed_AL
      data Vdp_FrontAxleRightWheelSpeed_AL: type=Ap_FrontAxleRightWheelSpeed_adt_AL
    Pi_FrontAxleSpeed_AL
      data Vdp_FrontAxleSpeed_AL: type=Ap_FrontAxleSpeed_adt_AL
    Pi_HazardLightSwitch_AL
      data Vdp_HazardLightSwitch_AL: type=I_HazardLightSwitch_AL
    Pi_HighLowBeamSwitch_AL
      data Vdp_HighLowBeamSwitch_AL: type=I_HighLowBeamSwitch_AL
    Pi_Hours_AL
      data Vdp_Hours_AL: type=I_Hours_AL
    Pi_Ignition_AL
      data Vdp_Ignition_AL: type=I_Ignition_AL
    Pi_LateralAcceleration_AL
      data Vdp_LateralAcceleration_AL: type=Ap_LateralAcceleration_adt_AL
    Pi_LocalHourOffset_AL
      data Vdp_LocalHourOffset_AL: type=Ap_LocalHourOffset_adt_AL
    Pi_LocalMinuteOffset_AL
      data Vdp_LocalMinuteOffset_AL: type=Ap_LocalMinuteOffset_adt_AL
    Pi_LongitudinalAcceleration_AL
      data Vdp_LongitudinalAcceleration_AL: type=Ap_LongitudinalAcceleration_adt_AL
    Pi_MessageAliveCounter_AL
      data Vdp_MessageAliveCounter_AL: type=I_MessageAliveCounter_AL
    Pi_MessageChecksum_AL
      data Vdp_MessageChecksum_AL: type=I_MessageChecksum_AL
    Pi_MessageCounter_AL
      data Vdp_MessageCounter_AL: type=I_MessageCounter_AL
    Pi_MessageCRC_AL
      data Vdp_MessageCRC_AL: type=I_MessageCRC_AL
    Pi_Minutes_AL
      data Vdp_Minutes_AL: type=I_Minutes_AL
    Pi_MOIS_Fn_Switch_sts_AL
      data Vdp_MOIS_Fn_Switch_sts_AL: type=I_MOIS_Fn_Switch_sts_AL
    Pi_Month_AL
      data Vdp_Month_AL: type=I_Month_AL
    Pi_ParkingBrakeSwitch_AL
      data Vdp_ParkingBrakeSwitch_AL: type=I_ParkingBrakeSwitch_AL
    Pi_RearAxleLeftWheelSpeed_AL
      data Vdp_RearAxleLeftWheelSpeed_AL: type=Ap_RearAxleLeftWheelSpeed_adt_AL
    Pi_RearAxleRightWheelSpeed_AL
      data Vdp_RearAxleRightWheelSpeed_AL: type=Ap_RearAxleRightWheelSpeed_adt_AL
    Pi_RelativeSpeedFrontAxleLeftWheel_AL
      data Vdp_RelativeSpeedFrontAxleLeftWheel_AL: type=Ap_RelativeSpeedFrontAxleLeftWheel_adt_AL
    Pi_RelativeSpeedFrontAxleRightWheel_AL
      data Vdp_RelativeSpeedFrontAxleRightWheel_AL: type=Ap_RelativeSpeedFrontAxleRightWheel_adt_AL
    Pi_RelativeSpeedRearAxle1LeftWheel_AL
      data Vdp_RelativeSpeedRearAxle1LeftWheel_AL: type=Ap_RelativeSpeedRearAxle1LeftWheel_adt_AL
    Pi_RelativeSpeedRearAxle1RightWheel_AL
      data Vdp_RelativeSpeedRearAxle1RightWheel_AL: type=Ap_RelativeSpeedRearAxle1RightWheel_adt_AL
    Pi_ReverseSwitchInfo_AL
      data Vdp_ReverseSwitchInfo_AL: type=I_ReverseSwitchInfo_AL
    Pi_SASCalibrated_AL
      data Vdp_SASCalibrated_AL: type=I_SASCalibrated_AL
    Pi_Seconds_AL
      data Vdp_Seconds_AL: type=Ap_Seconds_adt_AL
    Pi_BendOffPrbablityofMstImportatObj_AL
      data Vdp_BendOffPrbablityofMstImportatObj_AL: type=I_BendOffPrbablityofMstImportatObj_AL
    Pi_BlindSpotCollisionWarningLevel_AL
      data Vdp_BlindSpotCollisionWarningLevel_AL: type=I_BlindSpotCollisionWarningLevel_AL
    Pi_BlindSpotDetectionState_AL
      data Vdp_BlindSpotDetectionState_AL: type=I_BlindSpotDetectionState_AL
    Pi_BlindSpotWarnigRelevantObjDetect_AL
      data Vdp_BlindSpotWarnigRelevantObjDetect_AL: type=I_BlindSpotWarnigRelevantObjDetect_AL
    Pi_CollisionWarningLevel_AL
      data Vdp_CollisionWarningLevel_AL: type=I_CollisionWarningLevel_AL
    Pi_MOIS_CollisionWarningLevel_AL
      data Vdp_MOIS_CollisionWarningLevel_AL: type=I_MOIS_CollisionWarningLevel_AL
    Pi_MovingObjectDetectionState_AL
      data Vdp_MovingObjectDetectionState_AL: type=I_MovingObjectDetectionState_AL
    Pi_ObjectDetectionState_AL
      data Vdp_ObjectDetectionState_AL: type=I_ObjectDetectionState_AL
    Pi_SteeringWheelAngle_AL
      data Vdp_SteeringWheelAngle_AL: type=Ap_SteeringWheelAngle_adt_AL
    Pi_SteeringWheelAngleRange_AL
      data Vdp_SteeringWheelAngleRange_AL: type=Ap_SteeringWheelAngleRange_adt_AL
    Pi_SteeringWheelAngleRangeCounter_AL
      data Vdp_SteeringWheelAngleRangeCounter_AL: type=Ap_SteeringWheelAngleRangeCounter_adt_AL
    Pi_SteeringWheelAngleRangeCounterType_AL
      data Vdp_SteeringWheelAngleRangeCounterType_AL: type=I_SteeringWheelAngleRangeCounterType_AL
    Pi_SteerWheelAngle_AL
      data Vdp_SteerWheelAngle_AL: type=Ap_SteerWheelAngle_adt_AL
    Pi_Total_vehicle_distance_AL
      data Vdp_Total_vehicle_distance_AL: type=Ap_Total_vehicle_distance_adt_AL
    Pi_TransCurrentGear_AL
      data Vdp_TransCurrentGear_AL: type=Ap_TransCurrentGear_adt_AL
    Pi_Transmission_type_info_AL
      data Vdp_Transmission_type_info_AL: type=I_Transmission_type_info_AL
    Pi_TransmissionDrivelineEngaged_AL
      data Vdp_TransmissionDrivelineEngaged_AL: type=I_TransmissionDrivelineEngaged_AL
    Pi_TransmissionMode1Indicator_AL
      data Vdp_TransmissionMode1Indicator_AL: type=I_TransmissionMode1Indicator_AL
    Pi_TransmissionOutputShaftSpeed_AL
      data Vdp_TransmissionOutputShaftSpeed_AL: type=Ap_TransmissionOutputShaftSpeed_adt_AL
    Pi_TransmissionShiftInProcess_AL
      data Vdp_TransmissionShiftInProcess_AL: type=I_TransmissionShiftInProcess_AL
    Pi_TurnSignalSwitch_AL
      data Vdp_TurnSignalSwitch_AL: type=I_TurnSignalSwitch_AL
    Pi_VehicleIdentification_AL
      data Vdp_VehicleIdentification_AL: type=I_VehicleIdentification_AL
    Pi_WheelBasedVehicleSpeed_AL
      data Vdp_WheelBasedVehicleSpeed_AL: type=Ap_WheelBasedVehicleSpeed_adt_AL
    Pi_XBRActiveCtrlMode_AL
      data Vdp_XBRActiveCtrlMode_AL: type=I_XBRActiveCtrlMode_AL
    Pi_XBRSystemState_AL
      data Vdp_XBRSystemState_AL: type=I_XBRSystemState_AL
    Pi_YawRate_AL
      data Vdp_YawRate_AL: type=Ap_YawRate_adt_AL
    Pi_Year_AL
      data Vdp_Year_AL: type=I_Year_AL
    Pi_WarningRelevantObjectDetected_AL
      data Vdp_WarningRelevantObjectDetected_AL: type=I_WarningRelevantObjectDetected_AL
    Pi_BendOffPrbablityofMstImportatObj_Tx
      data Vdp_BendOffPrbablityofMstImportatObj_Tx: type=I_BendOffPrbablityofMstImportatObj_Tx
    Pi_BlindSpotCollisionWarningLevel_Tx
      data Vdp_BlindSpotCollisionWarningLevel_Tx: type=I_BlindSpotCollisionWarningLevel_Tx
    Pi_BlindSpotDetectionState_Tx
      data Vdp_BlindSpotDetectionState_Tx: type=I_BlindSpotDetectionState_Tx
    Pi_BlindSpotWarnigRelevantObjDetect_Tx
      data Vdp_BlindSpotWarnigRelevantObjDetect_Tx: type=I_BlindSpotWarnigRelevantObjDetect_Tx
  5 x client server interface:
    Pi_VCAN_Srv_DisableAppTx
      operation Operation
    Pi_VCAN_Srv_EnableAppTx
      operation Operation
    Pi_Get_RepetativeReset_Faultnum
      operation Operation
        arg faultnum: type=uint8, direction=INOUT, server-argument-impl-policy=USE-ARGUMENT-TYPE
    Pi_GetError_Status
      operation Operation
        arg NvM_Error_Status: type=NvM_RequestResultType, direction=INOUT, server-argument-impl-policy=USE-ARGUMENT-TYPE
    Pi_ReadNvM_Value
      operation Operation
        arg Sensorpos_Read_Record: type=Dt_SensorPosition_Status_T, direction=INOUT, server-argument-impl-policy=USE-ARGUMENT-TYPE
  sender receiver interface Pi_NvM_lock_Unclock_Status
    data De_NvM_lock_Unclock_Status: type=Dt_SensorPosition_Data_T
  sender receiver interface Pi_PinPosition_Mismatch_Fault_Status
    data De_PinPosition_Mismatch_Fault_Status: type=uint8
  client server interface Pi_SensorPosition_Pim_Read
    operation Operation
      arg sensor_pos: type=Dt_SensorPosition_Status_T, direction=OUT, server-argument-impl-policy=USE-ARGUMENT-TYPE
  40 x sender receiver interface:
    Pi_SG_ADAS_FN_Enable_disable_sts_ALVCAN
      data Vdp_SG_ADAS_FN_Enable_disable_sts_ALVCAN: type=I_SG_ADAS_FN_Enable_disable_sts_ALVCAN
    Pi_SG_CCVS1_ALVCAN
      data Vdp_SG_CCVS1_ALVCAN: type=Ap_SG_CCVS1_adt_ALVCAN
    Pi_SG_CLS_Tx_16_ALVCAN
      data Vdp_SG_CLS_Tx_16_ALVCAN: type=I_SG_CLS_Tx_16_ALVCAN
    Pi_SG_CLS_Tx_4_ALVCAN
      data Vdp_SG_CLS_Tx_4_ALVCAN: type=I_SG_CLS_Tx_4_ALVCAN
    Pi_SG_ETC2_00_ALVCAN
      data Vdp_SG_ETC2_00_ALVCAN: type=Ap_SG_ETC2_00_adt_ALVCAN
    Pi_SG_ETC2_03_ALVCAN
      data Vdp_SG_ETC2_03_ALVCAN: type=Ap_SG_ETC2_03_adt_ALVCAN
    Pi_SG_OEL_ALVCAN
      data Vdp_SG_OEL_ALVCAN: type=I_SG_OEL_ALVCAN
    Pi_SG_SAS_ALVCAN
      data Vdp_SG_SAS_ALVCAN: type=Ap_SG_SAS_adt_ALVCAN
    Pi_SG_TD_ALVCAN
      data Vdp_SG_TD_ALVCAN: type=Ap_SG_TD_adt_ALVCAN
    Pi_SG_VD_ALVCAN
      data Vdp_SG_VD_ALVCAN: type=Ap_SG_VD_adt_ALVCAN
    Pi_SG_VDC2_ALVCAN
      data Vdp_SG_VDC2_ALVCAN: type=Ap_SG_VDC2_adt_ALVCAN
    Pi_SG_VI_ALVCAN
      data Vdp_SG_VI_ALVCAN: type=I_SG_VI_ALVCAN
    Pi_SG_Fusion_AlignmentStatus1_ALPCAN
      data Vdp_SG_Fusion_AlignmentStatus1_ALPCAN: type=Ap_SG_Fusion_AlignmentStatus1_adt_ALPCAN
    Pi_SG_Fusion_AlignmentStatus2_ALPCAN
      data Vdp_SG_Fusion_AlignmentStatus2_ALPCAN: type=Ap_SG_Fusion_AlignmentStatus2_adt_ALPCAN
    Pi_SG_Fusion_RadarCapability_ALPCAN
      data Vdp_SG_Fusion_RadarCapability_ALPCAN: type=Ap_SG_Fusion_RadarCapability_adt_ALPCAN
    Pi_SG_Fusion_RadarStatus2_ALPCAN
      data Vdp_SG_Fusion_RadarStatus2_ALPCAN: type=Ap_SG_Fusion_RadarStatus2_adt_ALPCAN
    Pi_SG_GW_ADAS_FN_Enable_disable_sts_ALPCAN
      data Vdp_SG_GW_ADAS_FN_Enable_disable_sts_ALPCAN: type=I_SG_GW_ADAS_FN_Enable_disable_sts_ALPCAN
    Pi_SG_GW_CCVS1_ALPCAN
      data Vdp_SG_GW_CCVS1_ALPCAN: type=Ap_SG_GW_CCVS1_adt_ALPCAN
    Pi_SG_GW_CLS_Tx_16_ALPCAN
      data Vdp_SG_GW_CLS_Tx_16_ALPCAN: type=I_SG_GW_CLS_Tx_16_ALPCAN
    Pi_SG_GW_CLS_Tx_4_ALPCAN
      data Vdp_SG_GW_CLS_Tx_4_ALPCAN: type=I_SG_GW_CLS_Tx_4_ALPCAN
    Pi_SG_GW_ETC2_ALPCAN
      data Vdp_SG_GW_ETC2_ALPCAN: type=Ap_SG_GW_ETC2_adt_ALPCAN
    Pi_SG_GW_OEL_ALPCAN
      data Vdp_SG_GW_OEL_ALPCAN: type=I_SG_GW_OEL_ALPCAN
    Pi_SG_GW_SAS_ALPCAN
      data Vdp_SG_GW_SAS_ALPCAN: type=Ap_SG_GW_SAS_adt_ALPCAN
    Pi_SG_GW_TD_ALPCAN
      data Vdp_SG_GW_TD_ALPCAN: type=Ap_SG_GW_TD_adt_ALPCAN
    Pi_SG_GW_VD_ALPCAN
      data Vdp_SG_GW_VD_ALPCAN: type=Ap_SG_GW_VD_adt_ALPCAN
    Pi_SG_GW_VI_ALPCAN
      data Vdp_SG_GW_VI_ALPCAN: type=I_SG_GW_VI_ALPCAN
    Pi_SG_GW_ETC2_03_ALPCAN
      data Vdp_SG_GW_ETC2_03_ALPCAN: type=Ap_SG_GW_ETC2_03_adt_ALPCAN
    Pi_SG_GW_VDC2_ALPCAN
      data Vdp_SG_GW_VDC2_ALPCAN: type=Ap_SG_GW_VDC2_adt_ALPCAN
    Pi_SG_GW_prop_ADAS_BSIS_info_ALPCAN
      data Vdp_SG_GW_prop_ADAS_BSIS_info_ALPCAN: type=I_SG_GW_prop_ADAS_BSIS_info_ALPCAN
    Pi_SG_RDR_BSD1_Tx_ALPCAN
      data Vdp_SG_RDR_BSD1_Tx_ALPCAN: type=I_SG_RDR_BSD1_Tx_ALPCAN
    Pi_SG_MOIS_ALVCAN
      data Vdp_SG_MOIS_ALVCAN: type=I_SG_MOIS_ALVCAN
    Pi_SG_prop_ADAS_MOIS_info_ALVCAN
      data Vdp_SG_prop_ADAS_MOIS_info_ALVCAN: type=I_SG_prop_ADAS_MOIS_info_ALVCAN
    Pi_SG_Fusion_RadarHeader_ALPCAN
      data Vdp_SG_Fusion_RadarHeader_ALPCAN: type=Ap_SG_Fusion_RadarHeader_adt_ALPCAN
    Pi_SG_Fusion_RadarStatus_ALPCAN
      data Vdp_SG_Fusion_RadarStatus_ALPCAN: type=Ap_SG_Fusion_RadarStatus_adt_ALPCAN
    Pi_SG_RadarHeader_ALPCAN
      data Vdp_SG_RadarHeader_ALPCAN: type=Ap_SG_RadarHeader_adt_ALPCAN
    Pi_SG_RadarStatus1_ALPCAN
      data Vdp_SG_RadarStatus1_ALPCAN: type=Ap_SG_RadarStatus1_adt_ALPCAN
    Pi_Time_Synchronization_Fault_Status
      data De_Time_Synchronization_Fault_Status: type=uint8
    Pi_Com_Rx_Pcan_Timeout_Status
      data De_Com_Rx_Timeout_Status: type=uint8
    Pi_Com_Rx_Vcan_Safety_Timeout_Status
      data De_Com_Rx_Vcan_Timeout_Status: type=uint8
    Pi_Com_Rx_Vcan_Non_Safety_Timeout_Status
      data De_Com_Rx_Vcan_Non_Safety_Timeout_Status: type=uint8
  client server interface Pi_HSE_Security_generate_seed
    operation Operation
      arg Security_level: type=uint8, direction=IN, server-argument-impl-policy=USE-ARGUMENT-TYPE
      arg Seed_Value: type=uint8, direction=OUT, server-argument-impl-policy=USE-ARGUMENT-TYPE
  client server interface Pi_HSE_Security_Compare_key
    operation Operation
      arg Security_Level: type=uint8, direction=IN, server-argument-impl-policy=USE-ARGUMENT-TYPE
      arg Encrypted_key: type=Dcm_Data16ByteType, direction=IN, server-argument-impl-policy=USE-ARGUMENT-TYPE
      arg verify_Result: type=Crypto_ResultType, direction=OUT, server-argument-impl-policy=USE-ARGUMENT-TYPE
  sender receiver interface Pi_Security_Access_Ath_Fault
    data De_Security_Access_Ath_Fault: type=uint8
  sender receiver interface Pi_Sensor_NvM_Corruption_Fault
    data De_Sensor_NvM_Corruption_Fault: type=uint8
  client server interface Pi_Get_Pinposition_Status
    operation Operation
      arg Sensor_Position: type=uint8, direction=INOUT, server-argument-impl-policy=USE-ARGUMENT-TYPE
  8 x sender receiver interface:
    Pi_Crypto_customfuntions_version
      data De_Crypto_CustomFunctions_Version: type=Crypto_CustomFunctions_VersionStruct
    Pi_StaticAlignment_NonConfig_Param
      data De_DID_StaticAlignment_NonConfig_Param_T: type=DID_StaticAlignment_NonConfig_Param_T
    Pi_Static_Alignment_Engineering_Parameters
      data De_Static_Alignment_Engineering_Parameters: type=Dt_Static_Alignment_Engineering_Parameters
    Pi_Static_Alignment_Engineering_Write_Configuration_Parameters_CRC
      data De_Static_Alignment_Engineering_Write_Configuration_Parameters_CRC: type=Dt_Static_Alignment_Engineering_Write_Configuration_Parameters_CRC
    Pi_Service_Alignment_Engineering_Non_Configuration_Parameters
      data De_Service_Alignment_Engineering_Non_Configuration_Parameters: type=Dt_Service_Alignment_Engineering_Non_Configuration_Parameters
    Pi_Service_Alignment_Result_Parameters
      data De_Service_Alignment_Result_Parameters: type=Dt_Service_Alignment_Result_Parameters
    Pi_Auto_Alignment_Status_Information
      data De_Auto_Alignment_Status_Information: type=Dt_Auto_Alignment_Status_Information
    Pi_Manual_Alignment_Execution_Data_CRC
      data De_Manual_Alignment_Execution_Data_CRC: type=Dt_Manual_Alignment_Execution_Data_CRC
  client server interface Pi_Control_DTC_Service
    operation Operation
      arg Control: type=uint8, direction=IN, server-argument-impl-policy=USE-ARGUMENT-TYPE
  sender receiver interface Pi_VSE_NVM_Params
    data De_VSE_NVM_Params: type=Dt_VSE_NVM_Params
  sender receiver interface Pi_Communication_ETE_fault
    data De_Communication_ETE_fault: type=uint8
package /Interfaces/Events
  4 x sender receiver interface:
    Interface_RDR_SW_Info_Event
      data RDR_SW_Info: type=SR_RADAR_SW_INFO_RECORD
    Interface_RDR_Status_Event
      data RDR_Status: type=SR_RADAR_STATUS_RECORD
    Interface_Vechicle_Status_Event
      data Vehicle_Status: type=SR_VEHICLE_STATUS_RECORD
    Interface_DetectionList_Event
      data DetectionList_Event: type=SR_DETECTIONS_RECORD
