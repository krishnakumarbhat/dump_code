AUTOSAR XML (schema 00050)
package /Constants
  57 x constant specification:
    C_A2H_ErrorFlags: value-spec=fields=[blockage_data_checksum:0, alignment_data_checksum:0, blockage_complete:0, TD_Blockage:0, c0_xcp_connect_status:0, C2_Calib_CKSUM_FaultError:0]
    C_VldtnToFltMgr_InterProcessor_Commn_T: value-spec=fields=[host_loss_of_commn_with_arm_flt_status:0, arm_loss_of_commn_with_host_flt_status:0, arm_loss_of_commn_with_dsp_flt_status:0, dsp_loss_of_commn_with_arm_flt_status:0, dsp_loss_of_commn_with_host_flt_status:0, host_loss_of_commn_with_dsp_flt_status:0]
    C_VldtnToFltMgr_Memory_Diagnostics_T: value-spec=fields=[stack_overflow_flt_status:0, host_ram_memory_test_flt_status:0, host_appn_flash_checksum_flt_status:0, usc_validation_flt_status:0, smc_validtn_flt_status:0, core2_calib_flash_checksum_flt_status:0, Keep_Alive_Checksum_flt_sts:0, usc_unprogrammed_flt_status:0]
    C_VldtnToFltMgr_Micro_Temp_Fault_Status_T: value-spec=fields=[TR_MCUTempLowFault:0, TR_MCUTempHighFault:0, thermistor_flt_status:0, TR_ECUTempLowFault:0, TR_ECUTempHighFault:0]
    C_VldtnToFltMgr_MMIC_A_MMIC_Diag_T: value-spec=fields=[MMIC_TX_Temperature_flt_status:0, MMIC_chirp_pll_flt_status:0, MMIC_tx0_ball_brk_flt_status:0, MMIC_tx1_ball_brk_flt_status:0, MMIC_tx2_ball_brk_flt_status:0, MMIC_tx3_ball_brk_flt_status:0, MMIC_sensor_dead_flt_status:0, MMIC_safety_intergrity_flt_status:0, MMIC_TemperatureLow_flt_Status:0, MMIC_SafeStartUp_flt_Status:0, MMIC_Transmitter_ID_Fault:0, RF_BallBreak:0, MMIC_Loop_Back_Test_flt_status:0, Data_Acquisition_flt_status:0, RFE_Freq_Monitor_flt_sts:0, RFE_Power_Level_flt_sts:0, RFE_Lock_Step_flt_sts:0, RFE_CPU_flt_sts:0, RFE_Voltage_flt_sts:0, RFE_TX_RFBIST_flt_sts:0, RFE_RX_RFBIST_flt_sts:0, MMIC_Error_Recovery_Failure_Status:0, MMIC_Id_Unprogrammed_flt_status:0, API_Look_Config_flt_sts:0, API_Look_Complete_flt_sts:0, API_Look_Trigger_flt_sts:0, MMIC_Sec_Thermal_monitoring_flt_Status:0, MMIC_Secondary_Clock_Fault_Status:0, MMIC_Secondary_MIPI_Fault_Status:0, MMIC_Secondary_Register_Fault_Status:0, MMIC_Secondary_Ball_Break_Fault_Status:0, MMIC_Secondary_MCU_Fault_Status:0]
    C_VldtnToFltMgr_MMIC_B_Diag_T: value-spec=fields=[MMIC_B_tx_id_flt_status:0, MMIC_B_mipi_adc_flt_status:0, MMIC_B_Timeout_flt_status:0, MMIC_B_safety_integtrity_pfbist_flt_status:0, MMIC_B_safe_strt_flt_status:0, MMIC_B_SafetyInt_Check_flt_sts:0, MMIC_B_SensorDead_flt_sts:0, MMIC_B_SPI_Transfer_flt_status:0]
    C_Fault_T: value-spec=16 x 0
    C_VldtnToFltMgr_Vtg_Regulator_T: value-spec=fields=[supply_5v_out_of_range_flt_status:0, supply_2_3v_out_of_range_flt_status:0, supply_1_8v_out_of_range_flt_status:0, supply_1_2_5v_out_of_range_flt_status:0, supply_1_1v_out_of_range_flt_status:0, supply_3_3v_out_of_range_flt_status:0]
    CODED_FALSE: value-spec=85
    C_RadarDiagRequest_T: value-spec=fields=[RadarDiagShutdown:85, SafetyCriticalFaultActive:85, 85]
    C_Snapshot_SupplierCode: value-spec=fields=[CurrentAlignmentAngleUsed:0, EOLAlignmentAngle:0]
    C_SignalTimeoutStatus_Group2_T: value-spec=fields=ElementConstant:0
    C_ADC_Measurementinterface_T: value-spec=fields=[TR_MCUtemp_Calflt:0, TR_onboardThermistorFault:0]
    C_Snapshot_received_signal_T: value-spec=fields=[FlashingIndicatorCommandPosition:0, Rear_Gear_Engaged:0, VehicleSpeed:0, BatteryVoltageStatus:0]
    C_RawAdcData_T: value-spec=fields=[Adc_Board_Rev:0, Adc_Batt_Volt:0, Adc_Pos_Gnd_A:0, Adc_Pos_Gnd_B:0, Adc_Pos_Gnd_C:0, Adc_Pos_Gnd_D:0, Adc_Eth_0v9:0, Adc_Rdi_Detect:0, Adc_MMIC_Temp:0, Adc_Mcu_Temp:0, Validity_Flag:85]
    C_ECUTemperature: value-spec=fields=[MCUTemperature1:0, MCUTemeperature2:0, onboardTemperature:0]
    C_XCP_Fault_Override: value-spec=fields=[action:0, byte_pos:0, bit_pos:0]
    C_Command_Radiate_Final_T: value-spec=85
    C_MCU_initlaisation_NOTCompleted_T: value-spec=0
    C_Force_Radiate_Init_T: value-spec=2
    C_CustDegradation: value-spec=fields=[RadarDiagShutdown:85, SafetyCriticalFaultActive:85]
    C_ID_data: value-spec=fields=[MCU_ID:16 x 0, Unique_ID:8 x 0]
    C_Idt_Type_MMIC_Temperature: value-spec=fields=[MMIC_TX0_Temp:0, MMIC_TX1_Temp:0, MMIC_TX2_Temp:0, MMIC_TX3_Temp:0, MMIC_RX0_Temp:0, MMIC_PVT_Temp:0, MMIC_Quad_Temp:0]
    C_OpModeShutdown_init_T: value-spec=fields=[ShutdownRequested:85, ReturnToNormalRequested:85, CustShutdownTaskCompleted:85]
    C_IsRadiateForced_T: value-spec=85
    C_MMIC_B_ErrorFlags: value-spec=fields=[MMIC_B_Transmitter_ID_Fault:0, MMIC_B_MIPI_ADC_Fault:0, MMIC_B_Timeout_Error:0, MMIC_B_safety_integtrity_pfbist_Error:0, MMIC_B_SafeStartUp_Error:0, MMIC_B_SafetyInt_Check_Error:0, MMIC_B_SensorDead_Error:0, MMIC_B_SPI_Transfer_Error:0]
    C_TR_ModeManager_T: value-spec=fields=[TR_FCCU_fault:0, TR_MCUTempCalFlt:0, TR_MCUTempHighFault:0, TR_onboardThermistorFault:0, TR_ECUTempHighFault:0, TR_PLLLockFault:0, TR_InstructionSetCheckFault:0, TR_WatchdogFault:0, TR_StackOverUnderflowFault:0, TR_ApplicationFlashChecksumFault:0, TR_FlashMemoryECCFault:0, TR_RAMMemoryTestFault:0, TR_1_1V_SupplyOutOfRangeFault:0, TR_1_25V_SupplyOutOfRangeFault:0, TR_1_8V_SupplyOutOfRangeFault:0, TR_2_3V_SupplyOutOfRangeFault:0, TR_5_0V_SupplyOutOfRangeFault:0, TR_BatteryLowFault:0, TR_BatteryHighFault:0, TR_Core1toCore0Fault:0, TR_Core1toCore2Fault:0, TR_Core2toCore0Fault:0, TR_Core2toCore1Fault:0, TR_Core0toCore1Fault:0, TR_Core0toCore2Fault:0, 0, TR_PlatformTimeFault:0]
    C_Idt_XCP_LED_Output_Cntrl_T: value-spec=fields=[xcp_led_select:0, xcp_led_state:0]
    C_K_Force_Radiate_Init_T: value-spec=85
    C_Dt_FailSafe_ResetReason_T: value-spec=fields=[reset_reason:5 x 0, reset_counter:0, last_cycle_reset:0, reset_reason_crnt_indx:0, repetitive_reset_counter:0, wdg_failed_SE_info:5 x 0, RFE_Repetitive_Reset_Counter:0, {short-label=mem_exception_reason, fields=[ExceptionType:0, ExceptionCausingAddress:0, ExceptionStatusRegister:0, IsMemException_Occured:0, MemoryExceptionAddress:0, StackPointer:0]}, FCCU_Faults:10 x 0]
    C_FailSafe_ExceptionReason_T: value-spec=fields=[exception_reason_info:[fields=[exception_type:255, coreid:255, reserved:65535, spf_regs:5 x 4294967295], fields=[exception_type:255, coreid:255, reserved:65535, spf_regs:5 x 4294967295], fields=[exception_type:255, coreid:255, reserved:65535, spf_regs:5 x 4294967295]], exception_reason_crnt_indx:255]
    C_MMIC_ErrorFlags: value-spec=fields=[temperature_max_err:0, chirp_pll_err:0, tx0_ball_brk_err:0, tx1_ball_brk_err:0, tx2_ball_brk_err:0, tx3_ball_brk_err:0, sensor_dead_err:0, safety_intergrity_err:0, MMIC_TemperatureLowFault:0, MMIC_SafeStartUp_Error:0, MMIC_Transmitter_ID_Fault:0, RF_BallBreak:0, MMIC_Loop_Back_Test_Fault:0, Data_Acquisition_err:0, RFE_Freq_Monitor_err:0, RFE_Power_Level_err:0, RFE_Lock_Step_err:0, RFE_CPU_err:0, RFE_Voltage_err:0, RFE_TX_RFBIST_err:0, RFE_RX_RFBIST_err:0, MMIC_Error_Recovery_Failure:0, MMIC_Id_Unprogrammed_Error:0, MMIC_Secondary_Clock_Fault:0, API_Look_Config_err:0, API_Look_Complete_err:0, API_Look_Trigger_err:0, MMIC_RFE_MCU_Fault:0, MMIC_RFE_Par_Redun_Fault:0, MMIC_RFE_PLL_Lock_Fault:0, MMIC_Sec_Thermal_monitoring_flt:0, MMIC_Secondary_MIPI_Fault:0, MMIC_Secondary_Register_Fault:0, MMIC_Secondary_Ball_Break_Fault:0, MMIC_Secondary_MCU_Fault:0]
    C_Initial_Alignment_Performance_Result: value-spec=fields=[MeasuredRange:0, MeasuredRangeStd:0, MeasuredRangeRate:0, MeasuredRangeRateStd:0, MeasuredAmp:0, MeasuredAmpStd:0, DistanceAbsolute:0, DistanceEffective:0, AverageNumberOfDetections:0, DurationAbsolute:0, DurationEffective:0, AverageSpeed:0, VehicleCondition:0]
    C_FailSafe_ResetReason_T: value-spec=fields=[reset_reason:5 x 0, reset_counter:0, last_cycle_reset:0, reset_reason_crnt_indx:0, repetitive_reset_counter:0, RFE_Repetitive_Reset_Counter:0, {short-label=mem_exception_reason, fields=[ExceptionType:0, ExceptionCausingAddress:0, ExceptionStatusRegister:0, IsMemException_Occured:0, MemoryExceptionAddress:0, StackPointer:0]}, wdg_failed_SE_info:5 x 0, FCCU_Faults:10 x 0, StaticRegCheckFailureInfo:35 x 0, {short-label=NOC_LatentIntFault_Info, fields=[LatentFault0:0, LatentFault1:0, LatentFault2:0, LatentFault3:0, Resnum:0]}]
    C_AutoAlignment_NvM_T: value-spec=fields=[{short-label=Alignment_Initial_NVM_Data, fields=[0, 0, 0]}, {short-label=AlignmentDyn_Initial_NVM_Data, fields=[0, 0, 0]}, {short-label=Alignment_AutoCyclic_NVM_Data, fields=[AACurrentAzimuth:0, AACurrentElevation:0]}, {short-label=Alignment_Auto_NVM_data, fields=[AzimuthUpdates:0, ElevationUpdates:0, HostScf:0]}, AlignmentModeOut:0]
    C_Auto_Alignment_Result: value-spec=fields=[StartAzimuth:0, StartElevation:0, AACurrentAzimuth:0, AACurrentElevation:0, AAAzimuthStd:0, AAElevationStd:0, AzimuthError_positiveRead:0, AzimuthError_negativeRead:0, ElevationError_positive_Read:0, ElevationError_negative_Read:0, RollError_positive_Read:0, RollError_negative:0, AlignmentAutoStatus:0, AutoAlignmentFailRootCause:0, StartRoll:0, AACurrentRoll:0, AARollStd:0]
    C_Alignment_faults: value-spec=fields=[0, Static_Calibration_error:0, Service_Calibration_error:0, ShortTrack_Calibration_error:0, Autoalign_outof_range_error:0, Autoalignment_algo_error:0, Autoalignment_critical_misalignment_error:0, Autoalignment_sudden_jump_detection_error:0]
    C_AdcData_T: value-spec=fields=[Adc_Board_Rev:0, Adc_Batt_Volt:0, Adc_Pos_Gnd_A:0, Adc_Pos_Gnd_B:0, Adc_Pos_Gnd_C:0, Adc_Pos_Gnd_D:0, Adc_Eth_0v9:0, Adc_Rdi_Detect:0, Adc_MMIC_Temp:0, Adc_Mcu_Temp:0, Validity_Flag:85]
    C_Write_Alignment_NvM_Data: value-spec=fields=[AACurrentAzimuth:0, AACurrentElevation:0, AACurrentRoll:0, 0, 0, 0, 0, ElevationUpdates:0, AzimuthUpdates:0, RollUpdates:0, 0, 0, HostSpeedCompensationFactor:0, 0, 0, AlignmentModeOut:0, azimuth_estimation_qf:0, elevation_estimation_qf:0, scf_estimation_qf:0]
    C_Battery_Tst_T: value-spec=fields=[battery_low_flt_sts:0, battery_high_flt_sts:0]
    C_Initial_Alignment_Result: value-spec=fields=[AlignmentAzimuth:0, AlignmentElevation:0, AzimuthStd:0, ElevationStd:0, CalTime:0, AlignmentStaticStatus:0, AlignmentServiceStatus:0, AlignmentShortTrackStatus:0, ProgressPercent:0, AlignmentError:0, AlignmentRoll:0, RollStd:0]
    C_Customer_Domain_Faults: value-spec=fields=[Keep_Alive_Checksum_Error:0, PCAN_BussOff_Error:0]
    C_RadarCapability: value-spec=fields=[SLL_Fault:0, Range_Estimation_Fault:0, Blockage_Fault:0, Damping_Estimation_Fault:0, SPT_Fault:0, Safety_Integrity_Fault:0, Core_Self_Test_Fault:0, Detection_Procession_Loop_Overrun_Fault:0, Firstpass_Saturation_Fault:0, Dsp_Internal_Fault:0, Detection_Data_Integrity_Fault:0]
    C_D2H_ErrorFlags: value-spec=fields=[DSP_Unit_Calibration_Error:0, DSP_System_Modifiable_Calibration_Error:0, DSP_Loop_Over_Run:0]
    C_PltToFltMgr_Alignment_Faults: value-spec=fields=[85, Static_Calibration_flt_sts:85, Service_Calibration_flt_sts:85, ShortTrack_Calibration_flt_sts:85, Autoalign_outof_range_flt_sts:85, Autoalignment_algo_flt_sts:85, Autoalignment_sudden_jump_detection_error_flt_sts:85, Autoalignment_critical_misalignment_error_sts:85]
    C_VldtnToFltMgr_Blockage_Detection_T: value-spec=fields=[radar_blockage_flt_sts:85, blockage_algo_flt_sts:85, damping_algo_flt_sts:85, Sidelobe_Level_flt_sts:85]
    C_RadarCoreStatus_T: value-spec=fields=[2, 85, IsRadiating:170, OperationMode_Radar:3]
    C_RawAdcDataFilt_T: value-spec=fields=[Adc_Board_Rev:0, Adc_Batt_Volt:0, Adc_Pos_Gnd_A:0, Adc_Pos_Gnd_B:0, Adc_Pos_Gnd_C:0, Adc_Pos_Gnd_D:0, Adc_Eth_0v9:0, Adc_Rdi_Detect:0, Adc_MMIC_Temp:0, Adc_Mcu_Temp:0, Validity_Flag:0, Pos_Validity_Flag:0]
    C_Rdr_Hw_Tst_T: value-spec=fields=[dsp_loop_overrun_error_sts:0, c2_loop_overrun_error_sts:0, TR_Platformtime:0, SPT_error_sts:0, Range_algo_error_sts:0, PMIC_MCU_Comm_sts:0, Safety_Integrity_flt_sts:0, core_self_test_flt_status:0, Detection_Procession_Loop_Overrun_Fault_sts:0, Firstpass_Saturation_flt_sts:0, Dsp_Internal_Fault_sts:0, Detection_Data_Integrity_Fault_sts:0]
    C_VldtnToFltMgr_Host_Micro_Diag_T: value-spec=fields=[host_pll_lock_flt_status:0, watchdog_flt_status:0, host_instr_set_chk_flt_status:0, Signal_Integrity_Chk_Flt_Status:0, externalwdg_flt_status:0]
    C_MemExceptionInfo: value-spec=fields=[ExceptionType:0, ExceptionCausingAddress:0, ExceptionStatusRegister:0, IsMemException_Occured:0, MemoryExceptionAddress:0, StackPointer:0]
    C_Rfe_R1R2_Fault_T: value-spec=fields=[CORE_BANK_SFT_ERR_MON:0, CORE_BANK_SFT_ERR_STATUS:0, CORE_BANK_MCU_STS_MCU_MSSG:0, FUSA_IRQ0_FLAG_R:0, FUSA_IRQ1_FLAG_R:0, FUSA_IRQ2_FLAG_R:0, Api_ret_val:0, LOGEN_BANK_CHRP_GEN_ERROR:0, LOGEN_BANK_LOGEN_ERROR:0, CPU_SYS_MCU_ERR_0:0, CPU_SYS_MCU_ERR_1:0, CPU_SYS_MCU_ERR_2:0, CPU_SYS_MCU_ERR_3:0, ASYNC_BANK_ASYNC_ERR1:0, PROF_BANK_PRF_ERR1:0, PROF_BANK_PRF_ERR2:0, RXADC_FUSAMON:0, maf_status:0]
    C_XCP_Output_State: value-spec=fields=[xcp_set_output_select:0, xcp_set_output_state:0]
    C_ECC_Correctable_Error_Counters: value-spec=fields=[aa_mem_sec:0, artie_mem_sec:0, csi2_sec:0, dsp_opif_sec:0, dsp_idma_sec:0, dsp_iram_sec_axis:0, dsp_dcache_sec:0, dsp_dram_sec:0, dsp_icache_sec:0, dsp_iram_sec:0, ra_cqmem_sec:0, ra_dpmem_sec:0, ra_estmem_sec:0, ra_idxmem_sec:0, ra_phmem_sec:0, ra_wcmem_sec:0, sp_axi_m_corr:0, sp_axi_s_corr:0, sysmem0_sec:0, sysmem1_sec:0, not_recorded:0]
    C_VIN_T: value-spec=17 x 0
    C_SensorPos_default: value-spec=fields=[{short-label=SensorPosition_Data, fields=[SensorPos_Value:255, SensorPos_Lock_Status:255]}, SensorPos_CRC:0]
    Ct_AttemptCounter: value-spec=fields=[AttemptCounter1:0, AttemptCounter2:0]
