[part 3 of 4: package /ComponentTypes]
AUTOSAR XML (schema 00050)
package /ComponentTypes  (continued)
  composition sw component type PlatformCompositionType  (continued)
    102 x provide port:  (continued)
      Pp_SG_Detections_109_112_AL: nonqueued-sender-com-spec{data-element=Vdp_SG_Detections_109_112_AL, init-value=fields=[DET_AZIMUTH_109:0, DET_AZIMUTH_110:0, DET_AZIMUTH_111:0, DET_AZIMUTH_112:0, DET_AZIMUTH_ERR_109:0, DET_AZIMUTH_ERR_110:0, DET_AZIMUTH_ERR_111:0, DET_AZIMUTH_ERR_112:0, DET_BELOW_RAIN_THOLD_109:0, DET_BELOW_RAIN_THOLD_110:0, DET_BELOW_RAIN_THOLD_111:0, DET_BELOW_RAIN_THOLD_112:0, DET_BI_STATIC_FLAG_109:0, DET_BI_STATIC_FLAG_110:0, DET_BI_STATIC_FLAG_111:0, DET_BI_STATIC_FLAG_112:0, DET_CONFD_AZIMUTH_109:0, DET_CONFD_AZIMUTH_110:0, DET_CONFD_AZIMUTH_111:0, DET_CONFD_AZIMUTH_112:0, DET_CONFD_ELEVATION_109:0, DET_CONFD_ELEVATION_110:0, DET_CONFD_ELEVATION_111:0, DET_CONFD_ELEVATION_112:0, DET_ELEVATION_109:0, DET_ELEVATION_110:0, DET_ELEVATION_111:0, DET_ELEVATION_112:0, DET_ELEVATION_ERR_109:0, DET_ELEVATION_ERR_110:0, DET_ELEVATION_ERR_111:0, DET_ELEVATION_ERR_112:0, DET_EXISTENCE_PROB_109:0, DET_EXISTENCE_PROB_110:0, DET_EXISTENCE_PROB_111:0, DET_EXISTENCE_PROB_112:0, DET_HVC_FLAG_109:0, DET_HVC_FLAG_110:0, DET_HVC_FLAG_111:0, DET_HVC_FLAG_112:0, DET_IDM_109:0, DET_IDM_110:0, DET_IDM_111:0, DET_IDM_112:0, DET_MH_CRC16_109_112:0, DET_MH_CYCLE_COUNTER_109_112:0, DET_MH_SCAN_INDEX_4LSB_109_112:0, DET_MTD_109:0, DET_MTD_110:0, DET_MTD_111:0, DET_MTD_112:0, DET_PROB_1STAZHYPO_109:0, DET_PROB_1STAZHYPO_110:0, DET_PROB_1STAZHYPO_111:0, DET_PROB_1STAZHYPO_112:0, DET_RANGE_109:0, DET_RANGE_110:0, DET_RANGE_111:0, DET_RANGE_112:0, DET_RANGE_ERR_109:0, DET_RANGE_ERR_110:0, DET_RANGE_ERR_111:0, DET_RANGE_ERR_112:0, DET_RANGE_VELOCITY_109:16384, DET_RANGE_VELOCITY_110:16384, DET_RANGE_VELOCITY_111:16384, DET_RANGE_VELOCITY_112:16384, DET_RANGE_VELOCITY_ERR_109:0, DET_RANGE_VELOCITY_ERR_110:0, DET_RANGE_VELOCITY_ERR_111:0, DET_RANGE_VELOCITY_ERR_112:0, DET_RCS_109:128, DET_RCS_110:128, DET_RCS_111:128, DET_RCS_112:128, DET_SNR_109:0, DET_SNR_110:0, DET_SNR_111:0, DET_SNR_112:0, DET_SUPER_RES_TARGET_109:0, DET_SUPER_RES_TARGET_110:0, DET_SUPER_RES_TARGET_111:0, DET_SUPER_RES_TARGET_112:0]}, provided-interface=Pi_SG_Detections_109_112_AL
      Pp_SG_Detections_113_116_AL: nonqueued-sender-com-spec{data-element=Vdp_SG_Detections_113_116_AL, init-value=fields=[DET_AZIMUTH_113:0, DET_AZIMUTH_114:0, DET_AZIMUTH_115:0, DET_AZIMUTH_116:0, DET_AZIMUTH_ERR_113:0, DET_AZIMUTH_ERR_114:0, DET_AZIMUTH_ERR_115:0, DET_AZIMUTH_ERR_116:0, DET_BELOW_RAIN_THOLD_113:0, DET_BELOW_RAIN_THOLD_114:0, DET_BELOW_RAIN_THOLD_115:0, DET_BELOW_RAIN_THOLD_116:0, DET_BI_STATIC_FLAG_113:0, DET_BI_STATIC_FLAG_114:0, DET_BI_STATIC_FLAG_115:0, DET_BI_STATIC_FLAG_116:0, DET_CONFD_AZIMUTH_113:0, DET_CONFD_AZIMUTH_114:0, DET_CONFD_AZIMUTH_115:0, DET_CONFD_AZIMUTH_116:0, DET_CONFD_ELEVATION_113:0, DET_CONFD_ELEVATION_114:0, DET_CONFD_ELEVATION_115:0, DET_CONFD_ELEVATION_116:0, DET_ELEVATION_113:0, DET_ELEVATION_114:0, DET_ELEVATION_115:0, DET_ELEVATION_116:0, DET_ELEVATION_ERR_113:0, DET_ELEVATION_ERR_114:0, DET_ELEVATION_ERR_115:0, DET_ELEVATION_ERR_116:0, DET_EXISTENCE_PROB_113:0, DET_EXISTENCE_PROB_114:0, DET_EXISTENCE_PROB_115:0, DET_EXISTENCE_PROB_116:0, DET_HVC_FLAG_113:0, DET_HVC_FLAG_114:0, DET_HVC_FLAG_115:0, DET_HVC_FLAG_116:0, DET_IDM_113:0, DET_IDM_114:0, DET_IDM_115:0, DET_IDM_116:0, DET_MH_CRC16_113_116:0, DET_MH_CYCLE_COUNTER_113_116:0, DET_MH_SCAN_INDEX_4LSB_113_116:0, DET_MTD_113:0, DET_MTD_114:0, DET_MTD_115:0, DET_MTD_116:0, DET_PROB_1STAZHYPO_113:0, DET_PROB_1STAZHYPO_114:0, DET_PROB_1STAZHYPO_115:0, DET_PROB_1STAZHYPO_116:0, DET_RANGE_113:0, DET_RANGE_114:0, DET_RANGE_115:0, DET_RANGE_116:0, DET_RANGE_ERR_113:0, DET_RANGE_ERR_114:0, DET_RANGE_ERR_115:0, DET_RANGE_ERR_116:0, DET_RANGE_VELOCITY_113:16384, DET_RANGE_VELOCITY_114:16384, DET_RANGE_VELOCITY_115:16384, DET_RANGE_VELOCITY_116:16384, DET_RANGE_VELOCITY_ERR_113:0, DET_RANGE_VELOCITY_ERR_114:0, DET_RANGE_VELOCITY_ERR_115:0, DET_RANGE_VELOCITY_ERR_116:0, DET_RCS_113:128, DET_RCS_114:128, DET_RCS_115:128, DET_RCS_116:128, DET_SNR_113:0, DET_SNR_114:0, DET_SNR_115:0, DET_SNR_116:0, DET_SUPER_RES_TARGET_113:0, DET_SUPER_RES_TARGET_114:0, DET_SUPER_RES_TARGET_115:0, DET_SUPER_RES_TARGET_116:0]}, provided-interface=Pi_SG_Detections_113_116_AL
      Pp_SG_Detections_117_120_AL: nonqueued-sender-com-spec{data-element=Vdp_SG_Detections_117_120_AL, init-value=fields=[DET_AZIMUTH_117:0, DET_AZIMUTH_118:0, DET_AZIMUTH_119:0, DET_AZIMUTH_120:0, DET_AZIMUTH_ERR_117:0, DET_AZIMUTH_ERR_118:0, DET_AZIMUTH_ERR_119:0, DET_AZIMUTH_ERR_120:0, DET_BELOW_RAIN_THOLD_117:0, DET_BELOW_RAIN_THOLD_118:0, DET_BELOW_RAIN_THOLD_119:0, DET_BELOW_RAIN_THOLD_120:0, DET_BI_STATIC_FLAG_117:0, DET_BI_STATIC_FLAG_118:0, DET_BI_STATIC_FLAG_119:0, DET_BI_STATIC_FLAG_120:0, DET_CONFD_AZIMUTH_117:0, DET_CONFD_AZIMUTH_118:0, DET_CONFD_AZIMUTH_119:0, DET_CONFD_AZIMUTH_120:0, DET_CONFD_ELEVATION_117:0, DET_CONFD_ELEVATION_118:0, DET_CONFD_ELEVATION_119:0, DET_CONFD_ELEVATION_120:0, DET_ELEVATION_117:0, DET_ELEVATION_118:0, DET_ELEVATION_119:0, DET_ELEVATION_120:0, DET_ELEVATION_ERR_117:0, DET_ELEVATION_ERR_118:0, DET_ELEVATION_ERR_119:0, DET_ELEVATION_ERR_120:0, DET_EXISTENCE_PROB_117:0, DET_EXISTENCE_PROB_118:0, DET_EXISTENCE_PROB_119:0, DET_EXISTENCE_PROB_120:0, DET_HVC_FLAG_117:0, DET_HVC_FLAG_118:0, DET_HVC_FLAG_119:0, DET_HVC_FLAG_120:0, DET_IDM_117:0, DET_IDM_118:0, DET_IDM_119:0, DET_IDM_120:0, DET_MH_CRC16_117_120:0, DET_MH_CYCLE_COUNTER_117_120:0, DET_MH_SCAN_INDEX_4LSB_117_120:0, DET_MTD_117:0, DET_MTD_118:0, DET_MTD_119:0, DET_MTD_120:0, DET_PROB_1STAZHYPO_117:0, DET_PROB_1STAZHYPO_118:0, DET_PROB_1STAZHYPO_119:0, DET_PROB_1STAZHYPO_120:0, DET_RANGE_117:0, DET_RANGE_118:0, DET_RANGE_119:0, DET_RANGE_120:0, DET_RANGE_ERR_117:0, DET_RANGE_ERR_118:0, DET_RANGE_ERR_119:0, DET_RANGE_ERR_120:0, DET_RANGE_VELOCITY_117:16384, DET_RANGE_VELOCITY_118:16384, DET_RANGE_VELOCITY_119:16384, DET_RANGE_VELOCITY_120:16384, DET_RANGE_VELOCITY_ERR_117:0, DET_RANGE_VELOCITY_ERR_118:0, DET_RANGE_VELOCITY_ERR_119:0, DET_RANGE_VELOCITY_ERR_120:0, DET_RCS_117:128, DET_RCS_118:128, DET_RCS_119:128, DET_RCS_120:128, DET_SNR_117:0, DET_SNR_118:0, DET_SNR_119:0, DET_SNR_120:0, DET_SUPER_RES_TARGET_117:0, DET_SUPER_RES_TARGET_118:0, DET_SUPER_RES_TARGET_119:0, DET_SUPER_RES_TARGET_120:0]}, provided-interface=Pi_SG_Detections_117_120_AL
      Pp_SG_Detections_121_124_AL: nonqueued-sender-com-spec{data-element=Vdp_SG_Detections_121_124_AL, init-value=fields=[DET_AZIMUTH_121:0, DET_AZIMUTH_122:0, DET_AZIMUTH_123:0, DET_AZIMUTH_124:0, DET_AZIMUTH_ERR_121:0, DET_AZIMUTH_ERR_122:0, DET_AZIMUTH_ERR_123:0, DET_AZIMUTH_ERR_124:0, DET_BELOW_RAIN_THOLD_121:0, DET_BELOW_RAIN_THOLD_122:0, DET_BELOW_RAIN_THOLD_123:0, DET_BELOW_RAIN_THOLD_124:0, DET_BI_STATIC_FLAG_121:0, DET_BI_STATIC_FLAG_122:0, DET_BI_STATIC_FLAG_123:0, DET_BI_STATIC_FLAG_124:0, DET_CONFD_AZIMUTH_121:0, DET_CONFD_AZIMUTH_122:0, DET_CONFD_AZIMUTH_123:0, DET_CONFD_AZIMUTH_124:0, DET_CONFD_ELEVATION_121:0, DET_CONFD_ELEVATION_122:0, DET_CONFD_ELEVATION_123:0, DET_CONFD_ELEVATION_124:0, DET_ELEVATION_121:0, DET_ELEVATION_122:0, DET_ELEVATION_123:0, DET_ELEVATION_124:0, DET_ELEVATION_ERR_121:0, DET_ELEVATION_ERR_122:0, DET_ELEVATION_ERR_123:0, DET_ELEVATION_ERR_124:0, DET_EXISTENCE_PROB_121:0, DET_EXISTENCE_PROB_122:0, DET_EXISTENCE_PROB_123:0, DET_EXISTENCE_PROB_124:0, DET_HVC_FLAG_121:0, DET_HVC_FLAG_122:0, DET_HVC_FLAG_123:0, DET_HVC_FLAG_124:0, DET_IDM_121:0, DET_IDM_122:0, DET_IDM_123:0, DET_IDM_124:0, DET_MH_CRC16_121_124:0, DET_MH_CYCLE_COUNTER_121_124:0, DET_MH_SCAN_INDEX_4LSB_121_124:0, DET_MTD_121:0, DET_MTD_122:0, DET_MTD_123:0, DET_MTD_124:0, DET_PROB_1STAZHYPO_121:0, DET_PROB_1STAZHYPO_122:0, DET_PROB_1STAZHYPO_123:0, DET_PROB_1STAZHYPO_124:0, DET_RANGE_121:0, DET_RANGE_122:0, DET_RANGE_123:0, DET_RANGE_124:0, DET_RANGE_ERR_121:0, DET_RANGE_ERR_122:0, DET_RANGE_ERR_123:0, DET_RANGE_ERR_124:0, DET_RANGE_VELOCITY_121:16384, DET_RANGE_VELOCITY_122:16384, DET_RANGE_VELOCITY_123:16384, DET_RANGE_VELOCITY_124:16384, DET_RANGE_VELOCITY_ERR_121:0, DET_RANGE_VELOCITY_ERR_122:0, DET_RANGE_VELOCITY_ERR_123:0, DET_RANGE_VELOCITY_ERR_124:0, DET_RCS_121:128, DET_RCS_122:128, DET_RCS_123:128, DET_RCS_124:128, DET_SNR_121:0, DET_SNR_122:0, DET_SNR_123:0, DET_SNR_124:0, DET_SUPER_RES_TARGET_121:0, DET_SUPER_RES_TARGET_122:0, DET_SUPER_RES_TARGET_123:0, DET_SUPER_RES_TARGET_124:0]}, provided-interface=Pi_SG_Detections_121_124_AL
      Pp_SG_Detections_125_128_AL: nonqueued-sender-com-spec{data-element=Vdp_SG_Detections_125_128_AL, init-value=fields=[DET_AZIMUTH_125:0, DET_AZIMUTH_126:0, DET_AZIMUTH_127:0, DET_AZIMUTH_128:0, DET_AZIMUTH_ERR_125:0, DET_AZIMUTH_ERR_126:0, DET_AZIMUTH_ERR_127:0, DET_AZIMUTH_ERR_128:0, DET_BELOW_RAIN_THOLD_125:0, DET_BELOW_RAIN_THOLD_126:0, DET_BELOW_RAIN_THOLD_127:0, DET_BELOW_RAIN_THOLD_128:0, DET_BI_STATIC_FLAG_125:0, DET_BI_STATIC_FLAG_126:0, DET_BI_STATIC_FLAG_127:0, DET_BI_STATIC_FLAG_128:0, DET_CONFD_AZIMUTH_125:0, DET_CONFD_AZIMUTH_126:0, DET_CONFD_AZIMUTH_127:0, DET_CONFD_AZIMUTH_128:0, DET_CONFD_ELEVATION_125:0, DET_CONFD_ELEVATION_126:0, DET_CONFD_ELEVATION_127:0, DET_CONFD_ELEVATION_128:0, DET_ELEVATION_125:0, DET_ELEVATION_126:0, DET_ELEVATION_127:0, DET_ELEVATION_128:0, DET_ELEVATION_ERR_125:0, DET_ELEVATION_ERR_126:0, DET_ELEVATION_ERR_127:0, DET_ELEVATION_ERR_128:0, DET_EXISTENCE_PROB_125:0, DET_EXISTENCE_PROB_126:0, DET_EXISTENCE_PROB_127:0, DET_EXISTENCE_PROB_128:0, DET_HVC_FLAG_125:0, DET_HVC_FLAG_126:0, DET_HVC_FLAG_127:0, DET_HVC_FLAG_128:0, DET_IDM_125:0, DET_IDM_126:0, DET_IDM_127:0, DET_IDM_128:0, DET_MH_CRC16_125_128:0, DET_MH_CYCLE_COUNTER_125_128:0, DET_MH_SCAN_INDEX_4LSB_125_128:0, DET_MTD_125:0, DET_MTD_126:0, DET_MTD_127:0, DET_MTD_128:0, DET_PROB_1STAZHYPO_125:0, DET_PROB_1STAZHYPO_126:0, DET_PROB_1STAZHYPO_127:0, DET_PROB_1STAZHYPO_128:0, DET_RANGE_125:0, DET_RANGE_126:0, DET_RANGE_127:0, DET_RANGE_128:0, DET_RANGE_ERR_125:0, DET_RANGE_ERR_126:0, DET_RANGE_ERR_127:0, DET_RANGE_ERR_128:0, DET_RANGE_VELOCITY_125:16384, DET_RANGE_VELOCITY_126:16384, DET_RANGE_VELOCITY_127:16384, DET_RANGE_VELOCITY_128:16384, DET_RANGE_VELOCITY_ERR_125:0, DET_RANGE_VELOCITY_ERR_126:0, DET_RANGE_VELOCITY_ERR_127:0, DET_RANGE_VELOCITY_ERR_128:0, DET_RCS_125:128, DET_RCS_126:128, DET_RCS_127:128, DET_RCS_128:128, DET_SNR_125:0, DET_SNR_126:0, DET_SNR_127:0, DET_SNR_128:0, DET_SUPER_RES_TARGET_125:0, DET_SUPER_RES_TARGET_126:0, DET_SUPER_RES_TARGET_127:0, DET_SUPER_RES_TARGET_128:0]}, provided-interface=Pi_SG_Detections_125_128_AL
      Pp_SG_Detections_129_132_AL: nonqueued-sender-com-spec{data-element=Vdp_SG_Detections_129_132_AL, init-value=fields=[DET_AZIMUTH_129:0, DET_AZIMUTH_130:0, DET_AZIMUTH_131:0, DET_AZIMUTH_132:0, DET_AZIMUTH_ERR_129:0, DET_AZIMUTH_ERR_130:0, DET_AZIMUTH_ERR_131:0, DET_AZIMUTH_ERR_132:0, DET_BELOW_RAIN_THOLD_129:0, DET_BELOW_RAIN_THOLD_130:0, DET_BELOW_RAIN_THOLD_131:0, DET_BELOW_RAIN_THOLD_132:0, DET_BI_STATIC_FLAG_129:0, DET_BI_STATIC_FLAG_130:0, DET_BI_STATIC_FLAG_131:0, DET_BI_STATIC_FLAG_132:0, DET_CONFD_AZIMUTH_129:0, DET_CONFD_AZIMUTH_130:0, DET_CONFD_AZIMUTH_131:0, DET_CONFD_AZIMUTH_132:0, DET_CONFD_ELEVATION_129:0, DET_CONFD_ELEVATION_130:0, DET_CONFD_ELEVATION_131:0, DET_CONFD_ELEVATION_132:0, DET_ELEVATION_129:0, DET_ELEVATION_130:0, DET_ELEVATION_131:0, DET_ELEVATION_132:0, DET_ELEVATION_ERR_129:0, DET_ELEVATION_ERR_130:0, DET_ELEVATION_ERR_131:0, DET_ELEVATION_ERR_132:0, DET_EXISTENCE_PROB_129:0, DET_EXISTENCE_PROB_130:0, DET_EXISTENCE_PROB_131:0, DET_EXISTENCE_PROB_132:0, DET_HVC_FLAG_129:0, DET_HVC_FLAG_130:0, DET_HVC_FLAG_131:0, DET_HVC_FLAG_132:0, DET_IDM_129:0, DET_IDM_130:0, DET_IDM_131:0, DET_IDM_132:0, DET_MH_CRC16_129_132:0, DET_MH_CYCLE_COUNTER_129_132:0, DET_MH_SCAN_INDEX_4LSB_129_132:0, DET_MTD_129:0, DET_MTD_130:0, DET_MTD_131:0, DET_MTD_132:0, DET_PROB_1STAZHYPO_129:0, DET_PROB_1STAZHYPO_130:0, DET_PROB_1STAZHYPO_131:0, DET_PROB_1STAZHYPO_132:0, DET_RANGE_129:0, DET_RANGE_130:0, DET_RANGE_131:0, DET_RANGE_132:0, DET_RANGE_ERR_129:0, DET_RANGE_ERR_130:0, DET_RANGE_ERR_131:0, DET_RANGE_ERR_132:0, DET_RANGE_VELOCITY_129:16384, DET_RANGE_VELOCITY_130:16384, DET_RANGE_VELOCITY_131:16384, DET_RANGE_VELOCITY_132:16384, DET_RANGE_VELOCITY_ERR_129:0, DET_RANGE_VELOCITY_ERR_130:0, DET_RANGE_VELOCITY_ERR_131:0, DET_RANGE_VELOCITY_ERR_132:0, DET_RCS_129:128, DET_RCS_130:128, DET_RCS_131:128, DET_RCS_132:128, DET_SNR_129:0, DET_SNR_130:0, DET_SNR_131:0, DET_SNR_132:0, DET_SUPER_RES_TARGET_129:0, DET_SUPER_RES_TARGET_130:0, DET_SUPER_RES_TARGET_131:0, DET_SUPER_RES_TARGET_132:0]}, provided-interface=Pi_SG_Detections_129_132_AL
      Pp_SG_Detections_133_136_AL: nonqueued-sender-com-spec{data-element=Vdp_SG_Detections_133_136_AL, init-value=fields=[DET_AZIMUTH_133:0, DET_AZIMUTH_134:0, DET_AZIMUTH_135:0, DET_AZIMUTH_136:0, DET_AZIMUTH_ERR_133:0, DET_AZIMUTH_ERR_134:0, DET_AZIMUTH_ERR_135:0, DET_AZIMUTH_ERR_136:0, DET_BELOW_RAIN_THOLD_133:0, DET_BELOW_RAIN_THOLD_134:0, DET_BELOW_RAIN_THOLD_135:0, DET_BELOW_RAIN_THOLD_136:0, DET_BI_STATIC_FLAG_133:0, DET_BI_STATIC_FLAG_134:0, DET_BI_STATIC_FLAG_135:0, DET_BI_STATIC_FLAG_136:0, DET_CONFD_AZIMUTH_133:0, DET_CONFD_AZIMUTH_134:0, DET_CONFD_AZIMUTH_135:0, DET_CONFD_AZIMUTH_136:0, DET_CONFD_ELEVATION_133:0, DET_CONFD_ELEVATION_134:0, DET_CONFD_ELEVATION_135:0, DET_CONFD_ELEVATION_136:0, DET_ELEVATION_133:0, DET_ELEVATION_134:0, DET_ELEVATION_135:0, DET_ELEVATION_136:0, DET_ELEVATION_ERR_133:0, DET_ELEVATION_ERR_134:0, DET_ELEVATION_ERR_135:0, DET_ELEVATION_ERR_136:0, DET_EXISTENCE_PROB_133:0, DET_EXISTENCE_PROB_134:0, DET_EXISTENCE_PROB_135:0, DET_EXISTENCE_PROB_136:0, DET_HVC_FLAG_133:0, DET_HVC_FLAG_134:0, DET_HVC_FLAG_135:0, DET_HVC_FLAG_136:0, DET_IDM_133:0, DET_IDM_134:0, DET_IDM_135:0, DET_IDM_136:0, DET_MH_CRC16_133_136:0, DET_MH_CYCLE_COUNTER_133_136:0, DET_MH_SCAN_INDEX_4LSB_133_136:0, DET_MTD_133:0, DET_MTD_134:0, DET_MTD_135:0, DET_MTD_136:0, DET_PROB_1STAZHYPO_133:0, DET_PROB_1STAZHYPO_134:0, DET_PROB_1STAZHYPO_135:0, DET_PROB_1STAZHYPO_136:0, DET_RANGE_133:0, DET_RANGE_134:0, DET_RANGE_135:0, DET_RANGE_136:0, DET_RANGE_ERR_133:0, DET_RANGE_ERR_134:0, DET_RANGE_ERR_135:0, DET_RANGE_ERR_136:0, DET_RANGE_VELOCITY_133:16384, DET_RANGE_VELOCITY_134:16384, DET_RANGE_VELOCITY_135:16384, DET_RANGE_VELOCITY_136:16384, DET_RANGE_VELOCITY_ERR_133:0, DET_RANGE_VELOCITY_ERR_134:0, DET_RANGE_VELOCITY_ERR_135:0, DET_RANGE_VELOCITY_ERR_136:0, DET_RCS_133:128, DET_RCS_134:128, DET_RCS_135:128, DET_RCS_136:128, DET_SNR_133:0, DET_SNR_134:0, DET_SNR_135:0, DET_SNR_136:0, DET_SUPER_RES_TARGET_133:0, DET_SUPER_RES_TARGET_134:0, DET_SUPER_RES_TARGET_135:0, DET_SUPER_RES_TARGET_136:0]}, provided-interface=Pi_SG_Detections_133_136_AL
      Pp_SG_Detections_137_140_AL: nonqueued-sender-com-spec{data-element=Vdp_SG_Detections_137_140_AL, init-value=fields=[DET_AZIMUTH_137:0, DET_AZIMUTH_138:0, DET_AZIMUTH_139:0, DET_AZIMUTH_140:0, DET_AZIMUTH_ERR_137:0, DET_AZIMUTH_ERR_138:0, DET_AZIMUTH_ERR_139:0, DET_AZIMUTH_ERR_140:0, DET_BELOW_RAIN_THOLD_137:0, DET_BELOW_RAIN_THOLD_138:0, DET_BELOW_RAIN_THOLD_139:0, DET_BELOW_RAIN_THOLD_140:0, DET_BI_STATIC_FLAG_137:0, DET_BI_STATIC_FLAG_138:0, DET_BI_STATIC_FLAG_139:0, DET_BI_STATIC_FLAG_140:0, DET_CONFD_AZIMUTH_137:0, DET_CONFD_AZIMUTH_138:0, DET_CONFD_AZIMUTH_139:0, DET_CONFD_AZIMUTH_140:0, DET_CONFD_ELEVATION_137:0, DET_CONFD_ELEVATION_138:0, DET_CONFD_ELEVATION_139:0, DET_CONFD_ELEVATION_140:0, DET_ELEVATION_137:0, DET_ELEVATION_138:0, DET_ELEVATION_139:0, DET_ELEVATION_140:0, DET_ELEVATION_ERR_137:0, DET_ELEVATION_ERR_138:0, DET_ELEVATION_ERR_139:0, DET_ELEVATION_ERR_140:0, DET_EXISTENCE_PROB_137:0, DET_EXISTENCE_PROB_138:0, DET_EXISTENCE_PROB_139:0, DET_EXISTENCE_PROB_140:0, DET_HVC_FLAG_137:0, DET_HVC_FLAG_138:0, DET_HVC_FLAG_139:0, DET_HVC_FLAG_140:0, DET_IDM_137:0, DET_IDM_138:0, DET_IDM_139:0, DET_IDM_140:0, DET_MH_CRC16_137_140:0, DET_MH_CYCLE_COUNTER_137_140:0, DET_MH_SCAN_INDEX_4LSB_137_140:0, DET_MTD_137:0, DET_MTD_138:0, DET_MTD_139:0, DET_MTD_140:0, DET_PROB_1STAZHYPO_137:0, DET_PROB_1STAZHYPO_138:0, DET_PROB_1STAZHYPO_139:0, DET_PROB_1STAZHYPO_140:0, DET_RANGE_137:0, DET_RANGE_138:0, DET_RANGE_139:0, DET_RANGE_140:0, DET_RANGE_ERR_137:0, DET_RANGE_ERR_138:0, DET_RANGE_ERR_139:0, DET_RANGE_ERR_140:0, DET_RANGE_VELOCITY_137:16384, DET_RANGE_VELOCITY_138:16384, DET_RANGE_VELOCITY_139:16384, DET_RANGE_VELOCITY_140:16384, DET_RANGE_VELOCITY_ERR_137:0, DET_RANGE_VELOCITY_ERR_138:0, DET_RANGE_VELOCITY_ERR_139:0, DET_RANGE_VELOCITY_ERR_140:0, DET_RCS_137:128, DET_RCS_138:128, DET_RCS_139:128, DET_RCS_140:128, DET_SNR_137:0, DET_SNR_138:0, DET_SNR_139:0, DET_SNR_140:0, DET_SUPER_RES_TARGET_137:0, DET_SUPER_RES_TARGET_138:0, DET_SUPER_RES_TARGET_139:0, DET_SUPER_RES_TARGET_140:0]}, provided-interface=Pi_SG_Detections_137_140_AL
      Pp_SG_Detections_141_144_AL: nonqueued-sender-com-spec{data-element=Vdp_SG_Detections_141_144_AL, init-value=fields=[DET_AZIMUTH_141:0, DET_AZIMUTH_142:0, DET_AZIMUTH_143:0, DET_AZIMUTH_144:0, DET_AZIMUTH_ERR_141:0, DET_AZIMUTH_ERR_142:0, DET_AZIMUTH_ERR_143:0, DET_AZIMUTH_ERR_144:0, DET_BELOW_RAIN_THOLD_141:0, DET_BELOW_RAIN_THOLD_142:0, DET_BELOW_RAIN_THOLD_143:0, DET_BELOW_RAIN_THOLD_144:0, DET_BI_STATIC_FLAG_141:0, DET_BI_STATIC_FLAG_142:0, DET_BI_STATIC_FLAG_143:0, DET_BI_STATIC_FLAG_144:0, DET_CONFD_AZIMUTH_141:0, DET_CONFD_AZIMUTH_142:0, DET_CONFD_AZIMUTH_143:0, DET_CONFD_AZIMUTH_144:0, DET_CONFD_ELEVATION_141:0, DET_CONFD_ELEVATION_142:0, DET_CONFD_ELEVATION_143:0, DET_CONFD_ELEVATION_144:0, DET_ELEVATION_141:0, DET_ELEVATION_142:0, DET_ELEVATION_143:0, DET_ELEVATION_144:0, DET_ELEVATION_ERR_141:0, DET_ELEVATION_ERR_142:0, DET_ELEVATION_ERR_143:0, DET_ELEVATION_ERR_144:0, DET_EXISTENCE_PROB_141:0, DET_EXISTENCE_PROB_142:0, DET_EXISTENCE_PROB_143:0, DET_EXISTENCE_PROB_144:0, DET_HVC_FLAG_141:0, DET_HVC_FLAG_142:0, DET_HVC_FLAG_143:0, DET_HVC_FLAG_144:0, DET_IDM_141:0, DET_IDM_142:0, DET_IDM_143:0, DET_IDM_144:0, DET_MH_CRC16_141_144:0, DET_MH_CYCLE_COUNTER_141_144:0, DET_MH_SCAN_INDEX_4LSB_141_144:0, DET_MTD_141:0, DET_MTD_142:0, DET_MTD_143:0, DET_MTD_144:0, DET_PROB_1STAZHYPO_141:0, DET_PROB_1STAZHYPO_142:0, DET_PROB_1STAZHYPO_143:0, DET_PROB_1STAZHYPO_144:0, DET_RANGE_141:0, DET_RANGE_142:0, DET_RANGE_143:0, DET_RANGE_144:0, DET_RANGE_ERR_141:0, DET_RANGE_ERR_142:0, DET_RANGE_ERR_143:0, DET_RANGE_ERR_144:0, DET_RANGE_VELOCITY_141:16384, DET_RANGE_VELOCITY_142:16384, DET_RANGE_VELOCITY_143:16384, DET_RANGE_VELOCITY_144:16384, DET_RANGE_VELOCITY_ERR_141:0, DET_RANGE_VELOCITY_ERR_142:0, DET_RANGE_VELOCITY_ERR_143:0, DET_RANGE_VELOCITY_ERR_144:0, DET_RCS_141:128, DET_RCS_142:128, DET_RCS_143:128, DET_RCS_144:128, DET_SNR_141:0, DET_SNR_142:0, DET_SNR_143:0, DET_SNR_144:0, DET_SUPER_RES_TARGET_141:0, DET_SUPER_RES_TARGET_142:0, DET_SUPER_RES_TARGET_143:0, DET_SUPER_RES_TARGET_144:0]}, provided-interface=Pi_SG_Detections_141_144_AL
      Pp_SG_Detections_145_148_AL: nonqueued-sender-com-spec{data-element=Vdp_SG_Detections_145_148_AL, init-value=fields=[DET_AZIMUTH_145:0, DET_AZIMUTH_146:0, DET_AZIMUTH_147:0, DET_AZIMUTH_148:0, DET_AZIMUTH_ERR_145:0, DET_AZIMUTH_ERR_146:0, DET_AZIMUTH_ERR_147:0, DET_AZIMUTH_ERR_148:0, DET_BELOW_RAIN_THOLD_145:0, DET_BELOW_RAIN_THOLD_146:0, DET_BELOW_RAIN_THOLD_147:0, DET_BELOW_RAIN_THOLD_148:0, DET_BI_STATIC_FLAG_145:0, DET_BI_STATIC_FLAG_146:0, DET_BI_STATIC_FLAG_147:0, DET_BI_STATIC_FLAG_148:0, DET_CONFD_AZIMUTH_145:0, DET_CONFD_AZIMUTH_146:0, DET_CONFD_AZIMUTH_147:0, DET_CONFD_AZIMUTH_148:0, DET_CONFD_ELEVATION_145:0, DET_CONFD_ELEVATION_146:0, DET_CONFD_ELEVATION_147:0, DET_CONFD_ELEVATION_148:0, DET_ELEVATION_145:0, DET_ELEVATION_146:0, DET_ELEVATION_147:0, DET_ELEVATION_148:0, DET_ELEVATION_ERR_145:0, DET_ELEVATION_ERR_146:0, DET_ELEVATION_ERR_147:0, DET_ELEVATION_ERR_148:0, DET_EXISTENCE_PROB_145:0, DET_EXISTENCE_PROB_146:0, DET_EXISTENCE_PROB_147:0, DET_EXISTENCE_PROB_148:0, DET_HVC_FLAG_145:0, DET_HVC_FLAG_146:0, DET_HVC_FLAG_147:0, DET_HVC_FLAG_148:0, DET_IDM_145:0, DET_IDM_146:0, DET_IDM_147:0, DET_IDM_148:0, DET_MH_CRC16_145_148:0, DET_MH_CYCLE_COUNTER_145_148:0, DET_MH_SCAN_INDEX_4LSB_145_148:0, DET_MTD_145:0, DET_MTD_146:0, DET_MTD_147:0, DET_MTD_148:0, DET_PROB_1STAZHYPO_145:0, DET_PROB_1STAZHYPO_146:0, DET_PROB_1STAZHYPO_147:0, DET_PROB_1STAZHYPO_148:0, DET_RANGE_145:0, DET_RANGE_146:0, DET_RANGE_147:0, DET_RANGE_148:0, DET_RANGE_ERR_145:0, DET_RANGE_ERR_146:0, DET_RANGE_ERR_147:0, DET_RANGE_ERR_148:0, DET_RANGE_VELOCITY_145:16384, DET_RANGE_VELOCITY_146:16384, DET_RANGE_VELOCITY_147:16384, DET_RANGE_VELOCITY_148:16384, DET_RANGE_VELOCITY_ERR_145:0, DET_RANGE_VELOCITY_ERR_146:0, DET_RANGE_VELOCITY_ERR_147:0, DET_RANGE_VELOCITY_ERR_148:0, DET_RCS_145:128, DET_RCS_146:128, DET_RCS_147:128, DET_RCS_148:128, DET_SNR_145:0, DET_SNR_146:0, DET_SNR_147:0, DET_SNR_148:0, DET_SUPER_RES_TARGET_145:0, DET_SUPER_RES_TARGET_146:0, DET_SUPER_RES_TARGET_147:0, DET_SUPER_RES_TARGET_148:0]}, provided-interface=Pi_SG_Detections_145_148_AL
      Pp_SG_Detections_149_152_AL: nonqueued-sender-com-spec{data-element=Vdp_SG_Detections_149_152_AL, init-value=fields=[DET_AZIMUTH_149:0, DET_AZIMUTH_150:0, DET_AZIMUTH_151:0, DET_AZIMUTH_152:0, DET_AZIMUTH_ERR_149:0, DET_AZIMUTH_ERR_150:0, DET_AZIMUTH_ERR_151:0, DET_AZIMUTH_ERR_152:0, DET_BELOW_RAIN_THOLD_149:0, DET_BELOW_RAIN_THOLD_150:0, DET_BELOW_RAIN_THOLD_151:0, DET_BELOW_RAIN_THOLD_152:0, DET_BI_STATIC_FLAG_149:0, DET_BI_STATIC_FLAG_150:0, DET_BI_STATIC_FLAG_151:0, DET_BI_STATIC_FLAG_152:0, DET_CONFD_AZIMUTH_149:0, DET_CONFD_AZIMUTH_150:0, DET_CONFD_AZIMUTH_151:0, DET_CONFD_AZIMUTH_152:0, DET_CONFD_ELEVATION_149:0, DET_CONFD_ELEVATION_150:0, DET_CONFD_ELEVATION_151:0, DET_CONFD_ELEVATION_152:0, DET_ELEVATION_149:0, DET_ELEVATION_150:0, DET_ELEVATION_151:0, DET_ELEVATION_152:0, DET_ELEVATION_ERR_149:0, DET_ELEVATION_ERR_150:0, DET_ELEVATION_ERR_151:0, DET_ELEVATION_ERR_152:0, DET_EXISTENCE_PROB_149:0, DET_EXISTENCE_PROB_150:0, DET_EXISTENCE_PROB_151:0, DET_EXISTENCE_PROB_152:0, DET_HVC_FLAG_149:0, DET_HVC_FLAG_150:0, DET_HVC_FLAG_151:0, DET_HVC_FLAG_152:0, DET_IDM_149:0, DET_IDM_150:0, DET_IDM_151:0, DET_IDM_152:0, DET_MH_CRC16_149_152:0, DET_MH_CYCLE_COUNTER_149_152:0, DET_MH_SCAN_INDEX_4LSB_149_152:0, DET_MTD_149:0, DET_MTD_150:0, DET_MTD_151:0, DET_MTD_152:0, DET_PROB_1STAZHYPO_149:0, DET_PROB_1STAZHYPO_150:0, DET_PROB_1STAZHYPO_151:0, DET_PROB_1STAZHYPO_152:0, DET_RANGE_149:0, DET_RANGE_150:0, DET_RANGE_151:0, DET_RANGE_152:0, DET_RANGE_ERR_149:0, DET_RANGE_ERR_150:0, DET_RANGE_ERR_151:0, DET_RANGE_ERR_152:0, DET_RANGE_VELOCITY_149:16384, DET_RANGE_VELOCITY_150:16384, DET_RANGE_VELOCITY_151:16384, DET_RANGE_VELOCITY_152:16384, DET_RANGE_VELOCITY_ERR_149:0, DET_RANGE_VELOCITY_ERR_150:0, DET_RANGE_VELOCITY_ERR_151:0, DET_RANGE_VELOCITY_ERR_152:0, DET_RCS_149:128, DET_RCS_150:128, DET_RCS_151:128, DET_RCS_152:128, DET_SNR_149:0, DET_SNR_150:0, DET_SNR_151:0, DET_SNR_152:0, DET_SUPER_RES_TARGET_149:0, DET_SUPER_RES_TARGET_150:0, DET_SUPER_RES_TARGET_151:0, DET_SUPER_RES_TARGET_152:0]}, provided-interface=Pi_SG_Detections_149_152_AL
      Pp_SG_Detections_153_156_AL: nonqueued-sender-com-spec{data-element=Vdp_SG_Detections_153_156_AL, init-value=fields=[DET_AZIMUTH_153:0, DET_AZIMUTH_154:0, DET_AZIMUTH_155:0, DET_AZIMUTH_156:0, DET_AZIMUTH_ERR_153:0, DET_AZIMUTH_ERR_154:0, DET_AZIMUTH_ERR_155:0, DET_AZIMUTH_ERR_156:0, DET_BELOW_RAIN_THOLD_153:0, DET_BELOW_RAIN_THOLD_154:0, DET_BELOW_RAIN_THOLD_155:0, DET_BELOW_RAIN_THOLD_156:0, DET_BI_STATIC_FLAG_153:0, DET_BI_STATIC_FLAG_154:0, DET_BI_STATIC_FLAG_155:0, DET_BI_STATIC_FLAG_156:0, DET_CONFD_AZIMUTH_153:0, DET_CONFD_AZIMUTH_154:0, DET_CONFD_AZIMUTH_155:0, DET_CONFD_AZIMUTH_156:0, DET_CONFD_ELEVATION_153:0, DET_CONFD_ELEVATION_154:0, DET_CONFD_ELEVATION_155:0, DET_CONFD_ELEVATION_156:0, DET_ELEVATION_153:0, DET_ELEVATION_154:0, DET_ELEVATION_155:0, DET_ELEVATION_156:0, DET_ELEVATION_ERR_153:0, DET_ELEVATION_ERR_154:0, DET_ELEVATION_ERR_155:0, DET_ELEVATION_ERR_156:0, DET_EXISTENCE_PROB_153:0, DET_EXISTENCE_PROB_154:0, DET_EXISTENCE_PROB_155:0, DET_EXISTENCE_PROB_156:0, DET_HVC_FLAG_153:0, DET_HVC_FLAG_154:0, DET_HVC_FLAG_155:0, DET_HVC_FLAG_156:0, DET_IDM_153:0, DET_IDM_154:0, DET_IDM_155:0, DET_IDM_156:0, DET_MH_CRC16_153_156:0, DET_MH_CYCLE_COUNTER_153_156:0, DET_MH_SCAN_INDEX_4LSB_153_156:0, DET_MTD_153:0, DET_MTD_154:0, DET_MTD_155:0, DET_MTD_156:0, DET_PROB_1STAZHYPO_153:0, DET_PROB_1STAZHYPO_154:0, DET_PROB_1STAZHYPO_155:0, DET_PROB_1STAZHYPO_156:0, DET_RANGE_153:0, DET_RANGE_154:0, DET_RANGE_155:0, DET_RANGE_156:0, DET_RANGE_ERR_153:0, DET_RANGE_ERR_154:0, DET_RANGE_ERR_155:0, DET_RANGE_ERR_156:0, DET_RANGE_VELOCITY_153:16384, DET_RANGE_VELOCITY_154:16384, DET_RANGE_VELOCITY_155:16384, DET_RANGE_VELOCITY_156:16384, DET_RANGE_VELOCITY_ERR_153:0, DET_RANGE_VELOCITY_ERR_154:0, DET_RANGE_VELOCITY_ERR_155:0, DET_RANGE_VELOCITY_ERR_156:0, DET_RCS_153:128, DET_RCS_154:128, DET_RCS_155:128, DET_RCS_156:128, DET_SNR_153:0, DET_SNR_154:0, DET_SNR_155:0, DET_SNR_156:0, DET_SUPER_RES_TARGET_153:0, DET_SUPER_RES_TARGET_154:0, DET_SUPER_RES_TARGET_155:0, DET_SUPER_RES_TARGET_156:0]}, provided-interface=Pi_SG_Detections_153_156_AL
      Pp_SG_Detections_157_160_AL: nonqueued-sender-com-spec{data-element=Vdp_SG_Detections_157_160_AL, init-value=fields=[DET_AZIMUTH_157:0, DET_AZIMUTH_158:0, DET_AZIMUTH_159:0, DET_AZIMUTH_160:0, DET_AZIMUTH_ERR_157:0, DET_AZIMUTH_ERR_158:0, DET_AZIMUTH_ERR_159:0, DET_AZIMUTH_ERR_160:0, DET_BELOW_RAIN_THOLD_157:0, DET_BELOW_RAIN_THOLD_158:0, DET_BELOW_RAIN_THOLD_159:0, DET_BELOW_RAIN_THOLD_160:0, DET_BI_STATIC_FLAG_157:0, DET_BI_STATIC_FLAG_158:0, DET_BI_STATIC_FLAG_159:0, DET_BI_STATIC_FLAG_160:0, DET_CONFD_AZIMUTH_157:0, DET_CONFD_AZIMUTH_158:0, DET_CONFD_AZIMUTH_159:0, DET_CONFD_AZIMUTH_160:0, DET_CONFD_ELEVATION_157:0, DET_CONFD_ELEVATION_158:0, DET_CONFD_ELEVATION_159:0, DET_CONFD_ELEVATION_160:0, DET_ELEVATION_157:0, DET_ELEVATION_158:0, DET_ELEVATION_159:0, DET_ELEVATION_160:0, DET_ELEVATION_ERR_157:0, DET_ELEVATION_ERR_158:0, DET_ELEVATION_ERR_159:0, DET_ELEVATION_ERR_160:0, DET_EXISTENCE_PROB_157:0, DET_EXISTENCE_PROB_158:0, DET_EXISTENCE_PROB_159:0, DET_EXISTENCE_PROB_160:0, DET_HVC_FLAG_157:0, DET_HVC_FLAG_158:0, DET_HVC_FLAG_159:0, DET_HVC_FLAG_160:0, DET_IDM_157:0, DET_IDM_158:0, DET_IDM_159:0, DET_IDM_160:0, DET_MH_CRC16_157_160:0, DET_MH_CYCLE_COUNTER_157_160:0, DET_MH_SCAN_INDEX_4LSB_157_160:0, DET_MTD_157:0, DET_MTD_158:0, DET_MTD_159:0, DET_MTD_160:0, DET_PROB_1STAZHYPO_157:0, DET_PROB_1STAZHYPO_158:0, DET_PROB_1STAZHYPO_159:0, DET_PROB_1STAZHYPO_160:0, DET_RANGE_157:0, DET_RANGE_158:0, DET_RANGE_159:0, DET_RANGE_160:0, DET_RANGE_ERR_157:0, DET_RANGE_ERR_158:0, DET_RANGE_ERR_159:0, DET_RANGE_ERR_160:0, DET_RANGE_VELOCITY_157:16384, DET_RANGE_VELOCITY_158:16384, DET_RANGE_VELOCITY_159:16384, DET_RANGE_VELOCITY_160:16384, DET_RANGE_VELOCITY_ERR_157:0, DET_RANGE_VELOCITY_ERR_158:0, DET_RANGE_VELOCITY_ERR_159:0, DET_RANGE_VELOCITY_ERR_160:0, DET_RCS_157:128, DET_RCS_158:128, DET_RCS_159:128, DET_RCS_160:128, DET_SNR_157:0, DET_SNR_158:0, DET_SNR_159:0, DET_SNR_160:0, DET_SUPER_RES_TARGET_157:0, DET_SUPER_RES_TARGET_158:0, DET_SUPER_RES_TARGET_159:0, DET_SUPER_RES_TARGET_160:0]}, provided-interface=Pi_SG_Detections_157_160_AL
      Pp_SG_Detections_161_164_AL: nonqueued-sender-com-spec{data-element=Vdp_SG_Detections_161_164_AL, init-value=fields=[DET_AZIMUTH_161:0, DET_AZIMUTH_162:0, DET_AZIMUTH_163:0, DET_AZIMUTH_164:0, DET_AZIMUTH_ERR_161:0, DET_AZIMUTH_ERR_162:0, DET_AZIMUTH_ERR_163:0, DET_AZIMUTH_ERR_164:0, DET_BELOW_RAIN_THOLD_161:0, DET_BELOW_RAIN_THOLD_162:0, DET_BELOW_RAIN_THOLD_163:0, DET_BELOW_RAIN_THOLD_164:0, DET_BI_STATIC_FLAG_161:0, DET_BI_STATIC_FLAG_162:0, DET_BI_STATIC_FLAG_163:0, DET_BI_STATIC_FLAG_164:0, DET_CONFD_AZIMUTH_161:0, DET_CONFD_AZIMUTH_162:0, DET_CONFD_AZIMUTH_163:0, DET_CONFD_AZIMUTH_164:0, DET_CONFD_ELEVATION_161:0, DET_CONFD_ELEVATION_162:0, DET_CONFD_ELEVATION_163:0, DET_CONFD_ELEVATION_164:0, DET_ELEVATION_161:0, DET_ELEVATION_162:0, DET_ELEVATION_163:0, DET_ELEVATION_164:0, DET_ELEVATION_ERR_161:0, DET_ELEVATION_ERR_162:0, DET_ELEVATION_ERR_163:0, DET_ELEVATION_ERR_164:0, DET_EXISTENCE_PROB_161:0, DET_EXISTENCE_PROB_162:0, DET_EXISTENCE_PROB_163:0, DET_EXISTENCE_PROB_164:0, DET_HVC_FLAG_161:0, DET_HVC_FLAG_162:0, DET_HVC_FLAG_163:0, DET_HVC_FLAG_164:0, DET_IDM_161:0, DET_IDM_162:0, DET_IDM_163:0, DET_IDM_164:0, DET_MH_CRC16_161_164:0, DET_MH_CYCLE_COUNTER_161_164:0, DET_MH_SCAN_INDEX_4LSB_161_164:0, DET_MTD_161:0, DET_MTD_162:0, DET_MTD_163:0, DET_MTD_164:0, DET_PROB_1STAZHYPO_161:0, DET_PROB_1STAZHYPO_162:0, DET_PROB_1STAZHYPO_163:0, DET_PROB_1STAZHYPO_164:0, DET_RANGE_161:0, DET_RANGE_162:0, DET_RANGE_163:0, DET_RANGE_164:0, DET_RANGE_ERR_161:0, DET_RANGE_ERR_162:0, DET_RANGE_ERR_163:0, DET_RANGE_ERR_164:0, DET_RANGE_VELOCITY_161:16384, DET_RANGE_VELOCITY_162:16384, DET_RANGE_VELOCITY_163:16384, DET_RANGE_VELOCITY_164:16384, DET_RANGE_VELOCITY_ERR_161:0, DET_RANGE_VELOCITY_ERR_162:0, DET_RANGE_VELOCITY_ERR_163:0, DET_RANGE_VELOCITY_ERR_164:0, DET_RCS_161:128, DET_RCS_162:128, DET_RCS_163:128, DET_RCS_164:128, DET_SNR_161:0, DET_SNR_162:0, DET_SNR_163:0, DET_SNR_164:0, DET_SUPER_RES_TARGET_161:0, DET_SUPER_RES_TARGET_162:0, DET_SUPER_RES_TARGET_163:0, DET_SUPER_RES_TARGET_164:0]}, provided-interface=Pi_SG_Detections_161_164_AL
      Pp_SG_Detections_165_168_AL: nonqueued-sender-com-spec{data-element=Vdp_SG_Detections_165_168_AL, init-value=fields=[DET_AZIMUTH_165:0, DET_AZIMUTH_166:0, DET_AZIMUTH_167:0, DET_AZIMUTH_168:0, DET_AZIMUTH_ERR_165:0, DET_AZIMUTH_ERR_166:0, DET_AZIMUTH_ERR_167:0, DET_AZIMUTH_ERR_168:0, DET_BELOW_RAIN_THOLD_165:0, DET_BELOW_RAIN_THOLD_166:0, DET_BELOW_RAIN_THOLD_167:0, DET_BELOW_RAIN_THOLD_168:0, DET_BI_STATIC_FLAG_165:0, DET_BI_STATIC_FLAG_166:0, DET_BI_STATIC_FLAG_167:0, DET_BI_STATIC_FLAG_168:0, DET_CONFD_AZIMUTH_165:0, DET_CONFD_AZIMUTH_166:0, DET_CONFD_AZIMUTH_167:0, DET_CONFD_AZIMUTH_168:0, DET_CONFD_ELEVATION_165:0, DET_CONFD_ELEVATION_166:0, DET_CONFD_ELEVATION_167:0, DET_CONFD_ELEVATION_168:0, DET_ELEVATION_165:0, DET_ELEVATION_166:0, DET_ELEVATION_167:0, DET_ELEVATION_168:0, DET_ELEVATION_ERR_165:0, DET_ELEVATION_ERR_166:0, DET_ELEVATION_ERR_167:0, DET_ELEVATION_ERR_168:0, DET_EXISTENCE_PROB_165:0, DET_EXISTENCE_PROB_166:0, DET_EXISTENCE_PROB_167:0, DET_EXISTENCE_PROB_168:0, DET_HVC_FLAG_165:0, DET_HVC_FLAG_166:0, DET_HVC_FLAG_167:0, DET_HVC_FLAG_168:0, DET_IDM_165:0, DET_IDM_166:0, DET_IDM_167:0, DET_IDM_168:0, DET_MH_CRC16_165_168:0, DET_MH_CYCLE_COUNTER_165_168:0, DET_MH_SCAN_INDEX_4LSB_165_168:0, DET_MTD_165:0, DET_MTD_166:0, DET_MTD_167:0, DET_MTD_168:0, DET_PROB_1STAZHYPO_165:0, DET_PROB_1STAZHYPO_166:0, DET_PROB_1STAZHYPO_167:0, DET_PROB_1STAZHYPO_168:0, DET_RANGE_165:0, DET_RANGE_166:0, DET_RANGE_167:0, DET_RANGE_168:0, DET_RANGE_ERR_165:0, DET_RANGE_ERR_166:0, DET_RANGE_ERR_167:0, DET_RANGE_ERR_168:0, DET_RANGE_VELOCITY_165:16384, DET_RANGE_VELOCITY_166:16384, DET_RANGE_VELOCITY_167:16384, DET_RANGE_VELOCITY_168:16384, DET_RANGE_VELOCITY_ERR_165:0, DET_RANGE_VELOCITY_ERR_166:0, DET_RANGE_VELOCITY_ERR_167:0, DET_RANGE_VELOCITY_ERR_168:0, DET_RCS_165:128, DET_RCS_166:128, DET_RCS_167:128, DET_RCS_168:128, DET_SNR_165:0, DET_SNR_166:0, DET_SNR_167:0, DET_SNR_168:0, DET_SUPER_RES_TARGET_165:0, DET_SUPER_RES_TARGET_166:0, DET_SUPER_RES_TARGET_167:0, DET_SUPER_RES_TARGET_168:0]}, provided-interface=Pi_SG_Detections_165_168_AL
      Pp_SG_Detections_169_172_AL: nonqueued-sender-com-spec{data-element=Vdp_SG_Detections_169_172_AL, init-value=fields=[DET_AZIMUTH_169:0, DET_AZIMUTH_170:0, DET_AZIMUTH_171:0, DET_AZIMUTH_172:0, DET_AZIMUTH_ERR_169:0, DET_AZIMUTH_ERR_170:0, DET_AZIMUTH_ERR_171:0, DET_AZIMUTH_ERR_172:0, DET_BELOW_RAIN_THOLD_169:0, DET_BELOW_RAIN_THOLD_170:0, DET_BELOW_RAIN_THOLD_171:0, DET_BELOW_RAIN_THOLD_172:0, DET_BI_STATIC_FLAG_169:0, DET_BI_STATIC_FLAG_170:0, DET_BI_STATIC_FLAG_171:0, DET_BI_STATIC_FLAG_172:0, DET_CONFD_AZIMUTH_169:0, DET_CONFD_AZIMUTH_170:0, DET_CONFD_AZIMUTH_171:0, DET_CONFD_AZIMUTH_172:0, DET_CONFD_ELEVATION_169:0, DET_CONFD_ELEVATION_170:0, DET_CONFD_ELEVATION_171:0, DET_CONFD_ELEVATION_172:0, DET_ELEVATION_169:0, DET_ELEVATION_170:0, DET_ELEVATION_171:0, DET_ELEVATION_172:0, DET_ELEVATION_ERR_169:0, DET_ELEVATION_ERR_170:0, DET_ELEVATION_ERR_171:0, DET_ELEVATION_ERR_172:0, DET_EXISTENCE_PROB_169:0, DET_EXISTENCE_PROB_170:0, DET_EXISTENCE_PROB_171:0, DET_EXISTENCE_PROB_172:0, DET_HVC_FLAG_169:0, DET_HVC_FLAG_170:0, DET_HVC_FLAG_171:0, DET_HVC_FLAG_172:0, DET_IDM_169:0, DET_IDM_170:0, DET_IDM_171:0, DET_IDM_172:0, DET_MH_CRC16_169_172:0, DET_MH_CYCLE_COUNTER_169_172:0, DET_MH_SCAN_INDEX_4LSB_169_172:0, DET_MTD_169:0, DET_MTD_170:0, DET_MTD_171:0, DET_MTD_172:0, DET_PROB_1STAZHYPO_169:0, DET_PROB_1STAZHYPO_170:0, DET_PROB_1STAZHYPO_171:0, DET_PROB_1STAZHYPO_172:0, DET_RANGE_169:0, DET_RANGE_170:0, DET_RANGE_171:0, DET_RANGE_172:0, DET_RANGE_ERR_169:0, DET_RANGE_ERR_170:0, DET_RANGE_ERR_171:0, DET_RANGE_ERR_172:0, DET_RANGE_VELOCITY_169:16384, DET_RANGE_VELOCITY_170:16384, DET_RANGE_VELOCITY_171:16384, DET_RANGE_VELOCITY_172:16384, DET_RANGE_VELOCITY_ERR_169:0, DET_RANGE_VELOCITY_ERR_170:0, DET_RANGE_VELOCITY_ERR_171:0, DET_RANGE_VELOCITY_ERR_172:0, DET_RCS_169:128, DET_RCS_170:128, DET_RCS_171:128, DET_RCS_172:128, DET_SNR_169:0, DET_SNR_170:0, DET_SNR_171:0, DET_SNR_172:0, DET_SUPER_RES_TARGET_169:0, DET_SUPER_RES_TARGET_170:0, DET_SUPER_RES_TARGET_171:0, DET_SUPER_RES_TARGET_172:0]}, provided-interface=Pi_SG_Detections_169_172_AL
      Pp_SG_Detections_173_176_AL: nonqueued-sender-com-spec{data-element=Vdp_SG_Detections_173_176_AL, init-value=fields=[DET_AZIMUTH_173:0, DET_AZIMUTH_174:0, DET_AZIMUTH_175:0, DET_AZIMUTH_176:0, DET_AZIMUTH_ERR_173:0, DET_AZIMUTH_ERR_174:0, DET_AZIMUTH_ERR_175:0, DET_AZIMUTH_ERR_176:0, DET_BELOW_RAIN_THOLD_173:0, DET_BELOW_RAIN_THOLD_174:0, DET_BELOW_RAIN_THOLD_175:0, DET_BELOW_RAIN_THOLD_176:0, DET_BI_STATIC_FLAG_173:0, DET_BI_STATIC_FLAG_174:0, DET_BI_STATIC_FLAG_175:0, DET_BI_STATIC_FLAG_176:0, DET_CONFD_AZIMUTH_173:0, DET_CONFD_AZIMUTH_174:0, DET_CONFD_AZIMUTH_175:0, DET_CONFD_AZIMUTH_176:0, DET_CONFD_ELEVATION_173:0, DET_CONFD_ELEVATION_174:0, DET_CONFD_ELEVATION_175:0, DET_CONFD_ELEVATION_176:0, DET_ELEVATION_173:0, DET_ELEVATION_174:0, DET_ELEVATION_175:0, DET_ELEVATION_176:0, DET_ELEVATION_ERR_173:0, DET_ELEVATION_ERR_174:0, DET_ELEVATION_ERR_175:0, DET_ELEVATION_ERR_176:0, DET_EXISTENCE_PROB_173:0, DET_EXISTENCE_PROB_174:0, DET_EXISTENCE_PROB_175:0, DET_EXISTENCE_PROB_176:0, DET_HVC_FLAG_173:0, DET_HVC_FLAG_174:0, DET_HVC_FLAG_175:0, DET_HVC_FLAG_176:0, DET_IDM_173:0, DET_IDM_174:0, DET_IDM_175:0, DET_IDM_176:0, DET_MH_CRC16_173_176:0, DET_MH_CYCLE_COUNTER_173_176:0, DET_MH_SCAN_INDEX_4LSB_173_176:0, DET_MTD_173:0, DET_MTD_174:0, DET_MTD_175:0, DET_MTD_176:0, DET_PROB_1STAZHYPO_173:0, DET_PROB_1STAZHYPO_174:0, DET_PROB_1STAZHYPO_175:0, DET_PROB_1STAZHYPO_176:0, DET_RANGE_173:0, DET_RANGE_174:0, DET_RANGE_175:0, DET_RANGE_176:0, DET_RANGE_ERR_173:0, DET_RANGE_ERR_174:0, DET_RANGE_ERR_175:0, DET_RANGE_ERR_176:0, DET_RANGE_VELOCITY_173:16384, DET_RANGE_VELOCITY_174:16384, DET_RANGE_VELOCITY_175:16384, DET_RANGE_VELOCITY_176:16384, DET_RANGE_VELOCITY_ERR_173:0, DET_RANGE_VELOCITY_ERR_174:0, DET_RANGE_VELOCITY_ERR_175:0, DET_RANGE_VELOCITY_ERR_176:0, DET_RCS_173:128, DET_RCS_174:128, DET_RCS_175:128, DET_RCS_176:128, DET_SNR_173:0, DET_SNR_174:0, DET_SNR_175:0, DET_SNR_176:0, DET_SUPER_RES_TARGET_173:0, DET_SUPER_RES_TARGET_174:0, DET_SUPER_RES_TARGET_175:0, DET_SUPER_RES_TARGET_176:0]}, provided-interface=Pi_SG_Detections_173_176_AL
      Pp_SG_Detections_177_180_AL: nonqueued-sender-com-spec{data-element=Vdp_SG_Detections_177_180_AL, init-value=fields=[DET_AZIMUTH_177:0, DET_AZIMUTH_178:0, DET_AZIMUTH_179:0, DET_AZIMUTH_180:0, DET_AZIMUTH_ERR_177:0, DET_AZIMUTH_ERR_178:0, DET_AZIMUTH_ERR_179:0, DET_AZIMUTH_ERR_180:0, DET_BELOW_RAIN_THOLD_177:0, DET_BELOW_RAIN_THOLD_178:0, DET_BELOW_RAIN_THOLD_179:0, DET_BELOW_RAIN_THOLD_180:0, DET_BI_STATIC_FLAG_177:0, DET_BI_STATIC_FLAG_178:0, DET_BI_STATIC_FLAG_179:0, DET_BI_STATIC_FLAG_180:0, DET_CONFD_AZIMUTH_177:0, DET_CONFD_AZIMUTH_178:0, DET_CONFD_AZIMUTH_179:0, DET_CONFD_AZIMUTH_180:0, DET_CONFD_ELEVATION_177:0, DET_CONFD_ELEVATION_178:0, DET_CONFD_ELEVATION_179:0, DET_CONFD_ELEVATION_180:0, DET_ELEVATION_177:0, DET_ELEVATION_178:0, DET_ELEVATION_179:0, DET_ELEVATION_180:0, DET_ELEVATION_ERR_177:0, DET_ELEVATION_ERR_178:0, DET_ELEVATION_ERR_179:0, DET_ELEVATION_ERR_180:0, DET_EXISTENCE_PROB_177:0, DET_EXISTENCE_PROB_178:0, DET_EXISTENCE_PROB_179:0, DET_EXISTENCE_PROB_180:0, DET_HVC_FLAG_177:0, DET_HVC_FLAG_178:0, DET_HVC_FLAG_179:0, DET_HVC_FLAG_180:0, DET_IDM_177:0, DET_IDM_178:0, DET_IDM_179:0, DET_IDM_180:0, DET_MH_CRC16_177_180:0, DET_MH_CYCLE_COUNTER_177_180:0, DET_MH_SCAN_INDEX_4LSB_177_180:0, DET_MTD_177:0, DET_MTD_178:0, DET_MTD_179:0, DET_MTD_180:0, DET_PROB_1STAZHYPO_177:0, DET_PROB_1STAZHYPO_178:0, DET_PROB_1STAZHYPO_179:0, DET_PROB_1STAZHYPO_180:0, DET_RANGE_177:0, DET_RANGE_178:0, DET_RANGE_179:0, DET_RANGE_180:0, DET_RANGE_ERR_177:0, DET_RANGE_ERR_178:0, DET_RANGE_ERR_179:0, DET_RANGE_ERR_180:0, DET_RANGE_VELOCITY_177:16384, DET_RANGE_VELOCITY_178:16384, DET_RANGE_VELOCITY_179:16384, DET_RANGE_VELOCITY_180:16384, DET_RANGE_VELOCITY_ERR_177:0, DET_RANGE_VELOCITY_ERR_178:0, DET_RANGE_VELOCITY_ERR_179:0, DET_RANGE_VELOCITY_ERR_180:0, DET_RCS_177:128, DET_RCS_178:128, DET_RCS_179:128, DET_RCS_180:128, DET_SNR_177:0, DET_SNR_178:0, DET_SNR_179:0, DET_SNR_180:0, DET_SUPER_RES_TARGET_177:0, DET_SUPER_RES_TARGET_178:0, DET_SUPER_RES_TARGET_179:0, DET_SUPER_RES_TARGET_180:0]}, provided-interface=Pi_SG_Detections_177_180_AL
      Pp_SG_Detections_181_184_AL: nonqueued-sender-com-spec{data-element=Vdp_SG_Detections_181_184_AL, init-value=fields=[DET_AZIMUTH_181:0, DET_AZIMUTH_182:0, DET_AZIMUTH_183:0, DET_AZIMUTH_184:0, DET_AZIMUTH_ERR_181:0, DET_AZIMUTH_ERR_182:0, DET_AZIMUTH_ERR_183:0, DET_AZIMUTH_ERR_184:0, DET_BELOW_RAIN_THOLD_181:0, DET_BELOW_RAIN_THOLD_182:0, DET_BELOW_RAIN_THOLD_183:0, DET_BELOW_RAIN_THOLD_184:0, DET_BI_STATIC_FLAG_181:0, DET_BI_STATIC_FLAG_182:0, DET_BI_STATIC_FLAG_183:0, DET_BI_STATIC_FLAG_184:0, DET_CONFD_AZIMUTH_181:0, DET_CONFD_AZIMUTH_182:0, DET_CONFD_AZIMUTH_183:0, DET_CONFD_AZIMUTH_184:0, DET_CONFD_ELEVATION_181:0, DET_CONFD_ELEVATION_182:0, DET_CONFD_ELEVATION_183:0, DET_CONFD_ELEVATION_184:0, DET_ELEVATION_181:0, DET_ELEVATION_182:0, DET_ELEVATION_183:0, DET_ELEVATION_184:0, DET_ELEVATION_ERR_181:0, DET_ELEVATION_ERR_182:0, DET_ELEVATION_ERR_183:0, DET_ELEVATION_ERR_184:0, DET_EXISTENCE_PROB_181:0, DET_EXISTENCE_PROB_182:0, DET_EXISTENCE_PROB_183:0, DET_EXISTENCE_PROB_184:0, DET_HVC_FLAG_181:0, DET_HVC_FLAG_182:0, DET_HVC_FLAG_183:0, DET_HVC_FLAG_184:0, DET_IDM_181:0, DET_IDM_182:0, DET_IDM_183:0, DET_IDM_184:0, DET_MH_CRC16_181_184:0, DET_MH_CYCLE_COUNTER_181_184:0, DET_MH_SCAN_INDEX_4LSB_181_184:0, DET_MTD_181:0, DET_MTD_182:0, DET_MTD_183:0, DET_MTD_184:0, DET_PROB_1STAZHYPO_181:0, DET_PROB_1STAZHYPO_182:0, DET_PROB_1STAZHYPO_183:0, DET_PROB_1STAZHYPO_184:0, DET_RANGE_181:0, DET_RANGE_182:0, DET_RANGE_183:0, DET_RANGE_184:0, DET_RANGE_ERR_181:0, DET_RANGE_ERR_182:0, DET_RANGE_ERR_183:0, DET_RANGE_ERR_184:0, DET_RANGE_VELOCITY_181:16384, DET_RANGE_VELOCITY_182:16384, DET_RANGE_VELOCITY_183:16384, DET_RANGE_VELOCITY_184:16384, DET_RANGE_VELOCITY_ERR_181:0, DET_RANGE_VELOCITY_ERR_182:0, DET_RANGE_VELOCITY_ERR_183:0, DET_RANGE_VELOCITY_ERR_184:0, DET_RCS_181:128, DET_RCS_182:128, DET_RCS_183:128, DET_RCS_184:128, DET_SNR_181:0, DET_SNR_182:0, DET_SNR_183:0, DET_SNR_184:0, DET_SUPER_RES_TARGET_181:0, DET_SUPER_RES_TARGET_182:0, DET_SUPER_RES_TARGET_183:0, DET_SUPER_RES_TARGET_184:0]}, provided-interface=Pi_SG_Detections_181_184_AL
      Pp_SG_Detections_185_188_AL: nonqueued-sender-com-spec{data-element=Vdp_SG_Detections_185_188_AL, init-value=fields=[DET_AZIMUTH_185:0, DET_AZIMUTH_186:0, DET_AZIMUTH_187:0, DET_AZIMUTH_188:0, DET_AZIMUTH_ERR_185:0, DET_AZIMUTH_ERR_186:0, DET_AZIMUTH_ERR_187:0, DET_AZIMUTH_ERR_188:0, DET_BELOW_RAIN_THOLD_185:0, DET_BELOW_RAIN_THOLD_186:0, DET_BELOW_RAIN_THOLD_187:0, DET_BELOW_RAIN_THOLD_188:0, DET_BI_STATIC_FLAG_185:0, DET_BI_STATIC_FLAG_186:0, DET_BI_STATIC_FLAG_187:0, DET_BI_STATIC_FLAG_188:0, DET_CONFD_AZIMUTH_185:0, DET_CONFD_AZIMUTH_186:0, DET_CONFD_AZIMUTH_187:0, DET_CONFD_AZIMUTH_188:0, DET_CONFD_ELEVATION_185:0, DET_CONFD_ELEVATION_186:0, DET_CONFD_ELEVATION_187:0, DET_CONFD_ELEVATION_188:0, DET_ELEVATION_185:0, DET_ELEVATION_186:0, DET_ELEVATION_187:0, DET_ELEVATION_188:0, DET_ELEVATION_ERR_185:0, DET_ELEVATION_ERR_186:0, DET_ELEVATION_ERR_187:0, DET_ELEVATION_ERR_188:0, DET_EXISTENCE_PROB_185:0, DET_EXISTENCE_PROB_186:0, DET_EXISTENCE_PROB_187:0, DET_EXISTENCE_PROB_188:0, DET_HVC_FLAG_185:0, DET_HVC_FLAG_186:0, DET_HVC_FLAG_187:0, DET_HVC_FLAG_188:0, DET_IDM_185:0, DET_IDM_186:0, DET_IDM_187:0, DET_IDM_188:0, DET_MH_CRC16_185_188:0, DET_MH_CYCLE_COUNTER_185_188:0, DET_MH_SCAN_INDEX_4LSB_185_188:0, DET_MTD_185:0, DET_MTD_186:0, DET_MTD_187:0, DET_MTD_188:0, DET_PROB_1STAZHYPO_185:0, DET_PROB_1STAZHYPO_186:0, DET_PROB_1STAZHYPO_187:0, DET_PROB_1STAZHYPO_188:0, DET_RANGE_185:0, DET_RANGE_186:0, DET_RANGE_187:0, DET_RANGE_188:0, DET_RANGE_ERR_185:0, DET_RANGE_ERR_186:0, DET_RANGE_ERR_187:0, DET_RANGE_ERR_188:0, DET_RANGE_VELOCITY_185:16384, DET_RANGE_VELOCITY_186:16384, DET_RANGE_VELOCITY_187:16384, DET_RANGE_VELOCITY_188:16384, DET_RANGE_VELOCITY_ERR_185:0, DET_RANGE_VELOCITY_ERR_186:0, DET_RANGE_VELOCITY_ERR_187:0, DET_RANGE_VELOCITY_ERR_188:0, DET_RCS_185:128, DET_RCS_186:128, DET_RCS_187:128, DET_RCS_188:128, DET_SNR_185:0, DET_SNR_186:0, DET_SNR_187:0, DET_SNR_188:0, DET_SUPER_RES_TARGET_185:0, DET_SUPER_RES_TARGET_186:0, DET_SUPER_RES_TARGET_187:0, DET_SUPER_RES_TARGET_188:0]}, provided-interface=Pi_SG_Detections_185_188_AL
      Pp_SG_Detections_189_192_AL: nonqueued-sender-com-spec{data-element=Vdp_SG_Detections_189_192_AL, init-value=fields=[DET_AZIMUTH_189:0, DET_AZIMUTH_190:0, DET_AZIMUTH_191:0, DET_AZIMUTH_192:0, DET_AZIMUTH_ERR_189:0, DET_AZIMUTH_ERR_190:0, DET_AZIMUTH_ERR_191:0, DET_AZIMUTH_ERR_192:0, DET_BELOW_RAIN_THOLD_189:0, DET_BELOW_RAIN_THOLD_190:0, DET_BELOW_RAIN_THOLD_191:0, DET_BELOW_RAIN_THOLD_192:0, DET_BI_STATIC_FLAG_189:0, DET_BI_STATIC_FLAG_190:0, DET_BI_STATIC_FLAG_191:0, DET_BI_STATIC_FLAG_192:0, DET_CONFD_AZIMUTH_189:0, DET_CONFD_AZIMUTH_190:0, DET_CONFD_AZIMUTH_191:0, DET_CONFD_AZIMUTH_192:0, DET_CONFD_ELEVATION_189:0, DET_CONFD_ELEVATION_190:0, DET_CONFD_ELEVATION_191:0, DET_CONFD_ELEVATION_192:0, DET_ELEVATION_189:0, DET_ELEVATION_190:0, DET_ELEVATION_191:0, DET_ELEVATION_192:0, DET_ELEVATION_ERR_189:0, DET_ELEVATION_ERR_190:0, DET_ELEVATION_ERR_191:0, DET_ELEVATION_ERR_192:0, DET_EXISTENCE_PROB_189:0, DET_EXISTENCE_PROB_190:0, DET_EXISTENCE_PROB_191:0, DET_EXISTENCE_PROB_192:0, DET_HVC_FLAG_189:0, DET_HVC_FLAG_190:0, DET_HVC_FLAG_191:0, DET_HVC_FLAG_192:0, DET_IDM_189:0, DET_IDM_190:0, DET_IDM_191:0, DET_IDM_192:0, DET_MH_CRC16_189_192:0, DET_MH_CYCLE_COUNTER_189_192:0, DET_MH_SCAN_INDEX_4LSB_189_192:0, DET_MTD_189:0, DET_MTD_190:0, DET_MTD_191:0, DET_MTD_192:0, DET_PROB_1STAZHYPO_189:0, DET_PROB_1STAZHYPO_190:0, DET_PROB_1STAZHYPO_191:0, DET_PROB_1STAZHYPO_192:0, DET_RANGE_189:0, DET_RANGE_190:0, DET_RANGE_191:0, DET_RANGE_192:0, DET_RANGE_ERR_189:0, DET_RANGE_ERR_190:0, DET_RANGE_ERR_191:0, DET_RANGE_ERR_192:0, DET_RANGE_VELOCITY_189:16384, DET_RANGE_VELOCITY_190:16384, DET_RANGE_VELOCITY_191:16384, DET_RANGE_VELOCITY_192:16384, DET_RANGE_VELOCITY_ERR_189:0, DET_RANGE_VELOCITY_ERR_190:0, DET_RANGE_VELOCITY_ERR_191:0, DET_RANGE_VELOCITY_ERR_192:0, DET_RCS_189:128, DET_RCS_190:128, DET_RCS_191:128, DET_RCS_192:128, DET_SNR_189:0, DET_SNR_190:0, DET_SNR_191:0, DET_SNR_192:0, DET_SUPER_RES_TARGET_189:0, DET_SUPER_RES_TARGET_190:0, DET_SUPER_RES_TARGET_191:0, DET_SUPER_RES_TARGET_192:0]}, provided-interface=Pi_SG_Detections_189_192_AL
      Pp_SG_Detections_193_196_AL: nonqueued-sender-com-spec{data-element=Vdp_SG_Detections_193_196_AL, init-value=fields=[DET_AZIMUTH_193:0, DET_AZIMUTH_194:0, DET_AZIMUTH_195:0, DET_AZIMUTH_196:0, DET_AZIMUTH_ERR_193:0, DET_AZIMUTH_ERR_194:0, DET_AZIMUTH_ERR_195:0, DET_AZIMUTH_ERR_196:0, DET_BELOW_RAIN_THOLD_193:0, DET_BELOW_RAIN_THOLD_194:0, DET_BELOW_RAIN_THOLD_195:0, DET_BELOW_RAIN_THOLD_196:0, DET_BI_STATIC_FLAG_193:0, DET_BI_STATIC_FLAG_194:0, DET_BI_STATIC_FLAG_195:0, DET_BI_STATIC_FLAG_196:0, DET_CONFD_AZIMUTH_193:0, DET_CONFD_AZIMUTH_194:0, DET_CONFD_AZIMUTH_195:0, DET_CONFD_AZIMUTH_196:0, DET_CONFD_ELEVATION_193:0, DET_CONFD_ELEVATION_194:0, DET_CONFD_ELEVATION_195:0, DET_CONFD_ELEVATION_196:0, DET_ELEVATION_193:0, DET_ELEVATION_194:0, DET_ELEVATION_195:0, DET_ELEVATION_196:0, DET_ELEVATION_ERR_193:0, DET_ELEVATION_ERR_194:0, DET_ELEVATION_ERR_195:0, DET_ELEVATION_ERR_196:0, DET_EXISTENCE_PROB_193:0, DET_EXISTENCE_PROB_194:0, DET_EXISTENCE_PROB_195:0, DET_EXISTENCE_PROB_196:0, DET_HVC_FLAG_193:0, DET_HVC_FLAG_194:0, DET_HVC_FLAG_195:0, DET_HVC_FLAG_196:0, DET_IDM_193:0, DET_IDM_194:0, DET_IDM_195:0, DET_IDM_196:0, DET_MH_CRC16_193_196:0, DET_MH_CYCLE_COUNTER_193_196:0, DET_MH_SCAN_INDEX_4LSB_193_196:0, DET_MTD_193:0, DET_MTD_194:0, DET_MTD_195:0, DET_MTD_196:0, DET_PROB_1STAZHYPO_193:0, DET_PROB_1STAZHYPO_194:0, DET_PROB_1STAZHYPO_195:0, DET_PROB_1STAZHYPO_196:0, DET_RANGE_193:0, DET_RANGE_194:0, DET_RANGE_195:0, DET_RANGE_196:0, DET_RANGE_ERR_193:0, DET_RANGE_ERR_194:0, DET_RANGE_ERR_195:0, DET_RANGE_ERR_196:0, DET_RANGE_VELOCITY_193:16384, DET_RANGE_VELOCITY_194:16384, DET_RANGE_VELOCITY_195:16384, DET_RANGE_VELOCITY_196:16384, DET_RANGE_VELOCITY_ERR_193:0, DET_RANGE_VELOCITY_ERR_194:0, DET_RANGE_VELOCITY_ERR_195:0, DET_RANGE_VELOCITY_ERR_196:0, DET_RCS_193:128, DET_RCS_194:128, DET_RCS_195:128, DET_RCS_196:128, DET_SNR_193:0, DET_SNR_194:0, DET_SNR_195:0, DET_SNR_196:0, DET_SUPER_RES_TARGET_193:0, DET_SUPER_RES_TARGET_194:0, DET_SUPER_RES_TARGET_195:0, DET_SUPER_RES_TARGET_196:0]}, provided-interface=Pi_SG_Detections_193_196_AL
      Pp_SG_Detections_197_200_AL: nonqueued-sender-com-spec{data-element=Vdp_SG_Detections_197_200_AL, init-value=fields=[DET_AZIMUTH_197:0, DET_AZIMUTH_198:0, DET_AZIMUTH_199:0, DET_AZIMUTH_200:0, DET_AZIMUTH_ERR_197:0, DET_AZIMUTH_ERR_198:0, DET_AZIMUTH_ERR_199:0, DET_AZIMUTH_ERR_200:0, DET_BELOW_RAIN_THOLD_197:0, DET_BELOW_RAIN_THOLD_198:0, DET_BELOW_RAIN_THOLD_199:0, DET_BELOW_RAIN_THOLD_200:0, DET_BI_STATIC_FLAG_197:0, DET_BI_STATIC_FLAG_198:0, DET_BI_STATIC_FLAG_199:0, DET_BI_STATIC_FLAG_200:0, DET_CONFD_AZIMUTH_197:0, DET_CONFD_AZIMUTH_198:0, DET_CONFD_AZIMUTH_199:0, DET_CONFD_AZIMUTH_200:0, DET_CONFD_ELEVATION_197:0, DET_CONFD_ELEVATION_198:0, DET_CONFD_ELEVATION_199:0, DET_CONFD_ELEVATION_200:0, DET_ELEVATION_197:0, DET_ELEVATION_198:0, DET_ELEVATION_199:0, DET_ELEVATION_200:0, DET_ELEVATION_ERR_197:0, DET_ELEVATION_ERR_198:0, DET_ELEVATION_ERR_199:0, DET_ELEVATION_ERR_200:0, DET_EXISTENCE_PROB_197:0, DET_EXISTENCE_PROB_198:0, DET_EXISTENCE_PROB_199:0, DET_EXISTENCE_PROB_200:0, DET_HVC_FLAG_197:0, DET_HVC_FLAG_198:0, DET_HVC_FLAG_199:0, DET_HVC_FLAG_200:0, DET_IDM_197:0, DET_IDM_198:0, DET_IDM_199:0, DET_IDM_200:0, DET_MH_CRC16_197_200:0, DET_MH_CYCLE_COUNTER_197_200:0, DET_MH_SCAN_INDEX_4LSB_197_200:0, DET_MTD_197:0, DET_MTD_198:0, DET_MTD_199:0, DET_MTD_200:0, DET_PROB_1STAZHYPO_197:0, DET_PROB_1STAZHYPO_198:0, DET_PROB_1STAZHYPO_199:0, DET_PROB_1STAZHYPO_200:0, DET_RANGE_197:0, DET_RANGE_198:0, DET_RANGE_199:0, DET_RANGE_200:0, DET_RANGE_ERR_197:0, DET_RANGE_ERR_198:0, DET_RANGE_ERR_199:0, DET_RANGE_ERR_200:0, DET_RANGE_VELOCITY_197:16384, DET_RANGE_VELOCITY_198:16384, DET_RANGE_VELOCITY_199:16384, DET_RANGE_VELOCITY_200:16384, DET_RANGE_VELOCITY_ERR_197:0, DET_RANGE_VELOCITY_ERR_198:0, DET_RANGE_VELOCITY_ERR_199:0, DET_RANGE_VELOCITY_ERR_200:0, DET_RCS_197:128, DET_RCS_198:128, DET_RCS_199:128, DET_RCS_200:128, DET_SNR_197:0, DET_SNR_198:0, DET_SNR_199:0, DET_SNR_200:0, DET_SUPER_RES_TARGET_197:0, DET_SUPER_RES_TARGET_198:0, DET_SUPER_RES_TARGET_199:0, DET_SUPER_RES_TARGET_200:0]}, provided-interface=Pi_SG_Detections_197_200_AL
      Pp_SG_Detections_201_204_AL: nonqueued-sender-com-spec{data-element=Vdp_SG_Detections_201_204_AL, init-value=fields=[DET_AZIMUTH_201:0, DET_AZIMUTH_202:0, DET_AZIMUTH_203:0, DET_AZIMUTH_204:0, DET_AZIMUTH_ERR_201:0, DET_AZIMUTH_ERR_202:0, DET_AZIMUTH_ERR_203:0, DET_AZIMUTH_ERR_204:0, DET_BELOW_RAIN_THOLD_201:0, DET_BELOW_RAIN_THOLD_202:0, DET_BELOW_RAIN_THOLD_203:0, DET_BELOW_RAIN_THOLD_204:0, DET_BI_STATIC_FLAG_201:0, DET_BI_STATIC_FLAG_202:0, DET_BI_STATIC_FLAG_203:0, DET_BI_STATIC_FLAG_204:0, DET_CONFD_AZIMUTH_201:0, DET_CONFD_AZIMUTH_202:0, DET_CONFD_AZIMUTH_203:0, DET_CONFD_AZIMUTH_204:0, DET_CONFD_ELEVATION_201:0, DET_CONFD_ELEVATION_202:0, DET_CONFD_ELEVATION_203:0, DET_CONFD_ELEVATION_204:0, DET_ELEVATION_201:0, DET_ELEVATION_202:0, DET_ELEVATION_203:0, DET_ELEVATION_204:0, DET_ELEVATION_ERR_201:0, DET_ELEVATION_ERR_202:0, DET_ELEVATION_ERR_203:0, DET_ELEVATION_ERR_204:0, DET_EXISTENCE_PROB_201:0, DET_EXISTENCE_PROB_202:0, DET_EXISTENCE_PROB_203:0, DET_EXISTENCE_PROB_204:0, DET_HVC_FLAG_201:0, DET_HVC_FLAG_202:0, DET_HVC_FLAG_203:0, DET_HVC_FLAG_204:0, DET_IDM_201:0, DET_IDM_202:0, DET_IDM_203:0, DET_IDM_204:0, DET_MH_CRC16_201_204:0, DET_MH_CYCLE_COUNTER_201_204:0, DET_MH_SCAN_INDEX_4LSB_201_204:0, DET_MTD_201:0, DET_MTD_202:0, DET_MTD_203:0, DET_MTD_204:0, DET_PROB_1STAZHYPO_201:0, DET_PROB_1STAZHYPO_202:0, DET_PROB_1STAZHYPO_203:0, DET_PROB_1STAZHYPO_204:0, DET_RANGE_201:0, DET_RANGE_202:0, DET_RANGE_203:0, DET_RANGE_204:0, DET_RANGE_ERR_201:0, DET_RANGE_ERR_202:0, DET_RANGE_ERR_203:0, DET_RANGE_ERR_204:0, DET_RANGE_VELOCITY_201:16384, DET_RANGE_VELOCITY_202:16384, DET_RANGE_VELOCITY_203:16384, DET_RANGE_VELOCITY_204:16384, DET_RANGE_VELOCITY_ERR_201:0, DET_RANGE_VELOCITY_ERR_202:0, DET_RANGE_VELOCITY_ERR_203:0, DET_RANGE_VELOCITY_ERR_204:0, DET_RCS_201:128, DET_RCS_202:128, DET_RCS_203:128, DET_RCS_204:128, DET_SNR_201:0, DET_SNR_202:0, DET_SNR_203:0, DET_SNR_204:0, DET_SUPER_RES_TARGET_201:0, DET_SUPER_RES_TARGET_202:0, DET_SUPER_RES_TARGET_203:0, DET_SUPER_RES_TARGET_204:0]}, provided-interface=Pi_SG_Detections_201_204_AL
      Pp_SG_Detections_205_208_AL: nonqueued-sender-com-spec{data-element=Vdp_SG_Detections_205_208_AL, init-value=fields=[DET_AZIMUTH_205:0, DET_AZIMUTH_206:0, DET_AZIMUTH_207:0, DET_AZIMUTH_208:0, DET_AZIMUTH_ERR_205:0, DET_AZIMUTH_ERR_206:0, DET_AZIMUTH_ERR_207:0, DET_AZIMUTH_ERR_208:0, DET_BELOW_RAIN_THOLD_205:0, DET_BELOW_RAIN_THOLD_206:0, DET_BELOW_RAIN_THOLD_207:0, DET_BELOW_RAIN_THOLD_208:0, DET_BI_STATIC_FLAG_205:0, DET_BI_STATIC_FLAG_206:0, DET_BI_STATIC_FLAG_207:0, DET_BI_STATIC_FLAG_208:0, DET_CONFD_AZIMUTH_205:0, DET_CONFD_AZIMUTH_206:0, DET_CONFD_AZIMUTH_207:0, DET_CONFD_AZIMUTH_208:0, DET_CONFD_ELEVATION_205:0, DET_CONFD_ELEVATION_206:0, DET_CONFD_ELEVATION_207:0, DET_CONFD_ELEVATION_208:0, DET_ELEVATION_205:0, DET_ELEVATION_206:0, DET_ELEVATION_207:0, DET_ELEVATION_208:0, DET_ELEVATION_ERR_205:0, DET_ELEVATION_ERR_206:0, DET_ELEVATION_ERR_207:0, DET_ELEVATION_ERR_208:0, DET_EXISTENCE_PROB_205:0, DET_EXISTENCE_PROB_206:0, DET_EXISTENCE_PROB_207:0, DET_EXISTENCE_PROB_208:0, DET_HVC_FLAG_205:0, DET_HVC_FLAG_206:0, DET_HVC_FLAG_207:0, DET_HVC_FLAG_208:0, DET_IDM_205:0, DET_IDM_206:0, DET_IDM_207:0, DET_IDM_208:0, DET_MH_CRC16_205_208:0, DET_MH_CYCLE_COUNTER_205_208:0, DET_MH_SCAN_INDEX_4LSB_205_208:0, DET_MTD_205:0, DET_MTD_206:0, DET_MTD_207:0, DET_MTD_208:0, DET_PROB_1STAZHYPO_205:0, DET_PROB_1STAZHYPO_206:0, DET_PROB_1STAZHYPO_207:0, DET_PROB_1STAZHYPO_208:0, DET_RANGE_205:0, DET_RANGE_206:0, DET_RANGE_207:0, DET_RANGE_208:0, DET_RANGE_ERR_205:0, DET_RANGE_ERR_206:0, DET_RANGE_ERR_207:0, DET_RANGE_ERR_208:0, DET_RANGE_VELOCITY_205:16384, DET_RANGE_VELOCITY_206:16384, DET_RANGE_VELOCITY_207:16384, DET_RANGE_VELOCITY_208:16384, DET_RANGE_VELOCITY_ERR_205:0, DET_RANGE_VELOCITY_ERR_206:0, DET_RANGE_VELOCITY_ERR_207:0, DET_RANGE_VELOCITY_ERR_208:0, DET_RCS_205:128, DET_RCS_206:128, DET_RCS_207:128, DET_RCS_208:128, DET_SNR_205:0, DET_SNR_206:0, DET_SNR_207:0, DET_SNR_208:0, DET_SUPER_RES_TARGET_205:0, DET_SUPER_RES_TARGET_206:0, DET_SUPER_RES_TARGET_207:0, DET_SUPER_RES_TARGET_208:0]}, provided-interface=Pi_SG_Detections_205_208_AL
      Pp_SG_Detections_209_212_AL: nonqueued-sender-com-spec{data-element=Vdp_SG_Detections_209_212_AL, init-value=fields=[DET_AZIMUTH_209:0, DET_AZIMUTH_210:0, DET_AZIMUTH_211:0, DET_AZIMUTH_212:0, DET_AZIMUTH_ERR_209:0, DET_AZIMUTH_ERR_210:0, DET_AZIMUTH_ERR_211:0, DET_AZIMUTH_ERR_212:0, DET_BELOW_RAIN_THOLD_209:0, DET_BELOW_RAIN_THOLD_210:0, DET_BELOW_RAIN_THOLD_211:0, DET_BELOW_RAIN_THOLD_212:0, DET_BI_STATIC_FLAG_209:0, DET_BI_STATIC_FLAG_210:0, DET_BI_STATIC_FLAG_211:0, DET_BI_STATIC_FLAG_212:0, DET_CONFD_AZIMUTH_209:0, DET_CONFD_AZIMUTH_210:0, DET_CONFD_AZIMUTH_211:0, DET_CONFD_AZIMUTH_212:0, DET_CONFD_ELEVATION_209:0, DET_CONFD_ELEVATION_210:0, DET_CONFD_ELEVATION_211:0, DET_CONFD_ELEVATION_212:0, DET_ELEVATION_209:0, DET_ELEVATION_210:0, DET_ELEVATION_211:0, DET_ELEVATION_212:0, DET_ELEVATION_ERR_209:0, DET_ELEVATION_ERR_210:0, DET_ELEVATION_ERR_211:0, DET_ELEVATION_ERR_212:0, DET_EXISTENCE_PROB_209:0, DET_EXISTENCE_PROB_210:0, DET_EXISTENCE_PROB_211:0, DET_EXISTENCE_PROB_212:0, DET_HVC_FLAG_209:0, DET_HVC_FLAG_210:0, DET_HVC_FLAG_211:0, DET_HVC_FLAG_212:0, DET_IDM_209:0, DET_IDM_210:0, DET_IDM_211:0, DET_IDM_212:0, DET_MH_CRC16_209_212:0, DET_MH_CYCLE_COUNTER_209_212:0, DET_MH_SCAN_INDEX_4LSB_209_212:0, DET_MTD_209:0, DET_MTD_210:0, DET_MTD_211:0, DET_MTD_212:0, DET_PROB_1STAZHYPO_209:0, DET_PROB_1STAZHYPO_210:0, DET_PROB_1STAZHYPO_211:0, DET_PROB_1STAZHYPO_212:0, DET_RANGE_209:0, DET_RANGE_210:0, DET_RANGE_211:0, DET_RANGE_212:0, DET_RANGE_ERR_209:0, DET_RANGE_ERR_210:0, DET_RANGE_ERR_211:0, DET_RANGE_ERR_212:0, DET_RANGE_VELOCITY_209:16384, DET_RANGE_VELOCITY_210:16384, DET_RANGE_VELOCITY_211:16384, DET_RANGE_VELOCITY_212:16384, DET_RANGE_VELOCITY_ERR_209:0, DET_RANGE_VELOCITY_ERR_210:0, DET_RANGE_VELOCITY_ERR_211:0, DET_RANGE_VELOCITY_ERR_212:0, DET_RCS_209:128, DET_RCS_210:128, DET_RCS_211:128, DET_RCS_212:128, DET_SNR_209:0, DET_SNR_210:0, DET_SNR_211:0, DET_SNR_212:0, DET_SUPER_RES_TARGET_209:0, DET_SUPER_RES_TARGET_210:0, DET_SUPER_RES_TARGET_211:0, DET_SUPER_RES_TARGET_212:0]}, provided-interface=Pi_SG_Detections_209_212_AL
      Pp_SG_Detections_213_216_AL: nonqueued-sender-com-spec{data-element=Vdp_SG_Detections_213_216_AL, init-value=fields=[DET_AZIMUTH_213:0, DET_AZIMUTH_214:0, DET_AZIMUTH_215:0, DET_AZIMUTH_216:0, DET_AZIMUTH_ERR_213:0, DET_AZIMUTH_ERR_214:0, DET_AZIMUTH_ERR_215:0, DET_AZIMUTH_ERR_216:0, DET_BELOW_RAIN_THOLD_213:0, DET_BELOW_RAIN_THOLD_214:0, DET_BELOW_RAIN_THOLD_215:0, DET_BELOW_RAIN_THOLD_216:0, DET_BI_STATIC_FLAG_213:0, DET_BI_STATIC_FLAG_214:0, DET_BI_STATIC_FLAG_215:0, DET_BI_STATIC_FLAG_216:0, DET_CONFD_AZIMUTH_213:0, DET_CONFD_AZIMUTH_214:0, DET_CONFD_AZIMUTH_215:0, DET_CONFD_AZIMUTH_216:0, DET_CONFD_ELEVATION_213:0, DET_CONFD_ELEVATION_214:0, DET_CONFD_ELEVATION_215:0, DET_CONFD_ELEVATION_216:0, DET_ELEVATION_213:0, DET_ELEVATION_214:0, DET_ELEVATION_215:0, DET_ELEVATION_216:0, DET_ELEVATION_ERR_213:0, DET_ELEVATION_ERR_214:0, DET_ELEVATION_ERR_215:0, DET_ELEVATION_ERR_216:0, DET_EXISTENCE_PROB_213:0, DET_EXISTENCE_PROB_214:0, DET_EXISTENCE_PROB_215:0, DET_EXISTENCE_PROB_216:0, DET_HVC_FLAG_213:0, DET_HVC_FLAG_214:0, DET_HVC_FLAG_215:0, DET_HVC_FLAG_216:0, DET_IDM_213:0, DET_IDM_214:0, DET_IDM_215:0, DET_IDM_216:0, DET_MH_CRC16_213_216:0, DET_MH_CYCLE_COUNTER_213_216:0, DET_MH_SCAN_INDEX_4LSB_213_216:0, DET_MTD_213:0, DET_MTD_214:0, DET_MTD_215:0, DET_MTD_216:0, DET_PROB_1STAZHYPO_213:0, DET_PROB_1STAZHYPO_214:0, DET_PROB_1STAZHYPO_215:0, DET_PROB_1STAZHYPO_216:0, DET_RANGE_213:0, DET_RANGE_214:0, DET_RANGE_215:0, DET_RANGE_216:0, DET_RANGE_ERR_213:0, DET_RANGE_ERR_214:0, DET_RANGE_ERR_215:0, DET_RANGE_ERR_216:0, DET_RANGE_VELOCITY_213:16384, DET_RANGE_VELOCITY_214:16384, DET_RANGE_VELOCITY_215:16384, DET_RANGE_VELOCITY_216:16384, DET_RANGE_VELOCITY_ERR_213:0, DET_RANGE_VELOCITY_ERR_214:0, DET_RANGE_VELOCITY_ERR_215:0, DET_RANGE_VELOCITY_ERR_216:0, DET_RCS_213:128, DET_RCS_214:128, DET_RCS_215:128, DET_RCS_216:128, DET_SNR_213:0, DET_SNR_214:0, DET_SNR_215:0, DET_SNR_216:0, DET_SUPER_RES_TARGET_213:0, DET_SUPER_RES_TARGET_214:0, DET_SUPER_RES_TARGET_215:0, DET_SUPER_RES_TARGET_216:0]}, provided-interface=Pi_SG_Detections_213_216_AL
      Pp_SG_Detections_217_220_AL: nonqueued-sender-com-spec{data-element=Vdp_SG_Detections_217_220_AL, init-value=fields=[DET_AZIMUTH_217:0, DET_AZIMUTH_218:0, DET_AZIMUTH_219:0, DET_AZIMUTH_220:0, DET_AZIMUTH_ERR_217:0, DET_AZIMUTH_ERR_218:0, DET_AZIMUTH_ERR_219:0, DET_AZIMUTH_ERR_220:0, DET_BELOW_RAIN_THOLD_217:0, DET_BELOW_RAIN_THOLD_218:0, DET_BELOW_RAIN_THOLD_219:0, DET_BELOW_RAIN_THOLD_220:0, DET_BI_STATIC_FLAG_217:0, DET_BI_STATIC_FLAG_218:0, DET_BI_STATIC_FLAG_219:0, DET_BI_STATIC_FLAG_220:0, DET_CONFD_AZIMUTH_217:0, DET_CONFD_AZIMUTH_218:0, DET_CONFD_AZIMUTH_219:0, DET_CONFD_AZIMUTH_220:0, DET_CONFD_ELEVATION_217:0, DET_CONFD_ELEVATION_218:0, DET_CONFD_ELEVATION_219:0, DET_CONFD_ELEVATION_220:0, DET_ELEVATION_217:0, DET_ELEVATION_218:0, DET_ELEVATION_219:0, DET_ELEVATION_220:0, DET_ELEVATION_ERR_217:0, DET_ELEVATION_ERR_218:0, DET_ELEVATION_ERR_219:0, DET_ELEVATION_ERR_220:0, DET_EXISTENCE_PROB_217:0, DET_EXISTENCE_PROB_218:0, DET_EXISTENCE_PROB_219:0, DET_EXISTENCE_PROB_220:0, DET_HVC_FLAG_217:0, DET_HVC_FLAG_218:0, DET_HVC_FLAG_219:0, DET_HVC_FLAG_220:0, DET_IDM_217:0, DET_IDM_218:0, DET_IDM_219:0, DET_IDM_220:0, DET_MH_CRC16_217_220:0, DET_MH_CYCLE_COUNTER_217_220:0, DET_MH_SCAN_INDEX_4LSB_217_220:0, DET_MTD_217:0, DET_MTD_218:0, DET_MTD_219:0, DET_MTD_220:0, DET_PROB_1STAZHYPO_217:0, DET_PROB_1STAZHYPO_218:0, DET_PROB_1STAZHYPO_219:0, DET_PROB_1STAZHYPO_220:0, DET_RANGE_217:0, DET_RANGE_218:0, DET_RANGE_219:0, DET_RANGE_220:0, DET_RANGE_ERR_217:0, DET_RANGE_ERR_218:0, DET_RANGE_ERR_219:0, DET_RANGE_ERR_220:0, DET_RANGE_VELOCITY_217:16384, DET_RANGE_VELOCITY_218:16384, DET_RANGE_VELOCITY_219:16384, DET_RANGE_VELOCITY_220:16384, DET_RANGE_VELOCITY_ERR_217:0, DET_RANGE_VELOCITY_ERR_218:0, DET_RANGE_VELOCITY_ERR_219:0, DET_RANGE_VELOCITY_ERR_220:0, DET_RCS_217:128, DET_RCS_218:128, DET_RCS_219:128, DET_RCS_220:128, DET_SNR_217:0, DET_SNR_218:0, DET_SNR_219:0, DET_SNR_220:0, DET_SUPER_RES_TARGET_217:0, DET_SUPER_RES_TARGET_218:0, DET_SUPER_RES_TARGET_219:0, DET_SUPER_RES_TARGET_220:0]}, provided-interface=Pi_SG_Detections_217_220_AL
      Pp_SG_Detections_221_224_AL: nonqueued-sender-com-spec{data-element=Vdp_SG_Detections_221_224_AL, init-value=fields=[DET_AZIMUTH_221:0, DET_AZIMUTH_222:0, DET_AZIMUTH_223:0, DET_AZIMUTH_224:0, DET_AZIMUTH_ERR_221:0, DET_AZIMUTH_ERR_222:0, DET_AZIMUTH_ERR_223:0, DET_AZIMUTH_ERR_224:0, DET_BELOW_RAIN_THOLD_221:0, DET_BELOW_RAIN_THOLD_222:0, DET_BELOW_RAIN_THOLD_223:0, DET_BELOW_RAIN_THOLD_224:0, DET_BI_STATIC_FLAG_221:0, DET_BI_STATIC_FLAG_222:0, DET_BI_STATIC_FLAG_223:0, DET_BI_STATIC_FLAG_224:0, DET_CONFD_AZIMUTH_221:0, DET_CONFD_AZIMUTH_222:0, DET_CONFD_AZIMUTH_223:0, DET_CONFD_AZIMUTH_224:0, DET_CONFD_ELEVATION_221:0, DET_CONFD_ELEVATION_222:0, DET_CONFD_ELEVATION_223:0, DET_CONFD_ELEVATION_224:0, DET_ELEVATION_221:0, DET_ELEVATION_222:0, DET_ELEVATION_223:0, DET_ELEVATION_224:0, DET_ELEVATION_ERR_221:0, DET_ELEVATION_ERR_222:0, DET_ELEVATION_ERR_223:0, DET_ELEVATION_ERR_224:0, DET_EXISTENCE_PROB_221:0, DET_EXISTENCE_PROB_222:0, DET_EXISTENCE_PROB_223:0, DET_EXISTENCE_PROB_224:0, DET_HVC_FLAG_221:0, DET_HVC_FLAG_222:0, DET_HVC_FLAG_223:0, DET_HVC_FLAG_224:0, DET_IDM_221:0, DET_IDM_222:0, DET_IDM_223:0, DET_IDM_224:0, DET_MH_CRC16_221_224:0, DET_MH_CYCLE_COUNTER_221_224:0, DET_MH_SCAN_INDEX_4LSB_221_224:0, DET_MTD_221:0, DET_MTD_222:0, DET_MTD_223:0, DET_MTD_224:0, DET_PROB_1STAZHYPO_221:0, DET_PROB_1STAZHYPO_222:0, DET_PROB_1STAZHYPO_223:0, DET_PROB_1STAZHYPO_224:0, DET_RANGE_221:0, DET_RANGE_222:0, DET_RANGE_223:0, DET_RANGE_224:0, DET_RANGE_ERR_221:0, DET_RANGE_ERR_222:0, DET_RANGE_ERR_223:0, DET_RANGE_ERR_224:0, DET_RANGE_VELOCITY_221:16384, DET_RANGE_VELOCITY_222:16384, DET_RANGE_VELOCITY_223:16384, DET_RANGE_VELOCITY_224:16384, DET_RANGE_VELOCITY_ERR_221:0, DET_RANGE_VELOCITY_ERR_222:0, DET_RANGE_VELOCITY_ERR_223:0, DET_RANGE_VELOCITY_ERR_224:0, DET_RCS_221:128, DET_RCS_222:128, DET_RCS_223:128, DET_RCS_224:128, DET_SNR_221:0, DET_SNR_222:0, DET_SNR_223:0, DET_SNR_224:0, DET_SUPER_RES_TARGET_221:0, DET_SUPER_RES_TARGET_222:0, DET_SUPER_RES_TARGET_223:0, DET_SUPER_RES_TARGET_224:0]}, provided-interface=Pi_SG_Detections_221_224_AL
      Pp_SG_Detections_225_228_AL: nonqueued-sender-com-spec{data-element=Vdp_SG_Detections_225_228_AL, init-value=fields=[DET_AZIMUTH_225:0, DET_AZIMUTH_226:0, DET_AZIMUTH_227:0, DET_AZIMUTH_228:0, DET_AZIMUTH_ERR_225:0, DET_AZIMUTH_ERR_226:0, DET_AZIMUTH_ERR_227:0, DET_AZIMUTH_ERR_228:0, DET_BELOW_RAIN_THOLD_225:0, DET_BELOW_RAIN_THOLD_226:0, DET_BELOW_RAIN_THOLD_227:0, DET_BELOW_RAIN_THOLD_228:0, DET_BI_STATIC_FLAG_225:0, DET_BI_STATIC_FLAG_226:0, DET_BI_STATIC_FLAG_227:0, DET_BI_STATIC_FLAG_228:0, DET_CONFD_AZIMUTH_225:0, DET_CONFD_AZIMUTH_226:0, DET_CONFD_AZIMUTH_227:0, DET_CONFD_AZIMUTH_228:0, DET_CONFD_ELEVATION_225:0, DET_CONFD_ELEVATION_226:0, DET_CONFD_ELEVATION_227:0, DET_CONFD_ELEVATION_228:0, DET_ELEVATION_225:0, DET_ELEVATION_226:0, DET_ELEVATION_227:0, DET_ELEVATION_228:0, DET_ELEVATION_ERR_225:0, DET_ELEVATION_ERR_226:0, DET_ELEVATION_ERR_227:0, DET_ELEVATION_ERR_228:0, DET_EXISTENCE_PROB_225:0, DET_EXISTENCE_PROB_226:0, DET_EXISTENCE_PROB_227:0, DET_EXISTENCE_PROB_228:0, DET_HVC_FLAG_225:0, DET_HVC_FLAG_226:0, DET_HVC_FLAG_227:0, DET_HVC_FLAG_228:0, DET_IDM_225:0, DET_IDM_226:0, DET_IDM_227:0, DET_IDM_228:0, DET_MH_CRC16_225_228:0, DET_MH_CYCLE_COUNTER_225_228:0, DET_MH_SCAN_INDEX_4LSB_225_228:0, DET_MTD_225:0, DET_MTD_226:0, DET_MTD_227:0, DET_MTD_228:0, DET_PROB_1STAZHYPO_225:0, DET_PROB_1STAZHYPO_226:0, DET_PROB_1STAZHYPO_227:0, DET_PROB_1STAZHYPO_228:0, DET_RANGE_225:0, DET_RANGE_226:0, DET_RANGE_227:0, DET_RANGE_228:0, DET_RANGE_ERR_225:0, DET_RANGE_ERR_226:0, DET_RANGE_ERR_227:0, DET_RANGE_ERR_228:0, DET_RANGE_VELOCITY_225:16384, DET_RANGE_VELOCITY_226:16384, DET_RANGE_VELOCITY_227:16384, DET_RANGE_VELOCITY_228:16384, DET_RANGE_VELOCITY_ERR_225:0, DET_RANGE_VELOCITY_ERR_226:0, DET_RANGE_VELOCITY_ERR_227:0, DET_RANGE_VELOCITY_ERR_228:0, DET_RCS_225:128, DET_RCS_226:128, DET_RCS_227:128, DET_RCS_228:128, DET_SNR_225:0, DET_SNR_226:0, DET_SNR_227:0, DET_SNR_228:0, DET_SUPER_RES_TARGET_225:0, DET_SUPER_RES_TARGET_226:0, DET_SUPER_RES_TARGET_227:0, DET_SUPER_RES_TARGET_228:0]}, provided-interface=Pi_SG_Detections_225_228_AL
      Pp_SG_Detections_229_232_AL: nonqueued-sender-com-spec{data-element=Vdp_SG_Detections_229_232_AL, init-value=fields=[DET_AZIMUTH_229:0, DET_AZIMUTH_230:0, DET_AZIMUTH_231:0, DET_AZIMUTH_232:0, DET_AZIMUTH_ERR_229:0, DET_AZIMUTH_ERR_230:0, DET_AZIMUTH_ERR_231:0, DET_AZIMUTH_ERR_232:0, DET_BELOW_RAIN_THOLD_229:0, DET_BELOW_RAIN_THOLD_230:0, DET_BELOW_RAIN_THOLD_231:0, DET_BELOW_RAIN_THOLD_232:0, DET_BI_STATIC_FLAG_229:0, DET_BI_STATIC_FLAG_230:0, DET_BI_STATIC_FLAG_231:0, DET_BI_STATIC_FLAG_232:0, DET_CONFD_AZIMUTH_229:0, DET_CONFD_AZIMUTH_230:0, DET_CONFD_AZIMUTH_231:0, DET_CONFD_AZIMUTH_232:0, DET_CONFD_ELEVATION_229:0, DET_CONFD_ELEVATION_230:0, DET_CONFD_ELEVATION_231:0, DET_CONFD_ELEVATION_232:0, DET_ELEVATION_229:0, DET_ELEVATION_230:0, DET_ELEVATION_231:0, DET_ELEVATION_232:0, DET_ELEVATION_ERR_229:0, DET_ELEVATION_ERR_230:0, DET_ELEVATION_ERR_231:0, DET_ELEVATION_ERR_232:0, DET_EXISTENCE_PROB_229:0, DET_EXISTENCE_PROB_230:0, DET_EXISTENCE_PROB_231:0, DET_EXISTENCE_PROB_232:0, DET_HVC_FLAG_229:0, DET_HVC_FLAG_230:0, DET_HVC_FLAG_231:0, DET_HVC_FLAG_232:0, DET_IDM_229:0, DET_IDM_230:0, DET_IDM_231:0, DET_IDM_232:0, DET_MH_CRC16_229_232:0, DET_MH_CYCLE_COUNTER_229_232:0, DET_MH_SCAN_INDEX_4LSB_229_232:0, DET_MTD_229:0, DET_MTD_230:0, DET_MTD_231:0, DET_MTD_232:0, DET_PROB_1STAZHYPO_229:0, DET_PROB_1STAZHYPO_230:0, DET_PROB_1STAZHYPO_231:0, DET_PROB_1STAZHYPO_232:0, DET_RANGE_229:0, DET_RANGE_230:0, DET_RANGE_231:0, DET_RANGE_232:0, DET_RANGE_ERR_229:0, DET_RANGE_ERR_230:0, DET_RANGE_ERR_231:0, DET_RANGE_ERR_232:0, DET_RANGE_VELOCITY_229:16384, DET_RANGE_VELOCITY_230:16384, DET_RANGE_VELOCITY_231:16384, DET_RANGE_VELOCITY_232:16384, DET_RANGE_VELOCITY_ERR_229:0, DET_RANGE_VELOCITY_ERR_230:0, DET_RANGE_VELOCITY_ERR_231:0, DET_RANGE_VELOCITY_ERR_232:0, DET_RCS_229:128, DET_RCS_230:128, DET_RCS_231:128, DET_RCS_232:128, DET_SNR_229:0, DET_SNR_230:0, DET_SNR_231:0, DET_SNR_232:0, DET_SUPER_RES_TARGET_229:0, DET_SUPER_RES_TARGET_230:0, DET_SUPER_RES_TARGET_231:0, DET_SUPER_RES_TARGET_232:0]}, provided-interface=Pi_SG_Detections_229_232_AL
      Pp_SG_Detections_233_236_AL: nonqueued-sender-com-spec{data-element=Vdp_SG_Detections_233_236_AL, init-value=fields=[DET_AZIMUTH_233:0, DET_AZIMUTH_234:0, DET_AZIMUTH_235:0, DET_AZIMUTH_236:0, DET_AZIMUTH_ERR_233:0, DET_AZIMUTH_ERR_234:0, DET_AZIMUTH_ERR_235:0, DET_AZIMUTH_ERR_236:0, DET_BELOW_RAIN_THOLD_233:0, DET_BELOW_RAIN_THOLD_234:0, DET_BELOW_RAIN_THOLD_235:0, DET_BELOW_RAIN_THOLD_236:0, DET_BI_STATIC_FLAG_233:0, DET_BI_STATIC_FLAG_234:0, DET_BI_STATIC_FLAG_235:0, DET_BI_STATIC_FLAG_236:0, DET_CONFD_AZIMUTH_233:0, DET_CONFD_AZIMUTH_234:0, DET_CONFD_AZIMUTH_235:0, DET_CONFD_AZIMUTH_236:0, DET_CONFD_ELEVATION_233:0, DET_CONFD_ELEVATION_234:0, DET_CONFD_ELEVATION_235:0, DET_CONFD_ELEVATION_236:0, DET_ELEVATION_233:0, DET_ELEVATION_234:0, DET_ELEVATION_235:0, DET_ELEVATION_236:0, DET_ELEVATION_ERR_233:0, DET_ELEVATION_ERR_234:0, DET_ELEVATION_ERR_235:0, DET_ELEVATION_ERR_236:0, DET_EXISTENCE_PROB_233:0, DET_EXISTENCE_PROB_234:0, DET_EXISTENCE_PROB_235:0, DET_EXISTENCE_PROB_236:0, DET_HVC_FLAG_233:0, DET_HVC_FLAG_234:0, DET_HVC_FLAG_235:0, DET_HVC_FLAG_236:0, DET_IDM_233:0, DET_IDM_234:0, DET_IDM_235:0, DET_IDM_236:0, DET_MH_CRC16_233_236:0, DET_MH_CYCLE_COUNTER_233_236:0, DET_MH_SCAN_INDEX_4LSB_233_236:0, DET_MTD_233:0, DET_MTD_234:0, DET_MTD_235:0, DET_MTD_236:0, DET_PROB_1STAZHYPO_233:0, DET_PROB_1STAZHYPO_234:0, DET_PROB_1STAZHYPO_235:0, DET_PROB_1STAZHYPO_236:0, DET_RANGE_233:0, DET_RANGE_234:0, DET_RANGE_235:0, DET_RANGE_236:0, DET_RANGE_ERR_233:0, DET_RANGE_ERR_234:0, DET_RANGE_ERR_235:0, DET_RANGE_ERR_236:0, DET_RANGE_VELOCITY_233:16384, DET_RANGE_VELOCITY_234:16384, DET_RANGE_VELOCITY_235:16384, DET_RANGE_VELOCITY_236:16384, DET_RANGE_VELOCITY_ERR_233:0, DET_RANGE_VELOCITY_ERR_234:0, DET_RANGE_VELOCITY_ERR_235:0, DET_RANGE_VELOCITY_ERR_236:0, DET_RCS_233:128, DET_RCS_234:128, DET_RCS_235:128, DET_RCS_236:128, DET_SNR_233:0, DET_SNR_234:0, DET_SNR_235:0, DET_SNR_236:0, DET_SUPER_RES_TARGET_233:0, DET_SUPER_RES_TARGET_234:0, DET_SUPER_RES_TARGET_235:0, DET_SUPER_RES_TARGET_236:0]}, provided-interface=Pi_SG_Detections_233_236_AL
      Pp_SG_Detections_237_240_AL: nonqueued-sender-com-spec{data-element=Vdp_SG_Detections_237_240_AL, init-value=fields=[DET_AZIMUTH_237:0, DET_AZIMUTH_238:0, DET_AZIMUTH_239:0, DET_AZIMUTH_240:0, DET_AZIMUTH_ERR_237:0, DET_AZIMUTH_ERR_238:0, DET_AZIMUTH_ERR_239:0, DET_AZIMUTH_ERR_240:0, DET_BELOW_RAIN_THOLD_237:0, DET_BELOW_RAIN_THOLD_238:0, DET_BELOW_RAIN_THOLD_239:0, DET_BELOW_RAIN_THOLD_240:0, DET_BI_STATIC_FLAG_237:0, DET_BI_STATIC_FLAG_238:0, DET_BI_STATIC_FLAG_239:0, DET_BI_STATIC_FLAG_240:0, DET_CONFD_AZIMUTH_237:0, DET_CONFD_AZIMUTH_238:0, DET_CONFD_AZIMUTH_239:0, DET_CONFD_AZIMUTH_240:0, DET_CONFD_ELEVATION_237:0, DET_CONFD_ELEVATION_238:0, DET_CONFD_ELEVATION_239:0, DET_CONFD_ELEVATION_240:0, DET_ELEVATION_237:0, DET_ELEVATION_238:0, DET_ELEVATION_239:0, DET_ELEVATION_240:0, DET_ELEVATION_ERR_237:0, DET_ELEVATION_ERR_238:0, DET_ELEVATION_ERR_239:0, DET_ELEVATION_ERR_240:0, DET_EXISTENCE_PROB_237:0, DET_EXISTENCE_PROB_238:0, DET_EXISTENCE_PROB_239:0, DET_EXISTENCE_PROB_240:0, DET_HVC_FLAG_237:0, DET_HVC_FLAG_238:0, DET_HVC_FLAG_239:0, DET_HVC_FLAG_240:0, DET_IDM_237:0, DET_IDM_238:0, DET_IDM_239:0, DET_IDM_240:0, DET_MH_CRC16_237_240:0, DET_MH_CYCLE_COUNTER_237_240:0, DET_MH_SCAN_INDEX_4LSB_237_240:0, DET_MTD_237:0, DET_MTD_238:0, DET_MTD_239:0, DET_MTD_240:0, DET_PROB_1STAZHYPO_237:0, DET_PROB_1STAZHYPO_238:0, DET_PROB_1STAZHYPO_239:0, DET_PROB_1STAZHYPO_240:0, DET_RANGE_237:0, DET_RANGE_238:0, DET_RANGE_239:0, DET_RANGE_240:0, DET_RANGE_ERR_237:0, DET_RANGE_ERR_238:0, DET_RANGE_ERR_239:0, DET_RANGE_ERR_240:0, DET_RANGE_VELOCITY_237:16384, DET_RANGE_VELOCITY_238:16384, DET_RANGE_VELOCITY_239:16384, DET_RANGE_VELOCITY_240:16384, DET_RANGE_VELOCITY_ERR_237:0, DET_RANGE_VELOCITY_ERR_238:0, DET_RANGE_VELOCITY_ERR_239:0, DET_RANGE_VELOCITY_ERR_240:0, DET_RCS_237:128, DET_RCS_238:128, DET_RCS_239:128, DET_RCS_240:128, DET_SNR_237:0, DET_SNR_238:0, DET_SNR_239:0, DET_SNR_240:0, DET_SUPER_RES_TARGET_237:0, DET_SUPER_RES_TARGET_238:0, DET_SUPER_RES_TARGET_239:0, DET_SUPER_RES_TARGET_240:0]}, provided-interface=Pi_SG_Detections_237_240_AL
      Pp_SG_Detections_241_244_AL: nonqueued-sender-com-spec{data-element=Vdp_SG_Detections_241_244_AL, init-value=fields=[DET_AZIMUTH_241:0, DET_AZIMUTH_242:0, DET_AZIMUTH_243:0, DET_AZIMUTH_244:0, DET_AZIMUTH_ERR_241:0, DET_AZIMUTH_ERR_242:0, DET_AZIMUTH_ERR_243:0, DET_AZIMUTH_ERR_244:0, DET_BELOW_RAIN_THOLD_241:0, DET_BELOW_RAIN_THOLD_242:0, DET_BELOW_RAIN_THOLD_243:0, DET_BELOW_RAIN_THOLD_244:0, DET_BI_STATIC_FLAG_241:0, DET_BI_STATIC_FLAG_242:0, DET_BI_STATIC_FLAG_243:0, DET_BI_STATIC_FLAG_244:0, DET_CONFD_AZIMUTH_241:0, DET_CONFD_AZIMUTH_242:0, DET_CONFD_AZIMUTH_243:0, DET_CONFD_AZIMUTH_244:0, DET_CONFD_ELEVATION_241:0, DET_CONFD_ELEVATION_242:0, DET_CONFD_ELEVATION_243:0, DET_CONFD_ELEVATION_244:0, DET_ELEVATION_241:0, DET_ELEVATION_242:0, DET_ELEVATION_243:0, DET_ELEVATION_244:0, DET_ELEVATION_ERR_241:0, DET_ELEVATION_ERR_242:0, DET_ELEVATION_ERR_243:0, DET_ELEVATION_ERR_244:0, DET_EXISTENCE_PROB_241:0, DET_EXISTENCE_PROB_242:0, DET_EXISTENCE_PROB_243:0, DET_EXISTENCE_PROB_244:0, DET_HVC_FLAG_241:0, DET_HVC_FLAG_242:0, DET_HVC_FLAG_243:0, DET_HVC_FLAG_244:0, DET_IDM_241:0, DET_IDM_242:0, DET_IDM_243:0, DET_IDM_244:0, DET_MH_CRC16_241_244:0, DET_MH_CYCLE_COUNTER_241_244:0, DET_MH_SCAN_INDEX_4LSB_241_244:0, DET_MTD_241:0, DET_MTD_242:0, DET_MTD_243:0, DET_MTD_244:0, DET_PROB_1STAZHYPO_241:0, DET_PROB_1STAZHYPO_242:0, DET_PROB_1STAZHYPO_243:0, DET_PROB_1STAZHYPO_244:0, DET_RANGE_241:0, DET_RANGE_242:0, DET_RANGE_243:0, DET_RANGE_244:0, DET_RANGE_ERR_241:0, DET_RANGE_ERR_242:0, DET_RANGE_ERR_243:0, DET_RANGE_ERR_244:0, DET_RANGE_VELOCITY_241:16384, DET_RANGE_VELOCITY_242:16384, DET_RANGE_VELOCITY_243:16384, DET_RANGE_VELOCITY_244:16384, DET_RANGE_VELOCITY_ERR_241:0, DET_RANGE_VELOCITY_ERR_242:0, DET_RANGE_VELOCITY_ERR_243:0, DET_RANGE_VELOCITY_ERR_244:0, DET_RCS_241:128, DET_RCS_242:128, DET_RCS_243:128, DET_RCS_244:128, DET_SNR_241:0, DET_SNR_242:0, DET_SNR_243:0, DET_SNR_244:0, DET_SUPER_RES_TARGET_241:0, DET_SUPER_RES_TARGET_242:0, DET_SUPER_RES_TARGET_243:0, DET_SUPER_RES_TARGET_244:0]}, provided-interface=Pi_SG_Detections_241_244_AL
      Pp_SG_Detections_245_248_AL: nonqueued-sender-com-spec{data-element=Vdp_SG_Detections_245_248_AL, init-value=fields=[DET_AZIMUTH_245:0, DET_AZIMUTH_246:0, DET_AZIMUTH_247:0, DET_AZIMUTH_248:0, DET_AZIMUTH_ERR_245:0, DET_AZIMUTH_ERR_246:0, DET_AZIMUTH_ERR_247:0, DET_AZIMUTH_ERR_248:0, DET_BELOW_RAIN_THOLD_245:0, DET_BELOW_RAIN_THOLD_246:0, DET_BELOW_RAIN_THOLD_247:0, DET_BELOW_RAIN_THOLD_248:0, DET_BI_STATIC_FLAG_245:0, DET_BI_STATIC_FLAG_246:0, DET_BI_STATIC_FLAG_247:0, DET_BI_STATIC_FLAG_248:0, DET_CONFD_AZIMUTH_245:0, DET_CONFD_AZIMUTH_246:0, DET_CONFD_AZIMUTH_247:0, DET_CONFD_AZIMUTH_248:0, DET_CONFD_ELEVATION_245:0, DET_CONFD_ELEVATION_246:0, DET_CONFD_ELEVATION_247:0, DET_CONFD_ELEVATION_248:0, DET_ELEVATION_245:0, DET_ELEVATION_246:0, DET_ELEVATION_247:0, DET_ELEVATION_248:0, DET_ELEVATION_ERR_245:0, DET_ELEVATION_ERR_246:0, DET_ELEVATION_ERR_247:0, DET_ELEVATION_ERR_248:0, DET_EXISTENCE_PROB_245:0, DET_EXISTENCE_PROB_246:0, DET_EXISTENCE_PROB_247:0, DET_EXISTENCE_PROB_248:0, DET_HVC_FLAG_245:0, DET_HVC_FLAG_246:0, DET_HVC_FLAG_247:0, DET_HVC_FLAG_248:0, DET_IDM_245:0, DET_IDM_246:0, DET_IDM_247:0, DET_IDM_248:0, DET_MH_CRC16_245_248:0, DET_MH_CYCLE_COUNTER_245_248:0, DET_MH_SCAN_INDEX_4LSB_245_248:0, DET_MTD_245:0, DET_MTD_246:0, DET_MTD_247:0, DET_MTD_248:0, DET_PROB_1STAZHYPO_245:0, DET_PROB_1STAZHYPO_246:0, DET_PROB_1STAZHYPO_247:0, DET_PROB_1STAZHYPO_248:0, DET_RANGE_245:0, DET_RANGE_246:0, DET_RANGE_247:0, DET_RANGE_248:0, DET_RANGE_ERR_245:0, DET_RANGE_ERR_246:0, DET_RANGE_ERR_247:0, DET_RANGE_ERR_248:0, DET_RANGE_VELOCITY_245:16384, DET_RANGE_VELOCITY_246:16384, DET_RANGE_VELOCITY_247:16384, DET_RANGE_VELOCITY_248:16384, DET_RANGE_VELOCITY_ERR_245:0, DET_RANGE_VELOCITY_ERR_246:0, DET_RANGE_VELOCITY_ERR_247:0, DET_RANGE_VELOCITY_ERR_248:0, DET_RCS_245:128, DET_RCS_246:128, DET_RCS_247:128, DET_RCS_248:128, DET_SNR_245:0, DET_SNR_246:0, DET_SNR_247:0, DET_SNR_248:0, DET_SUPER_RES_TARGET_245:0, DET_SUPER_RES_TARGET_246:0, DET_SUPER_RES_TARGET_247:0, DET_SUPER_RES_TARGET_248:0]}, provided-interface=Pi_SG_Detections_245_248_AL
      Pp_SG_Detections_249_252_AL: nonqueued-sender-com-spec{data-element=Vdp_SG_Detections_249_252_AL, init-value=fields=[DET_AZIMUTH_249:0, DET_AZIMUTH_250:0, DET_AZIMUTH_251:0, DET_AZIMUTH_252:0, DET_AZIMUTH_ERR_249:0, DET_AZIMUTH_ERR_250:0, DET_AZIMUTH_ERR_251:0, DET_AZIMUTH_ERR_252:0, DET_BELOW_RAIN_THOLD_249:0, DET_BELOW_RAIN_THOLD_250:0, DET_BELOW_RAIN_THOLD_251:0, DET_BELOW_RAIN_THOLD_252:0, DET_BI_STATIC_FLAG_249:0, DET_BI_STATIC_FLAG_250:0, DET_BI_STATIC_FLAG_251:0, DET_BI_STATIC_FLAG_252:0, DET_CONFD_AZIMUTH_249:0, DET_CONFD_AZIMUTH_250:0, DET_CONFD_AZIMUTH_251:0, DET_CONFD_AZIMUTH_252:0, DET_CONFD_ELEVATION_249:0, DET_CONFD_ELEVATION_250:0, DET_CONFD_ELEVATION_251:0, DET_CONFD_ELEVATION_252:0, DET_ELEVATION_249:0, DET_ELEVATION_250:0, DET_ELEVATION_251:0, DET_ELEVATION_252:0, DET_ELEVATION_ERR_249:0, DET_ELEVATION_ERR_250:0, DET_ELEVATION_ERR_251:0, DET_ELEVATION_ERR_252:0, DET_EXISTENCE_PROB_249:0, DET_EXISTENCE_PROB_250:0, DET_EXISTENCE_PROB_251:0, DET_EXISTENCE_PROB_252:0, DET_HVC_FLAG_249:0, DET_HVC_FLAG_250:0, DET_HVC_FLAG_251:0, DET_HVC_FLAG_252:0, DET_IDM_249:0, DET_IDM_250:0, DET_IDM_251:0, DET_IDM_252:0, DET_MH_CRC16_249_252:0, DET_MH_CYCLE_COUNTER_249_252:0, DET_MH_SCAN_INDEX_4LSB_249_252:0, DET_MTD_249:0, DET_MTD_250:0, DET_MTD_251:0, DET_MTD_252:0, DET_PROB_1STAZHYPO_249:0, DET_PROB_1STAZHYPO_250:0, DET_PROB_1STAZHYPO_251:0, DET_PROB_1STAZHYPO_252:0, DET_RANGE_249:0, DET_RANGE_250:0, DET_RANGE_251:0, DET_RANGE_252:0, DET_RANGE_ERR_249:0, DET_RANGE_ERR_250:0, DET_RANGE_ERR_251:0, DET_RANGE_ERR_252:0, DET_RANGE_VELOCITY_249:16384, DET_RANGE_VELOCITY_250:16384, DET_RANGE_VELOCITY_251:16384, DET_RANGE_VELOCITY_252:16384, DET_RANGE_VELOCITY_ERR_249:0, DET_RANGE_VELOCITY_ERR_250:0, DET_RANGE_VELOCITY_ERR_251:0, DET_RANGE_VELOCITY_ERR_252:0, DET_RCS_249:128, DET_RCS_250:128, DET_RCS_251:128, DET_RCS_252:128, DET_SNR_249:0, DET_SNR_250:0, DET_SNR_251:0, DET_SNR_252:0, DET_SUPER_RES_TARGET_249:0, DET_SUPER_RES_TARGET_250:0, DET_SUPER_RES_TARGET_251:0, DET_SUPER_RES_TARGET_252:0]}, provided-interface=Pi_SG_Detections_249_252_AL
      Pp_SG_Detections_253_256_AL: nonqueued-sender-com-spec{data-element=Vdp_SG_Detections_253_256_AL, init-value=fields=[DET_AZIMUTH_253:0, DET_AZIMUTH_254:0, DET_AZIMUTH_255:0, DET_AZIMUTH_256:0, DET_AZIMUTH_ERR_253:0, DET_AZIMUTH_ERR_254:0, DET_AZIMUTH_ERR_255:0, DET_AZIMUTH_ERR_256:0, DET_BELOW_RAIN_THOLD_253:0, DET_BELOW_RAIN_THOLD_254:0, DET_BELOW_RAIN_THOLD_255:0, DET_BELOW_RAIN_THOLD_256:0, DET_BI_STATIC_FLAG_253:0, DET_BI_STATIC_FLAG_254:0, DET_BI_STATIC_FLAG_255:0, DET_BI_STATIC_FLAG_256:0, DET_CONFD_AZIMUTH_253:0, DET_CONFD_AZIMUTH_254:0, DET_CONFD_AZIMUTH_255:0, DET_CONFD_AZIMUTH_256:0, DET_CONFD_ELEVATION_253:0, DET_CONFD_ELEVATION_254:0, DET_CONFD_ELEVATION_255:0, DET_CONFD_ELEVATION_256:0, DET_ELEVATION_253:0, DET_ELEVATION_254:0, DET_ELEVATION_255:0, DET_ELEVATION_256:0, DET_ELEVATION_ERR_253:0, DET_ELEVATION_ERR_254:0, DET_ELEVATION_ERR_255:0, DET_ELEVATION_ERR_256:0, DET_EXISTENCE_PROB_253:0, DET_EXISTENCE_PROB_254:0, DET_EXISTENCE_PROB_255:0, DET_EXISTENCE_PROB_256:0, DET_HVC_FLAG_253:0, DET_HVC_FLAG_254:0, DET_HVC_FLAG_255:0, DET_HVC_FLAG_256:0, DET_IDM_253:0, DET_IDM_254:0, DET_IDM_255:0, DET_IDM_256:0, DET_MH_CRC16_253_256:0, DET_MH_CYCLE_COUNTER_253_256:0, DET_MH_SCAN_INDEX_4LSB_253_256:0, DET_MTD_253:0, DET_MTD_254:0, DET_MTD_255:0, DET_MTD_256:0, DET_PROB_1STAZHYPO_253:0, DET_PROB_1STAZHYPO_254:0, DET_PROB_1STAZHYPO_255:0, DET_PROB_1STAZHYPO_256:0, DET_RANGE_253:0, DET_RANGE_254:0, DET_RANGE_255:0, DET_RANGE_256:0, DET_RANGE_ERR_253:0, DET_RANGE_ERR_254:0, DET_RANGE_ERR_255:0, DET_RANGE_ERR_256:0, DET_RANGE_VELOCITY_253:16384, DET_RANGE_VELOCITY_254:16384, DET_RANGE_VELOCITY_255:16384, DET_RANGE_VELOCITY_256:16384, DET_RANGE_VELOCITY_ERR_253:0, DET_RANGE_VELOCITY_ERR_254:0, DET_RANGE_VELOCITY_ERR_255:0, DET_RANGE_VELOCITY_ERR_256:0, DET_RCS_253:128, DET_RCS_254:128, DET_RCS_255:128, DET_RCS_256:128, DET_SNR_253:0, DET_SNR_254:0, DET_SNR_255:0, DET_SNR_256:0, DET_SUPER_RES_TARGET_253:0, DET_SUPER_RES_TARGET_254:0, DET_SUPER_RES_TARGET_255:0, DET_SUPER_RES_TARGET_256:0]}, provided-interface=Pi_SG_Detections_253_256_AL
      Pp_SG_Detections_257_260_AL: nonqueued-sender-com-spec{data-element=Vdp_SG_Detections_257_260_AL, init-value=fields=[DET_AZIMUTH_257:0, DET_AZIMUTH_258:0, DET_AZIMUTH_259:0, DET_AZIMUTH_260:0, DET_AZIMUTH_ERR_257:0, DET_AZIMUTH_ERR_258:0, DET_AZIMUTH_ERR_259:0, DET_AZIMUTH_ERR_260:0, DET_BELOW_RAIN_THOLD_257:0, DET_BELOW_RAIN_THOLD_258:0, DET_BELOW_RAIN_THOLD_259:0, DET_BELOW_RAIN_THOLD_260:0, DET_BI_STATIC_FLAG_257:0, DET_BI_STATIC_FLAG_258:0, DET_BI_STATIC_FLAG_259:0, DET_BI_STATIC_FLAG_260:0, DET_CONFD_AZIMUTH_257:0, DET_CONFD_AZIMUTH_258:0, DET_CONFD_AZIMUTH_259:0, DET_CONFD_AZIMUTH_260:0, DET_CONFD_ELEVATION_257:0, DET_CONFD_ELEVATION_258:0, DET_CONFD_ELEVATION_259:0, DET_CONFD_ELEVATION_260:0, DET_ELEVATION_257:0, DET_ELEVATION_258:0, DET_ELEVATION_259:0, DET_ELEVATION_260:0, DET_ELEVATION_ERR_257:0, DET_ELEVATION_ERR_258:0, DET_ELEVATION_ERR_259:0, DET_ELEVATION_ERR_260:0, DET_EXISTENCE_PROB_257:0, DET_EXISTENCE_PROB_258:0, DET_EXISTENCE_PROB_259:0, DET_EXISTENCE_PROB_260:0, DET_HVC_FLAG_257:0, DET_HVC_FLAG_258:0, DET_HVC_FLAG_259:0, DET_HVC_FLAG_260:0, DET_IDM_257:0, DET_IDM_258:0, DET_IDM_259:0, DET_IDM_260:0, DET_MH_CRC16_257_260:0, DET_MH_CYCLE_COUNTER_257_260:0, DET_MH_SCAN_INDEX_4LSB_257_260:0, DET_MTD_257:0, DET_MTD_258:0, DET_MTD_259:0, DET_MTD_260:0, DET_PROB_1STAZHYPO_257:0, DET_PROB_1STAZHYPO_258:0, DET_PROB_1STAZHYPO_259:0, DET_PROB_1STAZHYPO_260:0, DET_RANGE_257:0, DET_RANGE_258:0, DET_RANGE_259:0, DET_RANGE_260:0, DET_RANGE_ERR_257:0, DET_RANGE_ERR_258:0, DET_RANGE_ERR_259:0, DET_RANGE_ERR_260:0, DET_RANGE_VELOCITY_257:16384, DET_RANGE_VELOCITY_258:16384, DET_RANGE_VELOCITY_259:16384, DET_RANGE_VELOCITY_260:16384, DET_RANGE_VELOCITY_ERR_257:0, DET_RANGE_VELOCITY_ERR_258:0, DET_RANGE_VELOCITY_ERR_259:0, DET_RANGE_VELOCITY_ERR_260:0, DET_RCS_257:128, DET_RCS_258:128, DET_RCS_259:128, DET_RCS_260:128, DET_SNR_257:0, DET_SNR_258:0, DET_SNR_259:0, DET_SNR_260:0, DET_SUPER_RES_TARGET_257:0, DET_SUPER_RES_TARGET_258:0, DET_SUPER_RES_TARGET_259:0, DET_SUPER_RES_TARGET_260:0]}, provided-interface=Pi_SG_Detections_257_260_AL
      Pp_SG_Detections_261_264_AL: nonqueued-sender-com-spec{data-element=Vdp_SG_Detections_261_264_AL, init-value=fields=[DET_AZIMUTH_261:0, DET_AZIMUTH_262:0, DET_AZIMUTH_263:0, DET_AZIMUTH_264:0, DET_AZIMUTH_ERR_261:0, DET_AZIMUTH_ERR_262:0, DET_AZIMUTH_ERR_263:0, DET_AZIMUTH_ERR_264:0, DET_BELOW_RAIN_THOLD_261:0, DET_BELOW_RAIN_THOLD_262:0, DET_BELOW_RAIN_THOLD_263:0, DET_BELOW_RAIN_THOLD_264:0, DET_BI_STATIC_FLAG_261:0, DET_BI_STATIC_FLAG_262:0, DET_BI_STATIC_FLAG_263:0, DET_BI_STATIC_FLAG_264:0, DET_CONFD_AZIMUTH_261:0, DET_CONFD_AZIMUTH_262:0, DET_CONFD_AZIMUTH_263:0, DET_CONFD_AZIMUTH_264:0, DET_CONFD_ELEVATION_261:0, DET_CONFD_ELEVATION_262:0, DET_CONFD_ELEVATION_263:0, DET_CONFD_ELEVATION_264:0, DET_ELEVATION_261:0, DET_ELEVATION_262:0, DET_ELEVATION_263:0, DET_ELEVATION_264:0, DET_ELEVATION_ERR_261:0, DET_ELEVATION_ERR_262:0, DET_ELEVATION_ERR_263:0, DET_ELEVATION_ERR_264:0, DET_EXISTENCE_PROB_261:0, DET_EXISTENCE_PROB_262:0, DET_EXISTENCE_PROB_263:0, DET_EXISTENCE_PROB_264:0, DET_HVC_FLAG_261:0, DET_HVC_FLAG_262:0, DET_HVC_FLAG_263:0, DET_HVC_FLAG_264:0, DET_IDM_261:0, DET_IDM_262:0, DET_IDM_263:0, DET_IDM_264:0, DET_MH_CRC16_261_264:0, DET_MH_CYCLE_COUNTER_261_264:0, DET_MH_SCAN_INDEX_4LSB_261_264:0, DET_MTD_261:0, DET_MTD_262:0, DET_MTD_263:0, DET_MTD_264:0, DET_PROB_1STAZHYPO_261:0, DET_PROB_1STAZHYPO_262:0, DET_PROB_1STAZHYPO_263:0, DET_PROB_1STAZHYPO_264:0, DET_RANGE_261:0, DET_RANGE_262:0, DET_RANGE_263:0, DET_RANGE_264:0, DET_RANGE_ERR_261:0, DET_RANGE_ERR_262:0, DET_RANGE_ERR_263:0, DET_RANGE_ERR_264:0, DET_RANGE_VELOCITY_261:16384, DET_RANGE_VELOCITY_262:16384, DET_RANGE_VELOCITY_263:16384, DET_RANGE_VELOCITY_264:16384, DET_RANGE_VELOCITY_ERR_261:0, DET_RANGE_VELOCITY_ERR_262:0, DET_RANGE_VELOCITY_ERR_263:0, DET_RANGE_VELOCITY_ERR_264:0, DET_RCS_261:128, DET_RCS_262:128, DET_RCS_263:128, DET_RCS_264:128, DET_SNR_261:0, DET_SNR_262:0, DET_SNR_263:0, DET_SNR_264:0, DET_SUPER_RES_TARGET_261:0, DET_SUPER_RES_TARGET_262:0, DET_SUPER_RES_TARGET_263:0, DET_SUPER_RES_TARGET_264:0]}, provided-interface=Pi_SG_Detections_261_264_AL
      Pp_SG_Detections_265_268_AL: nonqueued-sender-com-spec{data-element=Vdp_SG_Detections_265_268_AL, init-value=fields=[DET_AZIMUTH_265:0, DET_AZIMUTH_266:0, DET_AZIMUTH_267:0, DET_AZIMUTH_268:0, DET_AZIMUTH_ERR_265:0, DET_AZIMUTH_ERR_266:0, DET_AZIMUTH_ERR_267:0, DET_AZIMUTH_ERR_268:0, DET_BELOW_RAIN_THOLD_265:0, DET_BELOW_RAIN_THOLD_266:0, DET_BELOW_RAIN_THOLD_267:0, DET_BELOW_RAIN_THOLD_268:0, DET_BI_STATIC_FLAG_265:0, DET_BI_STATIC_FLAG_266:0, DET_BI_STATIC_FLAG_267:0, DET_BI_STATIC_FLAG_268:0, DET_CONFD_AZIMUTH_265:0, DET_CONFD_AZIMUTH_266:0, DET_CONFD_AZIMUTH_267:0, DET_CONFD_AZIMUTH_268:0, DET_CONFD_ELEVATION_265:0, DET_CONFD_ELEVATION_266:0, DET_CONFD_ELEVATION_267:0, DET_CONFD_ELEVATION_268:0, DET_ELEVATION_265:0, DET_ELEVATION_266:0, DET_ELEVATION_267:0, DET_ELEVATION_268:0, DET_ELEVATION_ERR_265:0, DET_ELEVATION_ERR_266:0, DET_ELEVATION_ERR_267:0, DET_ELEVATION_ERR_268:0, DET_EXISTENCE_PROB_265:0, DET_EXISTENCE_PROB_266:0, DET_EXISTENCE_PROB_267:0, DET_EXISTENCE_PROB_268:0, DET_HVC_FLAG_265:0, DET_HVC_FLAG_266:0, DET_HVC_FLAG_267:0, DET_HVC_FLAG_268:0, DET_IDM_265:0, DET_IDM_266:0, DET_IDM_267:0, DET_IDM_268:0, DET_MH_CRC16_265_268:0, DET_MH_CYCLE_COUNTER_265_268:0, DET_MH_SCAN_INDEX_4LSB_265_268:0, DET_MTD_265:0, DET_MTD_266:0, DET_MTD_267:0, DET_MTD_268:0, DET_PROB_1STAZHYPO_265:0, DET_PROB_1STAZHYPO_266:0, DET_PROB_1STAZHYPO_267:0, DET_PROB_1STAZHYPO_268:0, DET_RANGE_265:0, DET_RANGE_266:0, DET_RANGE_267:0, DET_RANGE_268:0, DET_RANGE_ERR_265:0, DET_RANGE_ERR_266:0, DET_RANGE_ERR_267:0, DET_RANGE_ERR_268:0, DET_RANGE_VELOCITY_265:16384, DET_RANGE_VELOCITY_266:16384, DET_RANGE_VELOCITY_267:16384, DET_RANGE_VELOCITY_268:16384, DET_RANGE_VELOCITY_ERR_265:0, DET_RANGE_VELOCITY_ERR_266:0, DET_RANGE_VELOCITY_ERR_267:0, DET_RANGE_VELOCITY_ERR_268:0, DET_RCS_265:128, DET_RCS_266:128, DET_RCS_267:128, DET_RCS_268:128, DET_SNR_265:0, DET_SNR_266:0, DET_SNR_267:0, DET_SNR_268:0, DET_SUPER_RES_TARGET_265:0, DET_SUPER_RES_TARGET_266:0, DET_SUPER_RES_TARGET_267:0, DET_SUPER_RES_TARGET_268:0]}, provided-interface=Pi_SG_Detections_265_268_AL
      Pp_SG_Detections_269_272_AL: nonqueued-sender-com-spec{data-element=Vdp_SG_Detections_269_272_AL, init-value=fields=[DET_AZIMUTH_269:0, DET_AZIMUTH_270:0, DET_AZIMUTH_271:0, DET_AZIMUTH_272:0, DET_AZIMUTH_ERR_269:0, DET_AZIMUTH_ERR_270:0, DET_AZIMUTH_ERR_271:0, DET_AZIMUTH_ERR_272:0, DET_BELOW_RAIN_THOLD_269:0, DET_BELOW_RAIN_THOLD_270:0, DET_BELOW_RAIN_THOLD_271:0, DET_BELOW_RAIN_THOLD_272:0, DET_BI_STATIC_FLAG_269:0, DET_BI_STATIC_FLAG_270:0, DET_BI_STATIC_FLAG_271:0, DET_BI_STATIC_FLAG_272:0, DET_CONFD_AZIMUTH_269:0, DET_CONFD_AZIMUTH_270:0, DET_CONFD_AZIMUTH_271:0, DET_CONFD_AZIMUTH_272:0, DET_CONFD_ELEVATION_269:0, DET_CONFD_ELEVATION_270:0, DET_CONFD_ELEVATION_271:0, DET_CONFD_ELEVATION_272:0, DET_ELEVATION_269:0, DET_ELEVATION_270:0, DET_ELEVATION_271:0, DET_ELEVATION_272:0, DET_ELEVATION_ERR_269:0, DET_ELEVATION_ERR_270:0, DET_ELEVATION_ERR_271:0, DET_ELEVATION_ERR_272:0, DET_EXISTENCE_PROB_269:0, DET_EXISTENCE_PROB_270:0, DET_EXISTENCE_PROB_271:0, DET_EXISTENCE_PROB_272:0, DET_HVC_FLAG_269:0, DET_HVC_FLAG_270:0, DET_HVC_FLAG_271:0, DET_HVC_FLAG_272:0, DET_IDM_269:0, DET_IDM_270:0, DET_IDM_271:0, DET_IDM_272:0, DET_MH_CRC16_269_272:0, DET_MH_CYCLE_COUNTER_269_272:0, DET_MH_SCAN_INDEX_4LSB_269_272:0, DET_MTD_269:0, DET_MTD_270:0, DET_MTD_271:0, DET_MTD_272:0, DET_PROB_1STAZHYPO_269:0, DET_PROB_1STAZHYPO_270:0, DET_PROB_1STAZHYPO_271:0, DET_PROB_1STAZHYPO_272:0, DET_RANGE_269:0, DET_RANGE_270:0, DET_RANGE_271:0, DET_RANGE_272:0, DET_RANGE_ERR_269:0, DET_RANGE_ERR_270:0, DET_RANGE_ERR_271:0, DET_RANGE_ERR_272:0, DET_RANGE_VELOCITY_269:16384, DET_RANGE_VELOCITY_270:16384, DET_RANGE_VELOCITY_271:16384, DET_RANGE_VELOCITY_272:16384, DET_RANGE_VELOCITY_ERR_269:0, DET_RANGE_VELOCITY_ERR_270:0, DET_RANGE_VELOCITY_ERR_271:0, DET_RANGE_VELOCITY_ERR_272:0, DET_RCS_269:128, DET_RCS_270:128, DET_RCS_271:128, DET_RCS_272:128, DET_SNR_269:0, DET_SNR_270:0, DET_SNR_271:0, DET_SNR_272:0, DET_SUPER_RES_TARGET_269:0, DET_SUPER_RES_TARGET_270:0, DET_SUPER_RES_TARGET_271:0, DET_SUPER_RES_TARGET_272:0]}, provided-interface=Pi_SG_Detections_269_272_AL
      Pp_SG_Detections_273_276_AL: nonqueued-sender-com-spec{data-element=Vdp_SG_Detections_273_276_AL, init-value=fields=[DET_AZIMUTH_273:0, DET_AZIMUTH_274:0, DET_AZIMUTH_275:0, DET_AZIMUTH_276:0, DET_AZIMUTH_ERR_273:0, DET_AZIMUTH_ERR_274:0, DET_AZIMUTH_ERR_275:0, DET_AZIMUTH_ERR_276:0, DET_BELOW_RAIN_THOLD_273:0, DET_BELOW_RAIN_THOLD_274:0, DET_BELOW_RAIN_THOLD_275:0, DET_BELOW_RAIN_THOLD_276:0, DET_BI_STATIC_FLAG_273:0, DET_BI_STATIC_FLAG_274:0, DET_BI_STATIC_FLAG_275:0, DET_BI_STATIC_FLAG_276:0, DET_CONFD_AZIMUTH_273:0, DET_CONFD_AZIMUTH_274:0, DET_CONFD_AZIMUTH_275:0, DET_CONFD_AZIMUTH_276:0, DET_CONFD_ELEVATION_273:0, DET_CONFD_ELEVATION_274:0, DET_CONFD_ELEVATION_275:0, DET_CONFD_ELEVATION_276:0, DET_ELEVATION_273:0, DET_ELEVATION_274:0, DET_ELEVATION_275:0, DET_ELEVATION_276:0, DET_ELEVATION_ERR_273:0, DET_ELEVATION_ERR_274:0, DET_ELEVATION_ERR_275:0, DET_ELEVATION_ERR_276:0, DET_EXISTENCE_PROB_273:0, DET_EXISTENCE_PROB_274:0, DET_EXISTENCE_PROB_275:0, DET_EXISTENCE_PROB_276:0, DET_HVC_FLAG_273:0, DET_HVC_FLAG_274:0, DET_HVC_FLAG_275:0, DET_HVC_FLAG_276:0, DET_IDM_273:0, DET_IDM_274:0, DET_IDM_275:0, DET_IDM_276:0, DET_MH_CRC16_273_276:0, DET_MH_CYCLE_COUNTER_273_276:0, DET_MH_SCAN_INDEX_4LSB_273_276:0, DET_MTD_273:0, DET_MTD_274:0, DET_MTD_275:0, DET_MTD_276:0, DET_PROB_1STAZHYPO_273:0, DET_PROB_1STAZHYPO_274:0, DET_PROB_1STAZHYPO_275:0, DET_PROB_1STAZHYPO_276:0, DET_RANGE_273:0, DET_RANGE_274:0, DET_RANGE_275:0, DET_RANGE_276:0, DET_RANGE_ERR_273:0, DET_RANGE_ERR_274:0, DET_RANGE_ERR_275:0, DET_RANGE_ERR_276:0, DET_RANGE_VELOCITY_273:16384, DET_RANGE_VELOCITY_274:16384, DET_RANGE_VELOCITY_275:16384, DET_RANGE_VELOCITY_276:16384, DET_RANGE_VELOCITY_ERR_273:0, DET_RANGE_VELOCITY_ERR_274:0, DET_RANGE_VELOCITY_ERR_275:0, DET_RANGE_VELOCITY_ERR_276:0, DET_RCS_273:128, DET_RCS_274:128, DET_RCS_275:128, DET_RCS_276:128, DET_SNR_273:0, DET_SNR_274:0, DET_SNR_275:0, DET_SNR_276:0, DET_SUPER_RES_TARGET_273:0, DET_SUPER_RES_TARGET_274:0, DET_SUPER_RES_TARGET_275:0, DET_SUPER_RES_TARGET_276:0]}, provided-interface=Pi_SG_Detections_273_276_AL
      Pp_SG_Detections_277_280_AL: nonqueued-sender-com-spec{data-element=Vdp_SG_Detections_277_280_AL, init-value=fields=[DET_AZIMUTH_277:0, DET_AZIMUTH_278:0, DET_AZIMUTH_279:0, DET_AZIMUTH_280:0, DET_AZIMUTH_ERR_277:0, DET_AZIMUTH_ERR_278:0, DET_AZIMUTH_ERR_279:0, DET_AZIMUTH_ERR_280:0, DET_BELOW_RAIN_THOLD_277:0, DET_BELOW_RAIN_THOLD_278:0, DET_BELOW_RAIN_THOLD_279:0, DET_BELOW_RAIN_THOLD_280:0, DET_BI_STATIC_FLAG_277:0, DET_BI_STATIC_FLAG_278:0, DET_BI_STATIC_FLAG_279:0, DET_BI_STATIC_FLAG_280:0, DET_CONFD_AZIMUTH_277:0, DET_CONFD_AZIMUTH_278:0, DET_CONFD_AZIMUTH_279:0, DET_CONFD_AZIMUTH_280:0, DET_CONFD_ELEVATION_277:0, DET_CONFD_ELEVATION_278:0, DET_CONFD_ELEVATION_279:0, DET_CONFD_ELEVATION_280:0, DET_ELEVATION_277:0, DET_ELEVATION_278:0, DET_ELEVATION_279:0, DET_ELEVATION_280:0, DET_ELEVATION_ERR_277:0, DET_ELEVATION_ERR_278:0, DET_ELEVATION_ERR_279:0, DET_ELEVATION_ERR_280:0, DET_EXISTENCE_PROB_277:0, DET_EXISTENCE_PROB_278:0, DET_EXISTENCE_PROB_279:0, DET_EXISTENCE_PROB_280:0, DET_HVC_FLAG_277:0, DET_HVC_FLAG_278:0, DET_HVC_FLAG_279:0, DET_HVC_FLAG_280:0, DET_IDM_277:0, DET_IDM_278:0, DET_IDM_279:0, DET_IDM_280:0, DET_MH_CRC16_277_280:0, DET_MH_CYCLE_COUNTER_277_280:0, DET_MH_SCAN_INDEX_4LSB_277_280:0, DET_MTD_277:0, DET_MTD_278:0, DET_MTD_279:0, DET_MTD_280:0, DET_PROB_1STAZHYPO_277:0, DET_PROB_1STAZHYPO_278:0, DET_PROB_1STAZHYPO_279:0, DET_PROB_1STAZHYPO_280:0, DET_RANGE_277:0, DET_RANGE_278:0, DET_RANGE_279:0, DET_RANGE_280:0, DET_RANGE_ERR_277:0, DET_RANGE_ERR_278:0, DET_RANGE_ERR_279:0, DET_RANGE_ERR_280:0, DET_RANGE_VELOCITY_277:16384, DET_RANGE_VELOCITY_278:16384, DET_RANGE_VELOCITY_279:16384, DET_RANGE_VELOCITY_280:16384, DET_RANGE_VELOCITY_ERR_277:0, DET_RANGE_VELOCITY_ERR_278:0, DET_RANGE_VELOCITY_ERR_279:0, DET_RANGE_VELOCITY_ERR_280:0, DET_RCS_277:128, DET_RCS_278:128, DET_RCS_279:128, DET_RCS_280:128, DET_SNR_277:0, DET_SNR_278:0, DET_SNR_279:0, DET_SNR_280:0, DET_SUPER_RES_TARGET_277:0, DET_SUPER_RES_TARGET_278:0, DET_SUPER_RES_TARGET_279:0, DET_SUPER_RES_TARGET_280:0]}, provided-interface=Pi_SG_Detections_277_280_AL
      Pp_SG_Detections_281_284_AL: nonqueued-sender-com-spec{data-element=Vdp_SG_Detections_281_284_AL, init-value=fields=[DET_AZIMUTH_281:0, DET_AZIMUTH_282:0, DET_AZIMUTH_283:0, DET_AZIMUTH_284:0, DET_AZIMUTH_ERR_281:0, DET_AZIMUTH_ERR_282:0, DET_AZIMUTH_ERR_283:0, DET_AZIMUTH_ERR_284:0, DET_BELOW_RAIN_THOLD_281:0, DET_BELOW_RAIN_THOLD_282:0, DET_BELOW_RAIN_THOLD_283:0, DET_BELOW_RAIN_THOLD_284:0, DET_BI_STATIC_FLAG_281:0, DET_BI_STATIC_FLAG_282:0, DET_BI_STATIC_FLAG_283:0, DET_BI_STATIC_FLAG_284:0, DET_CONFD_AZIMUTH_281:0, DET_CONFD_AZIMUTH_282:0, DET_CONFD_AZIMUTH_283:0, DET_CONFD_AZIMUTH_284:0, DET_CONFD_ELEVATION_281:0, DET_CONFD_ELEVATION_282:0, DET_CONFD_ELEVATION_283:0, DET_CONFD_ELEVATION_284:0, DET_ELEVATION_281:0, DET_ELEVATION_282:0, DET_ELEVATION_283:0, DET_ELEVATION_284:0, DET_ELEVATION_ERR_281:0, DET_ELEVATION_ERR_282:0, DET_ELEVATION_ERR_283:0, DET_ELEVATION_ERR_284:0, DET_EXISTENCE_PROB_281:0, DET_EXISTENCE_PROB_282:0, DET_EXISTENCE_PROB_283:0, DET_EXISTENCE_PROB_284:0, DET_HVC_FLAG_281:0, DET_HVC_FLAG_282:0, DET_HVC_FLAG_283:0, DET_HVC_FLAG_284:0, DET_IDM_281:0, DET_IDM_282:0, DET_IDM_283:0, DET_IDM_284:0, DET_MH_CRC16_281_284:0, DET_MH_CYCLE_COUNTER_281_284:0, DET_MH_SCAN_INDEX_4LSB_281_284:0, DET_MTD_281:0, DET_MTD_282:0, DET_MTD_283:0, DET_MTD_284:0, DET_PROB_1STAZHYPO_281:0, DET_PROB_1STAZHYPO_282:0, DET_PROB_1STAZHYPO_283:0, DET_PROB_1STAZHYPO_284:0, DET_RANGE_281:0, DET_RANGE_282:0, DET_RANGE_283:0, DET_RANGE_284:0, DET_RANGE_ERR_281:0, DET_RANGE_ERR_282:0, DET_RANGE_ERR_283:0, DET_RANGE_ERR_284:0, DET_RANGE_VELOCITY_281:16384, DET_RANGE_VELOCITY_282:16384, DET_RANGE_VELOCITY_283:16384, DET_RANGE_VELOCITY_284:16384, DET_RANGE_VELOCITY_ERR_281:0, DET_RANGE_VELOCITY_ERR_282:0, DET_RANGE_VELOCITY_ERR_283:0, DET_RANGE_VELOCITY_ERR_284:0, DET_RCS_281:128, DET_RCS_282:128, DET_RCS_283:128, DET_RCS_284:128, DET_SNR_281:0, DET_SNR_282:0, DET_SNR_283:0, DET_SNR_284:0, DET_SUPER_RES_TARGET_281:0, DET_SUPER_RES_TARGET_282:0, DET_SUPER_RES_TARGET_283:0, DET_SUPER_RES_TARGET_284:0]}, provided-interface=Pi_SG_Detections_281_284_AL
      Pp_SG_Detections_285_288_AL: nonqueued-sender-com-spec{data-element=Vdp_SG_Detections_285_288_AL, init-value=fields=[DET_AZIMUTH_285:0, DET_AZIMUTH_286:0, DET_AZIMUTH_287:0, DET_AZIMUTH_288:0, DET_AZIMUTH_ERR_285:0, DET_AZIMUTH_ERR_286:0, DET_AZIMUTH_ERR_287:0, DET_AZIMUTH_ERR_288:0, DET_BELOW_RAIN_THOLD_285:0, DET_BELOW_RAIN_THOLD_286:0, DET_BELOW_RAIN_THOLD_287:0, DET_BELOW_RAIN_THOLD_288:0, DET_BI_STATIC_FLAG_285:0, DET_BI_STATIC_FLAG_286:0, DET_BI_STATIC_FLAG_287:0, DET_BI_STATIC_FLAG_288:0, DET_CONFD_AZIMUTH_285:0, DET_CONFD_AZIMUTH_286:0, DET_CONFD_AZIMUTH_287:0, DET_CONFD_AZIMUTH_288:0, DET_CONFD_ELEVATION_285:0, DET_CONFD_ELEVATION_286:0, DET_CONFD_ELEVATION_287:0, DET_CONFD_ELEVATION_288:0, DET_ELEVATION_285:0, DET_ELEVATION_286:0, DET_ELEVATION_287:0, DET_ELEVATION_288:0, DET_ELEVATION_ERR_285:0, DET_ELEVATION_ERR_286:0, DET_ELEVATION_ERR_287:0, DET_ELEVATION_ERR_288:0, DET_EXISTENCE_PROB_285:0, DET_EXISTENCE_PROB_286:0, DET_EXISTENCE_PROB_287:0, DET_EXISTENCE_PROB_288:0, DET_HVC_FLAG_285:0, DET_HVC_FLAG_286:0, DET_HVC_FLAG_287:0, DET_HVC_FLAG_288:0, DET_IDM_285:0, DET_IDM_286:0, DET_IDM_287:0, DET_IDM_288:0, DET_MH_CRC16_285_288:0, DET_MH_CYCLE_COUNTER_285_288:0, DET_MH_SCAN_INDEX_4LSB_285_288:0, DET_MTD_285:0, DET_MTD_286:0, DET_MTD_287:0, DET_MTD_288:0, DET_PROB_1STAZHYPO_285:0, DET_PROB_1STAZHYPO_286:0, DET_PROB_1STAZHYPO_287:0, DET_PROB_1STAZHYPO_288:0, DET_RANGE_285:0, DET_RANGE_286:0, DET_RANGE_287:0, DET_RANGE_288:0, DET_RANGE_ERR_285:0, DET_RANGE_ERR_286:0, DET_RANGE_ERR_287:0, DET_RANGE_ERR_288:0, DET_RANGE_VELOCITY_285:16384, DET_RANGE_VELOCITY_286:16384, DET_RANGE_VELOCITY_287:16384, DET_RANGE_VELOCITY_288:16384, DET_RANGE_VELOCITY_ERR_285:0, DET_RANGE_VELOCITY_ERR_286:0, DET_RANGE_VELOCITY_ERR_287:0, DET_RANGE_VELOCITY_ERR_288:0, DET_RCS_285:128, DET_RCS_286:128, DET_RCS_287:128, DET_RCS_288:128, DET_SNR_285:0, DET_SNR_286:0, DET_SNR_287:0, DET_SNR_288:0, DET_SUPER_RES_TARGET_285:0, DET_SUPER_RES_TARGET_286:0, DET_SUPER_RES_TARGET_287:0, DET_SUPER_RES_TARGET_288:0]}, provided-interface=Pi_SG_Detections_285_288_AL
      Pp_SG_Detections_289_292_AL: nonqueued-sender-com-spec{data-element=Vdp_SG_Detections_289_292_AL, init-value=fields=[DET_AZIMUTH_289:0, DET_AZIMUTH_290:0, DET_AZIMUTH_291:0, DET_AZIMUTH_292:0, DET_AZIMUTH_ERR_289:0, DET_AZIMUTH_ERR_290:0, DET_AZIMUTH_ERR_291:0, DET_AZIMUTH_ERR_292:0, DET_BELOW_RAIN_THOLD_289:0, DET_BELOW_RAIN_THOLD_290:0, DET_BELOW_RAIN_THOLD_291:0, DET_BELOW_RAIN_THOLD_292:0, DET_BI_STATIC_FLAG_289:0, DET_BI_STATIC_FLAG_290:0, DET_BI_STATIC_FLAG_291:0, DET_BI_STATIC_FLAG_292:0, DET_CONFD_AZIMUTH_289:0, DET_CONFD_AZIMUTH_290:0, DET_CONFD_AZIMUTH_291:0, DET_CONFD_AZIMUTH_292:0, DET_CONFD_ELEVATION_289:0, DET_CONFD_ELEVATION_290:0, DET_CONFD_ELEVATION_291:0, DET_CONFD_ELEVATION_292:0, DET_ELEVATION_289:0, DET_ELEVATION_290:0, DET_ELEVATION_291:0, DET_ELEVATION_292:0, DET_ELEVATION_ERR_289:0, DET_ELEVATION_ERR_290:0, DET_ELEVATION_ERR_291:0, DET_ELEVATION_ERR_292:0, DET_EXISTENCE_PROB_289:0, DET_EXISTENCE_PROB_290:0, DET_EXISTENCE_PROB_291:0, DET_EXISTENCE_PROB_292:0, DET_HVC_FLAG_289:0, DET_HVC_FLAG_290:0, DET_HVC_FLAG_291:0, DET_HVC_FLAG_292:0, DET_IDM_289:0, DET_IDM_290:0, DET_IDM_291:0, DET_IDM_292:0, DET_MH_CRC16_289_292:0, DET_MH_CYCLE_COUNTER_289_292:0, DET_MH_SCAN_INDEX_4LSB_289_292:0, DET_MTD_289:0, DET_MTD_290:0, DET_MTD_291:0, DET_MTD_292:0, DET_PROB_1STAZHYPO_289:0, DET_PROB_1STAZHYPO_290:0, DET_PROB_1STAZHYPO_291:0, DET_PROB_1STAZHYPO_292:0, DET_RANGE_289:0, DET_RANGE_290:0, DET_RANGE_291:0, DET_RANGE_292:0, DET_RANGE_ERR_289:0, DET_RANGE_ERR_290:0, DET_RANGE_ERR_291:0, DET_RANGE_ERR_292:0, DET_RANGE_VELOCITY_289:16384, DET_RANGE_VELOCITY_290:16384, DET_RANGE_VELOCITY_291:16384, DET_RANGE_VELOCITY_292:16384, DET_RANGE_VELOCITY_ERR_289:0, DET_RANGE_VELOCITY_ERR_290:0, DET_RANGE_VELOCITY_ERR_291:0, DET_RANGE_VELOCITY_ERR_292:0, DET_RCS_289:128, DET_RCS_290:128, DET_RCS_291:128, DET_RCS_292:128, DET_SNR_289:0, DET_SNR_290:0, DET_SNR_291:0, DET_SNR_292:0, DET_SUPER_RES_TARGET_289:0, DET_SUPER_RES_TARGET_290:0, DET_SUPER_RES_TARGET_291:0, DET_SUPER_RES_TARGET_292:0]}, provided-interface=Pi_SG_Detections_289_292_AL
      Pp_SG_Detections_293_296_AL: nonqueued-sender-com-spec{data-element=Vdp_SG_Detections_293_296_AL, init-value=fields=[DET_AZIMUTH_293:0, DET_AZIMUTH_294:0, DET_AZIMUTH_295:0, DET_AZIMUTH_296:0, DET_AZIMUTH_ERR_293:0, DET_AZIMUTH_ERR_294:0, DET_AZIMUTH_ERR_295:0, DET_AZIMUTH_ERR_296:0, DET_BELOW_RAIN_THOLD_293:0, DET_BELOW_RAIN_THOLD_294:0, DET_BELOW_RAIN_THOLD_295:0, DET_BELOW_RAIN_THOLD_296:0, DET_BI_STATIC_FLAG_293:0, DET_BI_STATIC_FLAG_294:0, DET_BI_STATIC_FLAG_295:0, DET_BI_STATIC_FLAG_296:0, DET_CONFD_AZIMUTH_293:0, DET_CONFD_AZIMUTH_294:0, DET_CONFD_AZIMUTH_295:0, DET_CONFD_AZIMUTH_296:0, DET_CONFD_ELEVATION_293:0, DET_CONFD_ELEVATION_294:0, DET_CONFD_ELEVATION_295:0, DET_CONFD_ELEVATION_296:0, DET_ELEVATION_293:0, DET_ELEVATION_294:0, DET_ELEVATION_295:0, DET_ELEVATION_296:0, DET_ELEVATION_ERR_293:0, DET_ELEVATION_ERR_294:0, DET_ELEVATION_ERR_295:0, DET_ELEVATION_ERR_296:0, DET_EXISTENCE_PROB_293:0, DET_EXISTENCE_PROB_294:0, DET_EXISTENCE_PROB_295:0, DET_EXISTENCE_PROB_296:0, DET_HVC_FLAG_293:0, DET_HVC_FLAG_294:0, DET_HVC_FLAG_295:0, DET_HVC_FLAG_296:0, DET_IDM_293:0, DET_IDM_294:0, DET_IDM_295:0, DET_IDM_296:0, DET_MH_CRC16_293_296:0, DET_MH_CYCLE_COUNTER_293_296:0, DET_MH_SCAN_INDEX_4LSB_293_296:0, DET_MTD_293:0, DET_MTD_294:0, DET_MTD_295:0, DET_MTD_296:0, DET_PROB_1STAZHYPO_293:0, DET_PROB_1STAZHYPO_294:0, DET_PROB_1STAZHYPO_295:0, DET_PROB_1STAZHYPO_296:0, DET_RANGE_293:0, DET_RANGE_294:0, DET_RANGE_295:0, DET_RANGE_296:0, DET_RANGE_ERR_293:0, DET_RANGE_ERR_294:0, DET_RANGE_ERR_295:0, DET_RANGE_ERR_296:0, DET_RANGE_VELOCITY_293:16384, DET_RANGE_VELOCITY_294:16384, DET_RANGE_VELOCITY_295:16384, DET_RANGE_VELOCITY_296:16384, DET_RANGE_VELOCITY_ERR_293:0, DET_RANGE_VELOCITY_ERR_294:0, DET_RANGE_VELOCITY_ERR_295:0, DET_RANGE_VELOCITY_ERR_296:0, DET_RCS_293:128, DET_RCS_294:128, DET_RCS_295:128, DET_RCS_296:128, DET_SNR_293:0, DET_SNR_294:0, DET_SNR_295:0, DET_SNR_296:0, DET_SUPER_RES_TARGET_293:0, DET_SUPER_RES_TARGET_294:0, DET_SUPER_RES_TARGET_295:0, DET_SUPER_RES_TARGET_296:0]}, provided-interface=Pi_SG_Detections_293_296_AL
      Pp_SG_Detections_297_300_AL: nonqueued-sender-com-spec{data-element=Vdp_SG_Detections_297_300_AL, init-value=fields=[DET_AZIMUTH_297:0, DET_AZIMUTH_298:0, DET_AZIMUTH_299:0, DET_AZIMUTH_300:0, DET_AZIMUTH_ERR_297:0, DET_AZIMUTH_ERR_298:0, DET_AZIMUTH_ERR_299:0, DET_AZIMUTH_ERR_300:0, DET_BELOW_RAIN_THOLD_297:0, DET_BELOW_RAIN_THOLD_298:0, DET_BELOW_RAIN_THOLD_299:0, DET_BELOW_RAIN_THOLD_300:0, DET_BI_STATIC_FLAG_297:0, DET_BI_STATIC_FLAG_298:0, DET_BI_STATIC_FLAG_299:0, DET_BI_STATIC_FLAG_300:0, DET_CONFD_AZIMUTH_297:0, DET_CONFD_AZIMUTH_298:0, DET_CONFD_AZIMUTH_299:0, DET_CONFD_AZIMUTH_300:0, DET_CONFD_ELEVATION_297:0, DET_CONFD_ELEVATION_298:0, DET_CONFD_ELEVATION_299:0, DET_CONFD_ELEVATION_300:0, DET_ELEVATION_297:0, DET_ELEVATION_298:0, DET_ELEVATION_299:0, DET_ELEVATION_300:0, DET_ELEVATION_ERR_297:0, DET_ELEVATION_ERR_298:0, DET_ELEVATION_ERR_299:0, DET_ELEVATION_ERR_300:0, DET_EXISTENCE_PROB_297:0, DET_EXISTENCE_PROB_298:0, DET_EXISTENCE_PROB_299:0, DET_EXISTENCE_PROB_300:0, DET_HVC_FLAG_297:0, DET_HVC_FLAG_298:0, DET_HVC_FLAG_299:0, DET_HVC_FLAG_300:0, DET_IDM_297:0, DET_IDM_298:0, DET_IDM_299:0, DET_IDM_300:0, DET_MH_CRC16_297_300:0, DET_MH_CYCLE_COUNTER_297_300:0, DET_MH_SCAN_INDEX_4LSB_297_300:0, DET_MTD_297:0, DET_MTD_298:0, DET_MTD_299:0, DET_MTD_300:0, DET_PROB_1STAZHYPO_297:0, DET_PROB_1STAZHYPO_298:0, DET_PROB_1STAZHYPO_299:0, DET_PROB_1STAZHYPO_300:0, DET_RANGE_297:0, DET_RANGE_298:0, DET_RANGE_299:0, DET_RANGE_300:0, DET_RANGE_ERR_297:0, DET_RANGE_ERR_298:0, DET_RANGE_ERR_299:0, DET_RANGE_ERR_300:0, DET_RANGE_VELOCITY_297:16384, DET_RANGE_VELOCITY_298:16384, DET_RANGE_VELOCITY_299:16384, DET_RANGE_VELOCITY_300:16384, DET_RANGE_VELOCITY_ERR_297:0, DET_RANGE_VELOCITY_ERR_298:0, DET_RANGE_VELOCITY_ERR_299:0, DET_RANGE_VELOCITY_ERR_300:0, DET_RCS_297:128, DET_RCS_298:128, DET_RCS_299:128, DET_RCS_300:128, DET_SNR_297:0, DET_SNR_298:0, DET_SNR_299:0, DET_SNR_300:0, DET_SUPER_RES_TARGET_297:0, DET_SUPER_RES_TARGET_298:0, DET_SUPER_RES_TARGET_299:0, DET_SUPER_RES_TARGET_300:0]}, provided-interface=Pi_SG_Detections_297_300_AL
      Pp_SG_Detections_301_304_AL: nonqueued-sender-com-spec{data-element=Vdp_SG_Detections_301_304_AL, init-value=fields=[DET_AZIMUTH_301:0, DET_AZIMUTH_302:0, DET_AZIMUTH_303:0, DET_AZIMUTH_304:0, DET_AZIMUTH_ERR_301:0, DET_AZIMUTH_ERR_302:0, DET_AZIMUTH_ERR_303:0, DET_AZIMUTH_ERR_304:0, DET_BELOW_RAIN_THOLD_301:0, DET_BELOW_RAIN_THOLD_302:0, DET_BELOW_RAIN_THOLD_303:0, DET_BELOW_RAIN_THOLD_304:0, DET_BI_STATIC_FLAG_301:0, DET_BI_STATIC_FLAG_302:0, DET_BI_STATIC_FLAG_303:0, DET_BI_STATIC_FLAG_304:0, DET_CONFD_AZIMUTH_301:0, DET_CONFD_AZIMUTH_302:0, DET_CONFD_AZIMUTH_303:0, DET_CONFD_AZIMUTH_304:0, DET_CONFD_ELEVATION_301:0, DET_CONFD_ELEVATION_302:0, DET_CONFD_ELEVATION_303:0, DET_CONFD_ELEVATION_304:0, DET_ELEVATION_301:0, DET_ELEVATION_302:0, DET_ELEVATION_303:0, DET_ELEVATION_304:0, DET_ELEVATION_ERR_301:0, DET_ELEVATION_ERR_302:0, DET_ELEVATION_ERR_303:0, DET_ELEVATION_ERR_304:0, DET_EXISTENCE_PROB_301:0, DET_EXISTENCE_PROB_302:0, DET_EXISTENCE_PROB_303:0, DET_EXISTENCE_PROB_304:0, DET_HVC_FLAG_301:0, DET_HVC_FLAG_302:0, DET_HVC_FLAG_303:0, DET_HVC_FLAG_304:0, DET_IDM_301:0, DET_IDM_302:0, DET_IDM_303:0, DET_IDM_304:0, DET_MH_CRC16_301_304:0, DET_MH_CYCLE_COUNTER_301_304:0, DET_MH_SCAN_INDEX_4LSB_301_304:0, DET_MTD_301:0, DET_MTD_302:0, DET_MTD_303:0, DET_MTD_304:0, DET_PROB_1STAZHYPO_301:0, DET_PROB_1STAZHYPO_302:0, DET_PROB_1STAZHYPO_303:0, DET_PROB_1STAZHYPO_304:0, DET_RANGE_301:0, DET_RANGE_302:0, DET_RANGE_303:0, DET_RANGE_304:0, DET_RANGE_ERR_301:0, DET_RANGE_ERR_302:0, DET_RANGE_ERR_303:0, DET_RANGE_ERR_304:0, DET_RANGE_VELOCITY_301:16384, DET_RANGE_VELOCITY_302:16384, DET_RANGE_VELOCITY_303:16384, DET_RANGE_VELOCITY_304:16384, DET_RANGE_VELOCITY_ERR_301:0, DET_RANGE_VELOCITY_ERR_302:0, DET_RANGE_VELOCITY_ERR_303:0, DET_RANGE_VELOCITY_ERR_304:0, DET_RCS_301:128, DET_RCS_302:128, DET_RCS_303:128, DET_RCS_304:128, DET_SNR_301:0, DET_SNR_302:0, DET_SNR_303:0, DET_SNR_304:0, DET_SUPER_RES_TARGET_301:0, DET_SUPER_RES_TARGET_302:0, DET_SUPER_RES_TARGET_303:0, DET_SUPER_RES_TARGET_304:0]}, provided-interface=Pi_SG_Detections_301_304_AL
      Pp_SG_Detections_305_308_AL: nonqueued-sender-com-spec{data-element=Vdp_SG_Detections_305_308_AL, init-value=fields=[DET_AZIMUTH_305:0, DET_AZIMUTH_306:0, DET_AZIMUTH_307:0, DET_AZIMUTH_308:0, DET_AZIMUTH_ERR_305:0, DET_AZIMUTH_ERR_306:0, DET_AZIMUTH_ERR_307:0, DET_AZIMUTH_ERR_308:0, DET_BELOW_RAIN_THOLD_305:0, DET_BELOW_RAIN_THOLD_306:0, DET_BELOW_RAIN_THOLD_307:0, DET_BELOW_RAIN_THOLD_308:0, DET_BI_STATIC_FLAG_305:0, DET_BI_STATIC_FLAG_306:0, DET_BI_STATIC_FLAG_307:0, DET_BI_STATIC_FLAG_308:0, DET_CONFD_AZIMUTH_305:0, DET_CONFD_AZIMUTH_306:0, DET_CONFD_AZIMUTH_307:0, DET_CONFD_AZIMUTH_308:0, DET_CONFD_ELEVATION_305:0, DET_CONFD_ELEVATION_306:0, DET_CONFD_ELEVATION_307:0, DET_CONFD_ELEVATION_308:0, DET_ELEVATION_305:0, DET_ELEVATION_306:0, DET_ELEVATION_307:0, DET_ELEVATION_308:0, DET_ELEVATION_ERR_305:0, DET_ELEVATION_ERR_306:0, DET_ELEVATION_ERR_307:0, DET_ELEVATION_ERR_308:0, DET_EXISTENCE_PROB_305:0, DET_EXISTENCE_PROB_306:0, DET_EXISTENCE_PROB_307:0, DET_EXISTENCE_PROB_308:0, DET_HVC_FLAG_305:0, DET_HVC_FLAG_306:0, DET_HVC_FLAG_307:0, DET_HVC_FLAG_308:0, DET_IDM_305:0, DET_IDM_306:0, DET_IDM_307:0, DET_IDM_308:0, DET_MH_CRC16_305_308:0, DET_MH_CYCLE_COUNTER_305_308:0, DET_MH_SCAN_INDEX_4LSB_305_308:0, DET_MTD_305:0, DET_MTD_306:0, DET_MTD_307:0, DET_MTD_308:0, DET_PROB_1STAZHYPO_305:0, DET_PROB_1STAZHYPO_306:0, DET_PROB_1STAZHYPO_307:0, DET_PROB_1STAZHYPO_308:0, DET_RANGE_305:0, DET_RANGE_306:0, DET_RANGE_307:0, DET_RANGE_308:0, DET_RANGE_ERR_305:0, DET_RANGE_ERR_306:0, DET_RANGE_ERR_307:0, DET_RANGE_ERR_308:0, DET_RANGE_VELOCITY_305:16384, DET_RANGE_VELOCITY_306:16384, DET_RANGE_VELOCITY_307:16384, DET_RANGE_VELOCITY_308:16384, DET_RANGE_VELOCITY_ERR_305:0, DET_RANGE_VELOCITY_ERR_306:0, DET_RANGE_VELOCITY_ERR_307:0, DET_RANGE_VELOCITY_ERR_308:0, DET_RCS_305:128, DET_RCS_306:128, DET_RCS_307:128, DET_RCS_308:128, DET_SNR_305:0, DET_SNR_306:0, DET_SNR_307:0, DET_SNR_308:0, DET_SUPER_RES_TARGET_305:0, DET_SUPER_RES_TARGET_306:0, DET_SUPER_RES_TARGET_307:0, DET_SUPER_RES_TARGET_308:0]}, provided-interface=Pi_SG_Detections_305_308_AL
      Pp_SG_Detections_309_312_AL: nonqueued-sender-com-spec{data-element=Vdp_SG_Detections_309_312_AL, init-value=fields=[DET_AZIMUTH_309:0, DET_AZIMUTH_310:0, DET_AZIMUTH_311:0, DET_AZIMUTH_312:0, DET_AZIMUTH_ERR_309:0, DET_AZIMUTH_ERR_310:0, DET_AZIMUTH_ERR_311:0, DET_AZIMUTH_ERR_312:0, DET_BELOW_RAIN_THOLD_309:0, DET_BELOW_RAIN_THOLD_310:0, DET_BELOW_RAIN_THOLD_311:0, DET_BELOW_RAIN_THOLD_312:0, DET_BI_STATIC_FLAG_309:0, DET_BI_STATIC_FLAG_310:0, DET_BI_STATIC_FLAG_311:0, DET_BI_STATIC_FLAG_312:0, DET_CONFD_AZIMUTH_309:0, DET_CONFD_AZIMUTH_310:0, DET_CONFD_AZIMUTH_311:0, DET_CONFD_AZIMUTH_312:0, DET_CONFD_ELEVATION_309:0, DET_CONFD_ELEVATION_310:0, DET_CONFD_ELEVATION_311:0, DET_CONFD_ELEVATION_312:0, DET_ELEVATION_309:0, DET_ELEVATION_310:0, DET_ELEVATION_311:0, DET_ELEVATION_312:0, DET_ELEVATION_ERR_309:0, DET_ELEVATION_ERR_310:0, DET_ELEVATION_ERR_311:0, DET_ELEVATION_ERR_312:0, DET_EXISTENCE_PROB_309:0, DET_EXISTENCE_PROB_310:0, DET_EXISTENCE_PROB_311:0, DET_EXISTENCE_PROB_312:0, DET_HVC_FLAG_309:0, DET_HVC_FLAG_310:0, DET_HVC_FLAG_311:0, DET_HVC_FLAG_312:0, DET_IDM_309:0, DET_IDM_310:0, DET_IDM_311:0, DET_IDM_312:0, DET_MH_CRC16_309_312:0, DET_MH_CYCLE_COUNTER_309_312:0, DET_MH_SCAN_INDEX_4LSB_309_312:0, DET_MTD_309:0, DET_MTD_310:0, DET_MTD_311:0, DET_MTD_312:0, DET_PROB_1STAZHYPO_309:0, DET_PROB_1STAZHYPO_310:0, DET_PROB_1STAZHYPO_311:0, DET_PROB_1STAZHYPO_312:0, DET_RANGE_309:0, DET_RANGE_310:0, DET_RANGE_311:0, DET_RANGE_312:0, DET_RANGE_ERR_309:0, DET_RANGE_ERR_310:0, DET_RANGE_ERR_311:0, DET_RANGE_ERR_312:0, DET_RANGE_VELOCITY_309:16384, DET_RANGE_VELOCITY_310:16384, DET_RANGE_VELOCITY_311:16384, DET_RANGE_VELOCITY_312:16384, DET_RANGE_VELOCITY_ERR_309:0, DET_RANGE_VELOCITY_ERR_310:0, DET_RANGE_VELOCITY_ERR_311:0, DET_RANGE_VELOCITY_ERR_312:0, DET_RCS_309:128, DET_RCS_310:128, DET_RCS_311:128, DET_RCS_312:128, DET_SNR_309:0, DET_SNR_310:0, DET_SNR_311:0, DET_SNR_312:0, DET_SUPER_RES_TARGET_309:0, DET_SUPER_RES_TARGET_310:0, DET_SUPER_RES_TARGET_311:0, DET_SUPER_RES_TARGET_312:0]}, provided-interface=Pi_SG_Detections_309_312_AL
      Pp_SG_Detections_313_316_AL: nonqueued-sender-com-spec{data-element=Vdp_SG_Detections_313_316_AL, init-value=fields=[DET_AZIMUTH_313:0, DET_AZIMUTH_314:0, DET_AZIMUTH_315:0, DET_AZIMUTH_316:0, DET_AZIMUTH_ERR_313:0, DET_AZIMUTH_ERR_314:0, DET_AZIMUTH_ERR_315:0, DET_AZIMUTH_ERR_316:0, DET_BELOW_RAIN_THOLD_313:0, DET_BELOW_RAIN_THOLD_314:0, DET_BELOW_RAIN_THOLD_315:0, DET_BELOW_RAIN_THOLD_316:0, DET_BI_STATIC_FLAG_313:0, DET_BI_STATIC_FLAG_314:0, DET_BI_STATIC_FLAG_315:0, DET_BI_STATIC_FLAG_316:0, DET_CONFD_AZIMUTH_313:0, DET_CONFD_AZIMUTH_314:0, DET_CONFD_AZIMUTH_315:0, DET_CONFD_AZIMUTH_316:0, DET_CONFD_ELEVATION_313:0, DET_CONFD_ELEVATION_314:0, DET_CONFD_ELEVATION_315:0, DET_CONFD_ELEVATION_316:0, DET_ELEVATION_313:0, DET_ELEVATION_314:0, DET_ELEVATION_315:0, DET_ELEVATION_316:0, DET_ELEVATION_ERR_313:0, DET_ELEVATION_ERR_314:0, DET_ELEVATION_ERR_315:0, DET_ELEVATION_ERR_316:0, DET_EXISTENCE_PROB_313:0, DET_EXISTENCE_PROB_314:0, DET_EXISTENCE_PROB_315:0, DET_EXISTENCE_PROB_316:0, DET_HVC_FLAG_313:0, DET_HVC_FLAG_314:0, DET_HVC_FLAG_315:0, DET_HVC_FLAG_316:0, DET_IDM_313:0, DET_IDM_314:0, DET_IDM_315:0, DET_IDM_316:0, DET_MH_CRC16_313_316:0, DET_MH_CYCLE_COUNTER_313_316:0, DET_MH_SCAN_INDEX_4LSB_313_316:0, DET_MTD_313:0, DET_MTD_314:0, DET_MTD_315:0, DET_MTD_316:0, DET_PROB_1STAZHYPO_313:0, DET_PROB_1STAZHYPO_314:0, DET_PROB_1STAZHYPO_315:0, DET_PROB_1STAZHYPO_316:0, DET_RANGE_313:0, DET_RANGE_314:0, DET_RANGE_315:0, DET_RANGE_316:0, DET_RANGE_ERR_313:0, DET_RANGE_ERR_314:0, DET_RANGE_ERR_315:0, DET_RANGE_ERR_316:0, DET_RANGE_VELOCITY_313:16384, DET_RANGE_VELOCITY_314:16384, DET_RANGE_VELOCITY_315:16384, DET_RANGE_VELOCITY_316:16384, DET_RANGE_VELOCITY_ERR_313:0, DET_RANGE_VELOCITY_ERR_314:0, DET_RANGE_VELOCITY_ERR_315:0, DET_RANGE_VELOCITY_ERR_316:0, DET_RCS_313:128, DET_RCS_314:128, DET_RCS_315:128, DET_RCS_316:128, DET_SNR_313:0, DET_SNR_314:0, DET_SNR_315:0, DET_SNR_316:0, DET_SUPER_RES_TARGET_313:0, DET_SUPER_RES_TARGET_314:0, DET_SUPER_RES_TARGET_315:0, DET_SUPER_RES_TARGET_316:0]}, provided-interface=Pi_SG_Detections_313_316_AL
      Pp_SG_Detections_317_320_AL: nonqueued-sender-com-spec{data-element=Vdp_SG_Detections_317_320_AL, init-value=fields=[DET_AZIMUTH_317:0, DET_AZIMUTH_318:0, DET_AZIMUTH_319:0, DET_AZIMUTH_320:0, DET_AZIMUTH_ERR_317:0, DET_AZIMUTH_ERR_318:0, DET_AZIMUTH_ERR_319:0, DET_AZIMUTH_ERR_320:0, DET_BELOW_RAIN_THOLD_317:0, DET_BELOW_RAIN_THOLD_318:0, DET_BELOW_RAIN_THOLD_319:0, DET_BELOW_RAIN_THOLD_320:0, DET_BI_STATIC_FLAG_317:0, DET_BI_STATIC_FLAG_318:0, DET_BI_STATIC_FLAG_319:0, DET_BI_STATIC_FLAG_320:0, DET_CONFD_AZIMUTH_317:0, DET_CONFD_AZIMUTH_318:0, DET_CONFD_AZIMUTH_319:0, DET_CONFD_AZIMUTH_320:0, DET_CONFD_ELEVATION_317:0, DET_CONFD_ELEVATION_318:0, DET_CONFD_ELEVATION_319:0, DET_CONFD_ELEVATION_320:0, DET_ELEVATION_317:0, DET_ELEVATION_318:0, DET_ELEVATION_319:0, DET_ELEVATION_320:0, DET_ELEVATION_ERR_317:0, DET_ELEVATION_ERR_318:0, DET_ELEVATION_ERR_319:0, DET_ELEVATION_ERR_320:0, DET_EXISTENCE_PROB_317:0, DET_EXISTENCE_PROB_318:0, DET_EXISTENCE_PROB_319:0, DET_EXISTENCE_PROB_320:0, DET_HVC_FLAG_317:0, DET_HVC_FLAG_318:0, DET_HVC_FLAG_319:0, DET_HVC_FLAG_320:0, DET_IDM_317:0, DET_IDM_318:0, DET_IDM_319:0, DET_IDM_320:0, DET_MH_CRC16_317_320:0, DET_MH_CYCLE_COUNTER_317_320:0, DET_MH_SCAN_INDEX_4LSB_317_320:0, DET_MTD_317:0, DET_MTD_318:0, DET_MTD_319:0, DET_MTD_320:0, DET_PROB_1STAZHYPO_317:0, DET_PROB_1STAZHYPO_318:0, DET_PROB_1STAZHYPO_319:0, DET_PROB_1STAZHYPO_320:0, DET_RANGE_317:0, DET_RANGE_318:0, DET_RANGE_319:0, DET_RANGE_320:0, DET_RANGE_ERR_317:0, DET_RANGE_ERR_318:0, DET_RANGE_ERR_319:0, DET_RANGE_ERR_320:0, DET_RANGE_VELOCITY_317:16384, DET_RANGE_VELOCITY_318:16384, DET_RANGE_VELOCITY_319:16384, DET_RANGE_VELOCITY_320:16384, DET_RANGE_VELOCITY_ERR_317:0, DET_RANGE_VELOCITY_ERR_318:0, DET_RANGE_VELOCITY_ERR_319:0, DET_RANGE_VELOCITY_ERR_320:0, DET_RCS_317:128, DET_RCS_318:128, DET_RCS_319:128, DET_RCS_320:128, DET_SNR_317:0, DET_SNR_318:0, DET_SNR_319:0, DET_SNR_320:0, DET_SUPER_RES_TARGET_317:0, DET_SUPER_RES_TARGET_318:0, DET_SUPER_RES_TARGET_319:0, DET_SUPER_RES_TARGET_320:0]}, provided-interface=Pi_SG_Detections_317_320_AL
      Pp_SG_Detections_321_324_AL: nonqueued-sender-com-spec{data-element=Vdp_SG_Detections_321_324_AL, init-value=fields=[DET_AZIMUTH_321:0, DET_AZIMUTH_322:0, DET_AZIMUTH_323:0, DET_AZIMUTH_324:0, DET_AZIMUTH_ERR_321:0, DET_AZIMUTH_ERR_322:0, DET_AZIMUTH_ERR_323:0, DET_AZIMUTH_ERR_324:0, DET_BELOW_RAIN_THOLD_321:0, DET_BELOW_RAIN_THOLD_322:0, DET_BELOW_RAIN_THOLD_323:0, DET_BELOW_RAIN_THOLD_324:0, DET_BI_STATIC_FLAG_321:0, DET_BI_STATIC_FLAG_322:0, DET_BI_STATIC_FLAG_323:0, DET_BI_STATIC_FLAG_324:0, DET_CONFD_AZIMUTH_321:0, DET_CONFD_AZIMUTH_322:0, DET_CONFD_AZIMUTH_323:0, DET_CONFD_AZIMUTH_324:0, DET_CONFD_ELEVATION_321:0, DET_CONFD_ELEVATION_322:0, DET_CONFD_ELEVATION_323:0, DET_CONFD_ELEVATION_324:0, DET_ELEVATION_321:0, DET_ELEVATION_322:0, DET_ELEVATION_323:0, DET_ELEVATION_324:0, DET_ELEVATION_ERR_321:0, DET_ELEVATION_ERR_322:0, DET_ELEVATION_ERR_323:0, DET_ELEVATION_ERR_324:0, DET_EXISTENCE_PROB_321:0, DET_EXISTENCE_PROB_322:0, DET_EXISTENCE_PROB_323:0, DET_EXISTENCE_PROB_324:0, DET_HVC_FLAG_321:0, DET_HVC_FLAG_322:0, DET_HVC_FLAG_323:0, DET_HVC_FLAG_324:0, DET_IDM_321:0, DET_IDM_322:0, DET_IDM_323:0, DET_IDM_324:0, DET_MH_CRC16_321_324:0, DET_MH_CYCLE_COUNTER_321_324:0, DET_MH_SCAN_INDEX_4LSB_321_324:0, DET_MTD_321:0, DET_MTD_322:0, DET_MTD_323:0, DET_MTD_324:0, DET_PROB_1STAZHYPO_321:0, DET_PROB_1STAZHYPO_322:0, DET_PROB_1STAZHYPO_323:0, DET_PROB_1STAZHYPO_324:0, DET_RANGE_321:0, DET_RANGE_322:0, DET_RANGE_323:0, DET_RANGE_324:0, DET_RANGE_ERR_321:0, DET_RANGE_ERR_322:0, DET_RANGE_ERR_323:0, DET_RANGE_ERR_324:0, DET_RANGE_VELOCITY_321:16384, DET_RANGE_VELOCITY_322:16384, DET_RANGE_VELOCITY_323:16384, DET_RANGE_VELOCITY_324:16384, DET_RANGE_VELOCITY_ERR_321:0, DET_RANGE_VELOCITY_ERR_322:0, DET_RANGE_VELOCITY_ERR_323:0, DET_RANGE_VELOCITY_ERR_324:0, DET_RCS_321:128, DET_RCS_322:128, DET_RCS_323:128, DET_RCS_324:128, DET_SNR_321:0, DET_SNR_322:0, DET_SNR_323:0, DET_SNR_324:0, DET_SUPER_RES_TARGET_321:0, DET_SUPER_RES_TARGET_322:0, DET_SUPER_RES_TARGET_323:0, DET_SUPER_RES_TARGET_324:0]}, provided-interface=Pi_SG_Detections_321_324_AL
      Pp_SG_Detections_325_328_AL: nonqueued-sender-com-spec{data-element=Vdp_SG_Detections_325_328_AL, init-value=fields=[DET_AZIMUTH_325:0, DET_AZIMUTH_326:0, DET_AZIMUTH_327:0, DET_AZIMUTH_328:0, DET_AZIMUTH_ERR_325:0, DET_AZIMUTH_ERR_326:0, DET_AZIMUTH_ERR_327:0, DET_AZIMUTH_ERR_328:0, DET_BELOW_RAIN_THOLD_325:0, DET_BELOW_RAIN_THOLD_326:0, DET_BELOW_RAIN_THOLD_327:0, DET_BELOW_RAIN_THOLD_328:0, DET_BI_STATIC_FLAG_325:0, DET_BI_STATIC_FLAG_326:0, DET_BI_STATIC_FLAG_327:0, DET_BI_STATIC_FLAG_328:0, DET_CONFD_AZIMUTH_325:0, DET_CONFD_AZIMUTH_326:0, DET_CONFD_AZIMUTH_327:0, DET_CONFD_AZIMUTH_328:0, DET_CONFD_ELEVATION_325:0, DET_CONFD_ELEVATION_326:0, DET_CONFD_ELEVATION_327:0, DET_CONFD_ELEVATION_328:0, DET_ELEVATION_325:0, DET_ELEVATION_326:0, DET_ELEVATION_327:0, DET_ELEVATION_328:0, DET_ELEVATION_ERR_325:0, DET_ELEVATION_ERR_326:0, DET_ELEVATION_ERR_327:0, DET_ELEVATION_ERR_328:0, DET_EXISTENCE_PROB_325:0, DET_EXISTENCE_PROB_326:0, DET_EXISTENCE_PROB_327:0, DET_EXISTENCE_PROB_328:0, DET_HVC_FLAG_325:0, DET_HVC_FLAG_326:0, DET_HVC_FLAG_327:0, DET_HVC_FLAG_328:0, DET_IDM_325:0, DET_IDM_326:0, DET_IDM_327:0, DET_IDM_328:0, DET_MH_CRC16_325_328:0, DET_MH_CYCLE_COUNTER_325_328:0, DET_MH_SCAN_INDEX_4LSB_325_328:0, DET_MTD_325:0, DET_MTD_326:0, DET_MTD_327:0, DET_MTD_328:0, DET_PROB_1STAZHYPO_325:0, DET_PROB_1STAZHYPO_326:0, DET_PROB_1STAZHYPO_327:0, DET_PROB_1STAZHYPO_328:0, DET_RANGE_325:0, DET_RANGE_326:0, DET_RANGE_327:0, DET_RANGE_328:0, DET_RANGE_ERR_325:0, DET_RANGE_ERR_326:0, DET_RANGE_ERR_327:0, DET_RANGE_ERR_328:0, DET_RANGE_VELOCITY_325:16384, DET_RANGE_VELOCITY_326:16384, DET_RANGE_VELOCITY_327:16384, DET_RANGE_VELOCITY_328:16384, DET_RANGE_VELOCITY_ERR_325:0, DET_RANGE_VELOCITY_ERR_326:0, DET_RANGE_VELOCITY_ERR_327:0, DET_RANGE_VELOCITY_ERR_328:0, DET_RCS_325:128, DET_RCS_326:128, DET_RCS_327:128, DET_RCS_328:128, DET_SNR_325:0, DET_SNR_326:0, DET_SNR_327:0, DET_SNR_328:0, DET_SUPER_RES_TARGET_325:0, DET_SUPER_RES_TARGET_326:0, DET_SUPER_RES_TARGET_327:0, DET_SUPER_RES_TARGET_328:0]}, provided-interface=Pi_SG_Detections_325_328_AL
      Pp_SG_Detections_329_332_AL: nonqueued-sender-com-spec{data-element=Vdp_SG_Detections_329_332_AL, init-value=fields=[DET_AZIMUTH_329:0, DET_AZIMUTH_330:0, DET_AZIMUTH_331:0, DET_AZIMUTH_332:0, DET_AZIMUTH_ERR_329:0, DET_AZIMUTH_ERR_330:0, DET_AZIMUTH_ERR_331:0, DET_AZIMUTH_ERR_332:0, DET_BELOW_RAIN_THOLD_329:0, DET_BELOW_RAIN_THOLD_330:0, DET_BELOW_RAIN_THOLD_331:0, DET_BELOW_RAIN_THOLD_332:0, DET_BI_STATIC_FLAG_329:0, DET_BI_STATIC_FLAG_330:0, DET_BI_STATIC_FLAG_331:0, DET_BI_STATIC_FLAG_332:0, DET_CONFD_AZIMUTH_329:0, DET_CONFD_AZIMUTH_330:0, DET_CONFD_AZIMUTH_331:0, DET_CONFD_AZIMUTH_332:0, DET_CONFD_ELEVATION_329:0, DET_CONFD_ELEVATION_330:0, DET_CONFD_ELEVATION_331:0, DET_CONFD_ELEVATION_332:0, DET_ELEVATION_329:0, DET_ELEVATION_330:0, DET_ELEVATION_331:0, DET_ELEVATION_332:0, DET_ELEVATION_ERR_329:0, DET_ELEVATION_ERR_330:0, DET_ELEVATION_ERR_331:0, DET_ELEVATION_ERR_332:0, DET_EXISTENCE_PROB_329:0, DET_EXISTENCE_PROB_330:0, DET_EXISTENCE_PROB_331:0, DET_EXISTENCE_PROB_332:0, DET_HVC_FLAG_329:0, DET_HVC_FLAG_330:0, DET_HVC_FLAG_331:0, DET_HVC_FLAG_332:0, DET_IDM_329:0, DET_IDM_330:0, DET_IDM_331:0, DET_IDM_332:0, DET_MH_CRC16_329_332:0, DET_MH_CYCLE_COUNTER_329_332:0, DET_MH_SCAN_INDEX_4LSB_329_332:0, DET_MTD_329:0, DET_MTD_330:0, DET_MTD_331:0, DET_MTD_332:0, DET_PROB_1STAZHYPO_329:0, DET_PROB_1STAZHYPO_330:0, DET_PROB_1STAZHYPO_331:0, DET_PROB_1STAZHYPO_332:0, DET_RANGE_329:0, DET_RANGE_330:0, DET_RANGE_331:0, DET_RANGE_332:0, DET_RANGE_ERR_329:0, DET_RANGE_ERR_330:0, DET_RANGE_ERR_331:0, DET_RANGE_ERR_332:0, DET_RANGE_VELOCITY_329:16384, DET_RANGE_VELOCITY_330:16384, DET_RANGE_VELOCITY_331:16384, DET_RANGE_VELOCITY_332:16384, DET_RANGE_VELOCITY_ERR_329:0, DET_RANGE_VELOCITY_ERR_330:0, DET_RANGE_VELOCITY_ERR_331:0, DET_RANGE_VELOCITY_ERR_332:0, DET_RCS_329:128, DET_RCS_330:128, DET_RCS_331:128, DET_RCS_332:128, DET_SNR_329:0, DET_SNR_330:0, DET_SNR_331:0, DET_SNR_332:0, DET_SUPER_RES_TARGET_329:0, DET_SUPER_RES_TARGET_330:0, DET_SUPER_RES_TARGET_331:0, DET_SUPER_RES_TARGET_332:0]}, provided-interface=Pi_SG_Detections_329_332_AL
      Pp_SG_Detections_333_336_AL: nonqueued-sender-com-spec{data-element=Vdp_SG_Detections_333_336_AL, init-value=fields=[DET_AZIMUTH_333:0, DET_AZIMUTH_334:0, DET_AZIMUTH_335:0, DET_AZIMUTH_336:0, DET_AZIMUTH_ERR_333:0, DET_AZIMUTH_ERR_334:0, DET_AZIMUTH_ERR_335:0, DET_AZIMUTH_ERR_336:0, DET_BELOW_RAIN_THOLD_333:0, DET_BELOW_RAIN_THOLD_334:0, DET_BELOW_RAIN_THOLD_335:0, DET_BELOW_RAIN_THOLD_336:0, DET_BI_STATIC_FLAG_333:0, DET_BI_STATIC_FLAG_334:0, DET_BI_STATIC_FLAG_335:0, DET_BI_STATIC_FLAG_336:0, DET_CONFD_AZIMUTH_333:0, DET_CONFD_AZIMUTH_334:0, DET_CONFD_AZIMUTH_335:0, DET_CONFD_AZIMUTH_336:0, DET_CONFD_ELEVATION_333:0, DET_CONFD_ELEVATION_334:0, DET_CONFD_ELEVATION_335:0, DET_CONFD_ELEVATION_336:0, DET_ELEVATION_333:0, DET_ELEVATION_334:0, DET_ELEVATION_335:0, DET_ELEVATION_336:0, DET_ELEVATION_ERR_333:0, DET_ELEVATION_ERR_334:0, DET_ELEVATION_ERR_335:0, DET_ELEVATION_ERR_336:0, DET_EXISTENCE_PROB_333:0, DET_EXISTENCE_PROB_334:0, DET_EXISTENCE_PROB_335:0, DET_EXISTENCE_PROB_336:0, DET_HVC_FLAG_333:0, DET_HVC_FLAG_334:0, DET_HVC_FLAG_335:0, DET_HVC_FLAG_336:0, DET_IDM_333:0, DET_IDM_334:0, DET_IDM_335:0, DET_IDM_336:0, DET_MH_CRC16_333_336:0, DET_MH_CYCLE_COUNTER_333_336:0, DET_MH_SCAN_INDEX_4LSB_333_336:0, DET_MTD_333:0, DET_MTD_334:0, DET_MTD_335:0, DET_MTD_336:0, DET_PROB_1STAZHYPO_333:0, DET_PROB_1STAZHYPO_334:0, DET_PROB_1STAZHYPO_335:0, DET_PROB_1STAZHYPO_336:0, DET_RANGE_333:0, DET_RANGE_334:0, DET_RANGE_335:0, DET_RANGE_336:0, DET_RANGE_ERR_333:0, DET_RANGE_ERR_334:0, DET_RANGE_ERR_335:0, DET_RANGE_ERR_336:0, DET_RANGE_VELOCITY_333:16384, DET_RANGE_VELOCITY_334:16384, DET_RANGE_VELOCITY_335:16384, DET_RANGE_VELOCITY_336:16384, DET_RANGE_VELOCITY_ERR_333:0, DET_RANGE_VELOCITY_ERR_334:0, DET_RANGE_VELOCITY_ERR_335:0, DET_RANGE_VELOCITY_ERR_336:0, DET_RCS_333:128, DET_RCS_334:128, DET_RCS_335:128, DET_RCS_336:128, DET_SNR_333:0, DET_SNR_334:0, DET_SNR_335:0, DET_SNR_336:0, DET_SUPER_RES_TARGET_333:0, DET_SUPER_RES_TARGET_334:0, DET_SUPER_RES_TARGET_335:0, DET_SUPER_RES_TARGET_336:0]}, provided-interface=Pi_SG_Detections_333_336_AL
      Pp_SG_Detections_337_340_AL: nonqueued-sender-com-spec{data-element=Vdp_SG_Detections_337_340_AL, init-value=fields=[DET_AZIMUTH_337:0, DET_AZIMUTH_338:0, DET_AZIMUTH_339:0, DET_AZIMUTH_340:0, DET_AZIMUTH_ERR_337:0, DET_AZIMUTH_ERR_338:0, DET_AZIMUTH_ERR_339:0, DET_AZIMUTH_ERR_340:0, DET_BELOW_RAIN_THOLD_337:0, DET_BELOW_RAIN_THOLD_338:0, DET_BELOW_RAIN_THOLD_339:0, DET_BELOW_RAIN_THOLD_340:0, DET_BI_STATIC_FLAG_337:0, DET_BI_STATIC_FLAG_338:0, DET_BI_STATIC_FLAG_339:0, DET_BI_STATIC_FLAG_340:0, DET_CONFD_AZIMUTH_337:0, DET_CONFD_AZIMUTH_338:0, DET_CONFD_AZIMUTH_339:0, DET_CONFD_AZIMUTH_340:0, DET_CONFD_ELEVATION_337:0, DET_CONFD_ELEVATION_338:0, DET_CONFD_ELEVATION_339:0, DET_CONFD_ELEVATION_340:0, DET_ELEVATION_337:0, DET_ELEVATION_338:0, DET_ELEVATION_339:0, DET_ELEVATION_340:0, DET_ELEVATION_ERR_337:0, DET_ELEVATION_ERR_338:0, DET_ELEVATION_ERR_339:0, DET_ELEVATION_ERR_340:0, DET_EXISTENCE_PROB_337:0, DET_EXISTENCE_PROB_338:0, DET_EXISTENCE_PROB_339:0, DET_EXISTENCE_PROB_340:0, DET_HVC_FLAG_337:0, DET_HVC_FLAG_338:0, DET_HVC_FLAG_339:0, DET_HVC_FLAG_340:0, DET_IDM_337:0, DET_IDM_338:0, DET_IDM_339:0, DET_IDM_340:0, DET_MH_CRC16_337_340:0, DET_MH_CYCLE_COUNTER_337_340:0, DET_MH_SCAN_INDEX_4LSB_337_340:0, DET_MTD_337:0, DET_MTD_338:0, DET_MTD_339:0, DET_MTD_340:0, DET_PROB_1STAZHYPO_337:0, DET_PROB_1STAZHYPO_338:0, DET_PROB_1STAZHYPO_339:0, DET_PROB_1STAZHYPO_340:0, DET_RANGE_337:0, DET_RANGE_338:0, DET_RANGE_339:0, DET_RANGE_340:0, DET_RANGE_ERR_337:0, DET_RANGE_ERR_338:0, DET_RANGE_ERR_339:0, DET_RANGE_ERR_340:0, DET_RANGE_VELOCITY_337:16384, DET_RANGE_VELOCITY_338:16384, DET_RANGE_VELOCITY_339:16384, DET_RANGE_VELOCITY_340:16384, DET_RANGE_VELOCITY_ERR_337:0, DET_RANGE_VELOCITY_ERR_338:0, DET_RANGE_VELOCITY_ERR_339:0, DET_RANGE_VELOCITY_ERR_340:0, DET_RCS_337:128, DET_RCS_338:128, DET_RCS_339:128, DET_RCS_340:128, DET_SNR_337:0, DET_SNR_338:0, DET_SNR_339:0, DET_SNR_340:0, DET_SUPER_RES_TARGET_337:0, DET_SUPER_RES_TARGET_338:0, DET_SUPER_RES_TARGET_339:0, DET_SUPER_RES_TARGET_340:0]}, provided-interface=Pi_SG_Detections_337_340_AL
      Pp_SG_Detections_341_344_AL: nonqueued-sender-com-spec{data-element=Vdp_SG_Detections_341_344_AL, init-value=fields=[DET_AZIMUTH_341:0, DET_AZIMUTH_342:0, DET_AZIMUTH_343:0, DET_AZIMUTH_344:0, DET_AZIMUTH_ERR_341:0, DET_AZIMUTH_ERR_342:0, DET_AZIMUTH_ERR_343:0, DET_AZIMUTH_ERR_344:0, DET_BELOW_RAIN_THOLD_341:0, DET_BELOW_RAIN_THOLD_342:0, DET_BELOW_RAIN_THOLD_343:0, DET_BELOW_RAIN_THOLD_344:0, DET_BI_STATIC_FLAG_341:0, DET_BI_STATIC_FLAG_342:0, DET_BI_STATIC_FLAG_343:0, DET_BI_STATIC_FLAG_344:0, DET_CONFD_AZIMUTH_341:0, DET_CONFD_AZIMUTH_342:0, DET_CONFD_AZIMUTH_343:0, DET_CONFD_AZIMUTH_344:0, DET_CONFD_ELEVATION_341:0, DET_CONFD_ELEVATION_342:0, DET_CONFD_ELEVATION_343:0, DET_CONFD_ELEVATION_344:0, DET_ELEVATION_341:0, DET_ELEVATION_342:0, DET_ELEVATION_343:0, DET_ELEVATION_344:0, DET_ELEVATION_ERR_341:0, DET_ELEVATION_ERR_342:0, DET_ELEVATION_ERR_343:0, DET_ELEVATION_ERR_344:0, DET_EXISTENCE_PROB_341:0, DET_EXISTENCE_PROB_342:0, DET_EXISTENCE_PROB_343:0, DET_EXISTENCE_PROB_344:0, DET_HVC_FLAG_341:0, DET_HVC_FLAG_342:0, DET_HVC_FLAG_343:0, DET_HVC_FLAG_344:0, DET_IDM_341:0, DET_IDM_342:0, DET_IDM_343:0, DET_IDM_344:0, DET_MH_CRC16_341_344:0, DET_MH_CYCLE_COUNTER_341_344:0, DET_MH_SCAN_INDEX_4LSB_341_344:0, DET_MTD_341:0, DET_MTD_342:0, DET_MTD_343:0, DET_MTD_344:0, DET_PROB_1STAZHYPO_341:0, DET_PROB_1STAZHYPO_342:0, DET_PROB_1STAZHYPO_343:0, DET_PROB_1STAZHYPO_344:0, DET_RANGE_341:0, DET_RANGE_342:0, DET_RANGE_343:0, DET_RANGE_344:0, DET_RANGE_ERR_341:0, DET_RANGE_ERR_342:0, DET_RANGE_ERR_343:0, DET_RANGE_ERR_344:0, DET_RANGE_VELOCITY_341:16384, DET_RANGE_VELOCITY_342:16384, DET_RANGE_VELOCITY_343:16384, DET_RANGE_VELOCITY_344:16384, DET_RANGE_VELOCITY_ERR_341:0, DET_RANGE_VELOCITY_ERR_342:0, DET_RANGE_VELOCITY_ERR_343:0, DET_RANGE_VELOCITY_ERR_344:0, DET_RCS_341:128, DET_RCS_342:128, DET_RCS_343:128, DET_RCS_344:128, DET_SNR_341:0, DET_SNR_342:0, DET_SNR_343:0, DET_SNR_344:0, DET_SUPER_RES_TARGET_341:0, DET_SUPER_RES_TARGET_342:0, DET_SUPER_RES_TARGET_343:0, DET_SUPER_RES_TARGET_344:0]}, provided-interface=Pi_SG_Detections_341_344_AL
      Pp_SG_Detections_345_348_AL: nonqueued-sender-com-spec{data-element=Vdp_SG_Detections_345_348_AL, init-value=fields=[DET_AZIMUTH_345:0, DET_AZIMUTH_346:0, DET_AZIMUTH_347:0, DET_AZIMUTH_348:0, DET_AZIMUTH_ERR_345:0, DET_AZIMUTH_ERR_346:0, DET_AZIMUTH_ERR_347:0, DET_AZIMUTH_ERR_348:0, DET_BELOW_RAIN_THOLD_345:0, DET_BELOW_RAIN_THOLD_346:0, DET_BELOW_RAIN_THOLD_347:0, DET_BELOW_RAIN_THOLD_348:0, DET_BI_STATIC_FLAG_345:0, DET_BI_STATIC_FLAG_346:0, DET_BI_STATIC_FLAG_347:0, DET_BI_STATIC_FLAG_348:0, DET_CONFD_AZIMUTH_345:0, DET_CONFD_AZIMUTH_346:0, DET_CONFD_AZIMUTH_347:0, DET_CONFD_AZIMUTH_348:0, DET_CONFD_ELEVATION_345:0, DET_CONFD_ELEVATION_346:0, DET_CONFD_ELEVATION_347:0, DET_CONFD_ELEVATION_348:0, DET_ELEVATION_345:0, DET_ELEVATION_346:0, DET_ELEVATION_347:0, DET_ELEVATION_348:0, DET_ELEVATION_ERR_345:0, DET_ELEVATION_ERR_346:0, DET_ELEVATION_ERR_347:0, DET_ELEVATION_ERR_348:0, DET_EXISTENCE_PROB_345:0, DET_EXISTENCE_PROB_346:0, DET_EXISTENCE_PROB_347:0, DET_EXISTENCE_PROB_348:0, DET_HVC_FLAG_345:0, DET_HVC_FLAG_346:0, DET_HVC_FLAG_347:0, DET_HVC_FLAG_348:0, DET_IDM_345:0, DET_IDM_346:0, DET_IDM_347:0, DET_IDM_348:0, DET_MH_CRC16_345_348:0, DET_MH_CYCLE_COUNTER_345_348:0, DET_MH_SCAN_INDEX_4LSB_345_348:0, DET_MTD_345:0, DET_MTD_346:0, DET_MTD_347:0, DET_MTD_348:0, DET_PROB_1STAZHYPO_345:0, DET_PROB_1STAZHYPO_346:0, DET_PROB_1STAZHYPO_347:0, DET_PROB_1STAZHYPO_348:0, DET_RANGE_345:0, DET_RANGE_346:0, DET_RANGE_347:0, DET_RANGE_348:0, DET_RANGE_ERR_345:0, DET_RANGE_ERR_346:0, DET_RANGE_ERR_347:0, DET_RANGE_ERR_348:0, DET_RANGE_VELOCITY_345:16384, DET_RANGE_VELOCITY_346:16384, DET_RANGE_VELOCITY_347:16384, DET_RANGE_VELOCITY_348:16384, DET_RANGE_VELOCITY_ERR_345:0, DET_RANGE_VELOCITY_ERR_346:0, DET_RANGE_VELOCITY_ERR_347:0, DET_RANGE_VELOCITY_ERR_348:0, DET_RCS_345:128, DET_RCS_346:128, DET_RCS_347:128, DET_RCS_348:128, DET_SNR_345:0, DET_SNR_346:0, DET_SNR_347:0, DET_SNR_348:0, DET_SUPER_RES_TARGET_345:0, DET_SUPER_RES_TARGET_346:0, DET_SUPER_RES_TARGET_347:0, DET_SUPER_RES_TARGET_348:0]}, provided-interface=Pi_SG_Detections_345_348_AL
      Pp_SG_Detections_349_352_AL: nonqueued-sender-com-spec{data-element=Vdp_SG_Detections_349_352_AL, init-value=fields=[DET_AZIMUTH_349:0, DET_AZIMUTH_350:0, DET_AZIMUTH_351:0, DET_AZIMUTH_352:0, DET_AZIMUTH_ERR_349:0, DET_AZIMUTH_ERR_350:0, DET_AZIMUTH_ERR_351:0, DET_AZIMUTH_ERR_352:0, DET_BELOW_RAIN_THOLD_349:0, DET_BELOW_RAIN_THOLD_350:0, DET_BELOW_RAIN_THOLD_351:0, DET_BELOW_RAIN_THOLD_352:0, DET_BI_STATIC_FLAG_349:0, DET_BI_STATIC_FLAG_350:0, DET_BI_STATIC_FLAG_351:0, DET_BI_STATIC_FLAG_352:0, DET_CONFD_AZIMUTH_349:0, DET_CONFD_AZIMUTH_350:0, DET_CONFD_AZIMUTH_351:0, DET_CONFD_AZIMUTH_352:0, DET_CONFD_ELEVATION_349:0, DET_CONFD_ELEVATION_350:0, DET_CONFD_ELEVATION_351:0, DET_CONFD_ELEVATION_352:0, DET_ELEVATION_349:0, DET_ELEVATION_350:0, DET_ELEVATION_351:0, DET_ELEVATION_352:0, DET_ELEVATION_ERR_349:0, DET_ELEVATION_ERR_350:0, DET_ELEVATION_ERR_351:0, DET_ELEVATION_ERR_352:0, DET_EXISTENCE_PROB_349:0, DET_EXISTENCE_PROB_350:0, DET_EXISTENCE_PROB_351:0, DET_EXISTENCE_PROB_352:0, DET_HVC_FLAG_349:0, DET_HVC_FLAG_350:0, DET_HVC_FLAG_351:0, DET_HVC_FLAG_352:0, DET_IDM_349:0, DET_IDM_350:0, DET_IDM_351:0, DET_IDM_352:0, DET_MH_CRC16_349_352:0, DET_MH_CYCLE_COUNTER_349_352:0, DET_MH_SCAN_INDEX_4LSB_349_352:0, DET_MTD_349:0, DET_MTD_350:0, DET_MTD_351:0, DET_MTD_352:0, DET_PROB_1STAZHYPO_349:0, DET_PROB_1STAZHYPO_350:0, DET_PROB_1STAZHYPO_351:0, DET_PROB_1STAZHYPO_352:0, DET_RANGE_349:0, DET_RANGE_350:0, DET_RANGE_351:0, DET_RANGE_352:0, DET_RANGE_ERR_349:0, DET_RANGE_ERR_350:0, DET_RANGE_ERR_351:0, DET_RANGE_ERR_352:0, DET_RANGE_VELOCITY_349:16384, DET_RANGE_VELOCITY_350:16384, DET_RANGE_VELOCITY_351:16384, DET_RANGE_VELOCITY_352:16384, DET_RANGE_VELOCITY_ERR_349:0, DET_RANGE_VELOCITY_ERR_350:0, DET_RANGE_VELOCITY_ERR_351:0, DET_RANGE_VELOCITY_ERR_352:0, DET_RCS_349:128, DET_RCS_350:128, DET_RCS_351:128, DET_RCS_352:128, DET_SNR_349:0, DET_SNR_350:0, DET_SNR_351:0, DET_SNR_352:0, DET_SUPER_RES_TARGET_349:0, DET_SUPER_RES_TARGET_350:0, DET_SUPER_RES_TARGET_351:0, DET_SUPER_RES_TARGET_352:0]}, provided-interface=Pi_SG_Detections_349_352_AL
      Pp_SG_Detections_353_356_AL: nonqueued-sender-com-spec{data-element=Vdp_SG_Detections_353_356_AL, init-value=fields=[DET_AZIMUTH_353:0, DET_AZIMUTH_354:0, DET_AZIMUTH_355:0, DET_AZIMUTH_356:0, DET_AZIMUTH_ERR_353:0, DET_AZIMUTH_ERR_354:0, DET_AZIMUTH_ERR_355:0, DET_AZIMUTH_ERR_356:0, DET_BELOW_RAIN_THOLD_353:0, DET_BELOW_RAIN_THOLD_354:0, DET_BELOW_RAIN_THOLD_355:0, DET_BELOW_RAIN_THOLD_356:0, DET_BI_STATIC_FLAG_353:0, DET_BI_STATIC_FLAG_354:0, DET_BI_STATIC_FLAG_355:0, DET_BI_STATIC_FLAG_356:0, DET_CONFD_AZIMUTH_353:0, DET_CONFD_AZIMUTH_354:0, DET_CONFD_AZIMUTH_355:0, DET_CONFD_AZIMUTH_356:0, DET_CONFD_ELEVATION_353:0, DET_CONFD_ELEVATION_354:0, DET_CONFD_ELEVATION_355:0, DET_CONFD_ELEVATION_356:0, DET_ELEVATION_353:0, DET_ELEVATION_354:0, DET_ELEVATION_355:0, DET_ELEVATION_356:0, DET_ELEVATION_ERR_353:0, DET_ELEVATION_ERR_354:0, DET_ELEVATION_ERR_355:0, DET_ELEVATION_ERR_356:0, DET_EXISTENCE_PROB_353:0, DET_EXISTENCE_PROB_354:0, DET_EXISTENCE_PROB_355:0, DET_EXISTENCE_PROB_356:0, DET_HVC_FLAG_353:0, DET_HVC_FLAG_354:0, DET_HVC_FLAG_355:0, DET_HVC_FLAG_356:0, DET_IDM_353:0, DET_IDM_354:0, DET_IDM_355:0, DET_IDM_356:0, DET_MH_CRC16_353_356:0, DET_MH_CYCLE_COUNTER_353_356:0, DET_MH_SCAN_INDEX_4LSB_353_356:0, DET_MTD_353:0, DET_MTD_354:0, DET_MTD_355:0, DET_MTD_356:0, DET_PROB_1STAZHYPO_353:0, DET_PROB_1STAZHYPO_354:0, DET_PROB_1STAZHYPO_355:0, DET_PROB_1STAZHYPO_356:0, DET_RANGE_353:0, DET_RANGE_354:0, DET_RANGE_355:0, DET_RANGE_356:0, DET_RANGE_ERR_353:0, DET_RANGE_ERR_354:0, DET_RANGE_ERR_355:0, DET_RANGE_ERR_356:0, DET_RANGE_VELOCITY_353:16384, DET_RANGE_VELOCITY_354:16384, DET_RANGE_VELOCITY_355:16384, DET_RANGE_VELOCITY_356:16384, DET_RANGE_VELOCITY_ERR_353:0, DET_RANGE_VELOCITY_ERR_354:0, DET_RANGE_VELOCITY_ERR_355:0, DET_RANGE_VELOCITY_ERR_356:0, DET_RCS_353:128, DET_RCS_354:128, DET_RCS_355:128, DET_RCS_356:128, DET_SNR_353:0, DET_SNR_354:0, DET_SNR_355:0, DET_SNR_356:0, DET_SUPER_RES_TARGET_353:0, DET_SUPER_RES_TARGET_354:0, DET_SUPER_RES_TARGET_355:0, DET_SUPER_RES_TARGET_356:0]}, provided-interface=Pi_SG_Detections_353_356_AL
      Pp_SG_Detections_357_360_AL: nonqueued-sender-com-spec{data-element=Vdp_SG_Detections_357_360_AL, init-value=fields=[DET_AZIMUTH_357:0, DET_AZIMUTH_358:0, DET_AZIMUTH_359:0, DET_AZIMUTH_360:0, DET_AZIMUTH_ERR_357:0, DET_AZIMUTH_ERR_358:0, DET_AZIMUTH_ERR_359:0, DET_AZIMUTH_ERR_360:0, DET_BELOW_RAIN_THOLD_357:0, DET_BELOW_RAIN_THOLD_358:0, DET_BELOW_RAIN_THOLD_359:0, DET_BELOW_RAIN_THOLD_360:0, DET_BI_STATIC_FLAG_357:0, DET_BI_STATIC_FLAG_358:0, DET_BI_STATIC_FLAG_359:0, DET_BI_STATIC_FLAG_360:0, DET_CONFD_AZIMUTH_357:0, DET_CONFD_AZIMUTH_358:0, DET_CONFD_AZIMUTH_359:0, DET_CONFD_AZIMUTH_360:0, DET_CONFD_ELEVATION_357:0, DET_CONFD_ELEVATION_358:0, DET_CONFD_ELEVATION_359:0, DET_CONFD_ELEVATION_360:0, DET_ELEVATION_357:0, DET_ELEVATION_358:0, DET_ELEVATION_359:0, DET_ELEVATION_360:0, DET_ELEVATION_ERR_357:0, DET_ELEVATION_ERR_358:0, DET_ELEVATION_ERR_359:0, DET_ELEVATION_ERR_360:0, DET_EXISTENCE_PROB_357:0, DET_EXISTENCE_PROB_358:0, DET_EXISTENCE_PROB_359:0, DET_EXISTENCE_PROB_360:0, DET_HVC_FLAG_357:0, DET_HVC_FLAG_358:0, DET_HVC_FLAG_359:0, DET_HVC_FLAG_360:0, DET_IDM_357:0, DET_IDM_358:0, DET_IDM_359:0, DET_IDM_360:0, DET_MH_CRC16_357_360:0, DET_MH_CYCLE_COUNTER_357_360:0, DET_MH_SCAN_INDEX_4LSB_357_360:0, DET_MTD_357:0, DET_MTD_358:0, DET_MTD_359:0, DET_MTD_360:0, DET_PROB_1STAZHYPO_357:0, DET_PROB_1STAZHYPO_358:0, DET_PROB_1STAZHYPO_359:0, DET_PROB_1STAZHYPO_360:0, DET_RANGE_357:0, DET_RANGE_358:0, DET_RANGE_359:0, DET_RANGE_360:0, DET_RANGE_ERR_357:0, DET_RANGE_ERR_358:0, DET_RANGE_ERR_359:0, DET_RANGE_ERR_360:0, DET_RANGE_VELOCITY_357:16384, DET_RANGE_VELOCITY_358:16384, DET_RANGE_VELOCITY_359:16384, DET_RANGE_VELOCITY_360:16384, DET_RANGE_VELOCITY_ERR_357:0, DET_RANGE_VELOCITY_ERR_358:0, DET_RANGE_VELOCITY_ERR_359:0, DET_RANGE_VELOCITY_ERR_360:0, DET_RCS_357:128, DET_RCS_358:128, DET_RCS_359:128, DET_RCS_360:128, DET_SNR_357:0, DET_SNR_358:0, DET_SNR_359:0, DET_SNR_360:0, DET_SUPER_RES_TARGET_357:0, DET_SUPER_RES_TARGET_358:0, DET_SUPER_RES_TARGET_359:0, DET_SUPER_RES_TARGET_360:0]}, provided-interface=Pi_SG_Detections_357_360_AL
      Pp_SG_Detections_361_364_AL: nonqueued-sender-com-spec{data-element=Vdp_SG_Detections_361_364_AL, init-value=fields=[DET_AZIMUTH_361:0, DET_AZIMUTH_362:0, DET_AZIMUTH_363:0, DET_AZIMUTH_364:0, DET_AZIMUTH_ERR_361:0, DET_AZIMUTH_ERR_362:0, DET_AZIMUTH_ERR_363:0, DET_AZIMUTH_ERR_364:0, DET_BELOW_RAIN_THOLD_361:0, DET_BELOW_RAIN_THOLD_362:0, DET_BELOW_RAIN_THOLD_363:0, DET_BELOW_RAIN_THOLD_364:0, DET_BI_STATIC_FLAG_361:0, DET_BI_STATIC_FLAG_362:0, DET_BI_STATIC_FLAG_363:0, DET_BI_STATIC_FLAG_364:0, DET_CONFD_AZIMUTH_361:0, DET_CONFD_AZIMUTH_362:0, DET_CONFD_AZIMUTH_363:0, DET_CONFD_AZIMUTH_364:0, DET_CONFD_ELEVATION_361:0, DET_CONFD_ELEVATION_362:0, DET_CONFD_ELEVATION_363:0, DET_CONFD_ELEVATION_364:0, DET_ELEVATION_361:0, DET_ELEVATION_362:0, DET_ELEVATION_363:0, DET_ELEVATION_364:0, DET_ELEVATION_ERR_361:0, DET_ELEVATION_ERR_362:0, DET_ELEVATION_ERR_363:0, DET_ELEVATION_ERR_364:0, DET_EXISTENCE_PROB_361:0, DET_EXISTENCE_PROB_362:0, DET_EXISTENCE_PROB_363:0, DET_EXISTENCE_PROB_364:0, DET_HVC_FLAG_361:0, DET_HVC_FLAG_362:0, DET_HVC_FLAG_363:0, DET_HVC_FLAG_364:0, DET_IDM_361:0, DET_IDM_362:0, DET_IDM_363:0, DET_IDM_364:0, DET_MH_CRC16_361_364:0, DET_MH_CYCLE_COUNTER_361_364:0, DET_MH_SCAN_INDEX_4LSB_361_364:0, DET_MTD_361:0, DET_MTD_362:0, DET_MTD_363:0, DET_MTD_364:0, DET_PROB_1STAZHYPO_361:0, DET_PROB_1STAZHYPO_362:0, DET_PROB_1STAZHYPO_363:0, DET_PROB_1STAZHYPO_364:0, DET_RANGE_361:0, DET_RANGE_362:0, DET_RANGE_363:0, DET_RANGE_364:0, DET_RANGE_ERR_361:0, DET_RANGE_ERR_362:0, DET_RANGE_ERR_363:0, DET_RANGE_ERR_364:0, DET_RANGE_VELOCITY_361:16384, DET_RANGE_VELOCITY_362:16384, DET_RANGE_VELOCITY_363:16384, DET_RANGE_VELOCITY_364:16384, DET_RANGE_VELOCITY_ERR_361:0, DET_RANGE_VELOCITY_ERR_362:0, DET_RANGE_VELOCITY_ERR_363:0, DET_RANGE_VELOCITY_ERR_364:0, DET_RCS_361:128, DET_RCS_362:128, DET_RCS_363:128, DET_RCS_364:128, DET_SNR_361:0, DET_SNR_362:0, DET_SNR_363:0, DET_SNR_364:0, DET_SUPER_RES_TARGET_361:0, DET_SUPER_RES_TARGET_362:0, DET_SUPER_RES_TARGET_363:0, DET_SUPER_RES_TARGET_364:0]}, provided-interface=Pi_SG_Detections_361_364_AL
      Pp_SG_Detections_365_368_AL: nonqueued-sender-com-spec{data-element=Vdp_SG_Detections_365_368_AL, init-value=fields=[DET_AZIMUTH_365:0, DET_AZIMUTH_366:0, DET_AZIMUTH_367:0, DET_AZIMUTH_368:0, DET_AZIMUTH_ERR_365:0, DET_AZIMUTH_ERR_366:0, DET_AZIMUTH_ERR_367:0, DET_AZIMUTH_ERR_368:0, DET_BELOW_RAIN_THOLD_365:0, DET_BELOW_RAIN_THOLD_366:0, DET_BELOW_RAIN_THOLD_367:0, DET_BELOW_RAIN_THOLD_368:0, DET_BI_STATIC_FLAG_365:0, DET_BI_STATIC_FLAG_366:0, DET_BI_STATIC_FLAG_367:0, DET_BI_STATIC_FLAG_368:0, DET_CONFD_AZIMUTH_365:0, DET_CONFD_AZIMUTH_366:0, DET_CONFD_AZIMUTH_367:0, DET_CONFD_AZIMUTH_368:0, DET_CONFD_ELEVATION_365:0, DET_CONFD_ELEVATION_366:0, DET_CONFD_ELEVATION_367:0, DET_CONFD_ELEVATION_368:0, DET_ELEVATION_365:0, DET_ELEVATION_366:0, DET_ELEVATION_367:0, DET_ELEVATION_368:0, DET_ELEVATION_ERR_365:0, DET_ELEVATION_ERR_366:0, DET_ELEVATION_ERR_367:0, DET_ELEVATION_ERR_368:0, DET_EXISTENCE_PROB_365:0, DET_EXISTENCE_PROB_366:0, DET_EXISTENCE_PROB_367:0, DET_EXISTENCE_PROB_368:0, DET_HVC_FLAG_365:0, DET_HVC_FLAG_366:0, DET_HVC_FLAG_367:0, DET_HVC_FLAG_368:0, DET_IDM_365:0, DET_IDM_366:0, DET_IDM_367:0, DET_IDM_368:0, DET_MH_CRC16_365_368:0, DET_MH_CYCLE_COUNTER_365_368:0, DET_MH_SCAN_INDEX_4LSB_365_368:0, DET_MTD_365:0, DET_MTD_366:0, DET_MTD_367:0, DET_MTD_368:0, DET_PROB_1STAZHYPO_365:0, DET_PROB_1STAZHYPO_366:0, DET_PROB_1STAZHYPO_367:0, DET_PROB_1STAZHYPO_368:0, DET_RANGE_365:0, DET_RANGE_366:0, DET_RANGE_367:0, DET_RANGE_368:0, DET_RANGE_ERR_365:0, DET_RANGE_ERR_366:0, DET_RANGE_ERR_367:0, DET_RANGE_ERR_368:0, DET_RANGE_VELOCITY_365:16384, DET_RANGE_VELOCITY_366:16384, DET_RANGE_VELOCITY_367:16384, DET_RANGE_VELOCITY_368:16384, DET_RANGE_VELOCITY_ERR_365:0, DET_RANGE_VELOCITY_ERR_366:0, DET_RANGE_VELOCITY_ERR_367:0, DET_RANGE_VELOCITY_ERR_368:0, DET_RCS_365:128, DET_RCS_366:128, DET_RCS_367:128, DET_RCS_368:128, DET_SNR_365:0, DET_SNR_366:0, DET_SNR_367:0, DET_SNR_368:0, DET_SUPER_RES_TARGET_365:0, DET_SUPER_RES_TARGET_366:0, DET_SUPER_RES_TARGET_367:0, DET_SUPER_RES_TARGET_368:0]}, provided-interface=Pi_SG_Detections_365_368_AL
      Pp_SG_Detections_369_372_AL: nonqueued-sender-com-spec{data-element=Vdp_SG_Detections_369_372_AL, init-value=fields=[DET_AZIMUTH_369:0, DET_AZIMUTH_370:0, DET_AZIMUTH_371:0, DET_AZIMUTH_372:0, DET_AZIMUTH_ERR_369:0, DET_AZIMUTH_ERR_370:0, DET_AZIMUTH_ERR_371:0, DET_AZIMUTH_ERR_372:0, DET_BELOW_RAIN_THOLD_369:0, DET_BELOW_RAIN_THOLD_370:0, DET_BELOW_RAIN_THOLD_371:0, DET_BELOW_RAIN_THOLD_372:0, DET_BI_STATIC_FLAG_369:0, DET_BI_STATIC_FLAG_370:0, DET_BI_STATIC_FLAG_371:0, DET_BI_STATIC_FLAG_372:0, DET_CONFD_AZIMUTH_369:0, DET_CONFD_AZIMUTH_370:0, DET_CONFD_AZIMUTH_371:0, DET_CONFD_AZIMUTH_372:0, DET_CONFD_ELEVATION_369:0, DET_CONFD_ELEVATION_370:0, DET_CONFD_ELEVATION_371:0, DET_CONFD_ELEVATION_372:0, DET_ELEVATION_369:0, DET_ELEVATION_370:0, DET_ELEVATION_371:0, DET_ELEVATION_372:0, DET_ELEVATION_ERR_369:0, DET_ELEVATION_ERR_370:0, DET_ELEVATION_ERR_371:0, DET_ELEVATION_ERR_372:0, DET_EXISTENCE_PROB_369:0, DET_EXISTENCE_PROB_370:0, DET_EXISTENCE_PROB_371:0, DET_EXISTENCE_PROB_372:0, DET_HVC_FLAG_369:0, DET_HVC_FLAG_370:0, DET_HVC_FLAG_371:0, DET_HVC_FLAG_372:0, DET_IDM_369:0, DET_IDM_370:0, DET_IDM_371:0, DET_IDM_372:0, DET_MH_CRC16_369_372:0, DET_MH_CYCLE_COUNTER_369_372:0, DET_MH_SCAN_INDEX_4LSB_369_372:0, DET_MTD_369:0, DET_MTD_370:0, DET_MTD_371:0, DET_MTD_372:0, DET_PROB_1STAZHYPO_369:0, DET_PROB_1STAZHYPO_370:0, DET_PROB_1STAZHYPO_371:0, DET_PROB_1STAZHYPO_372:0, DET_RANGE_369:0, DET_RANGE_370:0, DET_RANGE_371:0, DET_RANGE_372:0, DET_RANGE_ERR_369:0, DET_RANGE_ERR_370:0, DET_RANGE_ERR_371:0, DET_RANGE_ERR_372:0, DET_RANGE_VELOCITY_369:16384, DET_RANGE_VELOCITY_370:16384, DET_RANGE_VELOCITY_371:16384, DET_RANGE_VELOCITY_372:16384, DET_RANGE_VELOCITY_ERR_369:0, DET_RANGE_VELOCITY_ERR_370:0, DET_RANGE_VELOCITY_ERR_371:0, DET_RANGE_VELOCITY_ERR_372:0, DET_RCS_369:128, DET_RCS_370:128, DET_RCS_371:128, DET_RCS_372:128, DET_SNR_369:0, DET_SNR_370:0, DET_SNR_371:0, DET_SNR_372:0, DET_SUPER_RES_TARGET_369:0, DET_SUPER_RES_TARGET_370:0, DET_SUPER_RES_TARGET_371:0, DET_SUPER_RES_TARGET_372:0]}, provided-interface=Pi_SG_Detections_369_372_AL
      Pp_SG_Detections_373_376_AL: nonqueued-sender-com-spec{data-element=Vdp_SG_Detections_373_376_AL, init-value=fields=[DET_AZIMUTH_373:0, DET_AZIMUTH_374:0, DET_AZIMUTH_375:0, DET_AZIMUTH_376:0, DET_AZIMUTH_ERR_373:0, DET_AZIMUTH_ERR_374:0, DET_AZIMUTH_ERR_375:0, DET_AZIMUTH_ERR_376:0, DET_BELOW_RAIN_THOLD_373:0, DET_BELOW_RAIN_THOLD_374:0, DET_BELOW_RAIN_THOLD_375:0, DET_BELOW_RAIN_THOLD_376:0, DET_BI_STATIC_FLAG_373:0, DET_BI_STATIC_FLAG_374:0, DET_BI_STATIC_FLAG_375:0, DET_BI_STATIC_FLAG_376:0, DET_CONFD_AZIMUTH_373:0, DET_CONFD_AZIMUTH_374:0, DET_CONFD_AZIMUTH_375:0, DET_CONFD_AZIMUTH_376:0, DET_CONFD_ELEVATION_373:0, DET_CONFD_ELEVATION_374:0, DET_CONFD_ELEVATION_375:0, DET_CONFD_ELEVATION_376:0, DET_ELEVATION_373:0, DET_ELEVATION_374:0, DET_ELEVATION_375:0, DET_ELEVATION_376:0, DET_ELEVATION_ERR_373:0, DET_ELEVATION_ERR_374:0, DET_ELEVATION_ERR_375:0, DET_ELEVATION_ERR_376:0, DET_EXISTENCE_PROB_373:0, DET_EXISTENCE_PROB_374:0, DET_EXISTENCE_PROB_375:0, DET_EXISTENCE_PROB_376:0, DET_HVC_FLAG_373:0, DET_HVC_FLAG_374:0, DET_HVC_FLAG_375:0, DET_HVC_FLAG_376:0, DET_IDM_373:0, DET_IDM_374:0, DET_IDM_375:0, DET_IDM_376:0, DET_MH_CRC16_373_376:0, DET_MH_CYCLE_COUNTER_373_376:0, DET_MH_SCAN_INDEX_4LSB_373_376:0, DET_MTD_373:0, DET_MTD_374:0, DET_MTD_375:0, DET_MTD_376:0, DET_PROB_1STAZHYPO_373:0, DET_PROB_1STAZHYPO_374:0, DET_PROB_1STAZHYPO_375:0, DET_PROB_1STAZHYPO_376:0, DET_RANGE_373:0, DET_RANGE_374:0, DET_RANGE_375:0, DET_RANGE_376:0, DET_RANGE_ERR_373:0, DET_RANGE_ERR_374:0, DET_RANGE_ERR_375:0, DET_RANGE_ERR_376:0, DET_RANGE_VELOCITY_373:16384, DET_RANGE_VELOCITY_374:16384, DET_RANGE_VELOCITY_375:16384, DET_RANGE_VELOCITY_376:16384, DET_RANGE_VELOCITY_ERR_373:0, DET_RANGE_VELOCITY_ERR_374:0, DET_RANGE_VELOCITY_ERR_375:0, DET_RANGE_VELOCITY_ERR_376:0, DET_RCS_373:128, DET_RCS_374:128, DET_RCS_375:128, DET_RCS_376:128, DET_SNR_373:0, DET_SNR_374:0, DET_SNR_375:0, DET_SNR_376:0, DET_SUPER_RES_TARGET_373:0, DET_SUPER_RES_TARGET_374:0, DET_SUPER_RES_TARGET_375:0, DET_SUPER_RES_TARGET_376:0]}, provided-interface=Pi_SG_Detections_373_376_AL
      Pp_SG_Detections_377_380_AL: nonqueued-sender-com-spec{data-element=Vdp_SG_Detections_377_380_AL, init-value=fields=[DET_AZIMUTH_377:0, DET_AZIMUTH_378:0, DET_AZIMUTH_379:0, DET_AZIMUTH_380:0, DET_AZIMUTH_ERR_377:0, DET_AZIMUTH_ERR_378:0, DET_AZIMUTH_ERR_379:0, DET_AZIMUTH_ERR_380:0, DET_BELOW_RAIN_THOLD_377:0, DET_BELOW_RAIN_THOLD_378:0, DET_BELOW_RAIN_THOLD_379:0, DET_BELOW_RAIN_THOLD_380:0, DET_BI_STATIC_FLAG_377:0, DET_BI_STATIC_FLAG_378:0, DET_BI_STATIC_FLAG_379:0, DET_BI_STATIC_FLAG_380:0, DET_CONFD_AZIMUTH_377:0, DET_CONFD_AZIMUTH_378:0, DET_CONFD_AZIMUTH_379:0, DET_CONFD_AZIMUTH_380:0, DET_CONFD_ELEVATION_377:0, DET_CONFD_ELEVATION_378:0, DET_CONFD_ELEVATION_379:0, DET_CONFD_ELEVATION_380:0, DET_ELEVATION_377:0, DET_ELEVATION_378:0, DET_ELEVATION_379:0, DET_ELEVATION_380:0, DET_ELEVATION_ERR_377:0, DET_ELEVATION_ERR_378:0, DET_ELEVATION_ERR_379:0, DET_ELEVATION_ERR_380:0, DET_EXISTENCE_PROB_377:0, DET_EXISTENCE_PROB_378:0, DET_EXISTENCE_PROB_379:0, DET_EXISTENCE_PROB_380:0, DET_HVC_FLAG_377:0, DET_HVC_FLAG_378:0, DET_HVC_FLAG_379:0, DET_HVC_FLAG_380:0, DET_IDM_377:0, DET_IDM_378:0, DET_IDM_379:0, DET_IDM_380:0, DET_MH_CRC16_377_380:0, DET_MH_CYCLE_COUNTER_377_380:0, DET_MH_SCAN_INDEX_4LSB_377_380:0, DET_MTD_377:0, DET_MTD_378:0, DET_MTD_379:0, DET_MTD_380:0, DET_PROB_1STAZHYPO_377:0, DET_PROB_1STAZHYPO_378:0, DET_PROB_1STAZHYPO_379:0, DET_PROB_1STAZHYPO_380:0, DET_RANGE_377:0, DET_RANGE_378:0, DET_RANGE_379:0, DET_RANGE_380:0, DET_RANGE_ERR_377:0, DET_RANGE_ERR_378:0, DET_RANGE_ERR_379:0, DET_RANGE_ERR_380:0, DET_RANGE_VELOCITY_377:16384, DET_RANGE_VELOCITY_378:16384, DET_RANGE_VELOCITY_379:16384, DET_RANGE_VELOCITY_380:16384, DET_RANGE_VELOCITY_ERR_377:0, DET_RANGE_VELOCITY_ERR_378:0, DET_RANGE_VELOCITY_ERR_379:0, DET_RANGE_VELOCITY_ERR_380:0, DET_RCS_377:128, DET_RCS_378:128, DET_RCS_379:128, DET_RCS_380:128, DET_SNR_377:0, DET_SNR_378:0, DET_SNR_379:0, DET_SNR_380:0, DET_SUPER_RES_TARGET_377:0, DET_SUPER_RES_TARGET_378:0, DET_SUPER_RES_TARGET_379:0, DET_SUPER_RES_TARGET_380:0]}, provided-interface=Pi_SG_Detections_377_380_AL
      Pp_SG_Detections_381_384_AL: nonqueued-sender-com-spec{data-element=Vdp_SG_Detections_381_384_AL, init-value=fields=[DET_AZIMUTH_381:0, DET_AZIMUTH_382:0, DET_AZIMUTH_383:0, DET_AZIMUTH_384:0, DET_AZIMUTH_ERR_381:0, DET_AZIMUTH_ERR_382:0, DET_AZIMUTH_ERR_383:0, DET_AZIMUTH_ERR_384:0, DET_BELOW_RAIN_THOLD_381:0, DET_BELOW_RAIN_THOLD_382:0, DET_BELOW_RAIN_THOLD_383:0, DET_BELOW_RAIN_THOLD_384:0, DET_BI_STATIC_FLAG_381:0, DET_BI_STATIC_FLAG_382:0, DET_BI_STATIC_FLAG_383:0, DET_BI_STATIC_FLAG_384:0, DET_CONFD_AZIMUTH_381:0, DET_CONFD_AZIMUTH_382:0, DET_CONFD_AZIMUTH_383:0, DET_CONFD_AZIMUTH_384:0, DET_CONFD_ELEVATION_381:0, DET_CONFD_ELEVATION_382:0, DET_CONFD_ELEVATION_383:0, DET_CONFD_ELEVATION_384:0, DET_ELEVATION_381:0, DET_ELEVATION_382:0, DET_ELEVATION_383:0, DET_ELEVATION_384:0, DET_ELEVATION_ERR_381:0, DET_ELEVATION_ERR_382:0, DET_ELEVATION_ERR_383:0, DET_ELEVATION_ERR_384:0, DET_EXISTENCE_PROB_381:0, DET_EXISTENCE_PROB_382:0, DET_EXISTENCE_PROB_383:0, DET_EXISTENCE_PROB_384:0, DET_HVC_FLAG_381:0, DET_HVC_FLAG_382:0, DET_HVC_FLAG_383:0, DET_HVC_FLAG_384:0, DET_IDM_381:0, DET_IDM_382:0, DET_IDM_383:0, DET_IDM_384:0, DET_MH_CRC16_381_384:0, DET_MH_CYCLE_COUNTER_381_384:0, DET_MH_SCAN_INDEX_4LSB_381_384:0, DET_MTD_381:0, DET_MTD_382:0, DET_MTD_383:0, DET_MTD_384:0, DET_PROB_1STAZHYPO_381:0, DET_PROB_1STAZHYPO_382:0, DET_PROB_1STAZHYPO_383:0, DET_PROB_1STAZHYPO_384:0, DET_RANGE_381:0, DET_RANGE_382:0, DET_RANGE_383:0, DET_RANGE_384:0, DET_RANGE_ERR_381:0, DET_RANGE_ERR_382:0, DET_RANGE_ERR_383:0, DET_RANGE_ERR_384:0, DET_RANGE_VELOCITY_381:16384, DET_RANGE_VELOCITY_382:16384, DET_RANGE_VELOCITY_383:16384, DET_RANGE_VELOCITY_384:16384, DET_RANGE_VELOCITY_ERR_381:0, DET_RANGE_VELOCITY_ERR_382:0, DET_RANGE_VELOCITY_ERR_383:0, DET_RANGE_VELOCITY_ERR_384:0, DET_RCS_381:128, DET_RCS_382:128, DET_RCS_383:128, DET_RCS_384:128, DET_SNR_381:0, DET_SNR_382:0, DET_SNR_383:0, DET_SNR_384:0, DET_SUPER_RES_TARGET_381:0, DET_SUPER_RES_TARGET_382:0, DET_SUPER_RES_TARGET_383:0, DET_SUPER_RES_TARGET_384:0]}, provided-interface=Pi_SG_Detections_381_384_AL
      Pp_SG_Detections_385_388_AL: nonqueued-sender-com-spec{data-element=Vdp_SG_Detections_385_388_AL, init-value=fields=[DET_AZIMUTH_385:0, DET_AZIMUTH_386:0, DET_AZIMUTH_387:0, DET_AZIMUTH_388:0, DET_AZIMUTH_ERR_385:0, DET_AZIMUTH_ERR_386:0, DET_AZIMUTH_ERR_387:0, DET_AZIMUTH_ERR_388:0, DET_BELOW_RAIN_THOLD_385:0, DET_BELOW_RAIN_THOLD_386:0, DET_BELOW_RAIN_THOLD_387:0, DET_BELOW_RAIN_THOLD_388:0, DET_BI_STATIC_FLAG_385:0, DET_BI_STATIC_FLAG_386:0, DET_BI_STATIC_FLAG_387:0, DET_BI_STATIC_FLAG_388:0, DET_CONFD_AZIMUTH_385:0, DET_CONFD_AZIMUTH_386:0, DET_CONFD_AZIMUTH_387:0, DET_CONFD_AZIMUTH_388:0, DET_CONFD_ELEVATION_385:0, DET_CONFD_ELEVATION_386:0, DET_CONFD_ELEVATION_387:0, DET_CONFD_ELEVATION_388:0, DET_ELEVATION_385:0, DET_ELEVATION_386:0, DET_ELEVATION_387:0, DET_ELEVATION_388:0, DET_ELEVATION_ERR_385:0, DET_ELEVATION_ERR_386:0, DET_ELEVATION_ERR_387:0, DET_ELEVATION_ERR_388:0, DET_EXISTENCE_PROB_385:0, DET_EXISTENCE_PROB_386:0, DET_EXISTENCE_PROB_387:0, DET_EXISTENCE_PROB_388:0, DET_HVC_FLAG_385:0, DET_HVC_FLAG_386:0, DET_HVC_FLAG_387:0, DET_HVC_FLAG_388:0, DET_IDM_385:0, DET_IDM_386:0, DET_IDM_387:0, DET_IDM_388:0, DET_MH_CRC16_385_388:0, DET_MH_CYCLE_COUNTER_385_388:0, DET_MH_SCAN_INDEX_4LSB_385_388:0, DET_MTD_385:0, DET_MTD_386:0, DET_MTD_387:0, DET_MTD_388:0, DET_PROB_1STAZHYPO_385:0, DET_PROB_1STAZHYPO_386:0, DET_PROB_1STAZHYPO_387:0, DET_PROB_1STAZHYPO_388:0, DET_RANGE_385:0, DET_RANGE_386:0, DET_RANGE_387:0, DET_RANGE_388:0, DET_RANGE_ERR_385:0, DET_RANGE_ERR_386:0, DET_RANGE_ERR_387:0, DET_RANGE_ERR_388:0, DET_RANGE_VELOCITY_385:16384, DET_RANGE_VELOCITY_386:16384, DET_RANGE_VELOCITY_387:16384, DET_RANGE_VELOCITY_388:16384, DET_RANGE_VELOCITY_ERR_385:0, DET_RANGE_VELOCITY_ERR_386:0, DET_RANGE_VELOCITY_ERR_387:0, DET_RANGE_VELOCITY_ERR_388:0, DET_RCS_385:128, DET_RCS_386:128, DET_RCS_387:128, DET_RCS_388:128, DET_SNR_385:0, DET_SNR_386:0, DET_SNR_387:0, DET_SNR_388:0, DET_SUPER_RES_TARGET_385:0, DET_SUPER_RES_TARGET_386:0, DET_SUPER_RES_TARGET_387:0, DET_SUPER_RES_TARGET_388:0]}, provided-interface=Pi_SG_Detections_385_388_AL
      Pp_SG_Detections_389_392_AL: nonqueued-sender-com-spec{data-element=Vdp_SG_Detections_389_392_AL, init-value=fields=[DET_AZIMUTH_389:0, DET_AZIMUTH_390:0, DET_AZIMUTH_391:0, DET_AZIMUTH_392:0, DET_AZIMUTH_ERR_389:0, DET_AZIMUTH_ERR_390:0, DET_AZIMUTH_ERR_391:0, DET_AZIMUTH_ERR_392:0, DET_BELOW_RAIN_THOLD_389:0, DET_BELOW_RAIN_THOLD_390:0, DET_BELOW_RAIN_THOLD_391:0, DET_BELOW_RAIN_THOLD_392:0, DET_BI_STATIC_FLAG_389:0, DET_BI_STATIC_FLAG_390:0, DET_BI_STATIC_FLAG_391:0, DET_BI_STATIC_FLAG_392:0, DET_CONFD_AZIMUTH_389:0, DET_CONFD_AZIMUTH_390:0, DET_CONFD_AZIMUTH_391:0, DET_CONFD_AZIMUTH_392:0, DET_CONFD_ELEVATION_389:0, DET_CONFD_ELEVATION_390:0, DET_CONFD_ELEVATION_391:0, DET_CONFD_ELEVATION_392:0, DET_ELEVATION_389:0, DET_ELEVATION_390:0, DET_ELEVATION_391:0, DET_ELEVATION_392:0, DET_ELEVATION_ERR_389:0, DET_ELEVATION_ERR_390:0, DET_ELEVATION_ERR_391:0, DET_ELEVATION_ERR_392:0, DET_EXISTENCE_PROB_389:0, DET_EXISTENCE_PROB_390:0, DET_EXISTENCE_PROB_391:0, DET_EXISTENCE_PROB_392:0, DET_HVC_FLAG_389:0, DET_HVC_FLAG_390:0, DET_HVC_FLAG_391:0, DET_HVC_FLAG_392:0, DET_IDM_389:0, DET_IDM_390:0, DET_IDM_391:0, DET_IDM_392:0, DET_MH_CRC16_389_392:0, DET_MH_CYCLE_COUNTER_389_392:0, DET_MH_SCAN_INDEX_4LSB_389_392:0, DET_MTD_389:0, DET_MTD_390:0, DET_MTD_391:0, DET_MTD_392:0, DET_PROB_1STAZHYPO_389:0, DET_PROB_1STAZHYPO_390:0, DET_PROB_1STAZHYPO_391:0, DET_PROB_1STAZHYPO_392:0, DET_RANGE_389:0, DET_RANGE_390:0, DET_RANGE_391:0, DET_RANGE_392:0, DET_RANGE_ERR_389:0, DET_RANGE_ERR_390:0, DET_RANGE_ERR_391:0, DET_RANGE_ERR_392:0, DET_RANGE_VELOCITY_389:16384, DET_RANGE_VELOCITY_390:16384, DET_RANGE_VELOCITY_391:16384, DET_RANGE_VELOCITY_392:16384, DET_RANGE_VELOCITY_ERR_389:0, DET_RANGE_VELOCITY_ERR_390:0, DET_RANGE_VELOCITY_ERR_391:0, DET_RANGE_VELOCITY_ERR_392:0, DET_RCS_389:128, DET_RCS_390:128, DET_RCS_391:128, DET_RCS_392:128, DET_SNR_389:0, DET_SNR_390:0, DET_SNR_391:0, DET_SNR_392:0, DET_SUPER_RES_TARGET_389:0, DET_SUPER_RES_TARGET_390:0, DET_SUPER_RES_TARGET_391:0, DET_SUPER_RES_TARGET_392:0]}, provided-interface=Pi_SG_Detections_389_392_AL
      Pp_SG_Detections_393_396_AL: nonqueued-sender-com-spec{data-element=Vdp_SG_Detections_393_396_AL, init-value=fields=[DET_AZIMUTH_393:0, DET_AZIMUTH_394:0, DET_AZIMUTH_395:0, DET_AZIMUTH_396:0, DET_AZIMUTH_ERR_393:0, DET_AZIMUTH_ERR_394:0, DET_AZIMUTH_ERR_395:0, DET_AZIMUTH_ERR_396:0, DET_BELOW_RAIN_THOLD_393:0, DET_BELOW_RAIN_THOLD_394:0, DET_BELOW_RAIN_THOLD_395:0, DET_BELOW_RAIN_THOLD_396:0, DET_BI_STATIC_FLAG_393:0, DET_BI_STATIC_FLAG_394:0, DET_BI_STATIC_FLAG_395:0, DET_BI_STATIC_FLAG_396:0, DET_CONFD_AZIMUTH_393:0, DET_CONFD_AZIMUTH_394:0, DET_CONFD_AZIMUTH_395:0, DET_CONFD_AZIMUTH_396:0, DET_CONFD_ELEVATION_393:0, DET_CONFD_ELEVATION_394:0, DET_CONFD_ELEVATION_395:0, DET_CONFD_ELEVATION_396:0, DET_ELEVATION_393:0, DET_ELEVATION_394:0, DET_ELEVATION_395:0, DET_ELEVATION_396:0, DET_ELEVATION_ERR_393:0, DET_ELEVATION_ERR_394:0, DET_ELEVATION_ERR_395:0, DET_ELEVATION_ERR_396:0, DET_EXISTENCE_PROB_393:0, DET_EXISTENCE_PROB_394:0, DET_EXISTENCE_PROB_395:0, DET_EXISTENCE_PROB_396:0, DET_HVC_FLAG_393:0, DET_HVC_FLAG_394:0, DET_HVC_FLAG_395:0, DET_HVC_FLAG_396:0, DET_IDM_393:0, DET_IDM_394:0, DET_IDM_395:0, DET_IDM_396:0, DET_MH_CRC16_393_396:0, DET_MH_CYCLE_COUNTER_393_396:0, DET_MH_SCAN_INDEX_4LSB_393_396:0, DET_MTD_393:0, DET_MTD_394:0, DET_MTD_395:0, DET_MTD_396:0, DET_PROB_1STAZHYPO_393:0, DET_PROB_1STAZHYPO_394:0, DET_PROB_1STAZHYPO_395:0, DET_PROB_1STAZHYPO_396:0, DET_RANGE_393:0, DET_RANGE_394:0, DET_RANGE_395:0, DET_RANGE_396:0, DET_RANGE_ERR_393:0, DET_RANGE_ERR_394:0, DET_RANGE_ERR_395:0, DET_RANGE_ERR_396:0, DET_RANGE_VELOCITY_393:16384, DET_RANGE_VELOCITY_394:16384, DET_RANGE_VELOCITY_395:16384, DET_RANGE_VELOCITY_396:16384, DET_RANGE_VELOCITY_ERR_393:0, DET_RANGE_VELOCITY_ERR_394:0, DET_RANGE_VELOCITY_ERR_395:0, DET_RANGE_VELOCITY_ERR_396:0, DET_RCS_393:128, DET_RCS_394:128, DET_RCS_395:128, DET_RCS_396:128, DET_SNR_393:0, DET_SNR_394:0, DET_SNR_395:0, DET_SNR_396:0, DET_SUPER_RES_TARGET_393:0, DET_SUPER_RES_TARGET_394:0, DET_SUPER_RES_TARGET_395:0, DET_SUPER_RES_TARGET_396:0]}, provided-interface=Pi_SG_Detections_393_396_AL
