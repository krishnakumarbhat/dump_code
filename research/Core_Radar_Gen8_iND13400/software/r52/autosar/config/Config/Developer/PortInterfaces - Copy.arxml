AUTOSAR XML (schema 00050)
package /MICROSAR/Dem_swc/Interfaces
  client server interface CallbackEventUdsStatusChanged: is-service=true, service-kind=DIAGNOSTIC-EVENT-MANAGER
    operation CallbackEventUdsStatusChanged
      arg EventStatusOld: type=Dem_UdsStatusByteType, direction=IN, server-argument-impl-policy=USE-ARGUMENT-TYPE
      arg EventStatusNew: type=Dem_UdsStatusByteType, direction=IN, server-argument-impl-policy=USE-ARGUMENT-TYPE
package /MICROSAR/NvM_swc/Interfaces
  client server interface NvMService_AC3_SRBS_Defs: is-service=true, service-kind=NON-VOLATILE-RAM-MANAGER
    7 x operation, all with possible-error=NvMService_AC3_SRBS_Defs/E_NOT_OK:
      EraseBlock
      GetErrorStatus
        arg ErrorStatus: type=NvM_RequestResultType, direction=OUT, server-argument-impl-policy=USE-ARGUMENT-TYPE
      InvalidateNvBlock
      ReadBlock
        arg DstPtr: type=dtRef_VOID, direction=IN, server-argument-impl-policy=USE-ARGUMENT-TYPE
      RestoreBlockDefaults
        arg DstPtr: type=dtRef_VOID, direction=IN, server-argument-impl-policy=USE-ARGUMENT-TYPE
      SetRamBlockStatus
        arg RamBlockStatus: type=boolean, direction=IN, server-argument-impl-policy=USE-ARGUMENT-TYPE
      WriteBlock
        arg SrcPtr: type=dtRef_const_VOID, direction=IN, server-argument-impl-policy=USE-ARGUMENT-TYPE
    error E_NOT_OK: error-code=1
package /MICROSAR/WdgM_swc/Interfaces
  client server interface WdgM_AliveSupervision: is-service=true, service-kind=WATCH-DOG-MANAGER
    operation CheckpointReached: possible-error=WdgM_AliveSupervision/E_NOT_OK  # Indicates to the Watchdog Manager that a Checkpoint within a Supervised Entity has been reached.
      arg CPID: type=WdgM_CheckpointIdType, direction=IN, server-argument-impl-policy=USE-ARGUMENT-TYPE  # Identifier of the checkpoint within a supervised entity that has been reached.
    error E_NOT_OK: error-code=1
  client server interface WdgM_General: is-service=true, service-kind=WATCH-DOG-MANAGER
    8 x operation, all with possible-error=WdgM_General/E_NOT_OK:
      ActivateSupervisionEntity  # Activates the supervision of the given supervised entity.
        arg SEID: type=WdgM_SupervisedEntityIdType, direction=IN, server-argument-impl-policy=USE-ARGUMENT-TYPE  # Identifier of the supervised entity whose supervision shall be enabled.
      DeactivateSupervisionEntity  # Deactivates the supervision of the given supervised entity.
        arg SEID: type=WdgM_SupervisedEntityIdType, direction=IN, server-argument-impl-policy=USE-ARGUMENT-TYPE  # Identifier of the supervised entity whose supervision shall be disenabled.
      GetFirstExpiredSEID  # Returns the id of that supervised entity which first reached the status WDGM_LOCAL_STATUS_EXPIRED.
        arg SEID: type=WdgM_SupervisedEntityIdType, direction=OUT, server-argument-impl-policy=USE-ARGUMENT-TYPE  # Pointer to a variable that stores the id of the supervised entity.
      GetGlobalStatus  # Returns the global supervision status of the Watchdog Manager.
        arg Status: type=WdgM_GlobalStatusType, direction=OUT, server-argument-impl-policy=USE-ARGUMENT-TYPE  # Global supervision status of the Watchdog Manager.
      GetLocalStatus  # Returns the supervision status of a supervised entity.
        arg SEID: type=WdgM_SupervisedEntityIdType, direction=IN, server-argument-impl-policy=USE-ARGUMENT-TYPE  # Identifier of the supervised entity whose supervision status shall be returned.
        arg Status: type=WdgM_LocalStatusType, direction=OUT, server-argument-impl-policy=USE-ARGUMENT-TYPE  # Supervision status of the given supervised entity.
      GetMode  # Returns the current mode of the Watchdog Manager.
        arg Mode: type=WdgM_ModeType, direction=OUT, server-argument-impl-policy=USE-ARGUMENT-TYPE  # Current mode of the Watchdog Manager.
      PerformReset  # Instructs the Watchdog Manager to cause a watchdog reset.
      SetMode  # Requests a new trigger mode
        arg Mode: type=WdgM_ModeType, direction=IN, server-argument-impl-policy=USE-ARGUMENT-TYPE  # Desired new trigger mode id.
        arg CallerID: type=uint16, direction=IN, server-argument-impl-policy=USE-ARGUMENT-TYPE  # Module ID of the calling module.
    error E_NOT_OK: error-code=1
package /MICROSAR/Dcm_swc
  mode declaration group DcmControlDtcSetting: category=EXPLICIT_ORDER, initial-mode=ENABLEDTCSETTING, on-transition-value=2
    mode ENABLEDTCSETTING: value=0
    mode DISABLEDTCSETTING: value=1
package /MICROSAR/Dcm_swc/Interfaces
  mode switch interface DcmControlDtcSetting: is-service=true, service-kind=DIAGNOSTIC-COMMUNICATION-MANAGER
    mode group DcmControlDtcSetting: type=DcmControlDtcSetting
package /Predefined_DEV/PortInterfaces
  43 x client server interface:
    NvMAdministration: is-service=true
      operation SetBlockProtection: possible-error=NvMAdministration/E_NOT_OK
        arg ProtectionEnabled: type=boolean, direction=IN, server-argument-impl-policy=USE-ARGUMENT-TYPE
      error E_NOT_OK: error-code=1
    NvMNotifyInitBlock: is-service=true
      operation InitBlock
    NvMNotifyJobFinished: is-service=true
      operation JobFinished
        arg ServiceId: type=NvM_ServiceIdType, direction=IN, server-argument-impl-policy=USE-ARGUMENT-TYPE
        arg JobResult: type=NvM_RequestResultType, direction=IN, server-argument-impl-policy=USE-ARGUMENT-TYPE
    NvMService: is-service=true
      operation GetErrorStatus: possible-error=NvMService/E_NOT_OK
        arg ErrorStatus: type=NvM_RequestResultType, direction=OUT, server-argument-impl-policy=USE-ARGUMENT-TYPE
      error E_NOT_OK: error-code=1
    NvMService_AC2: is-service=true
      operation GetErrorStatus: possible-error=NvMService_AC2/E_NOT_OK
        arg ErrorStatus: type=NvM_RequestResultType, direction=OUT, server-argument-impl-policy=USE-ARGUMENT-TYPE
      operation ReadBlock: possible-error=NvMService_AC2/E_NOT_OK
        arg DstPtr: type=dtRef_VOID, direction=IN, server-argument-impl-policy=USE-ARGUMENT-TYPE
      operation WriteBlock: possible-error=NvMService_AC2/E_NOT_OK
        arg SrcPtr: type=dtRef_const_VOID, direction=IN, server-argument-impl-policy=USE-ARGUMENT-TYPE
      error E_NOT_OK: error-code=1
    NvMService_AC2_Defs: is-service=true
      4 x operation, all with possible-error=NvMService_AC2_Defs/E_NOT_OK:
        GetErrorStatus
          arg ErrorStatus: type=NvM_RequestResultType, direction=OUT, server-argument-impl-policy=USE-ARGUMENT-TYPE
        ReadBlock
          arg DstPtr: type=dtRef_VOID, direction=IN, server-argument-impl-policy=USE-ARGUMENT-TYPE
        RestoreBlockDefaults
          arg DstPtr: type=dtRef_VOID, direction=IN, server-argument-impl-policy=USE-ARGUMENT-TYPE
        WriteBlock
          arg SrcPtr: type=dtRef_const_VOID, direction=IN, server-argument-impl-policy=USE-ARGUMENT-TYPE
      error E_NOT_OK: error-code=1
    NvMService_AC2_DS: is-service=true
      5 x operation, all with possible-error=NvMService_AC2_DS/E_NOT_OK:
        GetDataIndex
          arg DataIndex: type=uint8, direction=OUT, server-argument-impl-policy=USE-ARGUMENT-TYPE
        GetErrorStatus
          arg ErrorStatus: type=NvM_RequestResultType, direction=OUT, server-argument-impl-policy=USE-ARGUMENT-TYPE
        ReadBlock
          arg DstPtr: type=dtRef_VOID, direction=IN, server-argument-impl-policy=USE-ARGUMENT-TYPE
        SetDataIndex
          arg DataIndex: type=uint8, direction=IN, server-argument-impl-policy=USE-ARGUMENT-TYPE
        WriteBlock
          arg SrcPtr: type=dtRef_const_VOID, direction=IN, server-argument-impl-policy=USE-ARGUMENT-TYPE
      error E_NOT_OK: error-code=1
    NvMService_AC2_DS_Defs: is-service=true
      6 x operation, all with possible-error=NvMService_AC2_DS_Defs/E_NOT_OK:
        GetDataIndex
          arg DataIndex: type=uint8, direction=OUT, server-argument-impl-policy=USE-ARGUMENT-TYPE
        GetErrorStatus
          arg ErrorStatus: type=NvM_RequestResultType, direction=OUT, server-argument-impl-policy=USE-ARGUMENT-TYPE
        ReadBlock
          arg DstPtr: type=dtRef_VOID, direction=IN, server-argument-impl-policy=USE-ARGUMENT-TYPE
        RestoreBlockDefaults
          arg DstPtr: type=dtRef_VOID, direction=IN, server-argument-impl-policy=USE-ARGUMENT-TYPE
        SetDataIndex
          arg DataIndex: type=uint8, direction=IN, server-argument-impl-policy=USE-ARGUMENT-TYPE
        WriteBlock
          arg SrcPtr: type=dtRef_const_VOID, direction=IN, server-argument-impl-policy=USE-ARGUMENT-TYPE
      error E_NOT_OK: error-code=1
    NvMService_AC2_SRBS: is-service=true
      4 x operation, all with possible-error=NvMService_AC2_SRBS/E_NOT_OK:
        GetErrorStatus
          arg ErrorStatus: type=NvM_RequestResultType, direction=OUT, server-argument-impl-policy=USE-ARGUMENT-TYPE
        ReadBlock
          arg DstPtr: type=dtRef_VOID, direction=IN, server-argument-impl-policy=USE-ARGUMENT-TYPE
        SetRamBlockStatus
          arg RamBlockStatus: type=boolean, direction=IN, server-argument-impl-policy=USE-ARGUMENT-TYPE
        WriteBlock
          arg SrcPtr: type=dtRef_const_VOID, direction=IN, server-argument-impl-policy=USE-ARGUMENT-TYPE
      error E_NOT_OK: error-code=1
    NvMService_AC2_SRBS_Defs: is-service=true
      5 x operation, all with possible-error=NvMService_AC2_SRBS_Defs/E_NOT_OK:
        GetErrorStatus
          arg ErrorStatus: type=NvM_RequestResultType, direction=OUT, server-argument-impl-policy=USE-ARGUMENT-TYPE
        ReadBlock
          arg DstPtr: type=dtRef_VOID, direction=IN, server-argument-impl-policy=USE-ARGUMENT-TYPE
        RestoreBlockDefaults
          arg DstPtr: type=dtRef_VOID, direction=IN, server-argument-impl-policy=USE-ARGUMENT-TYPE
        SetRamBlockStatus
          arg RamBlockStatus: type=boolean, direction=IN, server-argument-impl-policy=USE-ARGUMENT-TYPE
        WriteBlock
          arg SrcPtr: type=dtRef_const_VOID, direction=IN, server-argument-impl-policy=USE-ARGUMENT-TYPE
      error E_NOT_OK: error-code=1
    NvMService_AC2_SRBS_DS: is-service=true
      6 x operation, all with possible-error=NvMService_AC2_SRBS_DS/E_NOT_OK:
        GetDataIndex
          arg DataIndex: type=uint8, direction=OUT, server-argument-impl-policy=USE-ARGUMENT-TYPE
        GetErrorStatus
          arg ErrorStatus: type=NvM_RequestResultType, direction=OUT, server-argument-impl-policy=USE-ARGUMENT-TYPE
        ReadBlock
          arg DstPtr: type=dtRef_VOID, direction=IN, server-argument-impl-policy=USE-ARGUMENT-TYPE
        SetDataIndex
          arg DataIndex: type=uint8, direction=IN, server-argument-impl-policy=USE-ARGUMENT-TYPE
        SetRamBlockStatus
          arg RamBlockStatus: type=boolean, direction=IN, server-argument-impl-policy=USE-ARGUMENT-TYPE
        WriteBlock
          arg SrcPtr: type=dtRef_const_VOID, direction=IN, server-argument-impl-policy=USE-ARGUMENT-TYPE
      error E_NOT_OK: error-code=1
    NvMService_AC2_SRBS_DS_Defs: is-service=true
      7 x operation, all with possible-error=NvMService_AC2_SRBS_DS_Defs/E_NOT_OK:
        GetDataIndex
          arg DataIndex: type=uint8, direction=OUT, server-argument-impl-policy=USE-ARGUMENT-TYPE
        GetErrorStatus
          arg ErrorStatus: type=NvM_RequestResultType, direction=OUT, server-argument-impl-policy=USE-ARGUMENT-TYPE
        ReadBlock
          arg DstPtr: type=dtRef_VOID, direction=IN, server-argument-impl-policy=USE-ARGUMENT-TYPE
        RestoreBlockDefaults
          arg DstPtr: type=dtRef_VOID, direction=IN, server-argument-impl-policy=USE-ARGUMENT-TYPE
        SetDataIndex
          arg DataIndex: type=uint8, direction=IN, server-argument-impl-policy=USE-ARGUMENT-TYPE
        SetRamBlockStatus
          arg RamBlockStatus: type=boolean, direction=IN, server-argument-impl-policy=USE-ARGUMENT-TYPE
        WriteBlock
          arg SrcPtr: type=dtRef_const_VOID, direction=IN, server-argument-impl-policy=USE-ARGUMENT-TYPE
      error E_NOT_OK: error-code=1
    NvMService_AC3: is-service=true
      5 x operation, all with possible-error=NvMService_AC3/E_NOT_OK:
        EraseBlock
        GetErrorStatus
          arg ErrorStatus: type=NvM_RequestResultType, direction=OUT, server-argument-impl-policy=USE-ARGUMENT-TYPE
        InvalidateNvBlock
        ReadBlock
          arg DstPtr: type=dtRef_VOID, direction=IN, server-argument-impl-policy=USE-ARGUMENT-TYPE
        WriteBlock
          arg SrcPtr: type=dtRef_const_VOID, direction=IN, server-argument-impl-policy=USE-ARGUMENT-TYPE
      error E_NOT_OK: error-code=1
    NvMService_AC3_Defs: is-service=true
      6 x operation, all with possible-error=NvMService_AC3_Defs/E_NOT_OK:
        EraseBlock
        GetErrorStatus
          arg ErrorStatus: type=NvM_RequestResultType, direction=OUT, server-argument-impl-policy=USE-ARGUMENT-TYPE
        InvalidateNvBlock
        ReadBlock
          arg DstPtr: type=dtRef_VOID, direction=IN, server-argument-impl-policy=USE-ARGUMENT-TYPE
        RestoreBlockDefaults
          arg DstPtr: type=dtRef_VOID, direction=IN, server-argument-impl-policy=USE-ARGUMENT-TYPE
        WriteBlock
          arg SrcPtr: type=dtRef_const_VOID, direction=IN, server-argument-impl-policy=USE-ARGUMENT-TYPE
      error E_NOT_OK: error-code=1
    NvMService_AC3_DS: is-service=true
      7 x operation, all with possible-error=NvMService_AC3_DS/E_NOT_OK:
        EraseBlock
        GetDataIndex
          arg DataIndex: type=uint8, direction=OUT, server-argument-impl-policy=USE-ARGUMENT-TYPE
        GetErrorStatus
          arg ErrorStatus: type=NvM_RequestResultType, direction=OUT, server-argument-impl-policy=USE-ARGUMENT-TYPE
        InvalidateNvBlock
        ReadBlock
          arg DstPtr: type=dtRef_VOID, direction=IN, server-argument-impl-policy=USE-ARGUMENT-TYPE
        SetDataIndex
          arg DataIndex: type=uint8, direction=IN, server-argument-impl-policy=USE-ARGUMENT-TYPE
        WriteBlock
          arg SrcPtr: type=dtRef_const_VOID, direction=IN, server-argument-impl-policy=USE-ARGUMENT-TYPE
      error E_NOT_OK: error-code=1
    NvMService_AC3_DS_Defs: is-service=true
      8 x operation, all with possible-error=NvMService_AC3_DS_Defs/E_NOT_OK:
        EraseBlock
        GetDataIndex
          arg DataIndex: type=uint8, direction=OUT, server-argument-impl-policy=USE-ARGUMENT-TYPE
        GetErrorStatus
          arg ErrorStatus: type=NvM_RequestResultType, direction=OUT, server-argument-impl-policy=USE-ARGUMENT-TYPE
        InvalidateNvBlock
        ReadBlock
          arg DstPtr: type=dtRef_VOID, direction=IN, server-argument-impl-policy=USE-ARGUMENT-TYPE
        RestoreBlockDefaults
          arg DstPtr: type=dtRef_VOID, direction=IN, server-argument-impl-policy=USE-ARGUMENT-TYPE
        SetDataIndex
          arg DataIndex: type=uint8, direction=IN, server-argument-impl-policy=USE-ARGUMENT-TYPE
        WriteBlock
          arg SrcPtr: type=dtRef_const_VOID, direction=IN, server-argument-impl-policy=USE-ARGUMENT-TYPE
      error E_NOT_OK: error-code=1
    NvMService_AC3_SRBS: is-service=true
      6 x operation, all with possible-error=NvMService_AC3_SRBS/E_NOT_OK:
        EraseBlock
        GetErrorStatus
          arg ErrorStatus: type=NvM_RequestResultType, direction=OUT, server-argument-impl-policy=USE-ARGUMENT-TYPE
        InvalidateNvBlock
        ReadBlock
          arg DstPtr: type=dtRef_VOID, direction=IN, server-argument-impl-policy=USE-ARGUMENT-TYPE
        SetRamBlockStatus
          arg RamBlockStatus: type=boolean, direction=IN, server-argument-impl-policy=USE-ARGUMENT-TYPE
        WriteBlock
          arg SrcPtr: type=dtRef_const_VOID, direction=IN, server-argument-impl-policy=USE-ARGUMENT-TYPE
      error E_NOT_OK: error-code=1
    NvMService_AC3_SRBS_Defs: is-service=true
      7 x operation, all with possible-error=NvMService_AC3_SRBS_Defs/E_NOT_OK:
        EraseBlock
        GetErrorStatus
          arg ErrorStatus: type=NvM_RequestResultType, direction=OUT, server-argument-impl-policy=USE-ARGUMENT-TYPE
        InvalidateNvBlock
        ReadBlock
          arg DstPtr: type=dtRef_VOID, direction=IN, server-argument-impl-policy=USE-ARGUMENT-TYPE
        RestoreBlockDefaults
          arg DstPtr: type=dtRef_VOID, direction=IN, server-argument-impl-policy=USE-ARGUMENT-TYPE
        SetRamBlockStatus
          arg RamBlockStatus: type=boolean, direction=IN, server-argument-impl-policy=USE-ARGUMENT-TYPE
        WriteBlock
          arg SrcPtr: type=dtRef_const_VOID, direction=IN, server-argument-impl-policy=USE-ARGUMENT-TYPE
      error E_NOT_OK: error-code=1
    NvMService_AC3_SRBS_DS: is-service=true
      8 x operation, all with possible-error=NvMService_AC3_SRBS_DS/E_NOT_OK:
        EraseBlock
        GetDataIndex
          arg DataIndex: type=uint8, direction=OUT, server-argument-impl-policy=USE-ARGUMENT-TYPE
        GetErrorStatus
          arg ErrorStatus: type=NvM_RequestResultType, direction=OUT, server-argument-impl-policy=USE-ARGUMENT-TYPE
        InvalidateNvBlock
        ReadBlock
          arg DstPtr: type=dtRef_VOID, direction=IN, server-argument-impl-policy=USE-ARGUMENT-TYPE
        SetDataIndex
          arg DataIndex: type=uint8, direction=IN, server-argument-impl-policy=USE-ARGUMENT-TYPE
        SetRamBlockStatus
          arg RamBlockStatus: type=boolean, direction=IN, server-argument-impl-policy=USE-ARGUMENT-TYPE
        WriteBlock
          arg SrcPtr: type=dtRef_const_VOID, direction=IN, server-argument-impl-policy=USE-ARGUMENT-TYPE
      error E_NOT_OK: error-code=1
    NvMService_AC3_SRBS_DS_Defs: is-service=true
      9 x operation, all with possible-error=NvMService_AC3_SRBS_DS_Defs/E_NOT_OK:
        EraseBlock
        GetDataIndex
          arg DataIndex: type=uint8, direction=OUT, server-argument-impl-policy=USE-ARGUMENT-TYPE
        GetErrorStatus
          arg ErrorStatus: type=NvM_RequestResultType, direction=OUT, server-argument-impl-policy=USE-ARGUMENT-TYPE
        InvalidateNvBlock
        ReadBlock
          arg DstPtr: type=dtRef_VOID, direction=IN, server-argument-impl-policy=USE-ARGUMENT-TYPE
        RestoreBlockDefaults
          arg DstPtr: type=dtRef_VOID, direction=IN, server-argument-impl-policy=USE-ARGUMENT-TYPE
        SetDataIndex
          arg DataIndex: type=uint8, direction=IN, server-argument-impl-policy=USE-ARGUMENT-TYPE
        SetRamBlockStatus
          arg RamBlockStatus: type=boolean, direction=IN, server-argument-impl-policy=USE-ARGUMENT-TYPE
        WriteBlock
          arg SrcPtr: type=dtRef_const_VOID, direction=IN, server-argument-impl-policy=USE-ARGUMENT-TYPE
      error E_NOT_OK: error-code=1
    NvMService_SRBS: is-service=true
      operation GetErrorStatus: possible-error=NvMService_SRBS/E_NOT_OK
        arg ErrorStatus: type=NvM_RequestResultType, direction=OUT, server-argument-impl-policy=USE-ARGUMENT-TYPE
      operation SetRamBlockStatus: possible-error=NvMService_SRBS/E_NOT_OK
        arg RamBlockStatus: type=boolean, direction=IN, server-argument-impl-policy=USE-ARGUMENT-TYPE
      error E_NOT_OK: error-code=1
    CallbackDTCStatusChange: is-service=true, service-kind=DIAGNOSTIC-EVENT-MANAGER
      operation DTCStatusChanged: possible-error=CallbackDTCStatusChange/E_NOT_OK
        arg DTC: type=uint32, direction=IN, server-argument-impl-policy=USE-ARGUMENT-TYPE
        arg DTCStatusOld: type=Dem_UdsStatusByteType, direction=IN, server-argument-impl-policy=USE-ARGUMENT-TYPE
        arg DTCStatusNew: type=Dem_UdsStatusByteType, direction=IN, server-argument-impl-policy=USE-ARGUMENT-TYPE
      error E_NOT_OK: error-code=1
    NvSWC_NvMAdministration
      operation SetBlockProtection: possible-error=NvSWC_NvMAdministration/E_NOT_OK
        arg ProtectionEnabled: type=boolean, direction=IN, server-argument-impl-policy=USE-ARGUMENT-TYPE
      error E_NOT_OK: error-code=1
    NvSWC_NvMNotifyInitBlock
      operation InitBlock
    NvSWC_NvMNotifyJobFinished
      operation JobFinished
        arg ServiceId: type=NvM_ServiceIdType, direction=IN, server-argument-impl-policy=USE-ARGUMENT-TYPE
        arg JobResult: type=NvM_RequestResultType, direction=IN, server-argument-impl-policy=USE-ARGUMENT-TYPE
    NvSWC_NvMService
      operation GetErrorStatus: possible-error=NvSWC_NvMService/E_NOT_OK
        arg ErrorStatus: type=NvM_RequestResultType, direction=OUT, server-argument-impl-policy=USE-ARGUMENT-TYPE
      error E_NOT_OK: error-code=1
    NvSWC_NvMService_AC2
      operation GetErrorStatus: possible-error=NvSWC_NvMService_AC2/E_NOT_OK
        arg ErrorStatus: type=NvM_RequestResultType, direction=OUT, server-argument-impl-policy=USE-ARGUMENT-TYPE
      operation ReadBlock: possible-error=NvSWC_NvMService_AC2/E_NOT_OK
        arg DstPtr: type=dtRef_VOID, direction=IN, server-argument-impl-policy=USE-ARGUMENT-TYPE
      operation WriteBlock: possible-error=NvSWC_NvMService_AC2/E_NOT_OK
        arg SrcPtr: type=dtRef_const_VOID, direction=IN, server-argument-impl-policy=USE-ARGUMENT-TYPE
      error E_NOT_OK: error-code=1
    NvSWC_NvMService_AC2_Defs
      4 x operation, all with possible-error=NvSWC_NvMService_AC2_Defs/E_NOT_OK:
        GetErrorStatus
          arg ErrorStatus: type=NvM_RequestResultType, direction=OUT, server-argument-impl-policy=USE-ARGUMENT-TYPE
        ReadBlock
          arg DstPtr: type=dtRef_VOID, direction=IN, server-argument-impl-policy=USE-ARGUMENT-TYPE
        RestoreBlockDefaults
          arg DstPtr: type=dtRef_VOID, direction=IN, server-argument-impl-policy=USE-ARGUMENT-TYPE
        WriteBlock
          arg SrcPtr: type=dtRef_const_VOID, direction=IN, server-argument-impl-policy=USE-ARGUMENT-TYPE
      error E_NOT_OK: error-code=1
    NvSWC_NvMService_AC2_DS
      5 x operation, all with possible-error=NvSWC_NvMService_AC2_DS/E_NOT_OK:
        GetDataIndex
          arg DataIndex: type=uint8, direction=OUT, server-argument-impl-policy=USE-ARGUMENT-TYPE
        GetErrorStatus
          arg ErrorStatus: type=NvM_RequestResultType, direction=OUT, server-argument-impl-policy=USE-ARGUMENT-TYPE
        ReadBlock
          arg DstPtr: type=dtRef_VOID, direction=IN, server-argument-impl-policy=USE-ARGUMENT-TYPE
        SetDataIndex
          arg DataIndex: type=uint8, direction=IN, server-argument-impl-policy=USE-ARGUMENT-TYPE
        WriteBlock
          arg SrcPtr: type=dtRef_const_VOID, direction=IN, server-argument-impl-policy=USE-ARGUMENT-TYPE
      error E_NOT_OK: error-code=1
    NvSWC_NvMService_AC2_DS_Defs
      6 x operation, all with possible-error=NvSWC_NvMService_AC2_DS_Defs/E_NOT_OK:
        GetDataIndex
          arg DataIndex: type=uint8, direction=OUT, server-argument-impl-policy=USE-ARGUMENT-TYPE
        GetErrorStatus
          arg ErrorStatus: type=NvM_RequestResultType, direction=OUT, server-argument-impl-policy=USE-ARGUMENT-TYPE
        ReadBlock
          arg DstPtr: type=dtRef_VOID, direction=IN, server-argument-impl-policy=USE-ARGUMENT-TYPE
        RestoreBlockDefaults
          arg DstPtr: type=dtRef_VOID, direction=IN, server-argument-impl-policy=USE-ARGUMENT-TYPE
        SetDataIndex
          arg DataIndex: type=uint8, direction=IN, server-argument-impl-policy=USE-ARGUMENT-TYPE
        WriteBlock
          arg SrcPtr: type=dtRef_const_VOID, direction=IN, server-argument-impl-policy=USE-ARGUMENT-TYPE
      error E_NOT_OK: error-code=1
    NvSWC_NvMService_AC2_SRBS
      4 x operation, all with possible-error=NvSWC_NvMService_AC2_SRBS/E_NOT_OK:
        GetErrorStatus
          arg ErrorStatus: type=NvM_RequestResultType, direction=OUT, server-argument-impl-policy=USE-ARGUMENT-TYPE
        ReadBlock
          arg DstPtr: type=dtRef_VOID, direction=IN, server-argument-impl-policy=USE-ARGUMENT-TYPE
        SetRamBlockStatus
          arg RamBlockStatus: type=boolean, direction=IN, server-argument-impl-policy=USE-ARGUMENT-TYPE
        WriteBlock
          arg SrcPtr: type=dtRef_const_VOID, direction=IN, server-argument-impl-policy=USE-ARGUMENT-TYPE
      error E_NOT_OK: error-code=1
    NvSWC_NvMService_AC2_SRBS_Defs
      5 x operation, all with possible-error=NvSWC_NvMService_AC2_SRBS_Defs/E_NOT_OK:
        GetErrorStatus
          arg ErrorStatus: type=NvM_RequestResultType, direction=OUT, server-argument-impl-policy=USE-ARGUMENT-TYPE
        ReadBlock
          arg DstPtr: type=dtRef_VOID, direction=IN, server-argument-impl-policy=USE-ARGUMENT-TYPE
        RestoreBlockDefaults
          arg DstPtr: type=dtRef_VOID, direction=IN, server-argument-impl-policy=USE-ARGUMENT-TYPE
        SetRamBlockStatus
          arg RamBlockStatus: type=boolean, direction=IN, server-argument-impl-policy=USE-ARGUMENT-TYPE
        WriteBlock
          arg SrcPtr: type=dtRef_const_VOID, direction=IN, server-argument-impl-policy=USE-ARGUMENT-TYPE
      error E_NOT_OK: error-code=1
    NvSWC_NvMService_AC2_SRBS_DS
      6 x operation, all with possible-error=NvSWC_NvMService_AC2_SRBS_DS/E_NOT_OK:
        GetDataIndex
          arg DataIndex: type=uint8, direction=OUT, server-argument-impl-policy=USE-ARGUMENT-TYPE
        GetErrorStatus
          arg ErrorStatus: type=NvM_RequestResultType, direction=OUT, server-argument-impl-policy=USE-ARGUMENT-TYPE
        ReadBlock
          arg DstPtr: type=dtRef_VOID, direction=IN, server-argument-impl-policy=USE-ARGUMENT-TYPE
        SetDataIndex
          arg DataIndex: type=uint8, direction=IN, server-argument-impl-policy=USE-ARGUMENT-TYPE
        SetRamBlockStatus
          arg RamBlockStatus: type=boolean, direction=IN, server-argument-impl-policy=USE-ARGUMENT-TYPE
        WriteBlock
          arg SrcPtr: type=dtRef_const_VOID, direction=IN, server-argument-impl-policy=USE-ARGUMENT-TYPE
      error E_NOT_OK: error-code=1
    NvSWC_NvMService_AC2_SRBS_DS_Defs
      7 x operation, all with possible-error=NvSWC_NvMService_AC2_SRBS_DS_Defs/E_NOT_OK:
        GetDataIndex
          arg DataIndex: type=uint8, direction=OUT, server-argument-impl-policy=USE-ARGUMENT-TYPE
        GetErrorStatus
          arg ErrorStatus: type=NvM_RequestResultType, direction=OUT, server-argument-impl-policy=USE-ARGUMENT-TYPE
        ReadBlock
          arg DstPtr: type=dtRef_VOID, direction=IN, server-argument-impl-policy=USE-ARGUMENT-TYPE
        RestoreBlockDefaults
          arg DstPtr: type=dtRef_VOID, direction=IN, server-argument-impl-policy=USE-ARGUMENT-TYPE
        SetDataIndex
          arg DataIndex: type=uint8, direction=IN, server-argument-impl-policy=USE-ARGUMENT-TYPE
        SetRamBlockStatus
          arg RamBlockStatus: type=boolean, direction=IN, server-argument-impl-policy=USE-ARGUMENT-TYPE
        WriteBlock
          arg SrcPtr: type=dtRef_const_VOID, direction=IN, server-argument-impl-policy=USE-ARGUMENT-TYPE
      error E_NOT_OK: error-code=1
    NvSWC_NvMService_AC3
      5 x operation, all with possible-error=NvSWC_NvMService_AC3/E_NOT_OK:
        EraseBlock
        GetErrorStatus
          arg ErrorStatus: type=NvM_RequestResultType, direction=OUT, server-argument-impl-policy=USE-ARGUMENT-TYPE
        InvalidateNvBlock
        ReadBlock
          arg DstPtr: type=dtRef_VOID, direction=IN, server-argument-impl-policy=USE-ARGUMENT-TYPE
        WriteBlock
          arg SrcPtr: type=dtRef_const_VOID, direction=IN, server-argument-impl-policy=USE-ARGUMENT-TYPE
      error E_NOT_OK: error-code=1
    NvSWC_NvMService_AC3_Defs
      6 x operation, all with possible-error=NvSWC_NvMService_AC3_Defs/E_NOT_OK:
        EraseBlock
        GetErrorStatus
          arg ErrorStatus: type=NvM_RequestResultType, direction=OUT, server-argument-impl-policy=USE-ARGUMENT-TYPE
        InvalidateNvBlock
        ReadBlock
          arg DstPtr: type=dtRef_VOID, direction=IN, server-argument-impl-policy=USE-ARGUMENT-TYPE
        RestoreBlockDefaults
          arg DstPtr: type=dtRef_VOID, direction=IN, server-argument-impl-policy=USE-ARGUMENT-TYPE
        WriteBlock
          arg SrcPtr: type=dtRef_const_VOID, direction=IN, server-argument-impl-policy=USE-ARGUMENT-TYPE
      error E_NOT_OK: error-code=1
    NvSWC_NvMService_AC3_DS
      7 x operation, all with possible-error=NvSWC_NvMService_AC3_DS/E_NOT_OK:
        EraseBlock
        GetDataIndex
          arg DataIndex: type=uint8, direction=OUT, server-argument-impl-policy=USE-ARGUMENT-TYPE
        GetErrorStatus
          arg ErrorStatus: type=NvM_RequestResultType, direction=OUT, server-argument-impl-policy=USE-ARGUMENT-TYPE
        InvalidateNvBlock
        ReadBlock
          arg DstPtr: type=dtRef_VOID, direction=IN, server-argument-impl-policy=USE-ARGUMENT-TYPE
        SetDataIndex
          arg DataIndex: type=uint8, direction=IN, server-argument-impl-policy=USE-ARGUMENT-TYPE
        WriteBlock
          arg SrcPtr: type=dtRef_const_VOID, direction=IN, server-argument-impl-policy=USE-ARGUMENT-TYPE
      error E_NOT_OK: error-code=1
    NvSWC_NvMService_AC3_DS_Defs
      8 x operation, all with possible-error=NvSWC_NvMService_AC3_DS_Defs/E_NOT_OK:
        EraseBlock
        GetDataIndex
          arg DataIndex: type=uint8, direction=OUT, server-argument-impl-policy=USE-ARGUMENT-TYPE
        GetErrorStatus
          arg ErrorStatus: type=NvM_RequestResultType, direction=OUT, server-argument-impl-policy=USE-ARGUMENT-TYPE
        InvalidateNvBlock
        ReadBlock
          arg DstPtr: type=dtRef_VOID, direction=IN, server-argument-impl-policy=USE-ARGUMENT-TYPE
        RestoreBlockDefaults
          arg DstPtr: type=dtRef_VOID, direction=IN, server-argument-impl-policy=USE-ARGUMENT-TYPE
        SetDataIndex
          arg DataIndex: type=uint8, direction=IN, server-argument-impl-policy=USE-ARGUMENT-TYPE
        WriteBlock
          arg SrcPtr: type=dtRef_const_VOID, direction=IN, server-argument-impl-policy=USE-ARGUMENT-TYPE
      error E_NOT_OK: error-code=1
    NvSWC_NvMService_AC3_SRBS
      6 x operation, all with possible-error=NvSWC_NvMService_AC3_SRBS/E_NOT_OK:
        EraseBlock
        GetErrorStatus
          arg ErrorStatus: type=NvM_RequestResultType, direction=OUT, server-argument-impl-policy=USE-ARGUMENT-TYPE
        InvalidateNvBlock
        ReadBlock
          arg DstPtr: type=dtRef_VOID, direction=IN, server-argument-impl-policy=USE-ARGUMENT-TYPE
        SetRamBlockStatus
          arg RamBlockStatus: type=boolean, direction=IN, server-argument-impl-policy=USE-ARGUMENT-TYPE
        WriteBlock
          arg SrcPtr: type=dtRef_const_VOID, direction=IN, server-argument-impl-policy=USE-ARGUMENT-TYPE
      error E_NOT_OK: error-code=1
    NvSWC_NvMService_AC3_SRBS_Defs
      7 x operation, all with possible-error=NvSWC_NvMService_AC3_SRBS_Defs/E_NOT_OK:
        EraseBlock
        GetErrorStatus
          arg ErrorStatus: type=NvM_RequestResultType, direction=OUT, server-argument-impl-policy=USE-ARGUMENT-TYPE
        InvalidateNvBlock
        ReadBlock
          arg DstPtr: type=dtRef_VOID, direction=IN, server-argument-impl-policy=USE-ARGUMENT-TYPE
        RestoreBlockDefaults
          arg DstPtr: type=dtRef_VOID, direction=IN, server-argument-impl-policy=USE-ARGUMENT-TYPE
        SetRamBlockStatus
          arg RamBlockStatus: type=boolean, direction=IN, server-argument-impl-policy=USE-ARGUMENT-TYPE
        WriteBlock
          arg SrcPtr: type=dtRef_const_VOID, direction=IN, server-argument-impl-policy=USE-ARGUMENT-TYPE
      error E_NOT_OK: error-code=1
    NvSWC_NvMService_AC3_SRBS_DS
      8 x operation, all with possible-error=NvSWC_NvMService_AC3_SRBS_DS/E_NOT_OK:
        EraseBlock
        GetDataIndex
          arg DataIndex: type=uint8, direction=OUT, server-argument-impl-policy=USE-ARGUMENT-TYPE
        GetErrorStatus
          arg ErrorStatus: type=NvM_RequestResultType, direction=OUT, server-argument-impl-policy=USE-ARGUMENT-TYPE
        InvalidateNvBlock
        ReadBlock
          arg DstPtr: type=dtRef_VOID, direction=IN, server-argument-impl-policy=USE-ARGUMENT-TYPE
        SetDataIndex
          arg DataIndex: type=uint8, direction=IN, server-argument-impl-policy=USE-ARGUMENT-TYPE
        SetRamBlockStatus
          arg RamBlockStatus: type=boolean, direction=IN, server-argument-impl-policy=USE-ARGUMENT-TYPE
        WriteBlock
          arg SrcPtr: type=dtRef_const_VOID, direction=IN, server-argument-impl-policy=USE-ARGUMENT-TYPE
      error E_NOT_OK: error-code=1
    NvSWC_NvMService_AC3_SRBS_DS_Defs
      9 x operation, all with possible-error=NvSWC_NvMService_AC3_SRBS_DS_Defs/E_NOT_OK:
        EraseBlock
        GetDataIndex
          arg DataIndex: type=uint8, direction=OUT, server-argument-impl-policy=USE-ARGUMENT-TYPE
        GetErrorStatus
          arg ErrorStatus: type=NvM_RequestResultType, direction=OUT, server-argument-impl-policy=USE-ARGUMENT-TYPE
        InvalidateNvBlock
        ReadBlock
          arg DstPtr: type=dtRef_VOID, direction=IN, server-argument-impl-policy=USE-ARGUMENT-TYPE
        RestoreBlockDefaults
          arg DstPtr: type=dtRef_VOID, direction=IN, server-argument-impl-policy=USE-ARGUMENT-TYPE
        SetDataIndex
          arg DataIndex: type=uint8, direction=IN, server-argument-impl-policy=USE-ARGUMENT-TYPE
        SetRamBlockStatus
          arg RamBlockStatus: type=boolean, direction=IN, server-argument-impl-policy=USE-ARGUMENT-TYPE
        WriteBlock
          arg SrcPtr: type=dtRef_const_VOID, direction=IN, server-argument-impl-policy=USE-ARGUMENT-TYPE
      error E_NOT_OK: error-code=1
    NvSWC_NvMService_SRBS
      operation GetErrorStatus: possible-error=NvSWC_NvMService_SRBS/E_NOT_OK
        arg ErrorStatus: type=NvM_RequestResultType, direction=OUT, server-argument-impl-policy=USE-ARGUMENT-TYPE
      operation SetRamBlockStatus: possible-error=NvSWC_NvMService_SRBS/E_NOT_OK
        arg RamBlockStatus: type=boolean, direction=IN, server-argument-impl-policy=USE-ARGUMENT-TYPE
      error E_NOT_OK: error-code=1
package /ModeDclrGroups
  mode declaration group DcmSessionPrecondition_Mode: category=EXPLICIT_ORDER, initial-mode=PowerON, on-transition-value=14
    14 x mode:
      HI_V1: value=3
      HI_V1_TONORM: value=11
      HI_V2: value=5
      HI_V2_TONORM: value=12
      HI_VTEMP_TONORM: value=10
      HI_Vtemp: value=13
      LO_V1: value=2
      LO_V1_TONORM: value=8
      LO_V2: value=4
      LO_V2_TONORM: value=9
      LO_VTEMP_TONORM: value=7
      LO_Vtemp: value=6
      NORMV: value=1
      PowerON: value=0
package /PortInterfaces
  94 x sender receiver interface:
    Pi_Diag_Req_Func
      data Diag_Req_Func: type=Diag_Req_Func
    Pi_TSYN_OVS
      data TSYN_OVS: type=TSYN_OVS
    Pi_SSTS_MH_VS_CRC16
      data SSTS_MH_VS_CRC16: type=SSTS_MH_VS_CRC16_impdt
    Pi_TSYN_PDU
      data TSYN_PDU: type=TSYN_PDU
    Pi_TSYN_RESERVED
      data TSYN_RESERVED: type=TSYN_RESERVED
    Pi_SSTS_MH_VS_CYCLE_COUNTER
      data SSTS_MH_VS_CYCLE_COUNTER: type=SSTS_MH_VS_CYCLE_COUNTER_impdt
    Pi_TSYN_SYNCTIME_NANOSEC
      data TSYN_SYNCTIME_NANOSEC: type=TSYN_SYNCTIME_NANOSEC
    Pi_TSYN_SYNCTIME_SEC
      data TSYN_SYNCTIME_SEC: type=TSYN_SYNCTIME_SEC
    Pi_TSYN_TIMEDOMAIN
      data TSYN_TIMEDOMAIN: type=TSYN_TIMEDOMAIN
    Pi_TSYN_USERBYTE
      data TSYN_USERBYTE: type=TSYN_USERBYTE
    Pi_TSYNC_CRC
      data TSYNC_CRC: type=TSYNC_CRC
    Pi_STC_MH_001_CRC16
      data STC_MH_001_CRC16: type=STC_MH_001_CRC16_impdt
    Pi_TSYN_SGW
      data TSYN_SGW: type=TSYN_SGW
    Pi_TSYN_SEQUENCE_COUNTER
      data TSYN_SEQUENCE_COUNTER: type=TSYN_SEQUENCE_COUNTER
    Pi_STC_MH_001_CYCLE_COUNTER
      data STC_MH_001_CYCLE_COUNTER: type=STC_MH_001_CYCLE_COUNTER_impdt
    Pi_STC_MIPI1_ERR_COUNTER
      data STC_MIPI1_ERR_COUNTER: type=STC_MIPI1_ERR_COUNTER_impdt
    Pi_STC_MIPI0_ERR_COUNTER
      data STC_MIPI0_ERR_COUNTER: type=STC_MIPI0_ERR_COUNTER_impdt
    Pi_STC_MMIC0_DRIVER_ERR_COUNTER
      data STC_MMIC0_DRIVER_ERR_COUNTER: type=STC_MMIC0_DRIVER_ERR_COUNTER_impdt
    Pi_STC_MMIC0_DRIVER_ERR_FLAG1
      data STC_MMIC0_DRIVER_ERR_FLAG1: type=STC_MMIC0_DRIVER_ERR_FLAG1_impdt
    Pi_STC_MMIC_SELECT
      data STC_MMIC_SELECT: type=STC_MMIC_SELECT_impdt
    Pi_STC_MMIC0_DRIVER_ERR_FLAG2
      data STC_MMIC0_DRIVER_ERR_FLAG2: type=STC_MMIC0_DRIVER_ERR_FLAG2_impdt
    Pi_STC_MMIC0_ISM_MODULE_ERR_REG
      data STC_MMIC0_ISM_MODULE_ERR_REG: type=STC_MMIC0_ISM_MODULE_ERR_REG_impdt
    Pi_STC_MMIC0_ERR_CODE
      data STC_MMIC0_ERR_CODE: type=STC_MMIC0_ERR_CODE_impdt
    Pi_STC_MMIC0_T_K_UNUSED_7
      data STC_MMIC0_T_K_UNUSED_7: type=STC_MMIC0_T_K_UNUSED_7_impdt
    Pi_STC_MMIC1_DRIVER_ERR_COUNTER
      data STC_MMIC1_DRIVER_ERR_COUNTER: type=STC_MMIC1_DRIVER_ERR_COUNTER_impdt
    Pi_STC_MMIC0_ISM_WARN_COUNTER
      data STC_MMIC0_ISM_WARN_COUNTER: type=STC_MMIC0_ISM_WARN_COUNTER_impdt
    Pi_STC_MMIC0_ISM_ERR_COUNTER
      data STC_MMIC0_ISM_ERR_COUNTER: type=STC_MMIC0_ISM_ERR_COUNTER_impdt
    Pi_STC_MMIC1_DRIVER_ERR_FLAG1
      data STC_MMIC1_DRIVER_ERR_FLAG1: type=STC_MMIC1_DRIVER_ERR_FLAG1_impdt
    Pi_STC_MMIC1_DRIVER_ERR_FLAG2
      data STC_MMIC1_DRIVER_ERR_FLAG2: type=STC_MMIC1_DRIVER_ERR_FLAG2_impdt
    Pi_STC_MMIC1_ERR_CODE
      data STC_MMIC1_ERR_CODE: type=STC_MMIC1_ERR_CODE_impdt
    Pi_STC_MMIC1_ISM_ERR_COUNTER
      data STC_MMIC1_ISM_ERR_COUNTER: type=STC_MMIC1_ISM_ERR_COUNTER_impdt
    Pi_STC_MMIC0_ISM_ERR_STATUS_REG
      data STC_MMIC0_ISM_ERR_STATUS_REG: type=STC_MMIC0_ISM_ERR_STATUS_REG_impdt
    Pi_STC_MMIC0_ISM_WARN_REG
      data STC_MMIC0_ISM_WARN_REG: type=STC_MMIC0_ISM_WARN_REG_impdt
    Pi_STC_MMIC1_ISM_ERR_STATUS_REG
      data STC_MMIC1_ISM_ERR_STATUS_REG: type=STC_MMIC1_ISM_ERR_STATUS_REG_impdt
    Pi_STC_MMIC0_T_K_UNUSED_6
      data STC_MMIC0_T_K_UNUSED_6: type=STC_MMIC0_T_K_UNUSED_6_impdt
    Pi_STC_MMIC1_ISM_WARN_COUNTER
      data STC_MMIC1_ISM_WARN_COUNTER: type=STC_MMIC1_ISM_WARN_COUNTER_impdt
    Pi_STC_MMIC1_ISM_MODULE_ERR_REG
      data STC_MMIC1_ISM_MODULE_ERR_REG: type=STC_MMIC1_ISM_MODULE_ERR_REG_impdt
    Pi_STS_MH_002_CRC16
      data STS_MH_002_CRC16: type=STS_MH_002_CRC16_impdt
    Pi_STC_MMIC1_ISM_WARN_REG
      data STC_MMIC1_ISM_WARN_REG: type=STC_MMIC1_ISM_WARN_REG_impdt
    Pi_STS_MMIC_MAX_TEMP
      data STS_MMIC_MAX_TEMP: type=STS_MMIC_MAX_TEMP_impdt
    Pi_STS_MH_002_CYCLE_COUNTER
      data STS_MH_002_CYCLE_COUNTER: type=STS_MH_002_CYCLE_COUNTER_impdt
    Pi_STC_MMIC1_T_K_UNUSED_6
      data STC_MMIC1_T_K_UNUSED_6: type=STC_MMIC1_T_K_UNUSED_6_impdt
    Pi_STS_MMIC_SELECT
      data STS_MMIC_SELECT: type=STS_MMIC_SELECT_impdt
    Pi_STS_MH_003_CRC16
      data STS_MH_003_CRC16: type=STS_MH_003_CRC16_impdt
    Pi_STC_MMIC1_T_K_UNUSED_7
      data STC_MMIC1_T_K_UNUSED_7: type=STC_MMIC1_T_K_UNUSED_7_impdt
    Pi_STS_MMIC0_TEMP_CHIRP
      data STS_MMIC0_TEMP_CHIRP: type=STS_MMIC0_TEMP_CHIRP_impdt
    Pi_STS_MH_003_CYCLE_COUNTER
      data STS_MH_003_CYCLE_COUNTER: type=STS_MH_003_CYCLE_COUNTER_impdt
    Pi_STS_MMIC0_TEMP_TX1
      data STS_MMIC0_TEMP_TX1: type=STS_MMIC0_TEMP_TX1_impdt
    Pi_STS_MMIC0_TEMP_TX2
      data STS_MMIC0_TEMP_TX2: type=STS_MMIC0_TEMP_TX2_impdt
    Pi_STS_MMIC0_TEMP_TX3
      data STS_MMIC0_TEMP_TX3: type=STS_MMIC0_TEMP_TX3_impdt
    Pi_STS_MMIC1_TEMP_CHIRP
      data STS_MMIC1_TEMP_CHIRP: type=STS_MMIC1_TEMP_CHIRP_impdt
    Pi_STS_MMIC1_TEMP_TX1
      data STS_MMIC1_TEMP_TX1: type=STS_MMIC1_TEMP_TX1_impdt
    Pi_STS_PROCESSOR_Temp3
      data STS_PROCESSOR_Temp3: type=STS_PROCESSOR_Temp3_impdt
    Pi_STS_MMIC1_TEMP_TX2
      data STS_MMIC1_TEMP_TX2: type=STS_MMIC1_TEMP_TX2_impdt
    Pi_STS_MMIC1_TEMP_TX3
      data STS_MMIC1_TEMP_TX3: type=STS_MMIC1_TEMP_TX3_impdt
    Pi_STC_SCAN_INDEX
      data STC_SCAN_INDEX: type=STC_SCAN_INDEX_impdt
    Pi_STS_PROCESSOR_Temp1
      data STS_PROCESSOR_Temp1: type=STS_PROCESSOR_Temp1_impdt
    Pi_STS_BOARD_THERMISTOR
      data STS_BOARD_THERMISTOR: type=STS_BOARD_THERMISTOR_impdt
    Pi_STS_PROCESSOR_Temp2
      data STS_PROCESSOR_Temp2: type=STS_PROCESSOR_Temp2_impdt
    Pi_STS_MH_001_CRC16
      data STS_MH_001_CRC16: type=STS_MH_001_CRC16_impdt
    Pi_STS_MH_001_CYCLE_COUNTER
      data STS_MH_001_CYCLE_COUNTER: type=STS_MH_001_CYCLE_COUNTER_impdt
    Pi_Diag_Req_Phys
      data Diag_Req_Phys: type=Diag_Req_Phys
    Pi_Diag_Resp_Phys
      data Diag_Resp_Phys: type=Diag_Resp_Phys
    Pi_Customer_Domain_Faults
      data De_Customer_Domain_Faults: type=Dt_Customer_Domain_Errors
    Pi_Diag_D2H_ErrorFlags
      data De_D2H_ErrorFlags: type=Dt_D2H_ErrorFlags
    Pi_Diag_MMIC_ErrorFlags
      data De_MMIC_ErrorFlags: type=Dt_MMIC_ErrorFlags
    Pi_Platform_Battery_Tst
      data De_Platform_Battery_Tst: type=Dt_Battery_Tst_T
    Pi_PltToFltMgr_MMIC_B_Diag
      data De_PltToFltMgr_MMIC_B_Diag_T: type=Dt_PltToFltMgr_MMIC_B_Diag_T
    Pi_PltToFltMgr_Ftr_Fn_Calib_Flt_Sts
      data PltToFltMgr_Ftr_Fn_Calib_Flt_Sts: type=uint8
    Pi_PltToFltMgr_InterProcessor_Commn
      data De_PltToFltMgr_InterProcessor_Commn_T: type=Dt_PltToFltMgr_InterProcessor_Commn_T
    Pi_Radar_Blockage_Flt_Sts
      data De_Radar_Blockage_Flt_Sts: type=Dt_PltToFltMgr_Blockage_Detection_T
    Pi_PltToFltMgr_Host_Micro_Diag
      data De_PltToFltMgr_Host_Micro_Diag: type=Dt_PltToFltMgr_Host_Micro_Diag_T
    Pi_PlatformInitializationStatus
      data De_MCU_InitializationStatus: type=Dt_InitializationStatus
    Pi_RawAdc_Data
      data De_RawAdcData: type=Dt_RawAdcDataFilt_T
    Pi_PltToFltMgr_Memory_Diagnostics
      data De_PltToFltMgr_Memory_Diagnostics: type=Dt_PltToFltMgr_Memory_Diagnostics_T
    Pi_Diag_MMIC_B_ErrorFlags
      data De_MMIC_B_ErrorFlags: type=Dt_MMIC_B_ErrorFlags
    Pi_PltToFltMgr_Micro_Temp_Fault_Status
      data De_PltToFltMgr_Micro_Temp_Fault_Status: type=Dt_PltToFltMgr_Micro_Temp_Fault_Status_T
    Pi_TR_Platfromtime
      data De_TR_Platfromtime: type=uint8
    Pi_Watchdog_Fault_Reset
      data De_Watchdog_Fault_Reset: type=uint8
    Pi_PltToFltMgr_Can_Bus_Off_Fault_Status
      data De_PltToFltMgr_Can_Bus_Off_Fault_Status: type=uint8
    Pi_PltToFltMgr_Trkr_Calib_Chksm_Flt_Sts
      data PltToFltMgr_Trkr_Calib_Chksm_Flt_Sts: type=uint8
    Pi_Radar_Interference_Flt_Sts
      data De_Radar_Interference_Flt_Sts: type=uint8
    Pi_PltToFltMgr_Mirror_Ram_Int_Flt_Sts
      data PltToFltMgr_Mirror_Ram_Int_Flt_Sts: type=uint8
    Pi_Rdr_Hw_Tst
      data De_Rdr_Hw_Tst: type=Dt_Rdr_Hw_Tst_T
    Pi_PltToFltMgr_Can_Controller_Fault_Status
      data De_PltToFltMgr_Can_Controller_Fault_Status: type=uint8
    Pi_Trkr_Calib_Chksm_Flt_Sts
      data Trkr_Calib_Chksm_Flt_Sts: type=uint8
    Pi_PltToFltMgr_Vtg_Regulator
      data De_PltToFltMgr_Vtg_Regulator_T: type=Dt_PltToFltMgr_Vtg_Regulator_T
    Pi_TR_initMCU_Fail
      data De_TR_InitMCU_fail: type=uint8
    Pi_RadarCoreStatusInterface
      data De_RadarCoreStatus: type=Dt_RadarCoreStatus
    Pi_PltToFltMgr_MMIC_A_MMIC_Diag
      data De_PltToFltMgr_MMIC_A_MMIC_Diag_T: type=Dt_PltToFltMgr_MMIC_A_MMIC_Diag_T
    Pi_Vbatt_State
      data De_Vbatt_State: type=Dt_VBattState_T
    Pi_XCP_ADC_MCU_Temp_Override
      data De_XCP_ADC_MCU_Temp_Override: type=uint8
    Pi_ModeManagerNVM_Interface
      data ModeManager_NVM: type=uint8
    Pi_RawAdcDataUnfiltered
      data RawAdcDataUnfiltered: type=Dt_RawAdcData_T
  client server interface Pi_FailSafe_Log_ResetReason
    operation FailSafe_Log_ResetReason
      arg reset_reason: type=Dt_ECU_ResetReasonType, direction=IN, server-argument-impl-policy=USE-ARGUMENT-TYPE
  client server interface Pi_Update_Thermal_Mon_Temps: is-service=true
    operation Read: possible-error=Pi_Update_Thermal_Mon_Temps/E_NOT_OK
      arg therm_temp_results: type=DT_Thermal_mon_mes_results_T, direction=OUT, server-argument-impl-policy=USE-ARGUMENT-TYPE
    error E_NOT_OK: error-code=1
  sender receiver interface Pi_OpModeInterface
    data De_OpModeShutdown: type=Dt_OpModeShutdown
  sender receiver interface Pi_SubState
    data De_SubState: type=Dt_SubState_T
  client server interface Pi_Get_PlatfromTime_us
    operation read
      arg instant_ustime: type=uint64, direction=OUT, server-argument-impl-policy=USE-ARGUMENT-TYPE
  sender receiver interface Pi_Analog_Channel_Count
    data De_Analog_Channel_Count: type=uint16
  sender receiver interface Pi_RadarRadiateInterface
    data De_CommandRadiate_Final: type=uint8
  sender receiver interface Pi_ECUPos_Value
    data De_ECUPos_Value: data-constr=uint8_DataConstr, type=Dt_ECUPosition_Value
  client server interface Pi_ECU_Reset
    operation ECU_Soft_Reset
  client server interface Pi_PltToFltMgr
    operation PltToFltMgr_NvM_FeeCriticalError_Diagnostics
  4 x sender receiver interface:
    Pi_Repetitive_Reset_Status
      data De_Repetitive_Reset_Status: type=uint8
    Pi_IoHwAb_VRM_State
      data De_VBattState_T: type=Dt_VBattState_T
    Pi_XCP_ForceRadiateInterface
      data De_XCPForceRadiate: type=Dt_ForceRadiate
    Pi_CustDegradation
      data De_CustDegradation: type=Dt_CustDegradation
  client server interface Pi_ThermMonTemp
    operation Read: possible-error=Pi_ThermMonTemp/E_NOT_OK
      arg temp_option: type=Dt_Therm_Mon_Temp_Opt_T, direction=IN, server-argument-impl-policy=USE-ARGUMENT-TYPE
      arg reqValue: type=DT_Thermal_Monitor_Temperatures_T, direction=OUT, server-argument-impl-policy=USE-ARGUMENT-TYPE
    error E_NOT_OK: error-code=1
    error E_OK: error-code=0
  client server interface Pi_Radar_Ctl_Look_Trigger
    operation Operation
  sender receiver interface Pi_MCU_Sensor_Count
    data De_MCU_Sensor_Count: type=uint8
  sender receiver interface Pi_CustForceRadiateInterface
    data CustForceRadiate: type=Dt_ForceRadiate
  client server interface Pi_Get_STM_TimeStamp: is-service=true
    operation Get_STM_TimeStamp
      arg arg: type=uint32, direction=OUT, server-argument-impl-policy=USE-ARGUMENT-TYPE
  client server interface Pi_Get_FloatingPinPosition: is-service=true
    operation FaultStatus
      arg Status: type=uint8, direction=OUT, server-argument-impl-policy=USE-ARGUMENT-TYPE
  sender receiver interface Pi_ID_data
    data De_ID_data: type=Dt_ID_data
  client server interface Pi_Trigger_NvM_Erase
    operation Operation
  client server interface Pi_PWMDutyCycle
    operation PWMDutyCycle
      arg DutyCycle: type=uint8, direction=IN, server-argument-impl-policy=USE-ARGUMENT-TYPE
  sender receiver interface Pi_A2H_ErrorFlags
    data De_A2H_ErrorFlags: type=Dt_A2H_ErrorFlags
  client server interface Pi_Set_DIO_LED_SRC_PULL: is-service=true
    operation Write: possible-error=Pi_Set_DIO_LED_SRC_PULL/E_NOT_OK
      arg Data: type=uint8, direction=IN, server-argument-impl-policy=USE-ARGUMENT-TYPE
    error E_NOT_OK: error-code=1
  7 x sender receiver interface:
    Pi_IsRadiateForced
      data De_IsRadiateForced: type=uint8
    Pi_ActiveFaultTable
      data De_ActiveFaultTable: type=Dt_Fault_T
    Pi_ShutdownTask
      data De_shutdownTask: type=uint8
    Pi_Appl_Get_Radar_Position
      data De_ECUPosition: type=Dt_ECUPosition
    Pi_Alignment_NvM_Data
      data Alignment_NvM_Data: type=Dt_Write_Alignment_NvM_Data_T
    Pi_platform_Time
      data De_platform_time: type=uint8
    Pi_Codding_Position_Pins_error
      data Codding_Position_Pins_error: type=uint8
  client server interface Ecu_Shutdown_Request
    operation Ecu_Shutdown_Request: possible-error=Ecu_Shutdown_Request/E_NOT_OK
      arg ShutdownTarget: type=EcuM_StateType, direction=IN, server-argument-impl-policy=USE-ARGUMENT-TYPE
      arg ReqStatus: type=Dt_Appl_ShutdownReqStatus, direction=OUT, server-argument-impl-policy=USE-ARGUMENT-TYPE
    error E_NOT_OK: error-code=1
  client server interface Pi_Get_PlatformTime_ms
    operation read
      arg instant_mstime: type=uint32, direction=OUT, server-argument-impl-policy=USE-ARGUMENT-TYPE
  11 x sender receiver interface:
    Pi_D2H_ErrorFlags
      data De_D2H_ErrorFlags: type=Dt_D2H_ErrorFlags
    Pi_Align_Write_XCP_Nvm_Record
      data Alignment_Record: type=Dt_Write_Alignment_NvM_Data_T
    Pi_TR_PlatformTime
      data De_PlatformTime: type=uint8
    Pi_ECU_Config
      data Dt_ECU_Config: type=Dt_Dataset_ECU_Config_T
    Pi_Read_NvM_record
      data De_Write_Alignment_NvM_Data: type=Dt_Write_Alignment_NvM_Data_T
    Pi_CPU_Load
      data De_CPU_Load: type=Dt_CPU_Load
    Pi_EcuIncompleteConfig_Status
      data De_EcuIncompleteConfig_Status: type=uint8
    Pi_Customer_SW_Version_Info
      data De_Customer_SW_Version_Info: type=Dt_Customer_SW_Version
    Pi_FailSafe_ResetReason
      data De_FailSafe_ResetReason: type=Dt_FailSafe_ResetReason_T
    Pi_FaultTestCompleteTable
      data De_FaultTestCompleteTable: type=Dt_Fault_T
    Pi_NvM_flag_status
      data Pim_write_status: type=uint8
  client server interface Pi_NvHandler_Trigger_Write
    operation NvHandler_Trigger_Write_To_NVM
      arg u8_ImmidieteWrite: type=uint8, direction=IN, server-argument-impl-policy=USE-ARGUMENT-TYPE
      arg dt_Nv_Caller_Id: type=Dt_Nv_Caller_ID, direction=IN, server-argument-impl-policy=USE-ARGUMENT-TYPE
  sender receiver interface Pi_FCCU_HW_State
    data FCCU_HW_State: data-constr=uint8_DataConstr, type=uint8
  client server interface Pi_ExtWdg_Disable
    operation Operation
  client server interface Pi_Alignment_Fault_Injection
    operation read
      arg Injection_control: type=uint8, direction=IN, server-argument-impl-policy=USE-ARGUMENT-TYPE
  sender receiver interface Pi_Forced_WDI_Disable_Diag
    data Forced_WDI_Disable: type=uint8
  client server interface Pi_ExtWdg_Enable
    operation Operation
  4 x sender receiver interface:
    Pi_Alignment_faults
      data De_Alignment_Faults: type=Dt_Alignment_Faults_T
    Pi_Frame_TimeoutStatus_Group2
      data TimeoutStatus_Group2: type=Dt_SignalTimeoutStatus_Group2_T
    Pi_RadarCapability_Faults
      data De_RadarCapability_Faults: type=Dt_RadarCapability_Faults
    Pi_Alignment_Type
      data Alignment_Type: type=Dt_AlignmentModeIn_T
  client server interface Pi_Trigger_Clear_Faults_PLT
    operation Operation
  4 x sender receiver interface:
    Pi_Alignment_flt_sts
      data De_PltToFltMgr_Alignment_Faults: type=Dt_PltToFltMgr_Alignment_Faults_T
    Pi_Alignment_Write_NvM_Data
      data Write_Alignment_NvM: type=Dt_Write_Alignment_NvM_Data_T
    Pi_RadarDiagRequestInterface
      data De_RadarDiagRequest: type=Dt_RadarDiagRequest
    Pi_Auto_Alignment_Data
      data Auto_Alignment_Data: type=Dt_Auto_Alignment_Result_T
  client server interface PostRadarProcessing_Debug
    operation Populate_Debug_Stream: possible-error=[PostRadarProcessing_Debug/E_OK, PostRadarProcessing_Debug/E_NOT_OK, PostRadarProcessing_Debug/E_OK, PostRadarProcessing_Debug/E_NOT_OK]
    error E_OK: error-code=0
    error E_NOT_OK: error-code=1
  sender receiver interface Pi_XCP_Fault_Override
    data De_XCP_Fault_Override: type=Idt_XCP_Fault_Override_T
  sender receiver interface Pi_initial_Alignment_Perform_Result
    data initial_Alignment_Perform: type=Dt_Initial_Alignment_Performance_Result_T
  client server interface PostRadarProcessing_MMIC
    operation Populate_MMIC_Stream: possible-error=[PostRadarProcessing_MMIC/E_OK, PostRadarProcessing_MMIC/E_NOT_OK, PostRadarProcessing_MMIC/E_OK, PostRadarProcessing_MMIC/E_NOT_OK]
    error E_OK: error-code=0
    error E_NOT_OK: error-code=1
  sender receiver interface Pi_Initial_Alignment_Result
    data Initial_Alignment_Result: type=Dt_Initial_Alignment_Result_T
  sender receiver interface Pi_RMID_Status
    data RMID_Status: type=uint8
  client server interface PostRadarProcessing_Detection
    operation Populate_Detection_Stream: possible-error=[PostRadarProcessing_Detection/E_OK, PostRadarProcessing_Detection/E_NOT_OK, PostRadarProcessing_Detection/E_OK, PostRadarProcessing_Detection/E_NOT_OK]
    error E_OK: error-code=0
    error E_NOT_OK: error-code=1
  sender receiver interface Pi_IPC_SWC_AutoAlignment
    data De_AutoAlignment: type=Dt_Alignment_NVM_T
  sender receiver interface Pi_SignalTimeout_Status
    data De_Status: type=uint8
  client server interface PostRadarProcessing_Header
    operation Populate_Header_Stream: possible-error=[PostRadarProcessing_Header/E_OK, PostRadarProcessing_Header/E_NOT_OK, PostRadarProcessing_Header/E_OK, PostRadarProcessing_Header/E_NOT_OK]
    error E_OK: error-code=0
    error E_NOT_OK: error-code=1
  sender receiver interface Pi_Snapshot_ALIGNMENT_STATUS
    data De_Snapshot_ALIGNMENT_STATUS: type=Dt_ALIGNMENT_STATUS
  sender receiver interface Pi_XCP_Alignment_Flag
    data De_XCP_Alignment_Flag: type=uint8
  client server interface PostRadarProcessing_RDD
    operation Populate_RDD_Stream: possible-error=[PostRadarProcessing_RDD/E_OK, PostRadarProcessing_RDD/E_NOT_OK, PostRadarProcessing_RDD/E_OK, PostRadarProcessing_RDD/E_NOT_OK]
    error E_OK: error-code=0
    error E_NOT_OK: error-code=1
  sender receiver interface Pi_Snapshot_Received_signal
    data De_SnapshotReceivedSignal: type=Dt_Snapshot_received_signal_T
  client server interface PostRadarProcessing_Radar_Capability
    operation Populate_Radar_Capability_Stream: possible-error=[PostRadarProcessing_Radar_Capability/E_OK, PostRadarProcessing_Radar_Capability/E_NOT_OK, PostRadarProcessing_Radar_Capability/E_OK, PostRadarProcessing_Radar_Capability/E_NOT_OK]
    error E_OK: error-code=0
    error E_NOT_OK: error-code=1
  client server interface PostRadarProcessing_Status
    operation Populate_Status_Stream: possible-error=[PostRadarProcessing_Status/E_OK, PostRadarProcessing_Status/E_NOT_OK, PostRadarProcessing_Status/E_OK, PostRadarProcessing_Status/E_NOT_OK]
    error E_OK: error-code=0
    error E_NOT_OK: error-code=1
  4 x sender receiver interface:
    Pi_SPI_Failure_Failt
      data SPI_Failure_Fault: type=uint8
    Pi_Fault_name_For_FHTI_Testing
      data De_Fault_name_FHTI: type=Dt_Fault_name_FHTI
    Pi_Internal_Wdg_Fail_Status
      data Internal_Wdg_Fail_Status: type=uint8
    Pi_RADAR_SensorMisaligned
      data RADAR_SensorMisaligned: type=uint8
  client server interface Pi_FCCU_Fault_Injection
    operation Read
      arg Injection_control: type=uint8, direction=IN, server-argument-impl-policy=USE-ARGUMENT-TYPE
      arg Failure_Type: type=uint8, direction=IN, server-argument-impl-policy=USE-ARGUMENT-TYPE
  sender receiver interface Pi_Wdg_Fault_Injection_Request
    data De_Wdg_Fault_Injection_Request: type=uint8
  sender receiver interface Pi_RADAR_SensorNotAligned
    data RADAR_SensorNotAligned: type=uint8
  client server interface Pi_FailSafe_Fault_Injection
    operation Read
      arg Injection_control: type=uint8, direction=IN, server-argument-impl-policy=USE-ARGUMENT-TYPE
      arg Failure_Type: type=uint8, direction=IN, server-argument-impl-policy=USE-ARGUMENT-TYPE
  client server interface Pi_IPC_Fault_Injection
    operation Read
      arg Injection_control: type=uint8, direction=IN, server-argument-impl-policy=USE-ARGUMENT-TYPE
      arg Failure_Type: type=uint8, direction=IN, server-argument-impl-policy=USE-ARGUMENT-TYPE
  sender receiver interface Pi_ModeManagerTestResultInterface
    data De_TR_ModeManager: type=Dt_TR_ModeManager
  4 x client server interface:
    Pi_Wdg_Disable
      operation Read
        arg Wdg_Type: type=Dt_Wdg_Type, direction=IN, server-argument-impl-policy=USE-ARGUMENT-TYPE
    Pi_MCU_Safety_Fault_Injection
      operation Read
        arg Injection_control: type=uint8, direction=IN, server-argument-impl-policy=USE-ARGUMENT-TYPE
        arg Failure_Type: type=uint8, direction=IN, server-argument-impl-policy=USE-ARGUMENT-TYPE
    Pi_PlatformTime_Fault_Injection
      operation Read
        arg Injection_control: type=uint8, direction=IN, server-argument-impl-policy=USE-ARGUMENT-TYPE
        arg Failure_Type: type=uint8, direction=IN, server-argument-impl-policy=USE-ARGUMENT-TYPE
    Pi_Radar_control_Fault_Injection
      operation Read
        arg Injection_control: type=uint8, direction=IN, server-argument-impl-policy=USE-ARGUMENT-TYPE
        arg Failure_Type: type=uint8, direction=IN, server-argument-impl-policy=USE-ARGUMENT-TYPE
  sender receiver interface Pi_Board_Revision
    data De_Board_Revision: type=uint8
  client server interface Pi_plt_time_register_set
    operation fault_type
      arg fault_type: type=uint8, direction=IN, server-argument-impl-policy=USE-ARGUMENT-TYPE
  5 x sender receiver interface:
    Pi_BoardRevision_Xcp
      data De_BoardRevision_Xcp: type=uint8
    Pi_IPC_Faults
      data De_IPC_Faults: type=Dt_IPC_Faults
    Pi_Time_Stamp
      data De_StbM_TimeStampType: type=StbM_TimeStampType
    Pi_Dinamo_Enable_Flag
      data De_Dinamo_Enable_Flag: type=uint8
    Pi_EcuSync_Offset_ms
      data De_EcuSync_Offset_ms: type=float32
  client server interface Pi_Get_Platform_Elapsed_ustime
    operation read
      arg inst_us_time: type=uint32, direction=OUT, server-argument-impl-policy=USE-ARGUMENT-TYPE
      arg start_time: type=uint64, direction=IN, server-argument-impl-policy=USE-ARGUMENT-TYPE
  sender receiver interface Pi_Diag_A2H_ErrorFlags
    data De_A2H_ErrorFlags: type=Dt_A2H_ErrorFlags
  client server interface Pi_WdgHandler_Fault_Injection
    operation Read
      arg Injection_control: type=uint8, direction=IN, server-argument-impl-policy=USE-ARGUMENT-TYPE
      arg Failure_Type: type=uint8, direction=IN, server-argument-impl-policy=USE-ARGUMENT-TYPE
  14 x sender receiver interface:
    Pi_DTC_Status
      data De_DTC_Status: type=Dt_DTC_Status_Type
    Pi_ECU_TemperatureInterface
      data ECUTemperature: type=Dt_ECUTemperature
    Pi_exception_reset_flt
      data exception_reset_flt: type=uint8
    Pi_Ftr_Fn_Calib_Flt_Sts
      data Ftr_Fn_Calib_Flt_Sts: type=uint8
    Pi_Intigrity_Status_DataSet
      data Intigrity_Status_DataSet: type=uint8
    Pi_Intigrity_Status_T
      data Dt_Intigrity_Status_T: type=uint8
    Pi_ipc_arm_host
      data ipc_arm_host: type=uint8
    Pi_ipc_dsp_host
      data ipc_dsp_host: type=uint8
    Pi_MCU_Startup_Fault_Status
      data MCU_Startup_Fault_Status: type=Dt_Mcu_Startup_Fault
    Pi_MicroTemp_Low_Deb_Reset
      data De_MicroTemp_Low_Deb_Reset: type=uint8
    Pi_ADC_Measurement_interface
      data Element: type=TR_AdcMeasurement_T
    Pi_OperationModeType
      data De_OperationMode_System: type=Dt_SystemOperationMode
    Pi_PCAN_Bus_Off_Fault_Flag
      data De_PCAN_Busoff_Fault_Flag: type=boolean
    Pi_PhysicalAdcData
      data De_PhysicalAdcData: type=Dt_AdcData_T
  mode switch interface Pi_DcmSessionPrecondition_Mode: is-service=true
    mode group De_DcmSessionPrecondition_Mode: type=DcmSessionPrecondition_Mode
  sender receiver interface Pi_TimeLeft_To_NextState
    data De_TimeLeft_To_NextState: type=uint16
  client server interface Pi_RawAdcCount: is-service=true
    operation Read: possible-error=Pi_RawAdcCount/E_NOT_OK
      arg RawAdcData: type=Dt_RawAdcData_T, direction=OUT, server-argument-impl-policy=USE-ARGUMENT-TYPE
    error E_NOT_OK: error-code=1
  trigger interface Pi_Radar_Ctl_Look_Complete
    trigger Trigger
  sender receiver interface Pi_Time_Stamp_Delta
    data De_Time_Stamp_Delta: type=Dt_Time_Stamp_Delta
  sender receiver interface Pi_STS_No_TSyn_Error
    data De_STS_No_TSyn_Error: type=Dt_STS_No_TSyn_Error
  client server interface Pi_Trigger_Clear_Faults_Operation
    operation Operation
  client server interface Pi_XCP_JTAG_Lock_Completed_State
    operation GetStatus: possible-error=Pi_XCP_JTAG_Lock_Completed_State/E_NOT_OK
      arg JTAG_PWD_Info: type=Dt_Struct_XCP_JTAG_PWD_T, direction=IN, server-argument-impl-policy=USE-ARGUMENT-TYPE
      arg JTAG_Lock_Status: type=Idt_JTAG_PWD_ReturnStatus_Enum_T, direction=OUT, server-argument-impl-policy=USE-ARGUMENT-TYPE
    error E_NOT_OK: error-code=1
  client server interface Pi_XCP_JTAG_Password
    operation Read: possible-error=[CRYPTO_E_KEY_EMPTY, CRYPTO_E_KEY_NOT_AVAILABLE, CRYPTO_E_KEY_READ_FAIL, Pi_XCP_JTAG_Password/E_NOT_OK]
      arg JTAG_PWD_Info: type=Dt_Struct_XCP_JTAG_PWD_T, direction=OUT, server-argument-impl-policy=USE-ARGUMENT-TYPE
    operation Write: possible-error=[CRYPTO_E_KEY_NOT_VALID, CRYPTO_E_KEY_WRITE_FAIL, Pi_XCP_JTAG_Password/E_NOT_OK]
      arg JTAG_PWD_Info: type=Dt_Struct_XCP_JTAG_PWD_T, direction=IN, server-argument-impl-policy=USE-ARGUMENT-TYPE
    6 x error:
      CRYPTO_E_KEY_EMPTY: error-code=13
      CRYPTO_E_KEY_NOT_AVAILABLE: error-code=8
      CRYPTO_E_KEY_NOT_VALID: error-code=9
      CRYPTO_E_KEY_READ_FAIL: error-code=6
      CRYPTO_E_KEY_WRITE_FAIL: error-code=7
      E_NOT_OK: error-code=1
  sender receiver interface Pi_ActiveFaultLatchTable
    data De_ActiveFaultLatchTable: type=Dt_Fault_T
  sender receiver interface Pi_FaultEnableTable
    data De_FaultEnableTable: type=Dt_Fault_T
  sender receiver interface Pi_HistoryFaultTable
    data De_HistoryFaultTable: type=Dt_Fault_T
  client server interface Pi_PltFCCU_TestFlashMemECCPath
    operation FCCU_TestFlashMemECCPath
      arg FLS_MemTestResult: type=uint8, direction=OUT, server-argument-impl-policy=USE-ARGUMENT-TYPE
  client server interface Pi_PltRRUFS_SafetyReq
    6 x operation:
      ECC_CacheMemory_SafetyCore_Disable
        arg ECC_CacheMemory_Status: type=Dt_PltRRUFS_SafetyReq_Status_T, direction=OUT, server-argument-impl-policy=USE-ARGUMENT-TYPE
      ECC_CacheMemory_SafetyCore_Enable
        arg ECC_CacheMemory_Status: type=Dt_PltRRUFS_SafetyReq_Status_T, direction=OUT, server-argument-impl-policy=USE-ARGUMENT-TYPE
      ECC_CacheMemory_SafetyCore_Status
        arg ECC_CacheMemory_Status: type=Dt_PltRRUFS_SafetyReq_Status_T, direction=OUT, server-argument-impl-policy=USE-ARGUMENT-TYPE
      ECC_FlashMemory_Fault_Report_Check
        arg ECC_FlashMemory_Status: type=Dt_PltRRUFS_SafetyReq_Status_T, direction=OUT, server-argument-impl-policy=USE-ARGUMENT-TYPE
      RCCU_CheckerCore_Status
        arg CheckerCore_Status: type=Dt_PltRRUFS_SafetyReq_Status_T, direction=OUT, server-argument-impl-policy=USE-ARGUMENT-TYPE
      RRU_FS_InitTest
        arg SafetyReq_Status: type=Dt_PltRRUFS_SafetyReq_Status_T, direction=OUT, server-argument-impl-policy=USE-ARGUMENT-TYPE
  4 x sender receiver interface:
    Pi_EOUT_PinIntegrity
      data De_EOUT_PinIntegrityStat: type=uint8
    Pi_MCU_Ram_Fault_Test_Status
      data De_MCU_Ram_Fault_Test_Status: type=uint8
    Pi_Plt_timer_start_ustime
      data De_Plt_timer_start_ustime: type=uint32
    Pi_XCP_Op_Mode
      data De_XCP_Op_Mode: type=Idt_XCP_Op_Mode_T
  client server interface Pi_PCAN_Srv_EnableAppTx
    operation Operation
  client server interface Pi_PCAN_Srv_DisableAppTx
    operation Operation
  client server interface Pi_NCFFchannel_IC
    operation Read: possible-error=[Pi_NCFFchannel_IC/E_NOT_OK, Pi_NCFFchannel_IC/E_NOT_OK]
      arg NCFF_Channel: type=NCFF_Channel_Number, direction=IN, server-argument-impl-policy=USE-ARGUMENT-TYPE
      arg Injection_control: type=Injection_Control, direction=IN, server-argument-impl-policy=USE-ARGUMENT-TYPE
      arg Return: type=Return, direction=OUT, server-argument-impl-policy=USE-ARGUMENT-TYPE
    error E_NOT_OK: error-code=1
  sender receiver interface Pi_FCCU_Init_Status
    data De_Init_Status: type=uint8
  sender receiver interface Pi_FCCU_Config_State
    data FCCU_Config_State: type=uint8
  7 x client server interface:
    Pi_ethernet_platform_stop_periodic_interface_control
      operation ethernet_platform_stop_periodic_interface_control
        arg Ethernet_plt_stop_periodic: type=uint8, direction=INOUT, server-argument-impl-policy=USE-ARGUMENT-TYPE
    Pi_ethernet_project_stop_periodic_interface_control
      operation Operation
    Pi_PCAN_stop_periodic_interface_control
      operation stop_periodic_interface_control
        arg Pcan_stop_periodic: type=uint8, direction=INOUT, server-argument-impl-policy=USE-ARGUMENT-TYPE
    Pi_Trigger_Clear_Faults
      operation Operation
    Pi_XCP_Enable_Disable
      operation Status
        arg XCP_Status: type=XCP_Status_T, direction=IN, server-argument-impl-policy=USE-ARGUMENT-TYPE
    Pi_VCAN_stop_periodic_interface_control
      operation Operation
    PostRadarProcessing_XCP_Event_Trigger
      operation Trigger_Look_Based_XCP_Event: possible-error=[PostRadarProcessing_XCP_Event_Trigger/E_NOT_OK, PostRadarProcessing_XCP_Event_Trigger/E_NOT_OK, PostRadarProcessing_XCP_Event_Trigger/E_OK, PostRadarProcessing_XCP_Event_Trigger/E_OK]
      error E_NOT_OK: error-code=1
      error E_OK: error-code=0
  36 x sender receiver interface:
    Aptiv_EN_DIS_T
      data EN_DIS: type=boolean
    Pi_Application_Checksum
      data De_Application_Checksum: type=uint32
    Pi_DSP_Read_Sensitivity_Factor
      data De_DSP_Read_Sensitivity_Factor: type=uint16
    Pi_DSP_Wr_Sensitivity_Factor
      data De_DSP_Wr_Read_Sensitivity_Factor: type=uint16
    Pi_DSP_XCP_Target_Select
      data De_DSP_XCP_Target_Select: type=Idt_XCP_Target_Select_T
    Pi_Calibration_Version_Info
      data De_Calibration_Version_Info: type=Idt_Cal_Version_Info_Type
    Pi_Keep_Alive_Checksum
      data De_Keep_Alive_Checksum: type=uint32
    Pi_MMIC_Count
      data De_MMIC_Count: type=uint8
    Pi_MMIC_Temperature
      data De_MMIC_Temperature: type=Idt_Type_MMIC_Temperature
    Pi_Primary_Bootloader_Checksum
      data De_Primary_Bootloader_Checksum: type=uint32
    Pi_Radar_CMD_Radiate
      data De_Radar_CMD_Radiate: type=uint8
    Pi_Radar_Init_Status
      data De_Radar_Init_Status: type=uint8
    Pi_Radar_RFBIST_Calib_Status
      data De_Radar_RFBIST_Calib_Status: type=Idt_XCP_RFBIST_Status_T
    Pi_UDP_Logging_Enabled_Flag
      data De_UDP_Logging_Enabled_Flag: type=boolean
    Pi_USC_Checksum
      data De_USC_Checksum: type=uint32
    Pi_XCP_DID_RESP
      data De_XCP_DID_RESP: type=Dt_Xcp_Read_Write_Did_T
    Pi_XCP_Ethernet_En_Dis
      data De_XCP_Ethernet_En_Dis: type=uint8
    Pi_XCP_Fault_Injection
      data De_Xcp_Fault_Injection: type=Dt_Fault_Injection
    Pi_XCP_HIL_Mode
      data De_XCP_HIL_Mode: type=uint8
    Pi_XCP_Hw_Interface_Cntrl
      data De_Hw_Interface_Cntrl: type=Dt_XCP_Hw_Interface_Cntrl
    Pi_XCP_Itv_IPC_Event_State
      data De_ITV_EVENT: type=Dt_ITV_EVENT
    Pi_XCP_Itv_IPC_State
      data De_XCP_SIM_MODE: type=Dt_XCP_SIM_MODE
    Pi_XCP_Itv_IPC_Value_State
      data De_ITV_VALUE: type=Dt_ITV_VALUE
    Pi_XCP_LED_OP_Cntrl
      data De_XCP_LED_OP_Cntrl: type=Idt_XCP_LED_Output_Cntrl_T
    Pi_XCP_NvM_Control
      data De_XCP_NvM_Control: type=Dt_XCP_NvM_Control_T
    Pi_XCP_PCAN_En_Dis
      data De_XCP_PCAN_En_Dis: type=uint8
    Pi_XCP_Program_Mode
      data De_XCP_Program_Mode: type=boolean
    Pi_XCP_RFBIST_Calib_Trigger
      data De_XCP_RFBIST_Calib_Trigger: type=uint8
    Pi_XCP_Single_Look_Enable
      data De_XCP_Single_Look_Enable: type=Idt_XCP_Single_Look_T
    Pi_XCP_VCAN_En_Dis
      data De_XCP_VCAN_En_Dis: type=uint8
    Pi_ADC_XCP_Req: is-service=true
      data De_ADC_XCP_Req: type=uint8
    Pi_XCP_CW_Mode
      data De_XCP_CW_Mode: type=uint8
    Pi_XCP_Data_Flash_Process
      data De_Data_Flash_Process: type=Idt_XCP_Data_Flash_Process_T
    Pi_XCP_DID_CMD
      data De_XCP_DID_CMD: type=Dt_Xcp_Read_Write_Did_T
    Pi_SMC_Checksum
      data De_SMC_Checksum: type=uint32
    Pi_SW_Version_Info
      data De_SW_Version_Info: type=Idt_SW_Version_Info_T
  client server interface PostRadarProcessing_ADC
    operation Populate_ADC_Stream: possible-error=[PostRadarProcessing_ADC/E_OK, PostRadarProcessing_ADC/E_NOT_OK, PostRadarProcessing_ADC/E_OK, PostRadarProcessing_ADC/E_NOT_OK]
    error E_OK: error-code=0
    error E_NOT_OK: error-code=1
  69 x sender receiver interface:
    Pi_SSTS_MH_VS_CRC16_1
      data Vdp_SSTS_MH_VS_CRC16: type=SSTS_MH_VS_CRC16_impdt
    Pi_SSTS_MH_VS_CYCLE_COUNTER_1
      data Vdp_SSTS_MH_VS_CYCLE_COUNTER: type=SSTS_MH_VS_CYCLE_COUNTER_impdt
    Pi_Alignment_IPC_Data
      data De_Alignment_IPC_Data: type=Dt_Alignment_IPC_Data
    Pi_Alignment_M2D_Data
      data De_Alignment_M2D_Data: type=Dt_Alignment_M2D_Data
    pi_externalwdg_init_status
      data de_wdginit_status: type=uint8
    Pi_FailSafe_Verify_ResetReason
      data FailSafe_Verify_ResetReason: type=uint8
    Pi_MemExceptionInfo
      data De_MemExceptionInfo: type=Dt_Memory_Exception_Info_T
    Pi_R1_NCF_Count
      data R1_NCF_Count: type=uint16
    Pi_RFE_NvM_Data
      data De_RFE_NvM_Data: type=Dt_Rfe_R1R2_Fault
    Pi_RFE_Repetitive_Fault_Status
      data De_RFE_Repetitive_Fault_Status: type=uint8
    Pi_RFE_Repetitive_Reset_Status
      data De_RFE_Repetitive_Reset_Status: type=uint8
    Pi_externalwatchdogstatus
      data de_externalwatchdogstatus: type=uint8
    Pi_AL_STS_001_CYCLE_COUNTER
      data Vdp_AL_STS_001_CYCLE_COUNTER: type=AL_STS_001_CYCLE_COUNTER_impdt
    Pi_AL_STS_001_MH_CRC16
      data Vdp_AL_STS_001_MH_CRC16: type=AL_STS_001_MH_CRC16_impdt
    Pi_AL_STS_002_CYCLE_COUNTER
      data Vdp_AL_STS_002_CYCLE_COUNTER: type=AL_STS_002_CYCLE_COUNTER_impdt
    Pi_AL_STS_002_MH_CRC16
      data Vdp_AL_STS_002_MH_CRC16: type=AL_STS_002_MH_CRC16_impdt
    Pi_CAP_CYCLE_COUNTER
      data Vdp_CAP_CYCLE_COUNTER: type=CAP_CYCLE_COUNTER_impdt
    Pi_CAP_MH_CRC16
      data Vdp_CAP_MH_CRC16: type=CAP_MH_CRC16_impdt
    Pi_DET_MH_CRC16
      data Vdp_DET_MH_CRC16: type=DET_MH_CRC16_impdt
    Pi_DET_MH_CYCLE_COUNTER
      data Vdp_DET_MH_CYCLE_COUNTER: type=DET_MH_CYCLE_COUNTER_impdt
    Pi_HED_MH_002_CRC16
      data Vdp_HED_MH_002_CRC16: type=HED_MH_002_CRC16_impdt
    Pi_HED_MH_002_CYCLE_COUNTER
      data Vdp_HED_MH_002_CYCLE_COUNTER: type=HED_MH_002_CYCLE_COUNTER_impdt
    Pi_HED_MH_CRC16
      data Vdp_HED_MH_CRC16: type=HED_MH_CRC16_impdt
    Pi_HED_MH_CYCLE_COUNTER
      data Vdp_HED_MH_CYCLE_COUNTER: type=HED_MH_CYCLE_COUNTER_impdt
    Pi_OBJ_MH_CRC16
      data Vdp_OBJ_MH_CRC16: type=OBJ_MH_CRC16_impdt
    Pi_OBJ_MH_CYCLE_COUNTER
      data Vdp_OBJ_MH_CYCLE_COUNTER: type=OBJ_MH_CYCLE_COUNTER_impdt
    Pi_SG_Alignment_Auto
      data Vdp_SG_Alignment_Auto: type=SG_Alignment_Auto_impdt
    Pi_SG_Alignment_Handler
      data Vdp_SG_Alignment_Handler: type=SG_Alignment_Handler_impdt
    Pi_SG_Alignment_Service
      data Vdp_SG_Alignment_Service: type=SG_Alignment_Service_impdt
    Pi_SG_Alignment_Short_Track
      data Vdp_SG_Alignment_Short_Track: type=SG_Alignment_Short_Track_impdt
    Pi_SG_Alignment_Static
      data Vdp_SG_Alignment_Static: type=SG_Alignment_Static_impdt
    Pi_SG_Capability_Damping
      data Vdp_SG_Capability_Damping: type=SG_Capability_Damping_impdt
    Pi_SG_Capability_Radar_Performance
      data Vdp_SG_Capability_Radar_Performance: type=SG_Capability_Radar_Performance_impdt
    Pi_SG_Capability_Range_Detection
      data Vdp_SG_Capability_Range_Detection: type=SG_Capability_Range_Detection_impdt
    Pi_SG_Capability_SLL_Monitoring
      data Vdp_SG_Capability_SLL_Monitoring: type=SG_Capability_SLL_Monitoring_impdt
    Pi_SG_Detection
      data Vdp_SG_Detection: type=SG_Detection_impdt
    Pi_SG_Header_Alignment
      data Vdp_SG_Header_Alignment: type=SG_Header_Alignment_impdt
    Pi_SG_Header_Cores_TimingMeasure
      data Vdp_SG_Header_Cores_TimingMeasure: type=SG_Header_Cores_TimingMeasure_impdt
    Pi_SG_Header_InfoDetection
      data Vdp_SG_Header_InfoDetection: type=SG_Header_InfoDetection_impdt
    Pi_SG_Header_Interface_Version
      data Vdp_SG_Header_Interface_Version: type=SG_Header_Interface_Version_impdt
    Pi_SG_Header_RadarState
      data Vdp_SG_Header_RadarState: type=SG_Header_RadarState_impdt
    Pi_SG_Header_SensorCoverage
      data Vdp_SG_Header_SensorCoverage: type=SG_Header_SensorCoverage_impdt
    Pi_SG_Header_TimeStamp
      data Vdp_SG_Header_TimeStamp: type=SG_Header_TimeStamp_impdt
    Pi_SG_Header_Tracker_Info
      data Vdp_SG_Header_Tracker_Info: type=SG_Header_Tracker_Info_impdt
    Pi_SG_Status_CalibrationVersion
      data Vdp_SG_Status_CalibrationVersion: type=SG_Status_CalibrationVersion_impdt
    Pi_SG_Status_Faults
      data Vdp_SG_Status_Faults: type=SG_Status_Faults_impdt
    Pi_SG_Status_HW_CAN_Version
      data Vdp_SG_Status_HW_CAN_Version: type=SG_Status_HW_CAN_Version_impdt
    Pi_SG_Status_MountingPos
      data Vdp_SG_Status_MountingPos: type=SG_Status_MountingPos_impdt
    Pi_SG_Status_Radar
      data Vdp_SG_Status_Radar: type=SG_Status_Radar_impdt
    Pi_SG_Status_SensorPerformance
      data Vdp_SG_Status_SensorPerformance: type=SG_Status_SensorPerformance_impdt
    Pi_SG_Status_SwVersion
      data Vdp_SG_Status_SwVersion: type=SG_Status_SwVersion_impdt
    Pi_SG_Status_SystemTime
      data Vdp_SG_Status_SystemTime: type=SG_Status_SystemTime_impdt
    Pi_SG_Status_Temprature
      data Vdp_SG_Status_Temprature: type=SG_Status_Temprature_impdt
    Pi_SG_Status_TimeSyncStatus
      data Vdp_SG_Status_TimeSyncStatus: type=SG_Status_TimeSyncStatus_impdt
    Pi_SG_Status_TrackerVersion
      data Vdp_SG_Status_TrackerVersion: type=SG_Status_TrackerVersion_impdt
    Pi_SG_Status_Vehicle
      data Vdp_SG_Status_Vehicle: type=SG_Status_Vehicle_impdt
    Pi_SG_TrackerObject
      data Vdp_SG_TrackerObject: type=SG_TrackerObject_impdt
    Pi_STS_MH_001_CRC16_1
      data Vdp_STS_MH_001_CRC16: type=STS_MH_001_CRC16_impdt
    Pi_STS_MH_001_CYCLE_COUNTER_1
      data Vdp_STS_MH_001_CYCLE_COUNTER: type=STS_MH_001_CYCLE_COUNTER_impdt
    Pi_STS_MH_002_CRC16_1
      data Vdp_STS_MH_002_CRC16: type=STS_MH_002_CRC16_impdt
    Pi_STS_MH_002_CYCLE_COUNTER_1
      data Vdp_STS_MH_002_CYCLE_COUNTER: type=STS_MH_002_CYCLE_COUNTER_impdt
    Pi_STS_MH_003_CRC16_1
      data Vdp_STS_MH_003_CRC16: type=STS_MH_003_CRC16_impdt
    Pi_STS_MH_003_CYCLE_COUNTER_1
      data Vdp_STS_MH_003_CYCLE_COUNTER: type=STS_MH_003_CYCLE_COUNTER_impdt
    Pi_SG_SystemStatus_AbsoluteTime
      data Vdp_SG_SystemStatus_AbsoluteTime: type=SG_SystemStatus_AbsoluteTime_impdt
    Pi_SG_SystemStatusVehicle
      data Vdp_SG_SystemStatusVehicle: type=SG_SystemStatusVehicle_impdt
    Pi_SG_SystemStatusVehicleState
      data Vdp_SG_SystemStatusVehicleState: type=SG_SystemStatusVehicleState_impdt
    Pi_SG_SytemStatus_ADASVersion
      data Vdp_SG_SytemStatus_ADASVersion: type=SG_SytemStatus_ADASVersion_impdt
    Pi_SSTS_MH_VS_CRC16_2
      data Vdp_SSTS_MH_VS_CRC16: type=SSTS_MH_VS_CRC16_impdt
    Pi_SSTS_MH_VS_CYCLE_COUNTER_2
      data Vdp_SSTS_MH_VS_CYCLE_COUNTER: type=SSTS_MH_VS_CYCLE_COUNTER_impdt
