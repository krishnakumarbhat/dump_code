[part 5 of 10: package /System]
AUTOSAR XML (schema 00053)
package /System  (continued)
  system System  (continued)
    system mapping System_MPPNG  (continued)
      data-mappings:  (continued)
        sender-receiver-to-signal-group-mapping={data-element=Pp_SG_Detections_257_260_AL.Vdp_SG_Detections_257_260_AL, signal-group=SG_Detections_257_260, type-mapping=sender-rec-record-type-mapping=record-element-mappings=[{application-record-element=DET_AZIMUTH_257, system-signal=DET_AZIMUTH_257}, {application-record-element=DET_AZIMUTH_258, system-signal=DET_AZIMUTH_258}, {application-record-element=DET_AZIMUTH_259, system-signal=DET_AZIMUTH_259}, {application-record-element=DET_AZIMUTH_260, system-signal=DET_AZIMUTH_260}, {application-record-element=DET_AZIMUTH_ERR_257, system-signal=DET_AZIMUTH_ERR_257}, {application-record-element=DET_AZIMUTH_ERR_258, system-signal=DET_AZIMUTH_ERR_258}, {application-record-element=DET_AZIMUTH_ERR_259, system-signal=DET_AZIMUTH_ERR_259}, {application-record-element=DET_AZIMUTH_ERR_260, system-signal=DET_AZIMUTH_ERR_260}, {application-record-element=DET_BELOW_RAIN_THOLD_257, system-signal=DET_BELOW_RAIN_THOLD_257}, {application-record-element=DET_BELOW_RAIN_THOLD_258, system-signal=DET_BELOW_RAIN_THOLD_258}, {application-record-element=DET_BELOW_RAIN_THOLD_259, system-signal=DET_BELOW_RAIN_THOLD_259}, {application-record-element=DET_BELOW_RAIN_THOLD_260, system-signal=DET_BELOW_RAIN_THOLD_260}, {application-record-element=DET_BI_STATIC_FLAG_257, system-signal=DET_BI_STATIC_FLAG_257}, {application-record-element=DET_BI_STATIC_FLAG_258, system-signal=DET_BI_STATIC_FLAG_258}, {application-record-element=DET_BI_STATIC_FLAG_259, system-signal=DET_BI_STATIC_FLAG_259}, {application-record-element=DET_BI_STATIC_FLAG_260, system-signal=DET_BI_STATIC_FLAG_260}, {application-record-element=DET_CONFD_AZIMUTH_257, system-signal=DET_CONFD_AZIMUTH_257}, {application-record-element=DET_CONFD_AZIMUTH_258, system-signal=DET_CONFD_AZIMUTH_258}, {application-record-element=DET_CONFD_AZIMUTH_259, system-signal=DET_CONFD_AZIMUTH_259}, {application-record-element=DET_CONFD_AZIMUTH_260, system-signal=DET_CONFD_AZIMUTH_260}, {application-record-element=DET_CONFD_ELEVATION_257, system-signal=DET_CONFD_ELEVATION_257}, {application-record-element=DET_CONFD_ELEVATION_258, system-signal=DET_CONFD_ELEVATION_258}, {application-record-element=DET_CONFD_ELEVATION_259, system-signal=DET_CONFD_ELEVATION_259}, {application-record-element=DET_CONFD_ELEVATION_260, system-signal=DET_CONFD_ELEVATION_260}, {application-record-element=DET_ELEVATION_257, system-signal=DET_ELEVATION_257}, {application-record-element=DET_ELEVATION_258, system-signal=DET_ELEVATION_258}, {application-record-element=DET_ELEVATION_259, system-signal=DET_ELEVATION_259}, {application-record-element=DET_ELEVATION_260, system-signal=DET_ELEVATION_260}, {application-record-element=DET_ELEVATION_ERR_257, system-signal=DET_ELEVATION_ERR_257}, {application-record-element=DET_ELEVATION_ERR_258, system-signal=DET_ELEVATION_ERR_258}, {application-record-element=DET_ELEVATION_ERR_259, system-signal=DET_ELEVATION_ERR_259}, {application-record-element=DET_ELEVATION_ERR_260, system-signal=DET_ELEVATION_ERR_260}, {application-record-element=DET_EXISTENCE_PROB_257, system-signal=DET_EXISTENCE_PROB_257}, {application-record-element=DET_EXISTENCE_PROB_258, system-signal=DET_EXISTENCE_PROB_258}, {application-record-element=DET_EXISTENCE_PROB_259, system-signal=DET_EXISTENCE_PROB_259}, {application-record-element=DET_EXISTENCE_PROB_260, system-signal=DET_EXISTENCE_PROB_260}, {application-record-element=DET_HVC_FLAG_257, system-signal=DET_HVC_FLAG_257}, {application-record-element=DET_HVC_FLAG_258, system-signal=DET_HVC_FLAG_258}, {application-record-element=DET_HVC_FLAG_259, system-signal=DET_HVC_FLAG_259}, {application-record-element=DET_HVC_FLAG_260, system-signal=DET_HVC_FLAG_260}, {application-record-element=DET_IDM_257, system-signal=DET_IDM_257}, {application-record-element=DET_IDM_258, system-signal=DET_IDM_258}, {application-record-element=DET_IDM_259, system-signal=DET_IDM_259}, {application-record-element=DET_IDM_260, system-signal=DET_IDM_260}, {application-record-element=DET_MH_CRC16_257_260, system-signal=DET_MH_CRC16_257_260}, {application-record-element=DET_MH_CYCLE_COUNTER_257_260, system-signal=DET_MH_CYCLE_COUNTER_257_260}, {application-record-element=DET_MH_SCAN_INDEX_4LSB_257_260, system-signal=DET_MH_SCAN_INDEX_4LSB_257_260}, {application-record-element=DET_MTD_257, system-signal=DET_MTD_257}, {application-record-element=DET_MTD_258, system-signal=DET_MTD_258}, {application-record-element=DET_MTD_259, system-signal=DET_MTD_259}, {application-record-element=DET_MTD_260, system-signal=DET_MTD_260}, {application-record-element=DET_PROB_1STAZHYPO_257, system-signal=DET_PROB_1STAZHYPO_257}, {application-record-element=DET_PROB_1STAZHYPO_258, system-signal=DET_PROB_1STAZHYPO_258}, {application-record-element=DET_PROB_1STAZHYPO_259, system-signal=DET_PROB_1STAZHYPO_259}, {application-record-element=DET_PROB_1STAZHYPO_260, system-signal=DET_PROB_1STAZHYPO_260}, {application-record-element=DET_RANGE_257, system-signal=DET_RANGE_257}, {application-record-element=DET_RANGE_258, system-signal=DET_RANGE_258}, {application-record-element=DET_RANGE_259, system-signal=DET_RANGE_259}, {application-record-element=DET_RANGE_260, system-signal=DET_RANGE_260}, {application-record-element=DET_RANGE_ERR_257, system-signal=DET_RANGE_ERR_257}, {application-record-element=DET_RANGE_ERR_258, system-signal=DET_RANGE_ERR_258}, {application-record-element=DET_RANGE_ERR_259, system-signal=DET_RANGE_ERR_259}, {application-record-element=DET_RANGE_ERR_260, system-signal=DET_RANGE_ERR_260}, {application-record-element=DET_RANGE_VELOCITY_257, system-signal=DET_RANGE_VELOCITY_257}, {application-record-element=DET_RANGE_VELOCITY_258, system-signal=DET_RANGE_VELOCITY_258}, {application-record-element=DET_RANGE_VELOCITY_259, system-signal=DET_RANGE_VELOCITY_259}, {application-record-element=DET_RANGE_VELOCITY_260, system-signal=DET_RANGE_VELOCITY_260}, {application-record-element=DET_RANGE_VELOCITY_ERR_257, system-signal=DET_RANGE_VELOCITY_ERR_257}, {application-record-element=DET_RANGE_VELOCITY_ERR_258, system-signal=DET_RANGE_VELOCITY_ERR_258}, {application-record-element=DET_RANGE_VELOCITY_ERR_259, system-signal=DET_RANGE_VELOCITY_ERR_259}, {application-record-element=DET_RANGE_VELOCITY_ERR_260, system-signal=DET_RANGE_VELOCITY_ERR_260}, {application-record-element=DET_RCS_257, system-signal=DET_RCS_257}, {application-record-element=DET_RCS_258, system-signal=DET_RCS_258}, {application-record-element=DET_RCS_259, system-signal=DET_RCS_259}, {application-record-element=DET_RCS_260, system-signal=DET_RCS_260}, {application-record-element=DET_SNR_257, system-signal=DET_SNR_257}, {application-record-element=DET_SNR_258, system-signal=DET_SNR_258}, {application-record-element=DET_SNR_259, system-signal=DET_SNR_259}, {application-record-element=DET_SNR_260, system-signal=DET_SNR_260}, {application-record-element=DET_SUPER_RES_TARGET_257, system-signal=DET_SUPER_RES_TARGET_257}, {application-record-element=DET_SUPER_RES_TARGET_258, system-signal=DET_SUPER_RES_TARGET_258}, {application-record-element=DET_SUPER_RES_TARGET_259, system-signal=DET_SUPER_RES_TARGET_259}, {application-record-element=DET_SUPER_RES_TARGET_260, system-signal=DET_SUPER_RES_TARGET_260}]}
        sender-receiver-to-signal-group-mapping={data-element=Pp_SG_Detections_261_264_AL.Vdp_SG_Detections_261_264_AL, signal-group=SG_Detections_261_264, type-mapping=sender-rec-record-type-mapping=record-element-mappings=[{application-record-element=DET_AZIMUTH_261, system-signal=DET_AZIMUTH_261}, {application-record-element=DET_AZIMUTH_262, system-signal=DET_AZIMUTH_262}, {application-record-element=DET_AZIMUTH_263, system-signal=DET_AZIMUTH_263}, {application-record-element=DET_AZIMUTH_264, system-signal=DET_AZIMUTH_264}, {application-record-element=DET_AZIMUTH_ERR_261, system-signal=DET_AZIMUTH_ERR_261}, {application-record-element=DET_AZIMUTH_ERR_262, system-signal=DET_AZIMUTH_ERR_262}, {application-record-element=DET_AZIMUTH_ERR_263, system-signal=DET_AZIMUTH_ERR_263}, {application-record-element=DET_AZIMUTH_ERR_264, system-signal=DET_AZIMUTH_ERR_264}, {application-record-element=DET_BELOW_RAIN_THOLD_261, system-signal=DET_BELOW_RAIN_THOLD_261}, {application-record-element=DET_BELOW_RAIN_THOLD_262, system-signal=DET_BELOW_RAIN_THOLD_262}, {application-record-element=DET_BELOW_RAIN_THOLD_263, system-signal=DET_BELOW_RAIN_THOLD_263}, {application-record-element=DET_BELOW_RAIN_THOLD_264, system-signal=DET_BELOW_RAIN_THOLD_264}, {application-record-element=DET_BI_STATIC_FLAG_261, system-signal=DET_BI_STATIC_FLAG_261}, {application-record-element=DET_BI_STATIC_FLAG_262, system-signal=DET_BI_STATIC_FLAG_262}, {application-record-element=DET_BI_STATIC_FLAG_263, system-signal=DET_BI_STATIC_FLAG_263}, {application-record-element=DET_BI_STATIC_FLAG_264, system-signal=DET_BI_STATIC_FLAG_264}, {application-record-element=DET_CONFD_AZIMUTH_261, system-signal=DET_CONFD_AZIMUTH_261}, {application-record-element=DET_CONFD_AZIMUTH_262, system-signal=DET_CONFD_AZIMUTH_262}, {application-record-element=DET_CONFD_AZIMUTH_263, system-signal=DET_CONFD_AZIMUTH_263}, {application-record-element=DET_CONFD_AZIMUTH_264, system-signal=DET_CONFD_AZIMUTH_264}, {application-record-element=DET_CONFD_ELEVATION_261, system-signal=DET_CONFD_ELEVATION_261}, {application-record-element=DET_CONFD_ELEVATION_262, system-signal=DET_CONFD_ELEVATION_262}, {application-record-element=DET_CONFD_ELEVATION_263, system-signal=DET_CONFD_ELEVATION_263}, {application-record-element=DET_CONFD_ELEVATION_264, system-signal=DET_CONFD_ELEVATION_264}, {application-record-element=DET_ELEVATION_261, system-signal=DET_ELEVATION_261}, {application-record-element=DET_ELEVATION_262, system-signal=DET_ELEVATION_262}, {application-record-element=DET_ELEVATION_263, system-signal=DET_ELEVATION_263}, {application-record-element=DET_ELEVATION_264, system-signal=DET_ELEVATION_264}, {application-record-element=DET_ELEVATION_ERR_261, system-signal=DET_ELEVATION_ERR_261}, {application-record-element=DET_ELEVATION_ERR_262, system-signal=DET_ELEVATION_ERR_262}, {application-record-element=DET_ELEVATION_ERR_263, system-signal=DET_ELEVATION_ERR_263}, {application-record-element=DET_ELEVATION_ERR_264, system-signal=DET_ELEVATION_ERR_264}, {application-record-element=DET_EXISTENCE_PROB_261, system-signal=DET_EXISTENCE_PROB_261}, {application-record-element=DET_EXISTENCE_PROB_262, system-signal=DET_EXISTENCE_PROB_262}, {application-record-element=DET_EXISTENCE_PROB_263, system-signal=DET_EXISTENCE_PROB_263}, {application-record-element=DET_EXISTENCE_PROB_264, system-signal=DET_EXISTENCE_PROB_264}, {application-record-element=DET_HVC_FLAG_261, system-signal=DET_HVC_FLAG_261}, {application-record-element=DET_HVC_FLAG_262, system-signal=DET_HVC_FLAG_262}, {application-record-element=DET_HVC_FLAG_263, system-signal=DET_HVC_FLAG_263}, {application-record-element=DET_HVC_FLAG_264, system-signal=DET_HVC_FLAG_264}, {application-record-element=DET_IDM_261, system-signal=DET_IDM_261}, {application-record-element=DET_IDM_262, system-signal=DET_IDM_262}, {application-record-element=DET_IDM_263, system-signal=DET_IDM_263}, {application-record-element=DET_IDM_264, system-signal=DET_IDM_264}, {application-record-element=DET_MH_CRC16_261_264, system-signal=DET_MH_CRC16_261_264}, {application-record-element=DET_MH_CYCLE_COUNTER_261_264, system-signal=DET_MH_CYCLE_COUNTER_261_264}, {application-record-element=DET_MH_SCAN_INDEX_4LSB_261_264, system-signal=DET_MH_SCAN_INDEX_4LSB_261_264}, {application-record-element=DET_MTD_261, system-signal=DET_MTD_261}, {application-record-element=DET_MTD_262, system-signal=DET_MTD_262}, {application-record-element=DET_MTD_263, system-signal=DET_MTD_263}, {application-record-element=DET_MTD_264, system-signal=DET_MTD_264}, {application-record-element=DET_PROB_1STAZHYPO_261, system-signal=DET_PROB_1STAZHYPO_261}, {application-record-element=DET_PROB_1STAZHYPO_262, system-signal=DET_PROB_1STAZHYPO_262}, {application-record-element=DET_PROB_1STAZHYPO_263, system-signal=DET_PROB_1STAZHYPO_263}, {application-record-element=DET_PROB_1STAZHYPO_264, system-signal=DET_PROB_1STAZHYPO_264}, {application-record-element=DET_RANGE_261, system-signal=DET_RANGE_261}, {application-record-element=DET_RANGE_262, system-signal=DET_RANGE_262}, {application-record-element=DET_RANGE_263, system-signal=DET_RANGE_263}, {application-record-element=DET_RANGE_264, system-signal=DET_RANGE_264}, {application-record-element=DET_RANGE_ERR_261, system-signal=DET_RANGE_ERR_261}, {application-record-element=DET_RANGE_ERR_262, system-signal=DET_RANGE_ERR_262}, {application-record-element=DET_RANGE_ERR_263, system-signal=DET_RANGE_ERR_263}, {application-record-element=DET_RANGE_ERR_264, system-signal=DET_RANGE_ERR_264}, {application-record-element=DET_RANGE_VELOCITY_261, system-signal=DET_RANGE_VELOCITY_261}, {application-record-element=DET_RANGE_VELOCITY_262, system-signal=DET_RANGE_VELOCITY_262}, {application-record-element=DET_RANGE_VELOCITY_263, system-signal=DET_RANGE_VELOCITY_263}, {application-record-element=DET_RANGE_VELOCITY_264, system-signal=DET_RANGE_VELOCITY_264}, {application-record-element=DET_RANGE_VELOCITY_ERR_261, system-signal=DET_RANGE_VELOCITY_ERR_261}, {application-record-element=DET_RANGE_VELOCITY_ERR_262, system-signal=DET_RANGE_VELOCITY_ERR_262}, {application-record-element=DET_RANGE_VELOCITY_ERR_263, system-signal=DET_RANGE_VELOCITY_ERR_263}, {application-record-element=DET_RANGE_VELOCITY_ERR_264, system-signal=DET_RANGE_VELOCITY_ERR_264}, {application-record-element=DET_RCS_261, system-signal=DET_RCS_261}, {application-record-element=DET_RCS_262, system-signal=DET_RCS_262}, {application-record-element=DET_RCS_263, system-signal=DET_RCS_263}, {application-record-element=DET_RCS_264, system-signal=DET_RCS_264}, {application-record-element=DET_SNR_261, system-signal=DET_SNR_261}, {application-record-element=DET_SNR_262, system-signal=DET_SNR_262}, {application-record-element=DET_SNR_263, system-signal=DET_SNR_263}, {application-record-element=DET_SNR_264, system-signal=DET_SNR_264}, {application-record-element=DET_SUPER_RES_TARGET_261, system-signal=DET_SUPER_RES_TARGET_261}, {application-record-element=DET_SUPER_RES_TARGET_262, system-signal=DET_SUPER_RES_TARGET_262}, {application-record-element=DET_SUPER_RES_TARGET_263, system-signal=DET_SUPER_RES_TARGET_263}, {application-record-element=DET_SUPER_RES_TARGET_264, system-signal=DET_SUPER_RES_TARGET_264}]}
        sender-receiver-to-signal-group-mapping={data-element=Pp_SG_Detections_265_268_AL.Vdp_SG_Detections_265_268_AL, signal-group=SG_Detections_265_268, type-mapping=sender-rec-record-type-mapping=record-element-mappings=[{application-record-element=DET_AZIMUTH_265, system-signal=DET_AZIMUTH_265}, {application-record-element=DET_AZIMUTH_266, system-signal=DET_AZIMUTH_266}, {application-record-element=DET_AZIMUTH_267, system-signal=DET_AZIMUTH_267}, {application-record-element=DET_AZIMUTH_268, system-signal=DET_AZIMUTH_268}, {application-record-element=DET_AZIMUTH_ERR_265, system-signal=DET_AZIMUTH_ERR_265}, {application-record-element=DET_AZIMUTH_ERR_266, system-signal=DET_AZIMUTH_ERR_266}, {application-record-element=DET_AZIMUTH_ERR_267, system-signal=DET_AZIMUTH_ERR_267}, {application-record-element=DET_AZIMUTH_ERR_268, system-signal=DET_AZIMUTH_ERR_268}, {application-record-element=DET_BELOW_RAIN_THOLD_265, system-signal=DET_BELOW_RAIN_THOLD_265}, {application-record-element=DET_BELOW_RAIN_THOLD_266, system-signal=DET_BELOW_RAIN_THOLD_266}, {application-record-element=DET_BELOW_RAIN_THOLD_267, system-signal=DET_BELOW_RAIN_THOLD_267}, {application-record-element=DET_BELOW_RAIN_THOLD_268, system-signal=DET_BELOW_RAIN_THOLD_268}, {application-record-element=DET_BI_STATIC_FLAG_265, system-signal=DET_BI_STATIC_FLAG_265}, {application-record-element=DET_BI_STATIC_FLAG_266, system-signal=DET_BI_STATIC_FLAG_266}, {application-record-element=DET_BI_STATIC_FLAG_267, system-signal=DET_BI_STATIC_FLAG_267}, {application-record-element=DET_BI_STATIC_FLAG_268, system-signal=DET_BI_STATIC_FLAG_268}, {application-record-element=DET_CONFD_AZIMUTH_265, system-signal=DET_CONFD_AZIMUTH_265}, {application-record-element=DET_CONFD_AZIMUTH_266, system-signal=DET_CONFD_AZIMUTH_266}, {application-record-element=DET_CONFD_AZIMUTH_267, system-signal=DET_CONFD_AZIMUTH_267}, {application-record-element=DET_CONFD_AZIMUTH_268, system-signal=DET_CONFD_AZIMUTH_268}, {application-record-element=DET_CONFD_ELEVATION_265, system-signal=DET_CONFD_ELEVATION_265}, {application-record-element=DET_CONFD_ELEVATION_266, system-signal=DET_CONFD_ELEVATION_266}, {application-record-element=DET_CONFD_ELEVATION_267, system-signal=DET_CONFD_ELEVATION_267}, {application-record-element=DET_CONFD_ELEVATION_268, system-signal=DET_CONFD_ELEVATION_268}, {application-record-element=DET_ELEVATION_265, system-signal=DET_ELEVATION_265}, {application-record-element=DET_ELEVATION_266, system-signal=DET_ELEVATION_266}, {application-record-element=DET_ELEVATION_267, system-signal=DET_ELEVATION_267}, {application-record-element=DET_ELEVATION_268, system-signal=DET_ELEVATION_268}, {application-record-element=DET_ELEVATION_ERR_265, system-signal=DET_ELEVATION_ERR_265}, {application-record-element=DET_ELEVATION_ERR_266, system-signal=DET_ELEVATION_ERR_266}, {application-record-element=DET_ELEVATION_ERR_267, system-signal=DET_ELEVATION_ERR_267}, {application-record-element=DET_ELEVATION_ERR_268, system-signal=DET_ELEVATION_ERR_268}, {application-record-element=DET_EXISTENCE_PROB_265, system-signal=DET_EXISTENCE_PROB_265}, {application-record-element=DET_EXISTENCE_PROB_266, system-signal=DET_EXISTENCE_PROB_266}, {application-record-element=DET_EXISTENCE_PROB_267, system-signal=DET_EXISTENCE_PROB_267}, {application-record-element=DET_EXISTENCE_PROB_268, system-signal=DET_EXISTENCE_PROB_268}, {application-record-element=DET_HVC_FLAG_265, system-signal=DET_HVC_FLAG_265}, {application-record-element=DET_HVC_FLAG_266, system-signal=DET_HVC_FLAG_266}, {application-record-element=DET_HVC_FLAG_267, system-signal=DET_HVC_FLAG_267}, {application-record-element=DET_HVC_FLAG_268, system-signal=DET_HVC_FLAG_268}, {application-record-element=DET_IDM_265, system-signal=DET_IDM_265}, {application-record-element=DET_IDM_266, system-signal=DET_IDM_266}, {application-record-element=DET_IDM_267, system-signal=DET_IDM_267}, {application-record-element=DET_IDM_268, system-signal=DET_IDM_268}, {application-record-element=DET_MH_CRC16_265_268, system-signal=DET_MH_CRC16_265_268}, {application-record-element=DET_MH_CYCLE_COUNTER_265_268, system-signal=DET_MH_CYCLE_COUNTER_265_268}, {application-record-element=DET_MH_SCAN_INDEX_4LSB_265_268, system-signal=DET_MH_SCAN_INDEX_4LSB_265_268}, {application-record-element=DET_MTD_265, system-signal=DET_MTD_265}, {application-record-element=DET_MTD_266, system-signal=DET_MTD_266}, {application-record-element=DET_MTD_267, system-signal=DET_MTD_267}, {application-record-element=DET_MTD_268, system-signal=DET_MTD_268}, {application-record-element=DET_PROB_1STAZHYPO_265, system-signal=DET_PROB_1STAZHYPO_265}, {application-record-element=DET_PROB_1STAZHYPO_266, system-signal=DET_PROB_1STAZHYPO_266}, {application-record-element=DET_PROB_1STAZHYPO_267, system-signal=DET_PROB_1STAZHYPO_267}, {application-record-element=DET_PROB_1STAZHYPO_268, system-signal=DET_PROB_1STAZHYPO_268}, {application-record-element=DET_RANGE_265, system-signal=DET_RANGE_265}, {application-record-element=DET_RANGE_266, system-signal=DET_RANGE_266}, {application-record-element=DET_RANGE_267, system-signal=DET_RANGE_267}, {application-record-element=DET_RANGE_268, system-signal=DET_RANGE_268}, {application-record-element=DET_RANGE_ERR_265, system-signal=DET_RANGE_ERR_265}, {application-record-element=DET_RANGE_ERR_266, system-signal=DET_RANGE_ERR_266}, {application-record-element=DET_RANGE_ERR_267, system-signal=DET_RANGE_ERR_267}, {application-record-element=DET_RANGE_ERR_268, system-signal=DET_RANGE_ERR_268}, {application-record-element=DET_RANGE_VELOCITY_265, system-signal=DET_RANGE_VELOCITY_265}, {application-record-element=DET_RANGE_VELOCITY_266, system-signal=DET_RANGE_VELOCITY_266}, {application-record-element=DET_RANGE_VELOCITY_267, system-signal=DET_RANGE_VELOCITY_267}, {application-record-element=DET_RANGE_VELOCITY_268, system-signal=DET_RANGE_VELOCITY_268}, {application-record-element=DET_RANGE_VELOCITY_ERR_265, system-signal=DET_RANGE_VELOCITY_ERR_265}, {application-record-element=DET_RANGE_VELOCITY_ERR_266, system-signal=DET_RANGE_VELOCITY_ERR_266}, {application-record-element=DET_RANGE_VELOCITY_ERR_267, system-signal=DET_RANGE_VELOCITY_ERR_267}, {application-record-element=DET_RANGE_VELOCITY_ERR_268, system-signal=DET_RANGE_VELOCITY_ERR_268}, {application-record-element=DET_RCS_265, system-signal=DET_RCS_265}, {application-record-element=DET_RCS_266, system-signal=DET_RCS_266}, {application-record-element=DET_RCS_267, system-signal=DET_RCS_267}, {application-record-element=DET_RCS_268, system-signal=DET_RCS_268}, {application-record-element=DET_SNR_265, system-signal=DET_SNR_265}, {application-record-element=DET_SNR_266, system-signal=DET_SNR_266}, {application-record-element=DET_SNR_267, system-signal=DET_SNR_267}, {application-record-element=DET_SNR_268, system-signal=DET_SNR_268}, {application-record-element=DET_SUPER_RES_TARGET_265, system-signal=DET_SUPER_RES_TARGET_265}, {application-record-element=DET_SUPER_RES_TARGET_266, system-signal=DET_SUPER_RES_TARGET_266}, {application-record-element=DET_SUPER_RES_TARGET_267, system-signal=DET_SUPER_RES_TARGET_267}, {application-record-element=DET_SUPER_RES_TARGET_268, system-signal=DET_SUPER_RES_TARGET_268}]}
        sender-receiver-to-signal-group-mapping={data-element=Pp_SG_Detections_269_272_AL.Vdp_SG_Detections_269_272_AL, signal-group=SG_Detections_269_272, type-mapping=sender-rec-record-type-mapping=record-element-mappings=[{application-record-element=DET_AZIMUTH_269, system-signal=DET_AZIMUTH_269}, {application-record-element=DET_AZIMUTH_270, system-signal=DET_AZIMUTH_270}, {application-record-element=DET_AZIMUTH_271, system-signal=DET_AZIMUTH_271}, {application-record-element=DET_AZIMUTH_272, system-signal=DET_AZIMUTH_272}, {application-record-element=DET_AZIMUTH_ERR_269, system-signal=DET_AZIMUTH_ERR_269}, {application-record-element=DET_AZIMUTH_ERR_270, system-signal=DET_AZIMUTH_ERR_270}, {application-record-element=DET_AZIMUTH_ERR_271, system-signal=DET_AZIMUTH_ERR_271}, {application-record-element=DET_AZIMUTH_ERR_272, system-signal=DET_AZIMUTH_ERR_272}, {application-record-element=DET_BELOW_RAIN_THOLD_269, system-signal=DET_BELOW_RAIN_THOLD_269}, {application-record-element=DET_BELOW_RAIN_THOLD_270, system-signal=DET_BELOW_RAIN_THOLD_270}, {application-record-element=DET_BELOW_RAIN_THOLD_271, system-signal=DET_BELOW_RAIN_THOLD_271}, {application-record-element=DET_BELOW_RAIN_THOLD_272, system-signal=DET_BELOW_RAIN_THOLD_272}, {application-record-element=DET_BI_STATIC_FLAG_269, system-signal=DET_BI_STATIC_FLAG_269}, {application-record-element=DET_BI_STATIC_FLAG_270, system-signal=DET_BI_STATIC_FLAG_270}, {application-record-element=DET_BI_STATIC_FLAG_271, system-signal=DET_BI_STATIC_FLAG_271}, {application-record-element=DET_BI_STATIC_FLAG_272, system-signal=DET_BI_STATIC_FLAG_272}, {application-record-element=DET_CONFD_AZIMUTH_269, system-signal=DET_CONFD_AZIMUTH_269}, {application-record-element=DET_CONFD_AZIMUTH_270, system-signal=DET_CONFD_AZIMUTH_270}, {application-record-element=DET_CONFD_AZIMUTH_271, system-signal=DET_CONFD_AZIMUTH_271}, {application-record-element=DET_CONFD_AZIMUTH_272, system-signal=DET_CONFD_AZIMUTH_272}, {application-record-element=DET_CONFD_ELEVATION_269, system-signal=DET_CONFD_ELEVATION_269}, {application-record-element=DET_CONFD_ELEVATION_270, system-signal=DET_CONFD_ELEVATION_270}, {application-record-element=DET_CONFD_ELEVATION_271, system-signal=DET_CONFD_ELEVATION_271}, {application-record-element=DET_CONFD_ELEVATION_272, system-signal=DET_CONFD_ELEVATION_272}, {application-record-element=DET_ELEVATION_269, system-signal=DET_ELEVATION_269}, {application-record-element=DET_ELEVATION_270, system-signal=DET_ELEVATION_270}, {application-record-element=DET_ELEVATION_271, system-signal=DET_ELEVATION_271}, {application-record-element=DET_ELEVATION_272, system-signal=DET_ELEVATION_272}, {application-record-element=DET_ELEVATION_ERR_269, system-signal=DET_ELEVATION_ERR_269}, {application-record-element=DET_ELEVATION_ERR_270, system-signal=DET_ELEVATION_ERR_270}, {application-record-element=DET_ELEVATION_ERR_271, system-signal=DET_ELEVATION_ERR_271}, {application-record-element=DET_ELEVATION_ERR_272, system-signal=DET_ELEVATION_ERR_272}, {application-record-element=DET_EXISTENCE_PROB_269, system-signal=DET_EXISTENCE_PROB_269}, {application-record-element=DET_EXISTENCE_PROB_270, system-signal=DET_EXISTENCE_PROB_270}, {application-record-element=DET_EXISTENCE_PROB_271, system-signal=DET_EXISTENCE_PROB_271}, {application-record-element=DET_EXISTENCE_PROB_272, system-signal=DET_EXISTENCE_PROB_272}, {application-record-element=DET_HVC_FLAG_269, system-signal=DET_HVC_FLAG_269}, {application-record-element=DET_HVC_FLAG_270, system-signal=DET_HVC_FLAG_270}, {application-record-element=DET_HVC_FLAG_271, system-signal=DET_HVC_FLAG_271}, {application-record-element=DET_HVC_FLAG_272, system-signal=DET_HVC_FLAG_272}, {application-record-element=DET_IDM_269, system-signal=DET_IDM_269}, {application-record-element=DET_IDM_270, system-signal=DET_IDM_270}, {application-record-element=DET_IDM_271, system-signal=DET_IDM_271}, {application-record-element=DET_IDM_272, system-signal=DET_IDM_272}, {application-record-element=DET_MH_CRC16_269_272, system-signal=DET_MH_CRC16_269_272}, {application-record-element=DET_MH_CYCLE_COUNTER_269_272, system-signal=DET_MH_CYCLE_COUNTER_269_272}, {application-record-element=DET_MH_SCAN_INDEX_4LSB_269_272, system-signal=DET_MH_SCAN_INDEX_4LSB_269_272}, {application-record-element=DET_MTD_269, system-signal=DET_MTD_269}, {application-record-element=DET_MTD_270, system-signal=DET_MTD_270}, {application-record-element=DET_MTD_271, system-signal=DET_MTD_271}, {application-record-element=DET_MTD_272, system-signal=DET_MTD_272}, {application-record-element=DET_PROB_1STAZHYPO_269, system-signal=DET_PROB_1STAZHYPO_269}, {application-record-element=DET_PROB_1STAZHYPO_270, system-signal=DET_PROB_1STAZHYPO_270}, {application-record-element=DET_PROB_1STAZHYPO_271, system-signal=DET_PROB_1STAZHYPO_271}, {application-record-element=DET_PROB_1STAZHYPO_272, system-signal=DET_PROB_1STAZHYPO_272}, {application-record-element=DET_RANGE_269, system-signal=DET_RANGE_269}, {application-record-element=DET_RANGE_270, system-signal=DET_RANGE_270}, {application-record-element=DET_RANGE_271, system-signal=DET_RANGE_271}, {application-record-element=DET_RANGE_272, system-signal=DET_RANGE_272}, {application-record-element=DET_RANGE_ERR_269, system-signal=DET_RANGE_ERR_269}, {application-record-element=DET_RANGE_ERR_270, system-signal=DET_RANGE_ERR_270}, {application-record-element=DET_RANGE_ERR_271, system-signal=DET_RANGE_ERR_271}, {application-record-element=DET_RANGE_ERR_272, system-signal=DET_RANGE_ERR_272}, {application-record-element=DET_RANGE_VELOCITY_269, system-signal=DET_RANGE_VELOCITY_269}, {application-record-element=DET_RANGE_VELOCITY_270, system-signal=DET_RANGE_VELOCITY_270}, {application-record-element=DET_RANGE_VELOCITY_271, system-signal=DET_RANGE_VELOCITY_271}, {application-record-element=DET_RANGE_VELOCITY_272, system-signal=DET_RANGE_VELOCITY_272}, {application-record-element=DET_RANGE_VELOCITY_ERR_269, system-signal=DET_RANGE_VELOCITY_ERR_269}, {application-record-element=DET_RANGE_VELOCITY_ERR_270, system-signal=DET_RANGE_VELOCITY_ERR_270}, {application-record-element=DET_RANGE_VELOCITY_ERR_271, system-signal=DET_RANGE_VELOCITY_ERR_271}, {application-record-element=DET_RANGE_VELOCITY_ERR_272, system-signal=DET_RANGE_VELOCITY_ERR_272}, {application-record-element=DET_RCS_269, system-signal=DET_RCS_269}, {application-record-element=DET_RCS_270, system-signal=DET_RCS_270}, {application-record-element=DET_RCS_271, system-signal=DET_RCS_271}, {application-record-element=DET_RCS_272, system-signal=DET_RCS_272}, {application-record-element=DET_SNR_269, system-signal=DET_SNR_269}, {application-record-element=DET_SNR_270, system-signal=DET_SNR_270}, {application-record-element=DET_SNR_271, system-signal=DET_SNR_271}, {application-record-element=DET_SNR_272, system-signal=DET_SNR_272}, {application-record-element=DET_SUPER_RES_TARGET_269, system-signal=DET_SUPER_RES_TARGET_269}, {application-record-element=DET_SUPER_RES_TARGET_270, system-signal=DET_SUPER_RES_TARGET_270}, {application-record-element=DET_SUPER_RES_TARGET_271, system-signal=DET_SUPER_RES_TARGET_271}, {application-record-element=DET_SUPER_RES_TARGET_272, system-signal=DET_SUPER_RES_TARGET_272}]}
        sender-receiver-to-signal-group-mapping={data-element=Pp_SG_Detections_273_276_AL.Vdp_SG_Detections_273_276_AL, signal-group=SG_Detections_273_276, type-mapping=sender-rec-record-type-mapping=record-element-mappings=[{application-record-element=DET_AZIMUTH_273, system-signal=DET_AZIMUTH_273}, {application-record-element=DET_AZIMUTH_274, system-signal=DET_AZIMUTH_274}, {application-record-element=DET_AZIMUTH_275, system-signal=DET_AZIMUTH_275}, {application-record-element=DET_AZIMUTH_276, system-signal=DET_AZIMUTH_276}, {application-record-element=DET_AZIMUTH_ERR_273, system-signal=DET_AZIMUTH_ERR_273}, {application-record-element=DET_AZIMUTH_ERR_274, system-signal=DET_AZIMUTH_ERR_274}, {application-record-element=DET_AZIMUTH_ERR_275, system-signal=DET_AZIMUTH_ERR_275}, {application-record-element=DET_AZIMUTH_ERR_276, system-signal=DET_AZIMUTH_ERR_276}, {application-record-element=DET_BELOW_RAIN_THOLD_273, system-signal=DET_BELOW_RAIN_THOLD_273}, {application-record-element=DET_BELOW_RAIN_THOLD_274, system-signal=DET_BELOW_RAIN_THOLD_274}, {application-record-element=DET_BELOW_RAIN_THOLD_275, system-signal=DET_BELOW_RAIN_THOLD_275}, {application-record-element=DET_BELOW_RAIN_THOLD_276, system-signal=DET_BELOW_RAIN_THOLD_276}, {application-record-element=DET_BI_STATIC_FLAG_273, system-signal=DET_BI_STATIC_FLAG_273}, {application-record-element=DET_BI_STATIC_FLAG_274, system-signal=DET_BI_STATIC_FLAG_274}, {application-record-element=DET_BI_STATIC_FLAG_275, system-signal=DET_BI_STATIC_FLAG_275}, {application-record-element=DET_BI_STATIC_FLAG_276, system-signal=DET_BI_STATIC_FLAG_276}, {application-record-element=DET_CONFD_AZIMUTH_273, system-signal=DET_CONFD_AZIMUTH_273}, {application-record-element=DET_CONFD_AZIMUTH_274, system-signal=DET_CONFD_AZIMUTH_274}, {application-record-element=DET_CONFD_AZIMUTH_275, system-signal=DET_CONFD_AZIMUTH_275}, {application-record-element=DET_CONFD_AZIMUTH_276, system-signal=DET_CONFD_AZIMUTH_276}, {application-record-element=DET_CONFD_ELEVATION_273, system-signal=DET_CONFD_ELEVATION_273}, {application-record-element=DET_CONFD_ELEVATION_274, system-signal=DET_CONFD_ELEVATION_274}, {application-record-element=DET_CONFD_ELEVATION_275, system-signal=DET_CONFD_ELEVATION_275}, {application-record-element=DET_CONFD_ELEVATION_276, system-signal=DET_CONFD_ELEVATION_276}, {application-record-element=DET_ELEVATION_273, system-signal=DET_ELEVATION_273}, {application-record-element=DET_ELEVATION_274, system-signal=DET_ELEVATION_274}, {application-record-element=DET_ELEVATION_275, system-signal=DET_ELEVATION_275}, {application-record-element=DET_ELEVATION_276, system-signal=DET_ELEVATION_276}, {application-record-element=DET_ELEVATION_ERR_273, system-signal=DET_ELEVATION_ERR_273}, {application-record-element=DET_ELEVATION_ERR_274, system-signal=DET_ELEVATION_ERR_274}, {application-record-element=DET_ELEVATION_ERR_275, system-signal=DET_ELEVATION_ERR_275}, {application-record-element=DET_ELEVATION_ERR_276, system-signal=DET_ELEVATION_ERR_276}, {application-record-element=DET_EXISTENCE_PROB_273, system-signal=DET_EXISTENCE_PROB_273}, {application-record-element=DET_EXISTENCE_PROB_274, system-signal=DET_EXISTENCE_PROB_274}, {application-record-element=DET_EXISTENCE_PROB_275, system-signal=DET_EXISTENCE_PROB_275}, {application-record-element=DET_EXISTENCE_PROB_276, system-signal=DET_EXISTENCE_PROB_276}, {application-record-element=DET_HVC_FLAG_273, system-signal=DET_HVC_FLAG_273}, {application-record-element=DET_HVC_FLAG_274, system-signal=DET_HVC_FLAG_274}, {application-record-element=DET_HVC_FLAG_275, system-signal=DET_HVC_FLAG_275}, {application-record-element=DET_HVC_FLAG_276, system-signal=DET_HVC_FLAG_276}, {application-record-element=DET_IDM_273, system-signal=DET_IDM_273}, {application-record-element=DET_IDM_274, system-signal=DET_IDM_274}, {application-record-element=DET_IDM_275, system-signal=DET_IDM_275}, {application-record-element=DET_IDM_276, system-signal=DET_IDM_276}, {application-record-element=DET_MH_CRC16_273_276, system-signal=DET_MH_CRC16_273_276}, {application-record-element=DET_MH_CYCLE_COUNTER_273_276, system-signal=DET_MH_CYCLE_COUNTER_273_276}, {application-record-element=DET_MH_SCAN_INDEX_4LSB_273_276, system-signal=DET_MH_SCAN_INDEX_4LSB_273_276}, {application-record-element=DET_MTD_273, system-signal=DET_MTD_273}, {application-record-element=DET_MTD_274, system-signal=DET_MTD_274}, {application-record-element=DET_MTD_275, system-signal=DET_MTD_275}, {application-record-element=DET_MTD_276, system-signal=DET_MTD_276}, {application-record-element=DET_PROB_1STAZHYPO_273, system-signal=DET_PROB_1STAZHYPO_273}, {application-record-element=DET_PROB_1STAZHYPO_274, system-signal=DET_PROB_1STAZHYPO_274}, {application-record-element=DET_PROB_1STAZHYPO_275, system-signal=DET_PROB_1STAZHYPO_275}, {application-record-element=DET_PROB_1STAZHYPO_276, system-signal=DET_PROB_1STAZHYPO_276}, {application-record-element=DET_RANGE_273, system-signal=DET_RANGE_273}, {application-record-element=DET_RANGE_274, system-signal=DET_RANGE_274}, {application-record-element=DET_RANGE_275, system-signal=DET_RANGE_275}, {application-record-element=DET_RANGE_276, system-signal=DET_RANGE_276}, {application-record-element=DET_RANGE_ERR_273, system-signal=DET_RANGE_ERR_273}, {application-record-element=DET_RANGE_ERR_274, system-signal=DET_RANGE_ERR_274}, {application-record-element=DET_RANGE_ERR_275, system-signal=DET_RANGE_ERR_275}, {application-record-element=DET_RANGE_ERR_276, system-signal=DET_RANGE_ERR_276}, {application-record-element=DET_RANGE_VELOCITY_273, system-signal=DET_RANGE_VELOCITY_273}, {application-record-element=DET_RANGE_VELOCITY_274, system-signal=DET_RANGE_VELOCITY_274}, {application-record-element=DET_RANGE_VELOCITY_275, system-signal=DET_RANGE_VELOCITY_275}, {application-record-element=DET_RANGE_VELOCITY_276, system-signal=DET_RANGE_VELOCITY_276}, {application-record-element=DET_RANGE_VELOCITY_ERR_273, system-signal=DET_RANGE_VELOCITY_ERR_273}, {application-record-element=DET_RANGE_VELOCITY_ERR_274, system-signal=DET_RANGE_VELOCITY_ERR_274}, {application-record-element=DET_RANGE_VELOCITY_ERR_275, system-signal=DET_RANGE_VELOCITY_ERR_275}, {application-record-element=DET_RANGE_VELOCITY_ERR_276, system-signal=DET_RANGE_VELOCITY_ERR_276}, {application-record-element=DET_RCS_273, system-signal=DET_RCS_273}, {application-record-element=DET_RCS_274, system-signal=DET_RCS_274}, {application-record-element=DET_RCS_275, system-signal=DET_RCS_275}, {application-record-element=DET_RCS_276, system-signal=DET_RCS_276}, {application-record-element=DET_SNR_273, system-signal=DET_SNR_273}, {application-record-element=DET_SNR_274, system-signal=DET_SNR_274}, {application-record-element=DET_SNR_275, system-signal=DET_SNR_275}, {application-record-element=DET_SNR_276, system-signal=DET_SNR_276}, {application-record-element=DET_SUPER_RES_TARGET_273, system-signal=DET_SUPER_RES_TARGET_273}, {application-record-element=DET_SUPER_RES_TARGET_274, system-signal=DET_SUPER_RES_TARGET_274}, {application-record-element=DET_SUPER_RES_TARGET_275, system-signal=DET_SUPER_RES_TARGET_275}, {application-record-element=DET_SUPER_RES_TARGET_276, system-signal=DET_SUPER_RES_TARGET_276}]}
        sender-receiver-to-signal-group-mapping={data-element=Pp_SG_Detections_277_280_AL.Vdp_SG_Detections_277_280_AL, signal-group=SG_Detections_277_280, type-mapping=sender-rec-record-type-mapping=record-element-mappings=[{application-record-element=DET_AZIMUTH_277, system-signal=DET_AZIMUTH_277}, {application-record-element=DET_AZIMUTH_278, system-signal=DET_AZIMUTH_278}, {application-record-element=DET_AZIMUTH_279, system-signal=DET_AZIMUTH_279}, {application-record-element=DET_AZIMUTH_280, system-signal=DET_AZIMUTH_280}, {application-record-element=DET_AZIMUTH_ERR_277, system-signal=DET_AZIMUTH_ERR_277}, {application-record-element=DET_AZIMUTH_ERR_278, system-signal=DET_AZIMUTH_ERR_278}, {application-record-element=DET_AZIMUTH_ERR_279, system-signal=DET_AZIMUTH_ERR_279}, {application-record-element=DET_AZIMUTH_ERR_280, system-signal=DET_AZIMUTH_ERR_280}, {application-record-element=DET_BELOW_RAIN_THOLD_277, system-signal=DET_BELOW_RAIN_THOLD_277}, {application-record-element=DET_BELOW_RAIN_THOLD_278, system-signal=DET_BELOW_RAIN_THOLD_278}, {application-record-element=DET_BELOW_RAIN_THOLD_279, system-signal=DET_BELOW_RAIN_THOLD_279}, {application-record-element=DET_BELOW_RAIN_THOLD_280, system-signal=DET_BELOW_RAIN_THOLD_280}, {application-record-element=DET_BI_STATIC_FLAG_277, system-signal=DET_BI_STATIC_FLAG_277}, {application-record-element=DET_BI_STATIC_FLAG_278, system-signal=DET_BI_STATIC_FLAG_278}, {application-record-element=DET_BI_STATIC_FLAG_279, system-signal=DET_BI_STATIC_FLAG_279}, {application-record-element=DET_BI_STATIC_FLAG_280, system-signal=DET_BI_STATIC_FLAG_280}, {application-record-element=DET_CONFD_AZIMUTH_277, system-signal=DET_CONFD_AZIMUTH_277}, {application-record-element=DET_CONFD_AZIMUTH_278, system-signal=DET_CONFD_AZIMUTH_278}, {application-record-element=DET_CONFD_AZIMUTH_279, system-signal=DET_CONFD_AZIMUTH_279}, {application-record-element=DET_CONFD_AZIMUTH_280, system-signal=DET_CONFD_AZIMUTH_280}, {application-record-element=DET_CONFD_ELEVATION_277, system-signal=DET_CONFD_ELEVATION_277}, {application-record-element=DET_CONFD_ELEVATION_278, system-signal=DET_CONFD_ELEVATION_278}, {application-record-element=DET_CONFD_ELEVATION_279, system-signal=DET_CONFD_ELEVATION_279}, {application-record-element=DET_CONFD_ELEVATION_280, system-signal=DET_CONFD_ELEVATION_280}, {application-record-element=DET_ELEVATION_277, system-signal=DET_ELEVATION_277}, {application-record-element=DET_ELEVATION_278, system-signal=DET_ELEVATION_278}, {application-record-element=DET_ELEVATION_279, system-signal=DET_ELEVATION_279}, {application-record-element=DET_ELEVATION_280, system-signal=DET_ELEVATION_280}, {application-record-element=DET_ELEVATION_ERR_277, system-signal=DET_ELEVATION_ERR_277}, {application-record-element=DET_ELEVATION_ERR_278, system-signal=DET_ELEVATION_ERR_278}, {application-record-element=DET_ELEVATION_ERR_279, system-signal=DET_ELEVATION_ERR_279}, {application-record-element=DET_ELEVATION_ERR_280, system-signal=DET_ELEVATION_ERR_280}, {application-record-element=DET_EXISTENCE_PROB_277, system-signal=DET_EXISTENCE_PROB_277}, {application-record-element=DET_EXISTENCE_PROB_278, system-signal=DET_EXISTENCE_PROB_278}, {application-record-element=DET_EXISTENCE_PROB_279, system-signal=DET_EXISTENCE_PROB_279}, {application-record-element=DET_EXISTENCE_PROB_280, system-signal=DET_EXISTENCE_PROB_280}, {application-record-element=DET_HVC_FLAG_277, system-signal=DET_HVC_FLAG_277}, {application-record-element=DET_HVC_FLAG_278, system-signal=DET_HVC_FLAG_278}, {application-record-element=DET_HVC_FLAG_279, system-signal=DET_HVC_FLAG_279}, {application-record-element=DET_HVC_FLAG_280, system-signal=DET_HVC_FLAG_280}, {application-record-element=DET_IDM_277, system-signal=DET_IDM_277}, {application-record-element=DET_IDM_278, system-signal=DET_IDM_278}, {application-record-element=DET_IDM_279, system-signal=DET_IDM_279}, {application-record-element=DET_IDM_280, system-signal=DET_IDM_280}, {application-record-element=DET_MH_CRC16_277_280, system-signal=DET_MH_CRC16_277_280}, {application-record-element=DET_MH_CYCLE_COUNTER_277_280, system-signal=DET_MH_CYCLE_COUNTER_277_280}, {application-record-element=DET_MH_SCAN_INDEX_4LSB_277_280, system-signal=DET_MH_SCAN_INDEX_4LSB_277_280}, {application-record-element=DET_MTD_277, system-signal=DET_MTD_277}, {application-record-element=DET_MTD_278, system-signal=DET_MTD_278}, {application-record-element=DET_MTD_279, system-signal=DET_MTD_279}, {application-record-element=DET_MTD_280, system-signal=DET_MTD_280}, {application-record-element=DET_PROB_1STAZHYPO_277, system-signal=DET_PROB_1STAZHYPO_277}, {application-record-element=DET_PROB_1STAZHYPO_278, system-signal=DET_PROB_1STAZHYPO_278}, {application-record-element=DET_PROB_1STAZHYPO_279, system-signal=DET_PROB_1STAZHYPO_279}, {application-record-element=DET_PROB_1STAZHYPO_280, system-signal=DET_PROB_1STAZHYPO_280}, {application-record-element=DET_RANGE_277, system-signal=DET_RANGE_277}, {application-record-element=DET_RANGE_278, system-signal=DET_RANGE_278}, {application-record-element=DET_RANGE_279, system-signal=DET_RANGE_279}, {application-record-element=DET_RANGE_280, system-signal=DET_RANGE_280}, {application-record-element=DET_RANGE_ERR_277, system-signal=DET_RANGE_ERR_277}, {application-record-element=DET_RANGE_ERR_278, system-signal=DET_RANGE_ERR_278}, {application-record-element=DET_RANGE_ERR_279, system-signal=DET_RANGE_ERR_279}, {application-record-element=DET_RANGE_ERR_280, system-signal=DET_RANGE_ERR_280}, {application-record-element=DET_RANGE_VELOCITY_277, system-signal=DET_RANGE_VELOCITY_277}, {application-record-element=DET_RANGE_VELOCITY_278, system-signal=DET_RANGE_VELOCITY_278}, {application-record-element=DET_RANGE_VELOCITY_279, system-signal=DET_RANGE_VELOCITY_279}, {application-record-element=DET_RANGE_VELOCITY_280, system-signal=DET_RANGE_VELOCITY_280}, {application-record-element=DET_RANGE_VELOCITY_ERR_277, system-signal=DET_RANGE_VELOCITY_ERR_277}, {application-record-element=DET_RANGE_VELOCITY_ERR_278, system-signal=DET_RANGE_VELOCITY_ERR_278}, {application-record-element=DET_RANGE_VELOCITY_ERR_279, system-signal=DET_RANGE_VELOCITY_ERR_279}, {application-record-element=DET_RANGE_VELOCITY_ERR_280, system-signal=DET_RANGE_VELOCITY_ERR_280}, {application-record-element=DET_RCS_277, system-signal=DET_RCS_277}, {application-record-element=DET_RCS_278, system-signal=DET_RCS_278}, {application-record-element=DET_RCS_279, system-signal=DET_RCS_279}, {application-record-element=DET_RCS_280, system-signal=DET_RCS_280}, {application-record-element=DET_SNR_277, system-signal=DET_SNR_277}, {application-record-element=DET_SNR_278, system-signal=DET_SNR_278}, {application-record-element=DET_SNR_279, system-signal=DET_SNR_279}, {application-record-element=DET_SNR_280, system-signal=DET_SNR_280}, {application-record-element=DET_SUPER_RES_TARGET_277, system-signal=DET_SUPER_RES_TARGET_277}, {application-record-element=DET_SUPER_RES_TARGET_278, system-signal=DET_SUPER_RES_TARGET_278}, {application-record-element=DET_SUPER_RES_TARGET_279, system-signal=DET_SUPER_RES_TARGET_279}, {application-record-element=DET_SUPER_RES_TARGET_280, system-signal=DET_SUPER_RES_TARGET_280}]}
        sender-receiver-to-signal-group-mapping={data-element=Pp_SG_Detections_281_284_AL.Vdp_SG_Detections_281_284_AL, signal-group=SG_Detections_281_284, type-mapping=sender-rec-record-type-mapping=record-element-mappings=[{application-record-element=DET_AZIMUTH_281, system-signal=DET_AZIMUTH_281}, {application-record-element=DET_AZIMUTH_282, system-signal=DET_AZIMUTH_282}, {application-record-element=DET_AZIMUTH_283, system-signal=DET_AZIMUTH_283}, {application-record-element=DET_AZIMUTH_284, system-signal=DET_AZIMUTH_284}, {application-record-element=DET_AZIMUTH_ERR_281, system-signal=DET_AZIMUTH_ERR_281}, {application-record-element=DET_AZIMUTH_ERR_282, system-signal=DET_AZIMUTH_ERR_282}, {application-record-element=DET_AZIMUTH_ERR_283, system-signal=DET_AZIMUTH_ERR_283}, {application-record-element=DET_AZIMUTH_ERR_284, system-signal=DET_AZIMUTH_ERR_284}, {application-record-element=DET_BELOW_RAIN_THOLD_281, system-signal=DET_BELOW_RAIN_THOLD_281}, {application-record-element=DET_BELOW_RAIN_THOLD_282, system-signal=DET_BELOW_RAIN_THOLD_282}, {application-record-element=DET_BELOW_RAIN_THOLD_283, system-signal=DET_BELOW_RAIN_THOLD_283}, {application-record-element=DET_BELOW_RAIN_THOLD_284, system-signal=DET_BELOW_RAIN_THOLD_284}, {application-record-element=DET_BI_STATIC_FLAG_281, system-signal=DET_BI_STATIC_FLAG_281}, {application-record-element=DET_BI_STATIC_FLAG_282, system-signal=DET_BI_STATIC_FLAG_282}, {application-record-element=DET_BI_STATIC_FLAG_283, system-signal=DET_BI_STATIC_FLAG_283}, {application-record-element=DET_BI_STATIC_FLAG_284, system-signal=DET_BI_STATIC_FLAG_284}, {application-record-element=DET_CONFD_AZIMUTH_281, system-signal=DET_CONFD_AZIMUTH_281}, {application-record-element=DET_CONFD_AZIMUTH_282, system-signal=DET_CONFD_AZIMUTH_282}, {application-record-element=DET_CONFD_AZIMUTH_283, system-signal=DET_CONFD_AZIMUTH_283}, {application-record-element=DET_CONFD_AZIMUTH_284, system-signal=DET_CONFD_AZIMUTH_284}, {application-record-element=DET_CONFD_ELEVATION_281, system-signal=DET_CONFD_ELEVATION_281}, {application-record-element=DET_CONFD_ELEVATION_282, system-signal=DET_CONFD_ELEVATION_282}, {application-record-element=DET_CONFD_ELEVATION_283, system-signal=DET_CONFD_ELEVATION_283}, {application-record-element=DET_CONFD_ELEVATION_284, system-signal=DET_CONFD_ELEVATION_284}, {application-record-element=DET_ELEVATION_281, system-signal=DET_ELEVATION_281}, {application-record-element=DET_ELEVATION_282, system-signal=DET_ELEVATION_282}, {application-record-element=DET_ELEVATION_283, system-signal=DET_ELEVATION_283}, {application-record-element=DET_ELEVATION_284, system-signal=DET_ELEVATION_284}, {application-record-element=DET_ELEVATION_ERR_281, system-signal=DET_ELEVATION_ERR_281}, {application-record-element=DET_ELEVATION_ERR_282, system-signal=DET_ELEVATION_ERR_282}, {application-record-element=DET_ELEVATION_ERR_283, system-signal=DET_ELEVATION_ERR_283}, {application-record-element=DET_ELEVATION_ERR_284, system-signal=DET_ELEVATION_ERR_284}, {application-record-element=DET_EXISTENCE_PROB_281, system-signal=DET_EXISTENCE_PROB_281}, {application-record-element=DET_EXISTENCE_PROB_282, system-signal=DET_EXISTENCE_PROB_282}, {application-record-element=DET_EXISTENCE_PROB_283, system-signal=DET_EXISTENCE_PROB_283}, {application-record-element=DET_EXISTENCE_PROB_284, system-signal=DET_EXISTENCE_PROB_284}, {application-record-element=DET_HVC_FLAG_281, system-signal=DET_HVC_FLAG_281}, {application-record-element=DET_HVC_FLAG_282, system-signal=DET_HVC_FLAG_282}, {application-record-element=DET_HVC_FLAG_283, system-signal=DET_HVC_FLAG_283}, {application-record-element=DET_HVC_FLAG_284, system-signal=DET_HVC_FLAG_284}, {application-record-element=DET_IDM_281, system-signal=DET_IDM_281}, {application-record-element=DET_IDM_282, system-signal=DET_IDM_282}, {application-record-element=DET_IDM_283, system-signal=DET_IDM_283}, {application-record-element=DET_IDM_284, system-signal=DET_IDM_284}, {application-record-element=DET_MH_CRC16_281_284, system-signal=DET_MH_CRC16_281_284}, {application-record-element=DET_MH_CYCLE_COUNTER_281_284, system-signal=DET_MH_CYCLE_COUNTER_281_284}, {application-record-element=DET_MH_SCAN_INDEX_4LSB_281_284, system-signal=DET_MH_SCAN_INDEX_4LSB_281_284}, {application-record-element=DET_MTD_281, system-signal=DET_MTD_281}, {application-record-element=DET_MTD_282, system-signal=DET_MTD_282}, {application-record-element=DET_MTD_283, system-signal=DET_MTD_283}, {application-record-element=DET_MTD_284, system-signal=DET_MTD_284}, {application-record-element=DET_PROB_1STAZHYPO_281, system-signal=DET_PROB_1STAZHYPO_281}, {application-record-element=DET_PROB_1STAZHYPO_282, system-signal=DET_PROB_1STAZHYPO_282}, {application-record-element=DET_PROB_1STAZHYPO_283, system-signal=DET_PROB_1STAZHYPO_283}, {application-record-element=DET_PROB_1STAZHYPO_284, system-signal=DET_PROB_1STAZHYPO_284}, {application-record-element=DET_RANGE_281, system-signal=DET_RANGE_281}, {application-record-element=DET_RANGE_282, system-signal=DET_RANGE_282}, {application-record-element=DET_RANGE_283, system-signal=DET_RANGE_283}, {application-record-element=DET_RANGE_284, system-signal=DET_RANGE_284}, {application-record-element=DET_RANGE_ERR_281, system-signal=DET_RANGE_ERR_281}, {application-record-element=DET_RANGE_ERR_282, system-signal=DET_RANGE_ERR_282}, {application-record-element=DET_RANGE_ERR_283, system-signal=DET_RANGE_ERR_283}, {application-record-element=DET_RANGE_ERR_284, system-signal=DET_RANGE_ERR_284}, {application-record-element=DET_RANGE_VELOCITY_281, system-signal=DET_RANGE_VELOCITY_281}, {application-record-element=DET_RANGE_VELOCITY_282, system-signal=DET_RANGE_VELOCITY_282}, {application-record-element=DET_RANGE_VELOCITY_283, system-signal=DET_RANGE_VELOCITY_283}, {application-record-element=DET_RANGE_VELOCITY_284, system-signal=DET_RANGE_VELOCITY_284}, {application-record-element=DET_RANGE_VELOCITY_ERR_281, system-signal=DET_RANGE_VELOCITY_ERR_281}, {application-record-element=DET_RANGE_VELOCITY_ERR_282, system-signal=DET_RANGE_VELOCITY_ERR_282}, {application-record-element=DET_RANGE_VELOCITY_ERR_283, system-signal=DET_RANGE_VELOCITY_ERR_283}, {application-record-element=DET_RANGE_VELOCITY_ERR_284, system-signal=DET_RANGE_VELOCITY_ERR_284}, {application-record-element=DET_RCS_281, system-signal=DET_RCS_281}, {application-record-element=DET_RCS_282, system-signal=DET_RCS_282}, {application-record-element=DET_RCS_283, system-signal=DET_RCS_283}, {application-record-element=DET_RCS_284, system-signal=DET_RCS_284}, {application-record-element=DET_SNR_281, system-signal=DET_SNR_281}, {application-record-element=DET_SNR_282, system-signal=DET_SNR_282}, {application-record-element=DET_SNR_283, system-signal=DET_SNR_283}, {application-record-element=DET_SNR_284, system-signal=DET_SNR_284}, {application-record-element=DET_SUPER_RES_TARGET_281, system-signal=DET_SUPER_RES_TARGET_281}, {application-record-element=DET_SUPER_RES_TARGET_282, system-signal=DET_SUPER_RES_TARGET_282}, {application-record-element=DET_SUPER_RES_TARGET_283, system-signal=DET_SUPER_RES_TARGET_283}, {application-record-element=DET_SUPER_RES_TARGET_284, system-signal=DET_SUPER_RES_TARGET_284}]}
        sender-receiver-to-signal-group-mapping={data-element=Pp_SG_Detections_285_288_AL.Vdp_SG_Detections_285_288_AL, signal-group=SG_Detections_285_288, type-mapping=sender-rec-record-type-mapping=record-element-mappings=[{application-record-element=DET_AZIMUTH_285, system-signal=DET_AZIMUTH_285}, {application-record-element=DET_AZIMUTH_286, system-signal=DET_AZIMUTH_286}, {application-record-element=DET_AZIMUTH_287, system-signal=DET_AZIMUTH_287}, {application-record-element=DET_AZIMUTH_288, system-signal=DET_AZIMUTH_288}, {application-record-element=DET_AZIMUTH_ERR_285, system-signal=DET_AZIMUTH_ERR_285}, {application-record-element=DET_AZIMUTH_ERR_286, system-signal=DET_AZIMUTH_ERR_286}, {application-record-element=DET_AZIMUTH_ERR_287, system-signal=DET_AZIMUTH_ERR_287}, {application-record-element=DET_AZIMUTH_ERR_288, system-signal=DET_AZIMUTH_ERR_288}, {application-record-element=DET_BELOW_RAIN_THOLD_285, system-signal=DET_BELOW_RAIN_THOLD_285}, {application-record-element=DET_BELOW_RAIN_THOLD_286, system-signal=DET_BELOW_RAIN_THOLD_286}, {application-record-element=DET_BELOW_RAIN_THOLD_287, system-signal=DET_BELOW_RAIN_THOLD_287}, {application-record-element=DET_BELOW_RAIN_THOLD_288, system-signal=DET_BELOW_RAIN_THOLD_288}, {application-record-element=DET_BI_STATIC_FLAG_285, system-signal=DET_BI_STATIC_FLAG_285}, {application-record-element=DET_BI_STATIC_FLAG_286, system-signal=DET_BI_STATIC_FLAG_286}, {application-record-element=DET_BI_STATIC_FLAG_287, system-signal=DET_BI_STATIC_FLAG_287}, {application-record-element=DET_BI_STATIC_FLAG_288, system-signal=DET_BI_STATIC_FLAG_288}, {application-record-element=DET_CONFD_AZIMUTH_285, system-signal=DET_CONFD_AZIMUTH_285}, {application-record-element=DET_CONFD_AZIMUTH_286, system-signal=DET_CONFD_AZIMUTH_286}, {application-record-element=DET_CONFD_AZIMUTH_287, system-signal=DET_CONFD_AZIMUTH_287}, {application-record-element=DET_CONFD_AZIMUTH_288, system-signal=DET_CONFD_AZIMUTH_288}, {application-record-element=DET_CONFD_ELEVATION_285, system-signal=DET_CONFD_ELEVATION_285}, {application-record-element=DET_CONFD_ELEVATION_286, system-signal=DET_CONFD_ELEVATION_286}, {application-record-element=DET_CONFD_ELEVATION_287, system-signal=DET_CONFD_ELEVATION_287}, {application-record-element=DET_CONFD_ELEVATION_288, system-signal=DET_CONFD_ELEVATION_288}, {application-record-element=DET_ELEVATION_285, system-signal=DET_ELEVATION_285}, {application-record-element=DET_ELEVATION_286, system-signal=DET_ELEVATION_286}, {application-record-element=DET_ELEVATION_287, system-signal=DET_ELEVATION_287}, {application-record-element=DET_ELEVATION_288, system-signal=DET_ELEVATION_288}, {application-record-element=DET_ELEVATION_ERR_285, system-signal=DET_ELEVATION_ERR_285}, {application-record-element=DET_ELEVATION_ERR_286, system-signal=DET_ELEVATION_ERR_286}, {application-record-element=DET_ELEVATION_ERR_287, system-signal=DET_ELEVATION_ERR_287}, {application-record-element=DET_ELEVATION_ERR_288, system-signal=DET_ELEVATION_ERR_288}, {application-record-element=DET_EXISTENCE_PROB_285, system-signal=DET_EXISTENCE_PROB_285}, {application-record-element=DET_EXISTENCE_PROB_286, system-signal=DET_EXISTENCE_PROB_286}, {application-record-element=DET_EXISTENCE_PROB_287, system-signal=DET_EXISTENCE_PROB_287}, {application-record-element=DET_EXISTENCE_PROB_288, system-signal=DET_EXISTENCE_PROB_288}, {application-record-element=DET_HVC_FLAG_285, system-signal=DET_HVC_FLAG_285}, {application-record-element=DET_HVC_FLAG_286, system-signal=DET_HVC_FLAG_286}, {application-record-element=DET_HVC_FLAG_287, system-signal=DET_HVC_FLAG_287}, {application-record-element=DET_HVC_FLAG_288, system-signal=DET_HVC_FLAG_288}, {application-record-element=DET_IDM_285, system-signal=DET_IDM_285}, {application-record-element=DET_IDM_286, system-signal=DET_IDM_286}, {application-record-element=DET_IDM_287, system-signal=DET_IDM_287}, {application-record-element=DET_IDM_288, system-signal=DET_IDM_288}, {application-record-element=DET_MH_CRC16_285_288, system-signal=DET_MH_CRC16_285_288}, {application-record-element=DET_MH_CYCLE_COUNTER_285_288, system-signal=DET_MH_CYCLE_COUNTER_285_288}, {application-record-element=DET_MH_SCAN_INDEX_4LSB_285_288, system-signal=DET_MH_SCAN_INDEX_4LSB_285_288}, {application-record-element=DET_MTD_285, system-signal=DET_MTD_285}, {application-record-element=DET_MTD_286, system-signal=DET_MTD_286}, {application-record-element=DET_MTD_287, system-signal=DET_MTD_287}, {application-record-element=DET_MTD_288, system-signal=DET_MTD_288}, {application-record-element=DET_PROB_1STAZHYPO_285, system-signal=DET_PROB_1STAZHYPO_285}, {application-record-element=DET_PROB_1STAZHYPO_286, system-signal=DET_PROB_1STAZHYPO_286}, {application-record-element=DET_PROB_1STAZHYPO_287, system-signal=DET_PROB_1STAZHYPO_287}, {application-record-element=DET_PROB_1STAZHYPO_288, system-signal=DET_PROB_1STAZHYPO_288}, {application-record-element=DET_RANGE_285, system-signal=DET_RANGE_285}, {application-record-element=DET_RANGE_286, system-signal=DET_RANGE_286}, {application-record-element=DET_RANGE_287, system-signal=DET_RANGE_287}, {application-record-element=DET_RANGE_288, system-signal=DET_RANGE_288}, {application-record-element=DET_RANGE_ERR_285, system-signal=DET_RANGE_ERR_285}, {application-record-element=DET_RANGE_ERR_286, system-signal=DET_RANGE_ERR_286}, {application-record-element=DET_RANGE_ERR_287, system-signal=DET_RANGE_ERR_287}, {application-record-element=DET_RANGE_ERR_288, system-signal=DET_RANGE_ERR_288}, {application-record-element=DET_RANGE_VELOCITY_285, system-signal=DET_RANGE_VELOCITY_285}, {application-record-element=DET_RANGE_VELOCITY_286, system-signal=DET_RANGE_VELOCITY_286}, {application-record-element=DET_RANGE_VELOCITY_287, system-signal=DET_RANGE_VELOCITY_287}, {application-record-element=DET_RANGE_VELOCITY_288, system-signal=DET_RANGE_VELOCITY_288}, {application-record-element=DET_RANGE_VELOCITY_ERR_285, system-signal=DET_RANGE_VELOCITY_ERR_285}, {application-record-element=DET_RANGE_VELOCITY_ERR_286, system-signal=DET_RANGE_VELOCITY_ERR_286}, {application-record-element=DET_RANGE_VELOCITY_ERR_287, system-signal=DET_RANGE_VELOCITY_ERR_287}, {application-record-element=DET_RANGE_VELOCITY_ERR_288, system-signal=DET_RANGE_VELOCITY_ERR_288}, {application-record-element=DET_RCS_285, system-signal=DET_RCS_285}, {application-record-element=DET_RCS_286, system-signal=DET_RCS_286}, {application-record-element=DET_RCS_287, system-signal=DET_RCS_287}, {application-record-element=DET_RCS_288, system-signal=DET_RCS_288}, {application-record-element=DET_SNR_285, system-signal=DET_SNR_285}, {application-record-element=DET_SNR_286, system-signal=DET_SNR_286}, {application-record-element=DET_SNR_287, system-signal=DET_SNR_287}, {application-record-element=DET_SNR_288, system-signal=DET_SNR_288}, {application-record-element=DET_SUPER_RES_TARGET_285, system-signal=DET_SUPER_RES_TARGET_285}, {application-record-element=DET_SUPER_RES_TARGET_286, system-signal=DET_SUPER_RES_TARGET_286}, {application-record-element=DET_SUPER_RES_TARGET_287, system-signal=DET_SUPER_RES_TARGET_287}, {application-record-element=DET_SUPER_RES_TARGET_288, system-signal=DET_SUPER_RES_TARGET_288}]}
        sender-receiver-to-signal-group-mapping={data-element=Pp_SG_Detections_289_292_AL.Vdp_SG_Detections_289_292_AL, signal-group=SG_Detections_289_292, type-mapping=sender-rec-record-type-mapping=record-element-mappings=[{application-record-element=DET_AZIMUTH_289, system-signal=DET_AZIMUTH_289}, {application-record-element=DET_AZIMUTH_290, system-signal=DET_AZIMUTH_290}, {application-record-element=DET_AZIMUTH_291, system-signal=DET_AZIMUTH_291}, {application-record-element=DET_AZIMUTH_292, system-signal=DET_AZIMUTH_292}, {application-record-element=DET_AZIMUTH_ERR_289, system-signal=DET_AZIMUTH_ERR_289}, {application-record-element=DET_AZIMUTH_ERR_290, system-signal=DET_AZIMUTH_ERR_290}, {application-record-element=DET_AZIMUTH_ERR_291, system-signal=DET_AZIMUTH_ERR_291}, {application-record-element=DET_AZIMUTH_ERR_292, system-signal=DET_AZIMUTH_ERR_292}, {application-record-element=DET_BELOW_RAIN_THOLD_289, system-signal=DET_BELOW_RAIN_THOLD_289}, {application-record-element=DET_BELOW_RAIN_THOLD_290, system-signal=DET_BELOW_RAIN_THOLD_290}, {application-record-element=DET_BELOW_RAIN_THOLD_291, system-signal=DET_BELOW_RAIN_THOLD_291}, {application-record-element=DET_BELOW_RAIN_THOLD_292, system-signal=DET_BELOW_RAIN_THOLD_292}, {application-record-element=DET_BI_STATIC_FLAG_289, system-signal=DET_BI_STATIC_FLAG_289}, {application-record-element=DET_BI_STATIC_FLAG_290, system-signal=DET_BI_STATIC_FLAG_290}, {application-record-element=DET_BI_STATIC_FLAG_291, system-signal=DET_BI_STATIC_FLAG_291}, {application-record-element=DET_BI_STATIC_FLAG_292, system-signal=DET_BI_STATIC_FLAG_292}, {application-record-element=DET_CONFD_AZIMUTH_289, system-signal=DET_CONFD_AZIMUTH_289}, {application-record-element=DET_CONFD_AZIMUTH_290, system-signal=DET_CONFD_AZIMUTH_290}, {application-record-element=DET_CONFD_AZIMUTH_291, system-signal=DET_CONFD_AZIMUTH_291}, {application-record-element=DET_CONFD_AZIMUTH_292, system-signal=DET_CONFD_AZIMUTH_292}, {application-record-element=DET_CONFD_ELEVATION_289, system-signal=DET_CONFD_ELEVATION_289}, {application-record-element=DET_CONFD_ELEVATION_290, system-signal=DET_CONFD_ELEVATION_290}, {application-record-element=DET_CONFD_ELEVATION_291, system-signal=DET_CONFD_ELEVATION_291}, {application-record-element=DET_CONFD_ELEVATION_292, system-signal=DET_CONFD_ELEVATION_292}, {application-record-element=DET_ELEVATION_289, system-signal=DET_ELEVATION_289}, {application-record-element=DET_ELEVATION_290, system-signal=DET_ELEVATION_290}, {application-record-element=DET_ELEVATION_291, system-signal=DET_ELEVATION_291}, {application-record-element=DET_ELEVATION_292, system-signal=DET_ELEVATION_292}, {application-record-element=DET_ELEVATION_ERR_289, system-signal=DET_ELEVATION_ERR_289}, {application-record-element=DET_ELEVATION_ERR_290, system-signal=DET_ELEVATION_ERR_290}, {application-record-element=DET_ELEVATION_ERR_291, system-signal=DET_ELEVATION_ERR_291}, {application-record-element=DET_ELEVATION_ERR_292, system-signal=DET_ELEVATION_ERR_292}, {application-record-element=DET_EXISTENCE_PROB_289, system-signal=DET_EXISTENCE_PROB_289}, {application-record-element=DET_EXISTENCE_PROB_290, system-signal=DET_EXISTENCE_PROB_290}, {application-record-element=DET_EXISTENCE_PROB_291, system-signal=DET_EXISTENCE_PROB_291}, {application-record-element=DET_EXISTENCE_PROB_292, system-signal=DET_EXISTENCE_PROB_292}, {application-record-element=DET_HVC_FLAG_289, system-signal=DET_HVC_FLAG_289}, {application-record-element=DET_HVC_FLAG_290, system-signal=DET_HVC_FLAG_290}, {application-record-element=DET_HVC_FLAG_291, system-signal=DET_HVC_FLAG_291}, {application-record-element=DET_HVC_FLAG_292, system-signal=DET_HVC_FLAG_292}, {application-record-element=DET_IDM_289, system-signal=DET_IDM_289}, {application-record-element=DET_IDM_290, system-signal=DET_IDM_290}, {application-record-element=DET_IDM_291, system-signal=DET_IDM_291}, {application-record-element=DET_IDM_292, system-signal=DET_IDM_292}, {application-record-element=DET_MH_CRC16_289_292, system-signal=DET_MH_CRC16_289_292}, {application-record-element=DET_MH_CYCLE_COUNTER_289_292, system-signal=DET_MH_CYCLE_COUNTER_289_292}, {application-record-element=DET_MH_SCAN_INDEX_4LSB_289_292, system-signal=DET_MH_SCAN_INDEX_4LSB_289_292}, {application-record-element=DET_MTD_289, system-signal=DET_MTD_289}, {application-record-element=DET_MTD_290, system-signal=DET_MTD_290}, {application-record-element=DET_MTD_291, system-signal=DET_MTD_291}, {application-record-element=DET_MTD_292, system-signal=DET_MTD_292}, {application-record-element=DET_PROB_1STAZHYPO_289, system-signal=DET_PROB_1STAZHYPO_289}, {application-record-element=DET_PROB_1STAZHYPO_290, system-signal=DET_PROB_1STAZHYPO_290}, {application-record-element=DET_PROB_1STAZHYPO_291, system-signal=DET_PROB_1STAZHYPO_291}, {application-record-element=DET_PROB_1STAZHYPO_292, system-signal=DET_PROB_1STAZHYPO_292}, {application-record-element=DET_RANGE_289, system-signal=DET_RANGE_289}, {application-record-element=DET_RANGE_290, system-signal=DET_RANGE_290}, {application-record-element=DET_RANGE_291, system-signal=DET_RANGE_291}, {application-record-element=DET_RANGE_292, system-signal=DET_RANGE_292}, {application-record-element=DET_RANGE_ERR_289, system-signal=DET_RANGE_ERR_289}, {application-record-element=DET_RANGE_ERR_290, system-signal=DET_RANGE_ERR_290}, {application-record-element=DET_RANGE_ERR_291, system-signal=DET_RANGE_ERR_291}, {application-record-element=DET_RANGE_ERR_292, system-signal=DET_RANGE_ERR_292}, {application-record-element=DET_RANGE_VELOCITY_289, system-signal=DET_RANGE_VELOCITY_289}, {application-record-element=DET_RANGE_VELOCITY_290, system-signal=DET_RANGE_VELOCITY_290}, {application-record-element=DET_RANGE_VELOCITY_291, system-signal=DET_RANGE_VELOCITY_291}, {application-record-element=DET_RANGE_VELOCITY_292, system-signal=DET_RANGE_VELOCITY_292}, {application-record-element=DET_RANGE_VELOCITY_ERR_289, system-signal=DET_RANGE_VELOCITY_ERR_289}, {application-record-element=DET_RANGE_VELOCITY_ERR_290, system-signal=DET_RANGE_VELOCITY_ERR_290}, {application-record-element=DET_RANGE_VELOCITY_ERR_291, system-signal=DET_RANGE_VELOCITY_ERR_291}, {application-record-element=DET_RANGE_VELOCITY_ERR_292, system-signal=DET_RANGE_VELOCITY_ERR_292}, {application-record-element=DET_RCS_289, system-signal=DET_RCS_289}, {application-record-element=DET_RCS_290, system-signal=DET_RCS_290}, {application-record-element=DET_RCS_291, system-signal=DET_RCS_291}, {application-record-element=DET_RCS_292, system-signal=DET_RCS_292}, {application-record-element=DET_SNR_289, system-signal=DET_SNR_289}, {application-record-element=DET_SNR_290, system-signal=DET_SNR_290}, {application-record-element=DET_SNR_291, system-signal=DET_SNR_291}, {application-record-element=DET_SNR_292, system-signal=DET_SNR_292}, {application-record-element=DET_SUPER_RES_TARGET_289, system-signal=DET_SUPER_RES_TARGET_289}, {application-record-element=DET_SUPER_RES_TARGET_290, system-signal=DET_SUPER_RES_TARGET_290}, {application-record-element=DET_SUPER_RES_TARGET_291, system-signal=DET_SUPER_RES_TARGET_291}, {application-record-element=DET_SUPER_RES_TARGET_292, system-signal=DET_SUPER_RES_TARGET_292}]}
        sender-receiver-to-signal-group-mapping={data-element=Pp_SG_Detections_293_296_AL.Vdp_SG_Detections_293_296_AL, signal-group=SG_Detections_293_296, type-mapping=sender-rec-record-type-mapping=record-element-mappings=[{application-record-element=DET_AZIMUTH_293, system-signal=DET_AZIMUTH_293}, {application-record-element=DET_AZIMUTH_294, system-signal=DET_AZIMUTH_294}, {application-record-element=DET_AZIMUTH_295, system-signal=DET_AZIMUTH_295}, {application-record-element=DET_AZIMUTH_296, system-signal=DET_AZIMUTH_296}, {application-record-element=DET_AZIMUTH_ERR_293, system-signal=DET_AZIMUTH_ERR_293}, {application-record-element=DET_AZIMUTH_ERR_294, system-signal=DET_AZIMUTH_ERR_294}, {application-record-element=DET_AZIMUTH_ERR_295, system-signal=DET_AZIMUTH_ERR_295}, {application-record-element=DET_AZIMUTH_ERR_296, system-signal=DET_AZIMUTH_ERR_296}, {application-record-element=DET_BELOW_RAIN_THOLD_293, system-signal=DET_BELOW_RAIN_THOLD_293}, {application-record-element=DET_BELOW_RAIN_THOLD_294, system-signal=DET_BELOW_RAIN_THOLD_294}, {application-record-element=DET_BELOW_RAIN_THOLD_295, system-signal=DET_BELOW_RAIN_THOLD_295}, {application-record-element=DET_BELOW_RAIN_THOLD_296, system-signal=DET_BELOW_RAIN_THOLD_296}, {application-record-element=DET_BI_STATIC_FLAG_293, system-signal=DET_BI_STATIC_FLAG_293}, {application-record-element=DET_BI_STATIC_FLAG_294, system-signal=DET_BI_STATIC_FLAG_294}, {application-record-element=DET_BI_STATIC_FLAG_295, system-signal=DET_BI_STATIC_FLAG_295}, {application-record-element=DET_BI_STATIC_FLAG_296, system-signal=DET_BI_STATIC_FLAG_296}, {application-record-element=DET_CONFD_AZIMUTH_293, system-signal=DET_CONFD_AZIMUTH_293}, {application-record-element=DET_CONFD_AZIMUTH_294, system-signal=DET_CONFD_AZIMUTH_294}, {application-record-element=DET_CONFD_AZIMUTH_295, system-signal=DET_CONFD_AZIMUTH_295}, {application-record-element=DET_CONFD_AZIMUTH_296, system-signal=DET_CONFD_AZIMUTH_296}, {application-record-element=DET_CONFD_ELEVATION_293, system-signal=DET_CONFD_ELEVATION_293}, {application-record-element=DET_CONFD_ELEVATION_294, system-signal=DET_CONFD_ELEVATION_294}, {application-record-element=DET_CONFD_ELEVATION_295, system-signal=DET_CONFD_ELEVATION_295}, {application-record-element=DET_CONFD_ELEVATION_296, system-signal=DET_CONFD_ELEVATION_296}, {application-record-element=DET_ELEVATION_293, system-signal=DET_ELEVATION_293}, {application-record-element=DET_ELEVATION_294, system-signal=DET_ELEVATION_294}, {application-record-element=DET_ELEVATION_295, system-signal=DET_ELEVATION_295}, {application-record-element=DET_ELEVATION_296, system-signal=DET_ELEVATION_296}, {application-record-element=DET_ELEVATION_ERR_293, system-signal=DET_ELEVATION_ERR_293}, {application-record-element=DET_ELEVATION_ERR_294, system-signal=DET_ELEVATION_ERR_294}, {application-record-element=DET_ELEVATION_ERR_295, system-signal=DET_ELEVATION_ERR_295}, {application-record-element=DET_ELEVATION_ERR_296, system-signal=DET_ELEVATION_ERR_296}, {application-record-element=DET_EXISTENCE_PROB_293, system-signal=DET_EXISTENCE_PROB_293}, {application-record-element=DET_EXISTENCE_PROB_294, system-signal=DET_EXISTENCE_PROB_294}, {application-record-element=DET_EXISTENCE_PROB_295, system-signal=DET_EXISTENCE_PROB_295}, {application-record-element=DET_EXISTENCE_PROB_296, system-signal=DET_EXISTENCE_PROB_296}, {application-record-element=DET_HVC_FLAG_293, system-signal=DET_HVC_FLAG_293}, {application-record-element=DET_HVC_FLAG_294, system-signal=DET_HVC_FLAG_294}, {application-record-element=DET_HVC_FLAG_295, system-signal=DET_HVC_FLAG_295}, {application-record-element=DET_HVC_FLAG_296, system-signal=DET_HVC_FLAG_296}, {application-record-element=DET_IDM_293, system-signal=DET_IDM_293}, {application-record-element=DET_IDM_294, system-signal=DET_IDM_294}, {application-record-element=DET_IDM_295, system-signal=DET_IDM_295}, {application-record-element=DET_IDM_296, system-signal=DET_IDM_296}, {application-record-element=DET_MH_CRC16_293_296, system-signal=DET_MH_CRC16_293_296}, {application-record-element=DET_MH_CYCLE_COUNTER_293_296, system-signal=DET_MH_CYCLE_COUNTER_293_296}, {application-record-element=DET_MH_SCAN_INDEX_4LSB_293_296, system-signal=DET_MH_SCAN_INDEX_4LSB_293_296}, {application-record-element=DET_MTD_293, system-signal=DET_MTD_293}, {application-record-element=DET_MTD_294, system-signal=DET_MTD_294}, {application-record-element=DET_MTD_295, system-signal=DET_MTD_295}, {application-record-element=DET_MTD_296, system-signal=DET_MTD_296}, {application-record-element=DET_PROB_1STAZHYPO_293, system-signal=DET_PROB_1STAZHYPO_293}, {application-record-element=DET_PROB_1STAZHYPO_294, system-signal=DET_PROB_1STAZHYPO_294}, {application-record-element=DET_PROB_1STAZHYPO_295, system-signal=DET_PROB_1STAZHYPO_295}, {application-record-element=DET_PROB_1STAZHYPO_296, system-signal=DET_PROB_1STAZHYPO_296}, {application-record-element=DET_RANGE_293, system-signal=DET_RANGE_293}, {application-record-element=DET_RANGE_294, system-signal=DET_RANGE_294}, {application-record-element=DET_RANGE_295, system-signal=DET_RANGE_295}, {application-record-element=DET_RANGE_296, system-signal=DET_RANGE_296}, {application-record-element=DET_RANGE_ERR_293, system-signal=DET_RANGE_ERR_293}, {application-record-element=DET_RANGE_ERR_294, system-signal=DET_RANGE_ERR_294}, {application-record-element=DET_RANGE_ERR_295, system-signal=DET_RANGE_ERR_295}, {application-record-element=DET_RANGE_ERR_296, system-signal=DET_RANGE_ERR_296}, {application-record-element=DET_RANGE_VELOCITY_293, system-signal=DET_RANGE_VELOCITY_293}, {application-record-element=DET_RANGE_VELOCITY_294, system-signal=DET_RANGE_VELOCITY_294}, {application-record-element=DET_RANGE_VELOCITY_295, system-signal=DET_RANGE_VELOCITY_295}, {application-record-element=DET_RANGE_VELOCITY_296, system-signal=DET_RANGE_VELOCITY_296}, {application-record-element=DET_RANGE_VELOCITY_ERR_293, system-signal=DET_RANGE_VELOCITY_ERR_293}, {application-record-element=DET_RANGE_VELOCITY_ERR_294, system-signal=DET_RANGE_VELOCITY_ERR_294}, {application-record-element=DET_RANGE_VELOCITY_ERR_295, system-signal=DET_RANGE_VELOCITY_ERR_295}, {application-record-element=DET_RANGE_VELOCITY_ERR_296, system-signal=DET_RANGE_VELOCITY_ERR_296}, {application-record-element=DET_RCS_293, system-signal=DET_RCS_293}, {application-record-element=DET_RCS_294, system-signal=DET_RCS_294}, {application-record-element=DET_RCS_295, system-signal=DET_RCS_295}, {application-record-element=DET_RCS_296, system-signal=DET_RCS_296}, {application-record-element=DET_SNR_293, system-signal=DET_SNR_293}, {application-record-element=DET_SNR_294, system-signal=DET_SNR_294}, {application-record-element=DET_SNR_295, system-signal=DET_SNR_295}, {application-record-element=DET_SNR_296, system-signal=DET_SNR_296}, {application-record-element=DET_SUPER_RES_TARGET_293, system-signal=DET_SUPER_RES_TARGET_293}, {application-record-element=DET_SUPER_RES_TARGET_294, system-signal=DET_SUPER_RES_TARGET_294}, {application-record-element=DET_SUPER_RES_TARGET_295, system-signal=DET_SUPER_RES_TARGET_295}, {application-record-element=DET_SUPER_RES_TARGET_296, system-signal=DET_SUPER_RES_TARGET_296}]}
        sender-receiver-to-signal-group-mapping={data-element=Pp_SG_Detections_297_300_AL.Vdp_SG_Detections_297_300_AL, signal-group=SG_Detections_297_300, type-mapping=sender-rec-record-type-mapping=record-element-mappings=[{application-record-element=DET_AZIMUTH_297, system-signal=DET_AZIMUTH_297}, {application-record-element=DET_AZIMUTH_298, system-signal=DET_AZIMUTH_298}, {application-record-element=DET_AZIMUTH_299, system-signal=DET_AZIMUTH_299}, {application-record-element=DET_AZIMUTH_300, system-signal=DET_AZIMUTH_300}, {application-record-element=DET_AZIMUTH_ERR_297, system-signal=DET_AZIMUTH_ERR_297}, {application-record-element=DET_AZIMUTH_ERR_298, system-signal=DET_AZIMUTH_ERR_298}, {application-record-element=DET_AZIMUTH_ERR_299, system-signal=DET_AZIMUTH_ERR_299}, {application-record-element=DET_AZIMUTH_ERR_300, system-signal=DET_AZIMUTH_ERR_300}, {application-record-element=DET_BELOW_RAIN_THOLD_297, system-signal=DET_BELOW_RAIN_THOLD_297}, {application-record-element=DET_BELOW_RAIN_THOLD_298, system-signal=DET_BELOW_RAIN_THOLD_298}, {application-record-element=DET_BELOW_RAIN_THOLD_299, system-signal=DET_BELOW_RAIN_THOLD_299}, {application-record-element=DET_BELOW_RAIN_THOLD_300, system-signal=DET_BELOW_RAIN_THOLD_300}, {application-record-element=DET_BI_STATIC_FLAG_297, system-signal=DET_BI_STATIC_FLAG_297}, {application-record-element=DET_BI_STATIC_FLAG_298, system-signal=DET_BI_STATIC_FLAG_298}, {application-record-element=DET_BI_STATIC_FLAG_299, system-signal=DET_BI_STATIC_FLAG_299}, {application-record-element=DET_BI_STATIC_FLAG_300, system-signal=DET_BI_STATIC_FLAG_300}, {application-record-element=DET_CONFD_AZIMUTH_297, system-signal=DET_CONFD_AZIMUTH_297}, {application-record-element=DET_CONFD_AZIMUTH_298, system-signal=DET_CONFD_AZIMUTH_298}, {application-record-element=DET_CONFD_AZIMUTH_299, system-signal=DET_CONFD_AZIMUTH_299}, {application-record-element=DET_CONFD_AZIMUTH_300, system-signal=DET_CONFD_AZIMUTH_300}, {application-record-element=DET_CONFD_ELEVATION_297, system-signal=DET_CONFD_ELEVATION_297}, {application-record-element=DET_CONFD_ELEVATION_298, system-signal=DET_CONFD_ELEVATION_298}, {application-record-element=DET_CONFD_ELEVATION_299, system-signal=DET_CONFD_ELEVATION_299}, {application-record-element=DET_CONFD_ELEVATION_300, system-signal=DET_CONFD_ELEVATION_300}, {application-record-element=DET_ELEVATION_297, system-signal=DET_ELEVATION_297}, {application-record-element=DET_ELEVATION_298, system-signal=DET_ELEVATION_298}, {application-record-element=DET_ELEVATION_299, system-signal=DET_ELEVATION_299}, {application-record-element=DET_ELEVATION_300, system-signal=DET_ELEVATION_300}, {application-record-element=DET_ELEVATION_ERR_297, system-signal=DET_ELEVATION_ERR_297}, {application-record-element=DET_ELEVATION_ERR_298, system-signal=DET_ELEVATION_ERR_298}, {application-record-element=DET_ELEVATION_ERR_299, system-signal=DET_ELEVATION_ERR_299}, {application-record-element=DET_ELEVATION_ERR_300, system-signal=DET_ELEVATION_ERR_300}, {application-record-element=DET_EXISTENCE_PROB_297, system-signal=DET_EXISTENCE_PROB_297}, {application-record-element=DET_EXISTENCE_PROB_298, system-signal=DET_EXISTENCE_PROB_298}, {application-record-element=DET_EXISTENCE_PROB_299, system-signal=DET_EXISTENCE_PROB_299}, {application-record-element=DET_EXISTENCE_PROB_300, system-signal=DET_EXISTENCE_PROB_300}, {application-record-element=DET_HVC_FLAG_297, system-signal=DET_HVC_FLAG_297}, {application-record-element=DET_HVC_FLAG_298, system-signal=DET_HVC_FLAG_298}, {application-record-element=DET_HVC_FLAG_299, system-signal=DET_HVC_FLAG_299}, {application-record-element=DET_HVC_FLAG_300, system-signal=DET_HVC_FLAG_300}, {application-record-element=DET_IDM_297, system-signal=DET_IDM_297}, {application-record-element=DET_IDM_298, system-signal=DET_IDM_298}, {application-record-element=DET_IDM_299, system-signal=DET_IDM_299}, {application-record-element=DET_IDM_300, system-signal=DET_IDM_300}, {application-record-element=DET_MH_CRC16_297_300, system-signal=DET_MH_CRC16_297_300}, {application-record-element=DET_MH_CYCLE_COUNTER_297_300, system-signal=DET_MH_CYCLE_COUNTER_297_300}, {application-record-element=DET_MH_SCAN_INDEX_4LSB_297_300, system-signal=DET_MH_SCAN_INDEX_4LSB_297_300}, {application-record-element=DET_MTD_297, system-signal=DET_MTD_297}, {application-record-element=DET_MTD_298, system-signal=DET_MTD_298}, {application-record-element=DET_MTD_299, system-signal=DET_MTD_299}, {application-record-element=DET_MTD_300, system-signal=DET_MTD_300}, {application-record-element=DET_PROB_1STAZHYPO_297, system-signal=DET_PROB_1STAZHYPO_297}, {application-record-element=DET_PROB_1STAZHYPO_298, system-signal=DET_PROB_1STAZHYPO_298}, {application-record-element=DET_PROB_1STAZHYPO_299, system-signal=DET_PROB_1STAZHYPO_299}, {application-record-element=DET_PROB_1STAZHYPO_300, system-signal=DET_PROB_1STAZHYPO_300}, {application-record-element=DET_RANGE_297, system-signal=DET_RANGE_297}, {application-record-element=DET_RANGE_298, system-signal=DET_RANGE_298}, {application-record-element=DET_RANGE_299, system-signal=DET_RANGE_299}, {application-record-element=DET_RANGE_300, system-signal=DET_RANGE_300}, {application-record-element=DET_RANGE_ERR_297, system-signal=DET_RANGE_ERR_297}, {application-record-element=DET_RANGE_ERR_298, system-signal=DET_RANGE_ERR_298}, {application-record-element=DET_RANGE_ERR_299, system-signal=DET_RANGE_ERR_299}, {application-record-element=DET_RANGE_ERR_300, system-signal=DET_RANGE_ERR_300}, {application-record-element=DET_RANGE_VELOCITY_297, system-signal=DET_RANGE_VELOCITY_297}, {application-record-element=DET_RANGE_VELOCITY_298, system-signal=DET_RANGE_VELOCITY_298}, {application-record-element=DET_RANGE_VELOCITY_299, system-signal=DET_RANGE_VELOCITY_299}, {application-record-element=DET_RANGE_VELOCITY_300, system-signal=DET_RANGE_VELOCITY_300}, {application-record-element=DET_RANGE_VELOCITY_ERR_297, system-signal=DET_RANGE_VELOCITY_ERR_297}, {application-record-element=DET_RANGE_VELOCITY_ERR_298, system-signal=DET_RANGE_VELOCITY_ERR_298}, {application-record-element=DET_RANGE_VELOCITY_ERR_299, system-signal=DET_RANGE_VELOCITY_ERR_299}, {application-record-element=DET_RANGE_VELOCITY_ERR_300, system-signal=DET_RANGE_VELOCITY_ERR_300}, {application-record-element=DET_RCS_297, system-signal=DET_RCS_297}, {application-record-element=DET_RCS_298, system-signal=DET_RCS_298}, {application-record-element=DET_RCS_299, system-signal=DET_RCS_299}, {application-record-element=DET_RCS_300, system-signal=DET_RCS_300}, {application-record-element=DET_SNR_297, system-signal=DET_SNR_297}, {application-record-element=DET_SNR_298, system-signal=DET_SNR_298}, {application-record-element=DET_SNR_299, system-signal=DET_SNR_299}, {application-record-element=DET_SNR_300, system-signal=DET_SNR_300}, {application-record-element=DET_SUPER_RES_TARGET_297, system-signal=DET_SUPER_RES_TARGET_297}, {application-record-element=DET_SUPER_RES_TARGET_298, system-signal=DET_SUPER_RES_TARGET_298}, {application-record-element=DET_SUPER_RES_TARGET_299, system-signal=DET_SUPER_RES_TARGET_299}, {application-record-element=DET_SUPER_RES_TARGET_300, system-signal=DET_SUPER_RES_TARGET_300}]}
        sender-receiver-to-signal-group-mapping={data-element=Pp_SG_Detections_301_304_AL.Vdp_SG_Detections_301_304_AL, signal-group=SG_Detections_301_304, type-mapping=sender-rec-record-type-mapping=record-element-mappings=[{application-record-element=DET_AZIMUTH_301, system-signal=DET_AZIMUTH_301}, {application-record-element=DET_AZIMUTH_302, system-signal=DET_AZIMUTH_302}, {application-record-element=DET_AZIMUTH_303, system-signal=DET_AZIMUTH_303}, {application-record-element=DET_AZIMUTH_304, system-signal=DET_AZIMUTH_304}, {application-record-element=DET_AZIMUTH_ERR_301, system-signal=DET_AZIMUTH_ERR_301}, {application-record-element=DET_AZIMUTH_ERR_302, system-signal=DET_AZIMUTH_ERR_302}, {application-record-element=DET_AZIMUTH_ERR_303, system-signal=DET_AZIMUTH_ERR_303}, {application-record-element=DET_AZIMUTH_ERR_304, system-signal=DET_AZIMUTH_ERR_304}, {application-record-element=DET_BELOW_RAIN_THOLD_301, system-signal=DET_BELOW_RAIN_THOLD_301}, {application-record-element=DET_BELOW_RAIN_THOLD_302, system-signal=DET_BELOW_RAIN_THOLD_302}, {application-record-element=DET_BELOW_RAIN_THOLD_303, system-signal=DET_BELOW_RAIN_THOLD_303}, {application-record-element=DET_BELOW_RAIN_THOLD_304, system-signal=DET_BELOW_RAIN_THOLD_304}, {application-record-element=DET_BI_STATIC_FLAG_301, system-signal=DET_BI_STATIC_FLAG_301}, {application-record-element=DET_BI_STATIC_FLAG_302, system-signal=DET_BI_STATIC_FLAG_302}, {application-record-element=DET_BI_STATIC_FLAG_303, system-signal=DET_BI_STATIC_FLAG_303}, {application-record-element=DET_BI_STATIC_FLAG_304, system-signal=DET_BI_STATIC_FLAG_304}, {application-record-element=DET_CONFD_AZIMUTH_301, system-signal=DET_CONFD_AZIMUTH_301}, {application-record-element=DET_CONFD_AZIMUTH_302, system-signal=DET_CONFD_AZIMUTH_302}, {application-record-element=DET_CONFD_AZIMUTH_303, system-signal=DET_CONFD_AZIMUTH_303}, {application-record-element=DET_CONFD_AZIMUTH_304, system-signal=DET_CONFD_AZIMUTH_304}, {application-record-element=DET_CONFD_ELEVATION_301, system-signal=DET_CONFD_ELEVATION_301}, {application-record-element=DET_CONFD_ELEVATION_302, system-signal=DET_CONFD_ELEVATION_302}, {application-record-element=DET_CONFD_ELEVATION_303, system-signal=DET_CONFD_ELEVATION_303}, {application-record-element=DET_CONFD_ELEVATION_304, system-signal=DET_CONFD_ELEVATION_304}, {application-record-element=DET_ELEVATION_301, system-signal=DET_ELEVATION_301}, {application-record-element=DET_ELEVATION_302, system-signal=DET_ELEVATION_302}, {application-record-element=DET_ELEVATION_303, system-signal=DET_ELEVATION_303}, {application-record-element=DET_ELEVATION_304, system-signal=DET_ELEVATION_304}, {application-record-element=DET_ELEVATION_ERR_301, system-signal=DET_ELEVATION_ERR_301}, {application-record-element=DET_ELEVATION_ERR_302, system-signal=DET_ELEVATION_ERR_302}, {application-record-element=DET_ELEVATION_ERR_303, system-signal=DET_ELEVATION_ERR_303}, {application-record-element=DET_ELEVATION_ERR_304, system-signal=DET_ELEVATION_ERR_304}, {application-record-element=DET_EXISTENCE_PROB_301, system-signal=DET_EXISTENCE_PROB_301}, {application-record-element=DET_EXISTENCE_PROB_302, system-signal=DET_EXISTENCE_PROB_302}, {application-record-element=DET_EXISTENCE_PROB_303, system-signal=DET_EXISTENCE_PROB_303}, {application-record-element=DET_EXISTENCE_PROB_304, system-signal=DET_EXISTENCE_PROB_304}, {application-record-element=DET_HVC_FLAG_301, system-signal=DET_HVC_FLAG_301}, {application-record-element=DET_HVC_FLAG_302, system-signal=DET_HVC_FLAG_302}, {application-record-element=DET_HVC_FLAG_303, system-signal=DET_HVC_FLAG_303}, {application-record-element=DET_HVC_FLAG_304, system-signal=DET_HVC_FLAG_304}, {application-record-element=DET_IDM_301, system-signal=DET_IDM_301}, {application-record-element=DET_IDM_302, system-signal=DET_IDM_302}, {application-record-element=DET_IDM_303, system-signal=DET_IDM_303}, {application-record-element=DET_IDM_304, system-signal=DET_IDM_304}, {application-record-element=DET_MH_CRC16_301_304, system-signal=DET_MH_CRC16_301_304}, {application-record-element=DET_MH_CYCLE_COUNTER_301_304, system-signal=DET_MH_CYCLE_COUNTER_301_304}, {application-record-element=DET_MH_SCAN_INDEX_4LSB_301_304, system-signal=DET_MH_SCAN_INDEX_4LSB_301_304}, {application-record-element=DET_MTD_301, system-signal=DET_MTD_301}, {application-record-element=DET_MTD_302, system-signal=DET_MTD_302}, {application-record-element=DET_MTD_303, system-signal=DET_MTD_303}, {application-record-element=DET_MTD_304, system-signal=DET_MTD_304}, {application-record-element=DET_PROB_1STAZHYPO_301, system-signal=DET_PROB_1STAZHYPO_301}, {application-record-element=DET_PROB_1STAZHYPO_302, system-signal=DET_PROB_1STAZHYPO_302}, {application-record-element=DET_PROB_1STAZHYPO_303, system-signal=DET_PROB_1STAZHYPO_303}, {application-record-element=DET_PROB_1STAZHYPO_304, system-signal=DET_PROB_1STAZHYPO_304}, {application-record-element=DET_RANGE_301, system-signal=DET_RANGE_301}, {application-record-element=DET_RANGE_302, system-signal=DET_RANGE_302}, {application-record-element=DET_RANGE_303, system-signal=DET_RANGE_303}, {application-record-element=DET_RANGE_304, system-signal=DET_RANGE_304}, {application-record-element=DET_RANGE_ERR_301, system-signal=DET_RANGE_ERR_301}, {application-record-element=DET_RANGE_ERR_302, system-signal=DET_RANGE_ERR_302}, {application-record-element=DET_RANGE_ERR_303, system-signal=DET_RANGE_ERR_303}, {application-record-element=DET_RANGE_ERR_304, system-signal=DET_RANGE_ERR_304}, {application-record-element=DET_RANGE_VELOCITY_301, system-signal=DET_RANGE_VELOCITY_301}, {application-record-element=DET_RANGE_VELOCITY_302, system-signal=DET_RANGE_VELOCITY_302}, {application-record-element=DET_RANGE_VELOCITY_303, system-signal=DET_RANGE_VELOCITY_303}, {application-record-element=DET_RANGE_VELOCITY_304, system-signal=DET_RANGE_VELOCITY_304}, {application-record-element=DET_RANGE_VELOCITY_ERR_301, system-signal=DET_RANGE_VELOCITY_ERR_301}, {application-record-element=DET_RANGE_VELOCITY_ERR_302, system-signal=DET_RANGE_VELOCITY_ERR_302}, {application-record-element=DET_RANGE_VELOCITY_ERR_303, system-signal=DET_RANGE_VELOCITY_ERR_303}, {application-record-element=DET_RANGE_VELOCITY_ERR_304, system-signal=DET_RANGE_VELOCITY_ERR_304}, {application-record-element=DET_RCS_301, system-signal=DET_RCS_301}, {application-record-element=DET_RCS_302, system-signal=DET_RCS_302}, {application-record-element=DET_RCS_303, system-signal=DET_RCS_303}, {application-record-element=DET_RCS_304, system-signal=DET_RCS_304}, {application-record-element=DET_SNR_301, system-signal=DET_SNR_301}, {application-record-element=DET_SNR_302, system-signal=DET_SNR_302}, {application-record-element=DET_SNR_303, system-signal=DET_SNR_303}, {application-record-element=DET_SNR_304, system-signal=DET_SNR_304}, {application-record-element=DET_SUPER_RES_TARGET_301, system-signal=DET_SUPER_RES_TARGET_301}, {application-record-element=DET_SUPER_RES_TARGET_302, system-signal=DET_SUPER_RES_TARGET_302}, {application-record-element=DET_SUPER_RES_TARGET_303, system-signal=DET_SUPER_RES_TARGET_303}, {application-record-element=DET_SUPER_RES_TARGET_304, system-signal=DET_SUPER_RES_TARGET_304}]}
        sender-receiver-to-signal-group-mapping={data-element=Pp_SG_Detections_305_308_AL.Vdp_SG_Detections_305_308_AL, signal-group=SG_Detections_305_308, type-mapping=sender-rec-record-type-mapping=record-element-mappings=[{application-record-element=DET_AZIMUTH_305, system-signal=DET_AZIMUTH_305}, {application-record-element=DET_AZIMUTH_306, system-signal=DET_AZIMUTH_306}, {application-record-element=DET_AZIMUTH_307, system-signal=DET_AZIMUTH_307}, {application-record-element=DET_AZIMUTH_308, system-signal=DET_AZIMUTH_308}, {application-record-element=DET_AZIMUTH_ERR_305, system-signal=DET_AZIMUTH_ERR_305}, {application-record-element=DET_AZIMUTH_ERR_306, system-signal=DET_AZIMUTH_ERR_306}, {application-record-element=DET_AZIMUTH_ERR_307, system-signal=DET_AZIMUTH_ERR_307}, {application-record-element=DET_AZIMUTH_ERR_308, system-signal=DET_AZIMUTH_ERR_308}, {application-record-element=DET_BELOW_RAIN_THOLD_305, system-signal=DET_BELOW_RAIN_THOLD_305}, {application-record-element=DET_BELOW_RAIN_THOLD_306, system-signal=DET_BELOW_RAIN_THOLD_306}, {application-record-element=DET_BELOW_RAIN_THOLD_307, system-signal=DET_BELOW_RAIN_THOLD_307}, {application-record-element=DET_BELOW_RAIN_THOLD_308, system-signal=DET_BELOW_RAIN_THOLD_308}, {application-record-element=DET_BI_STATIC_FLAG_305, system-signal=DET_BI_STATIC_FLAG_305}, {application-record-element=DET_BI_STATIC_FLAG_306, system-signal=DET_BI_STATIC_FLAG_306}, {application-record-element=DET_BI_STATIC_FLAG_307, system-signal=DET_BI_STATIC_FLAG_307}, {application-record-element=DET_BI_STATIC_FLAG_308, system-signal=DET_BI_STATIC_FLAG_308}, {application-record-element=DET_CONFD_AZIMUTH_305, system-signal=DET_CONFD_AZIMUTH_305}, {application-record-element=DET_CONFD_AZIMUTH_306, system-signal=DET_CONFD_AZIMUTH_306}, {application-record-element=DET_CONFD_AZIMUTH_307, system-signal=DET_CONFD_AZIMUTH_307}, {application-record-element=DET_CONFD_AZIMUTH_308, system-signal=DET_CONFD_AZIMUTH_308}, {application-record-element=DET_CONFD_ELEVATION_305, system-signal=DET_CONFD_ELEVATION_305}, {application-record-element=DET_CONFD_ELEVATION_306, system-signal=DET_CONFD_ELEVATION_306}, {application-record-element=DET_CONFD_ELEVATION_307, system-signal=DET_CONFD_ELEVATION_307}, {application-record-element=DET_CONFD_ELEVATION_308, system-signal=DET_CONFD_ELEVATION_308}, {application-record-element=DET_ELEVATION_305, system-signal=DET_ELEVATION_305}, {application-record-element=DET_ELEVATION_306, system-signal=DET_ELEVATION_306}, {application-record-element=DET_ELEVATION_307, system-signal=DET_ELEVATION_307}, {application-record-element=DET_ELEVATION_308, system-signal=DET_ELEVATION_308}, {application-record-element=DET_ELEVATION_ERR_305, system-signal=DET_ELEVATION_ERR_305}, {application-record-element=DET_ELEVATION_ERR_306, system-signal=DET_ELEVATION_ERR_306}, {application-record-element=DET_ELEVATION_ERR_307, system-signal=DET_ELEVATION_ERR_307}, {application-record-element=DET_ELEVATION_ERR_308, system-signal=DET_ELEVATION_ERR_308}, {application-record-element=DET_EXISTENCE_PROB_305, system-signal=DET_EXISTENCE_PROB_305}, {application-record-element=DET_EXISTENCE_PROB_306, system-signal=DET_EXISTENCE_PROB_306}, {application-record-element=DET_EXISTENCE_PROB_307, system-signal=DET_EXISTENCE_PROB_307}, {application-record-element=DET_EXISTENCE_PROB_308, system-signal=DET_EXISTENCE_PROB_308}, {application-record-element=DET_HVC_FLAG_305, system-signal=DET_HVC_FLAG_305}, {application-record-element=DET_HVC_FLAG_306, system-signal=DET_HVC_FLAG_306}, {application-record-element=DET_HVC_FLAG_307, system-signal=DET_HVC_FLAG_307}, {application-record-element=DET_HVC_FLAG_308, system-signal=DET_HVC_FLAG_308}, {application-record-element=DET_IDM_305, system-signal=DET_IDM_305}, {application-record-element=DET_IDM_306, system-signal=DET_IDM_306}, {application-record-element=DET_IDM_307, system-signal=DET_IDM_307}, {application-record-element=DET_IDM_308, system-signal=DET_IDM_308}, {application-record-element=DET_MH_CRC16_305_308, system-signal=DET_MH_CRC16_305_308}, {application-record-element=DET_MH_CYCLE_COUNTER_305_308, system-signal=DET_MH_CYCLE_COUNTER_305_308}, {application-record-element=DET_MH_SCAN_INDEX_4LSB_305_308, system-signal=DET_MH_SCAN_INDEX_4LSB_305_308}, {application-record-element=DET_MTD_305, system-signal=DET_MTD_305}, {application-record-element=DET_MTD_306, system-signal=DET_MTD_306}, {application-record-element=DET_MTD_307, system-signal=DET_MTD_307}, {application-record-element=DET_MTD_308, system-signal=DET_MTD_308}, {application-record-element=DET_PROB_1STAZHYPO_305, system-signal=DET_PROB_1STAZHYPO_305}, {application-record-element=DET_PROB_1STAZHYPO_306, system-signal=DET_PROB_1STAZHYPO_306}, {application-record-element=DET_PROB_1STAZHYPO_307, system-signal=DET_PROB_1STAZHYPO_307}, {application-record-element=DET_PROB_1STAZHYPO_308, system-signal=DET_PROB_1STAZHYPO_308}, {application-record-element=DET_RANGE_305, system-signal=DET_RANGE_305}, {application-record-element=DET_RANGE_306, system-signal=DET_RANGE_306}, {application-record-element=DET_RANGE_307, system-signal=DET_RANGE_307}, {application-record-element=DET_RANGE_308, system-signal=DET_RANGE_308}, {application-record-element=DET_RANGE_ERR_305, system-signal=DET_RANGE_ERR_305}, {application-record-element=DET_RANGE_ERR_306, system-signal=DET_RANGE_ERR_306}, {application-record-element=DET_RANGE_ERR_307, system-signal=DET_RANGE_ERR_307}, {application-record-element=DET_RANGE_ERR_308, system-signal=DET_RANGE_ERR_308}, {application-record-element=DET_RANGE_VELOCITY_305, system-signal=DET_RANGE_VELOCITY_305}, {application-record-element=DET_RANGE_VELOCITY_306, system-signal=DET_RANGE_VELOCITY_306}, {application-record-element=DET_RANGE_VELOCITY_307, system-signal=DET_RANGE_VELOCITY_307}, {application-record-element=DET_RANGE_VELOCITY_308, system-signal=DET_RANGE_VELOCITY_308}, {application-record-element=DET_RANGE_VELOCITY_ERR_305, system-signal=DET_RANGE_VELOCITY_ERR_305}, {application-record-element=DET_RANGE_VELOCITY_ERR_306, system-signal=DET_RANGE_VELOCITY_ERR_306}, {application-record-element=DET_RANGE_VELOCITY_ERR_307, system-signal=DET_RANGE_VELOCITY_ERR_307}, {application-record-element=DET_RANGE_VELOCITY_ERR_308, system-signal=DET_RANGE_VELOCITY_ERR_308}, {application-record-element=DET_RCS_305, system-signal=DET_RCS_305}, {application-record-element=DET_RCS_306, system-signal=DET_RCS_306}, {application-record-element=DET_RCS_307, system-signal=DET_RCS_307}, {application-record-element=DET_RCS_308, system-signal=DET_RCS_308}, {application-record-element=DET_SNR_305, system-signal=DET_SNR_305}, {application-record-element=DET_SNR_306, system-signal=DET_SNR_306}, {application-record-element=DET_SNR_307, system-signal=DET_SNR_307}, {application-record-element=DET_SNR_308, system-signal=DET_SNR_308}, {application-record-element=DET_SUPER_RES_TARGET_305, system-signal=DET_SUPER_RES_TARGET_305}, {application-record-element=DET_SUPER_RES_TARGET_306, system-signal=DET_SUPER_RES_TARGET_306}, {application-record-element=DET_SUPER_RES_TARGET_307, system-signal=DET_SUPER_RES_TARGET_307}, {application-record-element=DET_SUPER_RES_TARGET_308, system-signal=DET_SUPER_RES_TARGET_308}]}
        sender-receiver-to-signal-group-mapping={data-element=Pp_SG_Detections_309_312_AL.Vdp_SG_Detections_309_312_AL, signal-group=SG_Detections_309_312, type-mapping=sender-rec-record-type-mapping=record-element-mappings=[{application-record-element=DET_AZIMUTH_309, system-signal=DET_AZIMUTH_309}, {application-record-element=DET_AZIMUTH_310, system-signal=DET_AZIMUTH_310}, {application-record-element=DET_AZIMUTH_311, system-signal=DET_AZIMUTH_311}, {application-record-element=DET_AZIMUTH_312, system-signal=DET_AZIMUTH_312}, {application-record-element=DET_AZIMUTH_ERR_309, system-signal=DET_AZIMUTH_ERR_309}, {application-record-element=DET_AZIMUTH_ERR_310, system-signal=DET_AZIMUTH_ERR_310}, {application-record-element=DET_AZIMUTH_ERR_311, system-signal=DET_AZIMUTH_ERR_311}, {application-record-element=DET_AZIMUTH_ERR_312, system-signal=DET_AZIMUTH_ERR_312}, {application-record-element=DET_BELOW_RAIN_THOLD_309, system-signal=DET_BELOW_RAIN_THOLD_309}, {application-record-element=DET_BELOW_RAIN_THOLD_310, system-signal=DET_BELOW_RAIN_THOLD_310}, {application-record-element=DET_BELOW_RAIN_THOLD_311, system-signal=DET_BELOW_RAIN_THOLD_311}, {application-record-element=DET_BELOW_RAIN_THOLD_312, system-signal=DET_BELOW_RAIN_THOLD_312}, {application-record-element=DET_BI_STATIC_FLAG_309, system-signal=DET_BI_STATIC_FLAG_309}, {application-record-element=DET_BI_STATIC_FLAG_310, system-signal=DET_BI_STATIC_FLAG_310}, {application-record-element=DET_BI_STATIC_FLAG_311, system-signal=DET_BI_STATIC_FLAG_311}, {application-record-element=DET_BI_STATIC_FLAG_312, system-signal=DET_BI_STATIC_FLAG_312}, {application-record-element=DET_CONFD_AZIMUTH_309, system-signal=DET_CONFD_AZIMUTH_309}, {application-record-element=DET_CONFD_AZIMUTH_310, system-signal=DET_CONFD_AZIMUTH_310}, {application-record-element=DET_CONFD_AZIMUTH_311, system-signal=DET_CONFD_AZIMUTH_311}, {application-record-element=DET_CONFD_AZIMUTH_312, system-signal=DET_CONFD_AZIMUTH_312}, {application-record-element=DET_CONFD_ELEVATION_309, system-signal=DET_CONFD_ELEVATION_309}, {application-record-element=DET_CONFD_ELEVATION_310, system-signal=DET_CONFD_ELEVATION_310}, {application-record-element=DET_CONFD_ELEVATION_311, system-signal=DET_CONFD_ELEVATION_311}, {application-record-element=DET_CONFD_ELEVATION_312, system-signal=DET_CONFD_ELEVATION_312}, {application-record-element=DET_ELEVATION_309, system-signal=DET_ELEVATION_309}, {application-record-element=DET_ELEVATION_310, system-signal=DET_ELEVATION_310}, {application-record-element=DET_ELEVATION_311, system-signal=DET_ELEVATION_311}, {application-record-element=DET_ELEVATION_312, system-signal=DET_ELEVATION_312}, {application-record-element=DET_ELEVATION_ERR_309, system-signal=DET_ELEVATION_ERR_309}, {application-record-element=DET_ELEVATION_ERR_310, system-signal=DET_ELEVATION_ERR_310}, {application-record-element=DET_ELEVATION_ERR_311, system-signal=DET_ELEVATION_ERR_311}, {application-record-element=DET_ELEVATION_ERR_312, system-signal=DET_ELEVATION_ERR_312}, {application-record-element=DET_EXISTENCE_PROB_309, system-signal=DET_EXISTENCE_PROB_309}, {application-record-element=DET_EXISTENCE_PROB_310, system-signal=DET_EXISTENCE_PROB_310}, {application-record-element=DET_EXISTENCE_PROB_311, system-signal=DET_EXISTENCE_PROB_311}, {application-record-element=DET_EXISTENCE_PROB_312, system-signal=DET_EXISTENCE_PROB_312}, {application-record-element=DET_HVC_FLAG_309, system-signal=DET_HVC_FLAG_309}, {application-record-element=DET_HVC_FLAG_310, system-signal=DET_HVC_FLAG_310}, {application-record-element=DET_HVC_FLAG_311, system-signal=DET_HVC_FLAG_311}, {application-record-element=DET_HVC_FLAG_312, system-signal=DET_HVC_FLAG_312}, {application-record-element=DET_IDM_309, system-signal=DET_IDM_309}, {application-record-element=DET_IDM_310, system-signal=DET_IDM_310}, {application-record-element=DET_IDM_311, system-signal=DET_IDM_311}, {application-record-element=DET_IDM_312, system-signal=DET_IDM_312}, {application-record-element=DET_MH_CRC16_309_312, system-signal=DET_MH_CRC16_309_312}, {application-record-element=DET_MH_CYCLE_COUNTER_309_312, system-signal=DET_MH_CYCLE_COUNTER_309_312}, {application-record-element=DET_MH_SCAN_INDEX_4LSB_309_312, system-signal=DET_MH_SCAN_INDEX_4LSB_309_312}, {application-record-element=DET_MTD_309, system-signal=DET_MTD_309}, {application-record-element=DET_MTD_310, system-signal=DET_MTD_310}, {application-record-element=DET_MTD_311, system-signal=DET_MTD_311}, {application-record-element=DET_MTD_312, system-signal=DET_MTD_312}, {application-record-element=DET_PROB_1STAZHYPO_309, system-signal=DET_PROB_1STAZHYPO_309}, {application-record-element=DET_PROB_1STAZHYPO_310, system-signal=DET_PROB_1STAZHYPO_310}, {application-record-element=DET_PROB_1STAZHYPO_311, system-signal=DET_PROB_1STAZHYPO_311}, {application-record-element=DET_PROB_1STAZHYPO_312, system-signal=DET_PROB_1STAZHYPO_312}, {application-record-element=DET_RANGE_309, system-signal=DET_RANGE_309}, {application-record-element=DET_RANGE_310, system-signal=DET_RANGE_310}, {application-record-element=DET_RANGE_311, system-signal=DET_RANGE_311}, {application-record-element=DET_RANGE_312, system-signal=DET_RANGE_312}, {application-record-element=DET_RANGE_ERR_309, system-signal=DET_RANGE_ERR_309}, {application-record-element=DET_RANGE_ERR_310, system-signal=DET_RANGE_ERR_310}, {application-record-element=DET_RANGE_ERR_311, system-signal=DET_RANGE_ERR_311}, {application-record-element=DET_RANGE_ERR_312, system-signal=DET_RANGE_ERR_312}, {application-record-element=DET_RANGE_VELOCITY_309, system-signal=DET_RANGE_VELOCITY_309}, {application-record-element=DET_RANGE_VELOCITY_310, system-signal=DET_RANGE_VELOCITY_310}, {application-record-element=DET_RANGE_VELOCITY_311, system-signal=DET_RANGE_VELOCITY_311}, {application-record-element=DET_RANGE_VELOCITY_312, system-signal=DET_RANGE_VELOCITY_312}, {application-record-element=DET_RANGE_VELOCITY_ERR_309, system-signal=DET_RANGE_VELOCITY_ERR_309}, {application-record-element=DET_RANGE_VELOCITY_ERR_310, system-signal=DET_RANGE_VELOCITY_ERR_310}, {application-record-element=DET_RANGE_VELOCITY_ERR_311, system-signal=DET_RANGE_VELOCITY_ERR_311}, {application-record-element=DET_RANGE_VELOCITY_ERR_312, system-signal=DET_RANGE_VELOCITY_ERR_312}, {application-record-element=DET_RCS_309, system-signal=DET_RCS_309}, {application-record-element=DET_RCS_310, system-signal=DET_RCS_310}, {application-record-element=DET_RCS_311, system-signal=DET_RCS_311}, {application-record-element=DET_RCS_312, system-signal=DET_RCS_312}, {application-record-element=DET_SNR_309, system-signal=DET_SNR_309}, {application-record-element=DET_SNR_310, system-signal=DET_SNR_310}, {application-record-element=DET_SNR_311, system-signal=DET_SNR_311}, {application-record-element=DET_SNR_312, system-signal=DET_SNR_312}, {application-record-element=DET_SUPER_RES_TARGET_309, system-signal=DET_SUPER_RES_TARGET_309}, {application-record-element=DET_SUPER_RES_TARGET_310, system-signal=DET_SUPER_RES_TARGET_310}, {application-record-element=DET_SUPER_RES_TARGET_311, system-signal=DET_SUPER_RES_TARGET_311}, {application-record-element=DET_SUPER_RES_TARGET_312, system-signal=DET_SUPER_RES_TARGET_312}]}
        sender-receiver-to-signal-group-mapping={data-element=Pp_SG_Detections_313_316_AL.Vdp_SG_Detections_313_316_AL, signal-group=SG_Detections_313_316, type-mapping=sender-rec-record-type-mapping=record-element-mappings=[{application-record-element=DET_AZIMUTH_313, system-signal=DET_AZIMUTH_313}, {application-record-element=DET_AZIMUTH_314, system-signal=DET_AZIMUTH_314}, {application-record-element=DET_AZIMUTH_315, system-signal=DET_AZIMUTH_315}, {application-record-element=DET_AZIMUTH_316, system-signal=DET_AZIMUTH_316}, {application-record-element=DET_AZIMUTH_ERR_313, system-signal=DET_AZIMUTH_ERR_313}, {application-record-element=DET_AZIMUTH_ERR_314, system-signal=DET_AZIMUTH_ERR_314}, {application-record-element=DET_AZIMUTH_ERR_315, system-signal=DET_AZIMUTH_ERR_315}, {application-record-element=DET_AZIMUTH_ERR_316, system-signal=DET_AZIMUTH_ERR_316}, {application-record-element=DET_BELOW_RAIN_THOLD_313, system-signal=DET_BELOW_RAIN_THOLD_313}, {application-record-element=DET_BELOW_RAIN_THOLD_314, system-signal=DET_BELOW_RAIN_THOLD_314}, {application-record-element=DET_BELOW_RAIN_THOLD_315, system-signal=DET_BELOW_RAIN_THOLD_315}, {application-record-element=DET_BELOW_RAIN_THOLD_316, system-signal=DET_BELOW_RAIN_THOLD_316}, {application-record-element=DET_BI_STATIC_FLAG_313, system-signal=DET_BI_STATIC_FLAG_313}, {application-record-element=DET_BI_STATIC_FLAG_314, system-signal=DET_BI_STATIC_FLAG_314}, {application-record-element=DET_BI_STATIC_FLAG_315, system-signal=DET_BI_STATIC_FLAG_315}, {application-record-element=DET_BI_STATIC_FLAG_316, system-signal=DET_BI_STATIC_FLAG_316}, {application-record-element=DET_CONFD_AZIMUTH_313, system-signal=DET_CONFD_AZIMUTH_313}, {application-record-element=DET_CONFD_AZIMUTH_314, system-signal=DET_CONFD_AZIMUTH_314}, {application-record-element=DET_CONFD_AZIMUTH_315, system-signal=DET_CONFD_AZIMUTH_315}, {application-record-element=DET_CONFD_AZIMUTH_316, system-signal=DET_CONFD_AZIMUTH_316}, {application-record-element=DET_CONFD_ELEVATION_313, system-signal=DET_CONFD_ELEVATION_313}, {application-record-element=DET_CONFD_ELEVATION_314, system-signal=DET_CONFD_ELEVATION_314}, {application-record-element=DET_CONFD_ELEVATION_315, system-signal=DET_CONFD_ELEVATION_315}, {application-record-element=DET_CONFD_ELEVATION_316, system-signal=DET_CONFD_ELEVATION_316}, {application-record-element=DET_ELEVATION_313, system-signal=DET_ELEVATION_313}, {application-record-element=DET_ELEVATION_314, system-signal=DET_ELEVATION_314}, {application-record-element=DET_ELEVATION_315, system-signal=DET_ELEVATION_315}, {application-record-element=DET_ELEVATION_316, system-signal=DET_ELEVATION_316}, {application-record-element=DET_ELEVATION_ERR_313, system-signal=DET_ELEVATION_ERR_313}, {application-record-element=DET_ELEVATION_ERR_314, system-signal=DET_ELEVATION_ERR_314}, {application-record-element=DET_ELEVATION_ERR_315, system-signal=DET_ELEVATION_ERR_315}, {application-record-element=DET_ELEVATION_ERR_316, system-signal=DET_ELEVATION_ERR_316}, {application-record-element=DET_EXISTENCE_PROB_313, system-signal=DET_EXISTENCE_PROB_313}, {application-record-element=DET_EXISTENCE_PROB_314, system-signal=DET_EXISTENCE_PROB_314}, {application-record-element=DET_EXISTENCE_PROB_315, system-signal=DET_EXISTENCE_PROB_315}, {application-record-element=DET_EXISTENCE_PROB_316, system-signal=DET_EXISTENCE_PROB_316}, {application-record-element=DET_HVC_FLAG_313, system-signal=DET_HVC_FLAG_313}, {application-record-element=DET_HVC_FLAG_314, system-signal=DET_HVC_FLAG_314}, {application-record-element=DET_HVC_FLAG_315, system-signal=DET_HVC_FLAG_315}, {application-record-element=DET_HVC_FLAG_316, system-signal=DET_HVC_FLAG_316}, {application-record-element=DET_IDM_313, system-signal=DET_IDM_313}, {application-record-element=DET_IDM_314, system-signal=DET_IDM_314}, {application-record-element=DET_IDM_315, system-signal=DET_IDM_315}, {application-record-element=DET_IDM_316, system-signal=DET_IDM_316}, {application-record-element=DET_MH_CRC16_313_316, system-signal=DET_MH_CRC16_313_316}, {application-record-element=DET_MH_CYCLE_COUNTER_313_316, system-signal=DET_MH_CYCLE_COUNTER_313_316}, {application-record-element=DET_MH_SCAN_INDEX_4LSB_313_316, system-signal=DET_MH_SCAN_INDEX_4LSB_313_316}, {application-record-element=DET_MTD_313, system-signal=DET_MTD_313}, {application-record-element=DET_MTD_314, system-signal=DET_MTD_314}, {application-record-element=DET_MTD_315, system-signal=DET_MTD_315}, {application-record-element=DET_MTD_316, system-signal=DET_MTD_316}, {application-record-element=DET_PROB_1STAZHYPO_313, system-signal=DET_PROB_1STAZHYPO_313}, {application-record-element=DET_PROB_1STAZHYPO_314, system-signal=DET_PROB_1STAZHYPO_314}, {application-record-element=DET_PROB_1STAZHYPO_315, system-signal=DET_PROB_1STAZHYPO_315}, {application-record-element=DET_PROB_1STAZHYPO_316, system-signal=DET_PROB_1STAZHYPO_316}, {application-record-element=DET_RANGE_313, system-signal=DET_RANGE_313}, {application-record-element=DET_RANGE_314, system-signal=DET_RANGE_314}, {application-record-element=DET_RANGE_315, system-signal=DET_RANGE_315}, {application-record-element=DET_RANGE_316, system-signal=DET_RANGE_316}, {application-record-element=DET_RANGE_ERR_313, system-signal=DET_RANGE_ERR_313}, {application-record-element=DET_RANGE_ERR_314, system-signal=DET_RANGE_ERR_314}, {application-record-element=DET_RANGE_ERR_315, system-signal=DET_RANGE_ERR_315}, {application-record-element=DET_RANGE_ERR_316, system-signal=DET_RANGE_ERR_316}, {application-record-element=DET_RANGE_VELOCITY_313, system-signal=DET_RANGE_VELOCITY_313}, {application-record-element=DET_RANGE_VELOCITY_314, system-signal=DET_RANGE_VELOCITY_314}, {application-record-element=DET_RANGE_VELOCITY_315, system-signal=DET_RANGE_VELOCITY_315}, {application-record-element=DET_RANGE_VELOCITY_316, system-signal=DET_RANGE_VELOCITY_316}, {application-record-element=DET_RANGE_VELOCITY_ERR_313, system-signal=DET_RANGE_VELOCITY_ERR_313}, {application-record-element=DET_RANGE_VELOCITY_ERR_314, system-signal=DET_RANGE_VELOCITY_ERR_314}, {application-record-element=DET_RANGE_VELOCITY_ERR_315, system-signal=DET_RANGE_VELOCITY_ERR_315}, {application-record-element=DET_RANGE_VELOCITY_ERR_316, system-signal=DET_RANGE_VELOCITY_ERR_316}, {application-record-element=DET_RCS_313, system-signal=DET_RCS_313}, {application-record-element=DET_RCS_314, system-signal=DET_RCS_314}, {application-record-element=DET_RCS_315, system-signal=DET_RCS_315}, {application-record-element=DET_RCS_316, system-signal=DET_RCS_316}, {application-record-element=DET_SNR_313, system-signal=DET_SNR_313}, {application-record-element=DET_SNR_314, system-signal=DET_SNR_314}, {application-record-element=DET_SNR_315, system-signal=DET_SNR_315}, {application-record-element=DET_SNR_316, system-signal=DET_SNR_316}, {application-record-element=DET_SUPER_RES_TARGET_313, system-signal=DET_SUPER_RES_TARGET_313}, {application-record-element=DET_SUPER_RES_TARGET_314, system-signal=DET_SUPER_RES_TARGET_314}, {application-record-element=DET_SUPER_RES_TARGET_315, system-signal=DET_SUPER_RES_TARGET_315}, {application-record-element=DET_SUPER_RES_TARGET_316, system-signal=DET_SUPER_RES_TARGET_316}]}
        sender-receiver-to-signal-group-mapping={data-element=Pp_SG_Detections_317_320_AL.Vdp_SG_Detections_317_320_AL, signal-group=SG_Detections_317_320, type-mapping=sender-rec-record-type-mapping=record-element-mappings=[{application-record-element=DET_AZIMUTH_317, system-signal=DET_AZIMUTH_317}, {application-record-element=DET_AZIMUTH_318, system-signal=DET_AZIMUTH_318}, {application-record-element=DET_AZIMUTH_319, system-signal=DET_AZIMUTH_319}, {application-record-element=DET_AZIMUTH_320, system-signal=DET_AZIMUTH_320}, {application-record-element=DET_AZIMUTH_ERR_317, system-signal=DET_AZIMUTH_ERR_317}, {application-record-element=DET_AZIMUTH_ERR_318, system-signal=DET_AZIMUTH_ERR_318}, {application-record-element=DET_AZIMUTH_ERR_319, system-signal=DET_AZIMUTH_ERR_319}, {application-record-element=DET_AZIMUTH_ERR_320, system-signal=DET_AZIMUTH_ERR_320}, {application-record-element=DET_BELOW_RAIN_THOLD_317, system-signal=DET_BELOW_RAIN_THOLD_317}, {application-record-element=DET_BELOW_RAIN_THOLD_318, system-signal=DET_BELOW_RAIN_THOLD_318}, {application-record-element=DET_BELOW_RAIN_THOLD_319, system-signal=DET_BELOW_RAIN_THOLD_319}, {application-record-element=DET_BELOW_RAIN_THOLD_320, system-signal=DET_BELOW_RAIN_THOLD_320}, {application-record-element=DET_BI_STATIC_FLAG_317, system-signal=DET_BI_STATIC_FLAG_317}, {application-record-element=DET_BI_STATIC_FLAG_318, system-signal=DET_BI_STATIC_FLAG_318}, {application-record-element=DET_BI_STATIC_FLAG_319, system-signal=DET_BI_STATIC_FLAG_319}, {application-record-element=DET_BI_STATIC_FLAG_320, system-signal=DET_BI_STATIC_FLAG_320}, {application-record-element=DET_CONFD_AZIMUTH_317, system-signal=DET_CONFD_AZIMUTH_317}, {application-record-element=DET_CONFD_AZIMUTH_318, system-signal=DET_CONFD_AZIMUTH_318}, {application-record-element=DET_CONFD_AZIMUTH_319, system-signal=DET_CONFD_AZIMUTH_319}, {application-record-element=DET_CONFD_AZIMUTH_320, system-signal=DET_CONFD_AZIMUTH_320}, {application-record-element=DET_CONFD_ELEVATION_317, system-signal=DET_CONFD_ELEVATION_317}, {application-record-element=DET_CONFD_ELEVATION_318, system-signal=DET_CONFD_ELEVATION_318}, {application-record-element=DET_CONFD_ELEVATION_319, system-signal=DET_CONFD_ELEVATION_319}, {application-record-element=DET_CONFD_ELEVATION_320, system-signal=DET_CONFD_ELEVATION_320}, {application-record-element=DET_ELEVATION_317, system-signal=DET_ELEVATION_317}, {application-record-element=DET_ELEVATION_318, system-signal=DET_ELEVATION_318}, {application-record-element=DET_ELEVATION_319, system-signal=DET_ELEVATION_319}, {application-record-element=DET_ELEVATION_320, system-signal=DET_ELEVATION_320}, {application-record-element=DET_ELEVATION_ERR_317, system-signal=DET_ELEVATION_ERR_317}, {application-record-element=DET_ELEVATION_ERR_318, system-signal=DET_ELEVATION_ERR_318}, {application-record-element=DET_ELEVATION_ERR_319, system-signal=DET_ELEVATION_ERR_319}, {application-record-element=DET_ELEVATION_ERR_320, system-signal=DET_ELEVATION_ERR_320}, {application-record-element=DET_EXISTENCE_PROB_317, system-signal=DET_EXISTENCE_PROB_317}, {application-record-element=DET_EXISTENCE_PROB_318, system-signal=DET_EXISTENCE_PROB_318}, {application-record-element=DET_EXISTENCE_PROB_319, system-signal=DET_EXISTENCE_PROB_319}, {application-record-element=DET_EXISTENCE_PROB_320, system-signal=DET_EXISTENCE_PROB_320}, {application-record-element=DET_HVC_FLAG_317, system-signal=DET_HVC_FLAG_317}, {application-record-element=DET_HVC_FLAG_318, system-signal=DET_HVC_FLAG_318}, {application-record-element=DET_HVC_FLAG_319, system-signal=DET_HVC_FLAG_319}, {application-record-element=DET_HVC_FLAG_320, system-signal=DET_HVC_FLAG_320}, {application-record-element=DET_IDM_317, system-signal=DET_IDM_317}, {application-record-element=DET_IDM_318, system-signal=DET_IDM_318}, {application-record-element=DET_IDM_319, system-signal=DET_IDM_319}, {application-record-element=DET_IDM_320, system-signal=DET_IDM_320}, {application-record-element=DET_MH_CRC16_317_320, system-signal=DET_MH_CRC16_317_320}, {application-record-element=DET_MH_CYCLE_COUNTER_317_320, system-signal=DET_MH_CYCLE_COUNTER_317_320}, {application-record-element=DET_MH_SCAN_INDEX_4LSB_317_320, system-signal=DET_MH_SCAN_INDEX_4LSB_317_320}, {application-record-element=DET_MTD_317, system-signal=DET_MTD_317}, {application-record-element=DET_MTD_318, system-signal=DET_MTD_318}, {application-record-element=DET_MTD_319, system-signal=DET_MTD_319}, {application-record-element=DET_MTD_320, system-signal=DET_MTD_320}, {application-record-element=DET_PROB_1STAZHYPO_317, system-signal=DET_PROB_1STAZHYPO_317}, {application-record-element=DET_PROB_1STAZHYPO_318, system-signal=DET_PROB_1STAZHYPO_318}, {application-record-element=DET_PROB_1STAZHYPO_319, system-signal=DET_PROB_1STAZHYPO_319}, {application-record-element=DET_PROB_1STAZHYPO_320, system-signal=DET_PROB_1STAZHYPO_320}, {application-record-element=DET_RANGE_317, system-signal=DET_RANGE_317}, {application-record-element=DET_RANGE_318, system-signal=DET_RANGE_318}, {application-record-element=DET_RANGE_319, system-signal=DET_RANGE_319}, {application-record-element=DET_RANGE_320, system-signal=DET_RANGE_320}, {application-record-element=DET_RANGE_ERR_317, system-signal=DET_RANGE_ERR_317}, {application-record-element=DET_RANGE_ERR_318, system-signal=DET_RANGE_ERR_318}, {application-record-element=DET_RANGE_ERR_319, system-signal=DET_RANGE_ERR_319}, {application-record-element=DET_RANGE_ERR_320, system-signal=DET_RANGE_ERR_320}, {application-record-element=DET_RANGE_VELOCITY_317, system-signal=DET_RANGE_VELOCITY_317}, {application-record-element=DET_RANGE_VELOCITY_318, system-signal=DET_RANGE_VELOCITY_318}, {application-record-element=DET_RANGE_VELOCITY_319, system-signal=DET_RANGE_VELOCITY_319}, {application-record-element=DET_RANGE_VELOCITY_320, system-signal=DET_RANGE_VELOCITY_320}, {application-record-element=DET_RANGE_VELOCITY_ERR_317, system-signal=DET_RANGE_VELOCITY_ERR_317}, {application-record-element=DET_RANGE_VELOCITY_ERR_318, system-signal=DET_RANGE_VELOCITY_ERR_318}, {application-record-element=DET_RANGE_VELOCITY_ERR_319, system-signal=DET_RANGE_VELOCITY_ERR_319}, {application-record-element=DET_RANGE_VELOCITY_ERR_320, system-signal=DET_RANGE_VELOCITY_ERR_320}, {application-record-element=DET_RCS_317, system-signal=DET_RCS_317}, {application-record-element=DET_RCS_318, system-signal=DET_RCS_318}, {application-record-element=DET_RCS_319, system-signal=DET_RCS_319}, {application-record-element=DET_RCS_320, system-signal=DET_RCS_320}, {application-record-element=DET_SNR_317, system-signal=DET_SNR_317}, {application-record-element=DET_SNR_318, system-signal=DET_SNR_318}, {application-record-element=DET_SNR_319, system-signal=DET_SNR_319}, {application-record-element=DET_SNR_320, system-signal=DET_SNR_320}, {application-record-element=DET_SUPER_RES_TARGET_317, system-signal=DET_SUPER_RES_TARGET_317}, {application-record-element=DET_SUPER_RES_TARGET_318, system-signal=DET_SUPER_RES_TARGET_318}, {application-record-element=DET_SUPER_RES_TARGET_319, system-signal=DET_SUPER_RES_TARGET_319}, {application-record-element=DET_SUPER_RES_TARGET_320, system-signal=DET_SUPER_RES_TARGET_320}]}
        sender-receiver-to-signal-group-mapping={data-element=Pp_SG_Detections_321_324_AL.Vdp_SG_Detections_321_324_AL, signal-group=SG_Detections_321_324, type-mapping=sender-rec-record-type-mapping=record-element-mappings=[{application-record-element=DET_AZIMUTH_321, system-signal=DET_AZIMUTH_321}, {application-record-element=DET_AZIMUTH_322, system-signal=DET_AZIMUTH_322}, {application-record-element=DET_AZIMUTH_323, system-signal=DET_AZIMUTH_323}, {application-record-element=DET_AZIMUTH_324, system-signal=DET_AZIMUTH_324}, {application-record-element=DET_AZIMUTH_ERR_321, system-signal=DET_AZIMUTH_ERR_321}, {application-record-element=DET_AZIMUTH_ERR_322, system-signal=DET_AZIMUTH_ERR_322}, {application-record-element=DET_AZIMUTH_ERR_323, system-signal=DET_AZIMUTH_ERR_323}, {application-record-element=DET_AZIMUTH_ERR_324, system-signal=DET_AZIMUTH_ERR_324}, {application-record-element=DET_BELOW_RAIN_THOLD_321, system-signal=DET_BELOW_RAIN_THOLD_321}, {application-record-element=DET_BELOW_RAIN_THOLD_322, system-signal=DET_BELOW_RAIN_THOLD_322}, {application-record-element=DET_BELOW_RAIN_THOLD_323, system-signal=DET_BELOW_RAIN_THOLD_323}, {application-record-element=DET_BELOW_RAIN_THOLD_324, system-signal=DET_BELOW_RAIN_THOLD_324}, {application-record-element=DET_BI_STATIC_FLAG_321, system-signal=DET_BI_STATIC_FLAG_321}, {application-record-element=DET_BI_STATIC_FLAG_322, system-signal=DET_BI_STATIC_FLAG_322}, {application-record-element=DET_BI_STATIC_FLAG_323, system-signal=DET_BI_STATIC_FLAG_323}, {application-record-element=DET_BI_STATIC_FLAG_324, system-signal=DET_BI_STATIC_FLAG_324}, {application-record-element=DET_CONFD_AZIMUTH_321, system-signal=DET_CONFD_AZIMUTH_321}, {application-record-element=DET_CONFD_AZIMUTH_322, system-signal=DET_CONFD_AZIMUTH_322}, {application-record-element=DET_CONFD_AZIMUTH_323, system-signal=DET_CONFD_AZIMUTH_323}, {application-record-element=DET_CONFD_AZIMUTH_324, system-signal=DET_CONFD_AZIMUTH_324}, {application-record-element=DET_CONFD_ELEVATION_321, system-signal=DET_CONFD_ELEVATION_321}, {application-record-element=DET_CONFD_ELEVATION_322, system-signal=DET_CONFD_ELEVATION_322}, {application-record-element=DET_CONFD_ELEVATION_323, system-signal=DET_CONFD_ELEVATION_323}, {application-record-element=DET_CONFD_ELEVATION_324, system-signal=DET_CONFD_ELEVATION_324}, {application-record-element=DET_ELEVATION_321, system-signal=DET_ELEVATION_321}, {application-record-element=DET_ELEVATION_322, system-signal=DET_ELEVATION_322}, {application-record-element=DET_ELEVATION_323, system-signal=DET_ELEVATION_323}, {application-record-element=DET_ELEVATION_324, system-signal=DET_ELEVATION_324}, {application-record-element=DET_ELEVATION_ERR_321, system-signal=DET_ELEVATION_ERR_321}, {application-record-element=DET_ELEVATION_ERR_322, system-signal=DET_ELEVATION_ERR_322}, {application-record-element=DET_ELEVATION_ERR_323, system-signal=DET_ELEVATION_ERR_323}, {application-record-element=DET_ELEVATION_ERR_324, system-signal=DET_ELEVATION_ERR_324}, {application-record-element=DET_EXISTENCE_PROB_321, system-signal=DET_EXISTENCE_PROB_321}, {application-record-element=DET_EXISTENCE_PROB_322, system-signal=DET_EXISTENCE_PROB_322}, {application-record-element=DET_EXISTENCE_PROB_323, system-signal=DET_EXISTENCE_PROB_323}, {application-record-element=DET_EXISTENCE_PROB_324, system-signal=DET_EXISTENCE_PROB_324}, {application-record-element=DET_HVC_FLAG_321, system-signal=DET_HVC_FLAG_321}, {application-record-element=DET_HVC_FLAG_322, system-signal=DET_HVC_FLAG_322}, {application-record-element=DET_HVC_FLAG_323, system-signal=DET_HVC_FLAG_323}, {application-record-element=DET_HVC_FLAG_324, system-signal=DET_HVC_FLAG_324}, {application-record-element=DET_IDM_321, system-signal=DET_IDM_321}, {application-record-element=DET_IDM_322, system-signal=DET_IDM_322}, {application-record-element=DET_IDM_323, system-signal=DET_IDM_323}, {application-record-element=DET_IDM_324, system-signal=DET_IDM_324}, {application-record-element=DET_MH_CRC16_321_324, system-signal=DET_MH_CRC16_321_324}, {application-record-element=DET_MH_CYCLE_COUNTER_321_324, system-signal=DET_MH_CYCLE_COUNTER_321_324}, {application-record-element=DET_MH_SCAN_INDEX_4LSB_321_324, system-signal=DET_MH_SCAN_INDEX_4LSB_321_324}, {application-record-element=DET_MTD_321, system-signal=DET_MTD_321}, {application-record-element=DET_MTD_322, system-signal=DET_MTD_322}, {application-record-element=DET_MTD_323, system-signal=DET_MTD_323}, {application-record-element=DET_MTD_324, system-signal=DET_MTD_324}, {application-record-element=DET_PROB_1STAZHYPO_321, system-signal=DET_PROB_1STAZHYPO_321}, {application-record-element=DET_PROB_1STAZHYPO_322, system-signal=DET_PROB_1STAZHYPO_322}, {application-record-element=DET_PROB_1STAZHYPO_323, system-signal=DET_PROB_1STAZHYPO_323}, {application-record-element=DET_PROB_1STAZHYPO_324, system-signal=DET_PROB_1STAZHYPO_324}, {application-record-element=DET_RANGE_321, system-signal=DET_RANGE_321}, {application-record-element=DET_RANGE_322, system-signal=DET_RANGE_322}, {application-record-element=DET_RANGE_323, system-signal=DET_RANGE_323}, {application-record-element=DET_RANGE_324, system-signal=DET_RANGE_324}, {application-record-element=DET_RANGE_ERR_321, system-signal=DET_RANGE_ERR_321}, {application-record-element=DET_RANGE_ERR_322, system-signal=DET_RANGE_ERR_322}, {application-record-element=DET_RANGE_ERR_323, system-signal=DET_RANGE_ERR_323}, {application-record-element=DET_RANGE_ERR_324, system-signal=DET_RANGE_ERR_324}, {application-record-element=DET_RANGE_VELOCITY_321, system-signal=DET_RANGE_VELOCITY_321}, {application-record-element=DET_RANGE_VELOCITY_322, system-signal=DET_RANGE_VELOCITY_322}, {application-record-element=DET_RANGE_VELOCITY_323, system-signal=DET_RANGE_VELOCITY_323}, {application-record-element=DET_RANGE_VELOCITY_324, system-signal=DET_RANGE_VELOCITY_324}, {application-record-element=DET_RANGE_VELOCITY_ERR_321, system-signal=DET_RANGE_VELOCITY_ERR_321}, {application-record-element=DET_RANGE_VELOCITY_ERR_322, system-signal=DET_RANGE_VELOCITY_ERR_322}, {application-record-element=DET_RANGE_VELOCITY_ERR_323, system-signal=DET_RANGE_VELOCITY_ERR_323}, {application-record-element=DET_RANGE_VELOCITY_ERR_324, system-signal=DET_RANGE_VELOCITY_ERR_324}, {application-record-element=DET_RCS_321, system-signal=DET_RCS_321}, {application-record-element=DET_RCS_322, system-signal=DET_RCS_322}, {application-record-element=DET_RCS_323, system-signal=DET_RCS_323}, {application-record-element=DET_RCS_324, system-signal=DET_RCS_324}, {application-record-element=DET_SNR_321, system-signal=DET_SNR_321}, {application-record-element=DET_SNR_322, system-signal=DET_SNR_322}, {application-record-element=DET_SNR_323, system-signal=DET_SNR_323}, {application-record-element=DET_SNR_324, system-signal=DET_SNR_324}, {application-record-element=DET_SUPER_RES_TARGET_321, system-signal=DET_SUPER_RES_TARGET_321}, {application-record-element=DET_SUPER_RES_TARGET_322, system-signal=DET_SUPER_RES_TARGET_322}, {application-record-element=DET_SUPER_RES_TARGET_323, system-signal=DET_SUPER_RES_TARGET_323}, {application-record-element=DET_SUPER_RES_TARGET_324, system-signal=DET_SUPER_RES_TARGET_324}]}
        sender-receiver-to-signal-group-mapping={data-element=Pp_SG_Detections_325_328_AL.Vdp_SG_Detections_325_328_AL, signal-group=SG_Detections_325_328, type-mapping=sender-rec-record-type-mapping=record-element-mappings=[{application-record-element=DET_AZIMUTH_325, system-signal=DET_AZIMUTH_325}, {application-record-element=DET_AZIMUTH_326, system-signal=DET_AZIMUTH_326}, {application-record-element=DET_AZIMUTH_327, system-signal=DET_AZIMUTH_327}, {application-record-element=DET_AZIMUTH_328, system-signal=DET_AZIMUTH_328}, {application-record-element=DET_AZIMUTH_ERR_325, system-signal=DET_AZIMUTH_ERR_325}, {application-record-element=DET_AZIMUTH_ERR_326, system-signal=DET_AZIMUTH_ERR_326}, {application-record-element=DET_AZIMUTH_ERR_327, system-signal=DET_AZIMUTH_ERR_327}, {application-record-element=DET_AZIMUTH_ERR_328, system-signal=DET_AZIMUTH_ERR_328}, {application-record-element=DET_BELOW_RAIN_THOLD_325, system-signal=DET_BELOW_RAIN_THOLD_325}, {application-record-element=DET_BELOW_RAIN_THOLD_326, system-signal=DET_BELOW_RAIN_THOLD_326}, {application-record-element=DET_BELOW_RAIN_THOLD_327, system-signal=DET_BELOW_RAIN_THOLD_327}, {application-record-element=DET_BELOW_RAIN_THOLD_328, system-signal=DET_BELOW_RAIN_THOLD_328}, {application-record-element=DET_BI_STATIC_FLAG_325, system-signal=DET_BI_STATIC_FLAG_325}, {application-record-element=DET_BI_STATIC_FLAG_326, system-signal=DET_BI_STATIC_FLAG_326}, {application-record-element=DET_BI_STATIC_FLAG_327, system-signal=DET_BI_STATIC_FLAG_327}, {application-record-element=DET_BI_STATIC_FLAG_328, system-signal=DET_BI_STATIC_FLAG_328}, {application-record-element=DET_CONFD_AZIMUTH_325, system-signal=DET_CONFD_AZIMUTH_325}, {application-record-element=DET_CONFD_AZIMUTH_326, system-signal=DET_CONFD_AZIMUTH_326}, {application-record-element=DET_CONFD_AZIMUTH_327, system-signal=DET_CONFD_AZIMUTH_327}, {application-record-element=DET_CONFD_AZIMUTH_328, system-signal=DET_CONFD_AZIMUTH_328}, {application-record-element=DET_CONFD_ELEVATION_325, system-signal=DET_CONFD_ELEVATION_325}, {application-record-element=DET_CONFD_ELEVATION_326, system-signal=DET_CONFD_ELEVATION_326}, {application-record-element=DET_CONFD_ELEVATION_327, system-signal=DET_CONFD_ELEVATION_327}, {application-record-element=DET_CONFD_ELEVATION_328, system-signal=DET_CONFD_ELEVATION_328}, {application-record-element=DET_ELEVATION_325, system-signal=DET_ELEVATION_325}, {application-record-element=DET_ELEVATION_326, system-signal=DET_ELEVATION_326}, {application-record-element=DET_ELEVATION_327, system-signal=DET_ELEVATION_327}, {application-record-element=DET_ELEVATION_328, system-signal=DET_ELEVATION_328}, {application-record-element=DET_ELEVATION_ERR_325, system-signal=DET_ELEVATION_ERR_325}, {application-record-element=DET_ELEVATION_ERR_326, system-signal=DET_ELEVATION_ERR_326}, {application-record-element=DET_ELEVATION_ERR_327, system-signal=DET_ELEVATION_ERR_327}, {application-record-element=DET_ELEVATION_ERR_328, system-signal=DET_ELEVATION_ERR_328}, {application-record-element=DET_EXISTENCE_PROB_325, system-signal=DET_EXISTENCE_PROB_325}, {application-record-element=DET_EXISTENCE_PROB_326, system-signal=DET_EXISTENCE_PROB_326}, {application-record-element=DET_EXISTENCE_PROB_327, system-signal=DET_EXISTENCE_PROB_327}, {application-record-element=DET_EXISTENCE_PROB_328, system-signal=DET_EXISTENCE_PROB_328}, {application-record-element=DET_HVC_FLAG_325, system-signal=DET_HVC_FLAG_325}, {application-record-element=DET_HVC_FLAG_326, system-signal=DET_HVC_FLAG_326}, {application-record-element=DET_HVC_FLAG_327, system-signal=DET_HVC_FLAG_327}, {application-record-element=DET_HVC_FLAG_328, system-signal=DET_HVC_FLAG_328}, {application-record-element=DET_IDM_325, system-signal=DET_IDM_325}, {application-record-element=DET_IDM_326, system-signal=DET_IDM_326}, {application-record-element=DET_IDM_327, system-signal=DET_IDM_327}, {application-record-element=DET_IDM_328, system-signal=DET_IDM_328}, {application-record-element=DET_MH_CRC16_325_328, system-signal=DET_MH_CRC16_325_328}, {application-record-element=DET_MH_CYCLE_COUNTER_325_328, system-signal=DET_MH_CYCLE_COUNTER_325_328}, {application-record-element=DET_MH_SCAN_INDEX_4LSB_325_328, system-signal=DET_MH_SCAN_INDEX_4LSB_325_328}, {application-record-element=DET_MTD_325, system-signal=DET_MTD_325}, {application-record-element=DET_MTD_326, system-signal=DET_MTD_326}, {application-record-element=DET_MTD_327, system-signal=DET_MTD_327}, {application-record-element=DET_MTD_328, system-signal=DET_MTD_328}, {application-record-element=DET_PROB_1STAZHYPO_325, system-signal=DET_PROB_1STAZHYPO_325}, {application-record-element=DET_PROB_1STAZHYPO_326, system-signal=DET_PROB_1STAZHYPO_326}, {application-record-element=DET_PROB_1STAZHYPO_327, system-signal=DET_PROB_1STAZHYPO_327}, {application-record-element=DET_PROB_1STAZHYPO_328, system-signal=DET_PROB_1STAZHYPO_328}, {application-record-element=DET_RANGE_325, system-signal=DET_RANGE_325}, {application-record-element=DET_RANGE_326, system-signal=DET_RANGE_326}, {application-record-element=DET_RANGE_327, system-signal=DET_RANGE_327}, {application-record-element=DET_RANGE_328, system-signal=DET_RANGE_328}, {application-record-element=DET_RANGE_ERR_325, system-signal=DET_RANGE_ERR_325}, {application-record-element=DET_RANGE_ERR_326, system-signal=DET_RANGE_ERR_326}, {application-record-element=DET_RANGE_ERR_327, system-signal=DET_RANGE_ERR_327}, {application-record-element=DET_RANGE_ERR_328, system-signal=DET_RANGE_ERR_328}, {application-record-element=DET_RANGE_VELOCITY_325, system-signal=DET_RANGE_VELOCITY_325}, {application-record-element=DET_RANGE_VELOCITY_326, system-signal=DET_RANGE_VELOCITY_326}, {application-record-element=DET_RANGE_VELOCITY_327, system-signal=DET_RANGE_VELOCITY_327}, {application-record-element=DET_RANGE_VELOCITY_328, system-signal=DET_RANGE_VELOCITY_328}, {application-record-element=DET_RANGE_VELOCITY_ERR_325, system-signal=DET_RANGE_VELOCITY_ERR_325}, {application-record-element=DET_RANGE_VELOCITY_ERR_326, system-signal=DET_RANGE_VELOCITY_ERR_326}, {application-record-element=DET_RANGE_VELOCITY_ERR_327, system-signal=DET_RANGE_VELOCITY_ERR_327}, {application-record-element=DET_RANGE_VELOCITY_ERR_328, system-signal=DET_RANGE_VELOCITY_ERR_328}, {application-record-element=DET_RCS_325, system-signal=DET_RCS_325}, {application-record-element=DET_RCS_326, system-signal=DET_RCS_326}, {application-record-element=DET_RCS_327, system-signal=DET_RCS_327}, {application-record-element=DET_RCS_328, system-signal=DET_RCS_328}, {application-record-element=DET_SNR_325, system-signal=DET_SNR_325}, {application-record-element=DET_SNR_326, system-signal=DET_SNR_326}, {application-record-element=DET_SNR_327, system-signal=DET_SNR_327}, {application-record-element=DET_SNR_328, system-signal=DET_SNR_328}, {application-record-element=DET_SUPER_RES_TARGET_325, system-signal=DET_SUPER_RES_TARGET_325}, {application-record-element=DET_SUPER_RES_TARGET_326, system-signal=DET_SUPER_RES_TARGET_326}, {application-record-element=DET_SUPER_RES_TARGET_327, system-signal=DET_SUPER_RES_TARGET_327}, {application-record-element=DET_SUPER_RES_TARGET_328, system-signal=DET_SUPER_RES_TARGET_328}]}
        sender-receiver-to-signal-group-mapping={data-element=Pp_SG_Detections_329_332_AL.Vdp_SG_Detections_329_332_AL, signal-group=SG_Detections_329_332, type-mapping=sender-rec-record-type-mapping=record-element-mappings=[{application-record-element=DET_AZIMUTH_329, system-signal=DET_AZIMUTH_329}, {application-record-element=DET_AZIMUTH_330, system-signal=DET_AZIMUTH_330}, {application-record-element=DET_AZIMUTH_331, system-signal=DET_AZIMUTH_331}, {application-record-element=DET_AZIMUTH_332, system-signal=DET_AZIMUTH_332}, {application-record-element=DET_AZIMUTH_ERR_329, system-signal=DET_AZIMUTH_ERR_329}, {application-record-element=DET_AZIMUTH_ERR_330, system-signal=DET_AZIMUTH_ERR_330}, {application-record-element=DET_AZIMUTH_ERR_331, system-signal=DET_AZIMUTH_ERR_331}, {application-record-element=DET_AZIMUTH_ERR_332, system-signal=DET_AZIMUTH_ERR_332}, {application-record-element=DET_BELOW_RAIN_THOLD_329, system-signal=DET_BELOW_RAIN_THOLD_329}, {application-record-element=DET_BELOW_RAIN_THOLD_330, system-signal=DET_BELOW_RAIN_THOLD_330}, {application-record-element=DET_BELOW_RAIN_THOLD_331, system-signal=DET_BELOW_RAIN_THOLD_331}, {application-record-element=DET_BELOW_RAIN_THOLD_332, system-signal=DET_BELOW_RAIN_THOLD_332}, {application-record-element=DET_BI_STATIC_FLAG_329, system-signal=DET_BI_STATIC_FLAG_329}, {application-record-element=DET_BI_STATIC_FLAG_330, system-signal=DET_BI_STATIC_FLAG_330}, {application-record-element=DET_BI_STATIC_FLAG_331, system-signal=DET_BI_STATIC_FLAG_331}, {application-record-element=DET_BI_STATIC_FLAG_332, system-signal=DET_BI_STATIC_FLAG_332}, {application-record-element=DET_CONFD_AZIMUTH_329, system-signal=DET_CONFD_AZIMUTH_329}, {application-record-element=DET_CONFD_AZIMUTH_330, system-signal=DET_CONFD_AZIMUTH_330}, {application-record-element=DET_CONFD_AZIMUTH_331, system-signal=DET_CONFD_AZIMUTH_331}, {application-record-element=DET_CONFD_AZIMUTH_332, system-signal=DET_CONFD_AZIMUTH_332}, {application-record-element=DET_CONFD_ELEVATION_329, system-signal=DET_CONFD_ELEVATION_329}, {application-record-element=DET_CONFD_ELEVATION_330, system-signal=DET_CONFD_ELEVATION_330}, {application-record-element=DET_CONFD_ELEVATION_331, system-signal=DET_CONFD_ELEVATION_331}, {application-record-element=DET_CONFD_ELEVATION_332, system-signal=DET_CONFD_ELEVATION_332}, {application-record-element=DET_ELEVATION_329, system-signal=DET_ELEVATION_329}, {application-record-element=DET_ELEVATION_330, system-signal=DET_ELEVATION_330}, {application-record-element=DET_ELEVATION_331, system-signal=DET_ELEVATION_331}, {application-record-element=DET_ELEVATION_332, system-signal=DET_ELEVATION_332}, {application-record-element=DET_ELEVATION_ERR_329, system-signal=DET_ELEVATION_ERR_329}, {application-record-element=DET_ELEVATION_ERR_330, system-signal=DET_ELEVATION_ERR_330}, {application-record-element=DET_ELEVATION_ERR_331, system-signal=DET_ELEVATION_ERR_331}, {application-record-element=DET_ELEVATION_ERR_332, system-signal=DET_ELEVATION_ERR_332}, {application-record-element=DET_EXISTENCE_PROB_329, system-signal=DET_EXISTENCE_PROB_329}, {application-record-element=DET_EXISTENCE_PROB_330, system-signal=DET_EXISTENCE_PROB_330}, {application-record-element=DET_EXISTENCE_PROB_331, system-signal=DET_EXISTENCE_PROB_331}, {application-record-element=DET_EXISTENCE_PROB_332, system-signal=DET_EXISTENCE_PROB_332}, {application-record-element=DET_HVC_FLAG_329, system-signal=DET_HVC_FLAG_329}, {application-record-element=DET_HVC_FLAG_330, system-signal=DET_HVC_FLAG_330}, {application-record-element=DET_HVC_FLAG_331, system-signal=DET_HVC_FLAG_331}, {application-record-element=DET_HVC_FLAG_332, system-signal=DET_HVC_FLAG_332}, {application-record-element=DET_IDM_329, system-signal=DET_IDM_329}, {application-record-element=DET_IDM_330, system-signal=DET_IDM_330}, {application-record-element=DET_IDM_331, system-signal=DET_IDM_331}, {application-record-element=DET_IDM_332, system-signal=DET_IDM_332}, {application-record-element=DET_MH_CRC16_329_332, system-signal=DET_MH_CRC16_329_332}, {application-record-element=DET_MH_CYCLE_COUNTER_329_332, system-signal=DET_MH_CYCLE_COUNTER_329_332}, {application-record-element=DET_MH_SCAN_INDEX_4LSB_329_332, system-signal=DET_MH_SCAN_INDEX_4LSB_329_332}, {application-record-element=DET_MTD_329, system-signal=DET_MTD_329}, {application-record-element=DET_MTD_330, system-signal=DET_MTD_330}, {application-record-element=DET_MTD_331, system-signal=DET_MTD_331}, {application-record-element=DET_MTD_332, system-signal=DET_MTD_332}, {application-record-element=DET_PROB_1STAZHYPO_329, system-signal=DET_PROB_1STAZHYPO_329}, {application-record-element=DET_PROB_1STAZHYPO_330, system-signal=DET_PROB_1STAZHYPO_330}, {application-record-element=DET_PROB_1STAZHYPO_331, system-signal=DET_PROB_1STAZHYPO_331}, {application-record-element=DET_PROB_1STAZHYPO_332, system-signal=DET_PROB_1STAZHYPO_332}, {application-record-element=DET_RANGE_329, system-signal=DET_RANGE_329}, {application-record-element=DET_RANGE_330, system-signal=DET_RANGE_330}, {application-record-element=DET_RANGE_331, system-signal=DET_RANGE_331}, {application-record-element=DET_RANGE_332, system-signal=DET_RANGE_332}, {application-record-element=DET_RANGE_ERR_329, system-signal=DET_RANGE_ERR_329}, {application-record-element=DET_RANGE_ERR_330, system-signal=DET_RANGE_ERR_330}, {application-record-element=DET_RANGE_ERR_331, system-signal=DET_RANGE_ERR_331}, {application-record-element=DET_RANGE_ERR_332, system-signal=DET_RANGE_ERR_332}, {application-record-element=DET_RANGE_VELOCITY_329, system-signal=DET_RANGE_VELOCITY_329}, {application-record-element=DET_RANGE_VELOCITY_330, system-signal=DET_RANGE_VELOCITY_330}, {application-record-element=DET_RANGE_VELOCITY_331, system-signal=DET_RANGE_VELOCITY_331}, {application-record-element=DET_RANGE_VELOCITY_332, system-signal=DET_RANGE_VELOCITY_332}, {application-record-element=DET_RANGE_VELOCITY_ERR_329, system-signal=DET_RANGE_VELOCITY_ERR_329}, {application-record-element=DET_RANGE_VELOCITY_ERR_330, system-signal=DET_RANGE_VELOCITY_ERR_330}, {application-record-element=DET_RANGE_VELOCITY_ERR_331, system-signal=DET_RANGE_VELOCITY_ERR_331}, {application-record-element=DET_RANGE_VELOCITY_ERR_332, system-signal=DET_RANGE_VELOCITY_ERR_332}, {application-record-element=DET_RCS_329, system-signal=DET_RCS_329}, {application-record-element=DET_RCS_330, system-signal=DET_RCS_330}, {application-record-element=DET_RCS_331, system-signal=DET_RCS_331}, {application-record-element=DET_RCS_332, system-signal=DET_RCS_332}, {application-record-element=DET_SNR_329, system-signal=DET_SNR_329}, {application-record-element=DET_SNR_330, system-signal=DET_SNR_330}, {application-record-element=DET_SNR_331, system-signal=DET_SNR_331}, {application-record-element=DET_SNR_332, system-signal=DET_SNR_332}, {application-record-element=DET_SUPER_RES_TARGET_329, system-signal=DET_SUPER_RES_TARGET_329}, {application-record-element=DET_SUPER_RES_TARGET_330, system-signal=DET_SUPER_RES_TARGET_330}, {application-record-element=DET_SUPER_RES_TARGET_331, system-signal=DET_SUPER_RES_TARGET_331}, {application-record-element=DET_SUPER_RES_TARGET_332, system-signal=DET_SUPER_RES_TARGET_332}]}
        sender-receiver-to-signal-group-mapping={data-element=Pp_SG_Detections_333_336_AL.Vdp_SG_Detections_333_336_AL, signal-group=SG_Detections_333_336, type-mapping=sender-rec-record-type-mapping=record-element-mappings=[{application-record-element=DET_AZIMUTH_333, system-signal=DET_AZIMUTH_333}, {application-record-element=DET_AZIMUTH_334, system-signal=DET_AZIMUTH_334}, {application-record-element=DET_AZIMUTH_335, system-signal=DET_AZIMUTH_335}, {application-record-element=DET_AZIMUTH_336, system-signal=DET_AZIMUTH_336}, {application-record-element=DET_AZIMUTH_ERR_333, system-signal=DET_AZIMUTH_ERR_333}, {application-record-element=DET_AZIMUTH_ERR_334, system-signal=DET_AZIMUTH_ERR_334}, {application-record-element=DET_AZIMUTH_ERR_335, system-signal=DET_AZIMUTH_ERR_335}, {application-record-element=DET_AZIMUTH_ERR_336, system-signal=DET_AZIMUTH_ERR_336}, {application-record-element=DET_BELOW_RAIN_THOLD_333, system-signal=DET_BELOW_RAIN_THOLD_333}, {application-record-element=DET_BELOW_RAIN_THOLD_334, system-signal=DET_BELOW_RAIN_THOLD_334}, {application-record-element=DET_BELOW_RAIN_THOLD_335, system-signal=DET_BELOW_RAIN_THOLD_335}, {application-record-element=DET_BELOW_RAIN_THOLD_336, system-signal=DET_BELOW_RAIN_THOLD_336}, {application-record-element=DET_BI_STATIC_FLAG_333, system-signal=DET_BI_STATIC_FLAG_333}, {application-record-element=DET_BI_STATIC_FLAG_334, system-signal=DET_BI_STATIC_FLAG_334}, {application-record-element=DET_BI_STATIC_FLAG_335, system-signal=DET_BI_STATIC_FLAG_335}, {application-record-element=DET_BI_STATIC_FLAG_336, system-signal=DET_BI_STATIC_FLAG_336}, {application-record-element=DET_CONFD_AZIMUTH_333, system-signal=DET_CONFD_AZIMUTH_333}, {application-record-element=DET_CONFD_AZIMUTH_334, system-signal=DET_CONFD_AZIMUTH_334}, {application-record-element=DET_CONFD_AZIMUTH_335, system-signal=DET_CONFD_AZIMUTH_335}, {application-record-element=DET_CONFD_AZIMUTH_336, system-signal=DET_CONFD_AZIMUTH_336}, {application-record-element=DET_CONFD_ELEVATION_333, system-signal=DET_CONFD_ELEVATION_333}, {application-record-element=DET_CONFD_ELEVATION_334, system-signal=DET_CONFD_ELEVATION_334}, {application-record-element=DET_CONFD_ELEVATION_335, system-signal=DET_CONFD_ELEVATION_335}, {application-record-element=DET_CONFD_ELEVATION_336, system-signal=DET_CONFD_ELEVATION_336}, {application-record-element=DET_ELEVATION_333, system-signal=DET_ELEVATION_333}, {application-record-element=DET_ELEVATION_334, system-signal=DET_ELEVATION_334}, {application-record-element=DET_ELEVATION_335, system-signal=DET_ELEVATION_335}, {application-record-element=DET_ELEVATION_336, system-signal=DET_ELEVATION_336}, {application-record-element=DET_ELEVATION_ERR_333, system-signal=DET_ELEVATION_ERR_333}, {application-record-element=DET_ELEVATION_ERR_334, system-signal=DET_ELEVATION_ERR_334}, {application-record-element=DET_ELEVATION_ERR_335, system-signal=DET_ELEVATION_ERR_335}, {application-record-element=DET_ELEVATION_ERR_336, system-signal=DET_ELEVATION_ERR_336}, {application-record-element=DET_EXISTENCE_PROB_333, system-signal=DET_EXISTENCE_PROB_333}, {application-record-element=DET_EXISTENCE_PROB_334, system-signal=DET_EXISTENCE_PROB_334}, {application-record-element=DET_EXISTENCE_PROB_335, system-signal=DET_EXISTENCE_PROB_335}, {application-record-element=DET_EXISTENCE_PROB_336, system-signal=DET_EXISTENCE_PROB_336}, {application-record-element=DET_HVC_FLAG_333, system-signal=DET_HVC_FLAG_333}, {application-record-element=DET_HVC_FLAG_334, system-signal=DET_HVC_FLAG_334}, {application-record-element=DET_HVC_FLAG_335, system-signal=DET_HVC_FLAG_335}, {application-record-element=DET_HVC_FLAG_336, system-signal=DET_HVC_FLAG_336}, {application-record-element=DET_IDM_333, system-signal=DET_IDM_333}, {application-record-element=DET_IDM_334, system-signal=DET_IDM_334}, {application-record-element=DET_IDM_335, system-signal=DET_IDM_335}, {application-record-element=DET_IDM_336, system-signal=DET_IDM_336}, {application-record-element=DET_MH_CRC16_333_336, system-signal=DET_MH_CRC16_333_336}, {application-record-element=DET_MH_CYCLE_COUNTER_333_336, system-signal=DET_MH_CYCLE_COUNTER_333_336}, {application-record-element=DET_MH_SCAN_INDEX_4LSB_333_336, system-signal=DET_MH_SCAN_INDEX_4LSB_333_336}, {application-record-element=DET_MTD_333, system-signal=DET_MTD_333}, {application-record-element=DET_MTD_334, system-signal=DET_MTD_334}, {application-record-element=DET_MTD_335, system-signal=DET_MTD_335}, {application-record-element=DET_MTD_336, system-signal=DET_MTD_336}, {application-record-element=DET_PROB_1STAZHYPO_333, system-signal=DET_PROB_1STAZHYPO_333}, {application-record-element=DET_PROB_1STAZHYPO_334, system-signal=DET_PROB_1STAZHYPO_334}, {application-record-element=DET_PROB_1STAZHYPO_335, system-signal=DET_PROB_1STAZHYPO_335}, {application-record-element=DET_PROB_1STAZHYPO_336, system-signal=DET_PROB_1STAZHYPO_336}, {application-record-element=DET_RANGE_333, system-signal=DET_RANGE_333}, {application-record-element=DET_RANGE_334, system-signal=DET_RANGE_334}, {application-record-element=DET_RANGE_335, system-signal=DET_RANGE_335}, {application-record-element=DET_RANGE_336, system-signal=DET_RANGE_336}, {application-record-element=DET_RANGE_ERR_333, system-signal=DET_RANGE_ERR_333}, {application-record-element=DET_RANGE_ERR_334, system-signal=DET_RANGE_ERR_334}, {application-record-element=DET_RANGE_ERR_335, system-signal=DET_RANGE_ERR_335}, {application-record-element=DET_RANGE_ERR_336, system-signal=DET_RANGE_ERR_336}, {application-record-element=DET_RANGE_VELOCITY_333, system-signal=DET_RANGE_VELOCITY_333}, {application-record-element=DET_RANGE_VELOCITY_334, system-signal=DET_RANGE_VELOCITY_334}, {application-record-element=DET_RANGE_VELOCITY_335, system-signal=DET_RANGE_VELOCITY_335}, {application-record-element=DET_RANGE_VELOCITY_336, system-signal=DET_RANGE_VELOCITY_336}, {application-record-element=DET_RANGE_VELOCITY_ERR_333, system-signal=DET_RANGE_VELOCITY_ERR_333}, {application-record-element=DET_RANGE_VELOCITY_ERR_334, system-signal=DET_RANGE_VELOCITY_ERR_334}, {application-record-element=DET_RANGE_VELOCITY_ERR_335, system-signal=DET_RANGE_VELOCITY_ERR_335}, {application-record-element=DET_RANGE_VELOCITY_ERR_336, system-signal=DET_RANGE_VELOCITY_ERR_336}, {application-record-element=DET_RCS_333, system-signal=DET_RCS_333}, {application-record-element=DET_RCS_334, system-signal=DET_RCS_334}, {application-record-element=DET_RCS_335, system-signal=DET_RCS_335}, {application-record-element=DET_RCS_336, system-signal=DET_RCS_336}, {application-record-element=DET_SNR_333, system-signal=DET_SNR_333}, {application-record-element=DET_SNR_334, system-signal=DET_SNR_334}, {application-record-element=DET_SNR_335, system-signal=DET_SNR_335}, {application-record-element=DET_SNR_336, system-signal=DET_SNR_336}, {application-record-element=DET_SUPER_RES_TARGET_333, system-signal=DET_SUPER_RES_TARGET_333}, {application-record-element=DET_SUPER_RES_TARGET_334, system-signal=DET_SUPER_RES_TARGET_334}, {application-record-element=DET_SUPER_RES_TARGET_335, system-signal=DET_SUPER_RES_TARGET_335}, {application-record-element=DET_SUPER_RES_TARGET_336, system-signal=DET_SUPER_RES_TARGET_336}]}
        sender-receiver-to-signal-group-mapping={data-element=Pp_SG_Detections_337_340_AL.Vdp_SG_Detections_337_340_AL, signal-group=SG_Detections_337_340, type-mapping=sender-rec-record-type-mapping=record-element-mappings=[{application-record-element=DET_AZIMUTH_337, system-signal=DET_AZIMUTH_337}, {application-record-element=DET_AZIMUTH_338, system-signal=DET_AZIMUTH_338}, {application-record-element=DET_AZIMUTH_339, system-signal=DET_AZIMUTH_339}, {application-record-element=DET_AZIMUTH_340, system-signal=DET_AZIMUTH_340}, {application-record-element=DET_AZIMUTH_ERR_337, system-signal=DET_AZIMUTH_ERR_337}, {application-record-element=DET_AZIMUTH_ERR_338, system-signal=DET_AZIMUTH_ERR_338}, {application-record-element=DET_AZIMUTH_ERR_339, system-signal=DET_AZIMUTH_ERR_339}, {application-record-element=DET_AZIMUTH_ERR_340, system-signal=DET_AZIMUTH_ERR_340}, {application-record-element=DET_BELOW_RAIN_THOLD_337, system-signal=DET_BELOW_RAIN_THOLD_337}, {application-record-element=DET_BELOW_RAIN_THOLD_338, system-signal=DET_BELOW_RAIN_THOLD_338}, {application-record-element=DET_BELOW_RAIN_THOLD_339, system-signal=DET_BELOW_RAIN_THOLD_339}, {application-record-element=DET_BELOW_RAIN_THOLD_340, system-signal=DET_BELOW_RAIN_THOLD_340}, {application-record-element=DET_BI_STATIC_FLAG_337, system-signal=DET_BI_STATIC_FLAG_337}, {application-record-element=DET_BI_STATIC_FLAG_338, system-signal=DET_BI_STATIC_FLAG_338}, {application-record-element=DET_BI_STATIC_FLAG_339, system-signal=DET_BI_STATIC_FLAG_339}, {application-record-element=DET_BI_STATIC_FLAG_340, system-signal=DET_BI_STATIC_FLAG_340}, {application-record-element=DET_CONFD_AZIMUTH_337, system-signal=DET_CONFD_AZIMUTH_337}, {application-record-element=DET_CONFD_AZIMUTH_338, system-signal=DET_CONFD_AZIMUTH_338}, {application-record-element=DET_CONFD_AZIMUTH_339, system-signal=DET_CONFD_AZIMUTH_339}, {application-record-element=DET_CONFD_AZIMUTH_340, system-signal=DET_CONFD_AZIMUTH_340}, {application-record-element=DET_CONFD_ELEVATION_337, system-signal=DET_CONFD_ELEVATION_337}, {application-record-element=DET_CONFD_ELEVATION_338, system-signal=DET_CONFD_ELEVATION_338}, {application-record-element=DET_CONFD_ELEVATION_339, system-signal=DET_CONFD_ELEVATION_339}, {application-record-element=DET_CONFD_ELEVATION_340, system-signal=DET_CONFD_ELEVATION_340}, {application-record-element=DET_ELEVATION_337, system-signal=DET_ELEVATION_337}, {application-record-element=DET_ELEVATION_338, system-signal=DET_ELEVATION_338}, {application-record-element=DET_ELEVATION_339, system-signal=DET_ELEVATION_339}, {application-record-element=DET_ELEVATION_340, system-signal=DET_ELEVATION_340}, {application-record-element=DET_ELEVATION_ERR_337, system-signal=DET_ELEVATION_ERR_337}, {application-record-element=DET_ELEVATION_ERR_338, system-signal=DET_ELEVATION_ERR_338}, {application-record-element=DET_ELEVATION_ERR_339, system-signal=DET_ELEVATION_ERR_339}, {application-record-element=DET_ELEVATION_ERR_340, system-signal=DET_ELEVATION_ERR_340}, {application-record-element=DET_EXISTENCE_PROB_337, system-signal=DET_EXISTENCE_PROB_337}, {application-record-element=DET_EXISTENCE_PROB_338, system-signal=DET_EXISTENCE_PROB_338}, {application-record-element=DET_EXISTENCE_PROB_339, system-signal=DET_EXISTENCE_PROB_339}, {application-record-element=DET_EXISTENCE_PROB_340, system-signal=DET_EXISTENCE_PROB_340}, {application-record-element=DET_HVC_FLAG_337, system-signal=DET_HVC_FLAG_337}, {application-record-element=DET_HVC_FLAG_338, system-signal=DET_HVC_FLAG_338}, {application-record-element=DET_HVC_FLAG_339, system-signal=DET_HVC_FLAG_339}, {application-record-element=DET_HVC_FLAG_340, system-signal=DET_HVC_FLAG_340}, {application-record-element=DET_IDM_337, system-signal=DET_IDM_337}, {application-record-element=DET_IDM_338, system-signal=DET_IDM_338}, {application-record-element=DET_IDM_339, system-signal=DET_IDM_339}, {application-record-element=DET_IDM_340, system-signal=DET_IDM_340}, {application-record-element=DET_MH_CRC16_337_340, system-signal=DET_MH_CRC16_337_340}, {application-record-element=DET_MH_CYCLE_COUNTER_337_340, system-signal=DET_MH_CYCLE_COUNTER_337_340}, {application-record-element=DET_MH_SCAN_INDEX_4LSB_337_340, system-signal=DET_MH_SCAN_INDEX_4LSB_337_340}, {application-record-element=DET_MTD_337, system-signal=DET_MTD_337}, {application-record-element=DET_MTD_338, system-signal=DET_MTD_338}, {application-record-element=DET_MTD_339, system-signal=DET_MTD_339}, {application-record-element=DET_MTD_340, system-signal=DET_MTD_340}, {application-record-element=DET_PROB_1STAZHYPO_337, system-signal=DET_PROB_1STAZHYPO_337}, {application-record-element=DET_PROB_1STAZHYPO_338, system-signal=DET_PROB_1STAZHYPO_338}, {application-record-element=DET_PROB_1STAZHYPO_339, system-signal=DET_PROB_1STAZHYPO_339}, {application-record-element=DET_PROB_1STAZHYPO_340, system-signal=DET_PROB_1STAZHYPO_340}, {application-record-element=DET_RANGE_337, system-signal=DET_RANGE_337}, {application-record-element=DET_RANGE_338, system-signal=DET_RANGE_338}, {application-record-element=DET_RANGE_339, system-signal=DET_RANGE_339}, {application-record-element=DET_RANGE_340, system-signal=DET_RANGE_340}, {application-record-element=DET_RANGE_ERR_337, system-signal=DET_RANGE_ERR_337}, {application-record-element=DET_RANGE_ERR_338, system-signal=DET_RANGE_ERR_338}, {application-record-element=DET_RANGE_ERR_339, system-signal=DET_RANGE_ERR_339}, {application-record-element=DET_RANGE_ERR_340, system-signal=DET_RANGE_ERR_340}, {application-record-element=DET_RANGE_VELOCITY_337, system-signal=DET_RANGE_VELOCITY_337}, {application-record-element=DET_RANGE_VELOCITY_338, system-signal=DET_RANGE_VELOCITY_338}, {application-record-element=DET_RANGE_VELOCITY_339, system-signal=DET_RANGE_VELOCITY_339}, {application-record-element=DET_RANGE_VELOCITY_340, system-signal=DET_RANGE_VELOCITY_340}, {application-record-element=DET_RANGE_VELOCITY_ERR_337, system-signal=DET_RANGE_VELOCITY_ERR_337}, {application-record-element=DET_RANGE_VELOCITY_ERR_338, system-signal=DET_RANGE_VELOCITY_ERR_338}, {application-record-element=DET_RANGE_VELOCITY_ERR_339, system-signal=DET_RANGE_VELOCITY_ERR_339}, {application-record-element=DET_RANGE_VELOCITY_ERR_340, system-signal=DET_RANGE_VELOCITY_ERR_340}, {application-record-element=DET_RCS_337, system-signal=DET_RCS_337}, {application-record-element=DET_RCS_338, system-signal=DET_RCS_338}, {application-record-element=DET_RCS_339, system-signal=DET_RCS_339}, {application-record-element=DET_RCS_340, system-signal=DET_RCS_340}, {application-record-element=DET_SNR_337, system-signal=DET_SNR_337}, {application-record-element=DET_SNR_338, system-signal=DET_SNR_338}, {application-record-element=DET_SNR_339, system-signal=DET_SNR_339}, {application-record-element=DET_SNR_340, system-signal=DET_SNR_340}, {application-record-element=DET_SUPER_RES_TARGET_337, system-signal=DET_SUPER_RES_TARGET_337}, {application-record-element=DET_SUPER_RES_TARGET_338, system-signal=DET_SUPER_RES_TARGET_338}, {application-record-element=DET_SUPER_RES_TARGET_339, system-signal=DET_SUPER_RES_TARGET_339}, {application-record-element=DET_SUPER_RES_TARGET_340, system-signal=DET_SUPER_RES_TARGET_340}]}
        sender-receiver-to-signal-group-mapping={data-element=Pp_SG_Detections_341_344_AL.Vdp_SG_Detections_341_344_AL, signal-group=SG_Detections_341_344, type-mapping=sender-rec-record-type-mapping=record-element-mappings=[{application-record-element=DET_AZIMUTH_341, system-signal=DET_AZIMUTH_341}, {application-record-element=DET_AZIMUTH_342, system-signal=DET_AZIMUTH_342}, {application-record-element=DET_AZIMUTH_343, system-signal=DET_AZIMUTH_343}, {application-record-element=DET_AZIMUTH_344, system-signal=DET_AZIMUTH_344}, {application-record-element=DET_AZIMUTH_ERR_341, system-signal=DET_AZIMUTH_ERR_341}, {application-record-element=DET_AZIMUTH_ERR_342, system-signal=DET_AZIMUTH_ERR_342}, {application-record-element=DET_AZIMUTH_ERR_343, system-signal=DET_AZIMUTH_ERR_343}, {application-record-element=DET_AZIMUTH_ERR_344, system-signal=DET_AZIMUTH_ERR_344}, {application-record-element=DET_BELOW_RAIN_THOLD_341, system-signal=DET_BELOW_RAIN_THOLD_341}, {application-record-element=DET_BELOW_RAIN_THOLD_342, system-signal=DET_BELOW_RAIN_THOLD_342}, {application-record-element=DET_BELOW_RAIN_THOLD_343, system-signal=DET_BELOW_RAIN_THOLD_343}, {application-record-element=DET_BELOW_RAIN_THOLD_344, system-signal=DET_BELOW_RAIN_THOLD_344}, {application-record-element=DET_BI_STATIC_FLAG_341, system-signal=DET_BI_STATIC_FLAG_341}, {application-record-element=DET_BI_STATIC_FLAG_342, system-signal=DET_BI_STATIC_FLAG_342}, {application-record-element=DET_BI_STATIC_FLAG_343, system-signal=DET_BI_STATIC_FLAG_343}, {application-record-element=DET_BI_STATIC_FLAG_344, system-signal=DET_BI_STATIC_FLAG_344}, {application-record-element=DET_CONFD_AZIMUTH_341, system-signal=DET_CONFD_AZIMUTH_341}, {application-record-element=DET_CONFD_AZIMUTH_342, system-signal=DET_CONFD_AZIMUTH_342}, {application-record-element=DET_CONFD_AZIMUTH_343, system-signal=DET_CONFD_AZIMUTH_343}, {application-record-element=DET_CONFD_AZIMUTH_344, system-signal=DET_CONFD_AZIMUTH_344}, {application-record-element=DET_CONFD_ELEVATION_341, system-signal=DET_CONFD_ELEVATION_341}, {application-record-element=DET_CONFD_ELEVATION_342, system-signal=DET_CONFD_ELEVATION_342}, {application-record-element=DET_CONFD_ELEVATION_343, system-signal=DET_CONFD_ELEVATION_343}, {application-record-element=DET_CONFD_ELEVATION_344, system-signal=DET_CONFD_ELEVATION_344}, {application-record-element=DET_ELEVATION_341, system-signal=DET_ELEVATION_341}, {application-record-element=DET_ELEVATION_342, system-signal=DET_ELEVATION_342}, {application-record-element=DET_ELEVATION_343, system-signal=DET_ELEVATION_343}, {application-record-element=DET_ELEVATION_344, system-signal=DET_ELEVATION_344}, {application-record-element=DET_ELEVATION_ERR_341, system-signal=DET_ELEVATION_ERR_341}, {application-record-element=DET_ELEVATION_ERR_342, system-signal=DET_ELEVATION_ERR_342}, {application-record-element=DET_ELEVATION_ERR_343, system-signal=DET_ELEVATION_ERR_343}, {application-record-element=DET_ELEVATION_ERR_344, system-signal=DET_ELEVATION_ERR_344}, {application-record-element=DET_EXISTENCE_PROB_341, system-signal=DET_EXISTENCE_PROB_341}, {application-record-element=DET_EXISTENCE_PROB_342, system-signal=DET_EXISTENCE_PROB_342}, {application-record-element=DET_EXISTENCE_PROB_343, system-signal=DET_EXISTENCE_PROB_343}, {application-record-element=DET_EXISTENCE_PROB_344, system-signal=DET_EXISTENCE_PROB_344}, {application-record-element=DET_HVC_FLAG_341, system-signal=DET_HVC_FLAG_341}, {application-record-element=DET_HVC_FLAG_342, system-signal=DET_HVC_FLAG_342}, {application-record-element=DET_HVC_FLAG_343, system-signal=DET_HVC_FLAG_343}, {application-record-element=DET_HVC_FLAG_344, system-signal=DET_HVC_FLAG_344}, {application-record-element=DET_IDM_341, system-signal=DET_IDM_341}, {application-record-element=DET_IDM_342, system-signal=DET_IDM_342}, {application-record-element=DET_IDM_343, system-signal=DET_IDM_343}, {application-record-element=DET_IDM_344, system-signal=DET_IDM_344}, {application-record-element=DET_MH_CRC16_341_344, system-signal=DET_MH_CRC16_341_344}, {application-record-element=DET_MH_CYCLE_COUNTER_341_344, system-signal=DET_MH_CYCLE_COUNTER_341_344}, {application-record-element=DET_MH_SCAN_INDEX_4LSB_341_344, system-signal=DET_MH_SCAN_INDEX_4LSB_341_344}, {application-record-element=DET_MTD_341, system-signal=DET_MTD_341}, {application-record-element=DET_MTD_342, system-signal=DET_MTD_342}, {application-record-element=DET_MTD_343, system-signal=DET_MTD_343}, {application-record-element=DET_MTD_344, system-signal=DET_MTD_344}, {application-record-element=DET_PROB_1STAZHYPO_341, system-signal=DET_PROB_1STAZHYPO_341}, {application-record-element=DET_PROB_1STAZHYPO_342, system-signal=DET_PROB_1STAZHYPO_342}, {application-record-element=DET_PROB_1STAZHYPO_343, system-signal=DET_PROB_1STAZHYPO_343}, {application-record-element=DET_PROB_1STAZHYPO_344, system-signal=DET_PROB_1STAZHYPO_344}, {application-record-element=DET_RANGE_341, system-signal=DET_RANGE_341}, {application-record-element=DET_RANGE_342, system-signal=DET_RANGE_342}, {application-record-element=DET_RANGE_343, system-signal=DET_RANGE_343}, {application-record-element=DET_RANGE_344, system-signal=DET_RANGE_344}, {application-record-element=DET_RANGE_ERR_341, system-signal=DET_RANGE_ERR_341}, {application-record-element=DET_RANGE_ERR_342, system-signal=DET_RANGE_ERR_342}, {application-record-element=DET_RANGE_ERR_343, system-signal=DET_RANGE_ERR_343}, {application-record-element=DET_RANGE_ERR_344, system-signal=DET_RANGE_ERR_344}, {application-record-element=DET_RANGE_VELOCITY_341, system-signal=DET_RANGE_VELOCITY_341}, {application-record-element=DET_RANGE_VELOCITY_342, system-signal=DET_RANGE_VELOCITY_342}, {application-record-element=DET_RANGE_VELOCITY_343, system-signal=DET_RANGE_VELOCITY_343}, {application-record-element=DET_RANGE_VELOCITY_344, system-signal=DET_RANGE_VELOCITY_344}, {application-record-element=DET_RANGE_VELOCITY_ERR_341, system-signal=DET_RANGE_VELOCITY_ERR_341}, {application-record-element=DET_RANGE_VELOCITY_ERR_342, system-signal=DET_RANGE_VELOCITY_ERR_342}, {application-record-element=DET_RANGE_VELOCITY_ERR_343, system-signal=DET_RANGE_VELOCITY_ERR_343}, {application-record-element=DET_RANGE_VELOCITY_ERR_344, system-signal=DET_RANGE_VELOCITY_ERR_344}, {application-record-element=DET_RCS_341, system-signal=DET_RCS_341}, {application-record-element=DET_RCS_342, system-signal=DET_RCS_342}, {application-record-element=DET_RCS_343, system-signal=DET_RCS_343}, {application-record-element=DET_RCS_344, system-signal=DET_RCS_344}, {application-record-element=DET_SNR_341, system-signal=DET_SNR_341}, {application-record-element=DET_SNR_342, system-signal=DET_SNR_342}, {application-record-element=DET_SNR_343, system-signal=DET_SNR_343}, {application-record-element=DET_SNR_344, system-signal=DET_SNR_344}, {application-record-element=DET_SUPER_RES_TARGET_341, system-signal=DET_SUPER_RES_TARGET_341}, {application-record-element=DET_SUPER_RES_TARGET_342, system-signal=DET_SUPER_RES_TARGET_342}, {application-record-element=DET_SUPER_RES_TARGET_343, system-signal=DET_SUPER_RES_TARGET_343}, {application-record-element=DET_SUPER_RES_TARGET_344, system-signal=DET_SUPER_RES_TARGET_344}]}
        sender-receiver-to-signal-group-mapping={data-element=Pp_SG_Detections_345_348_AL.Vdp_SG_Detections_345_348_AL, signal-group=SG_Detections_345_348, type-mapping=sender-rec-record-type-mapping=record-element-mappings=[{application-record-element=DET_AZIMUTH_345, system-signal=DET_AZIMUTH_345}, {application-record-element=DET_AZIMUTH_346, system-signal=DET_AZIMUTH_346}, {application-record-element=DET_AZIMUTH_347, system-signal=DET_AZIMUTH_347}, {application-record-element=DET_AZIMUTH_348, system-signal=DET_AZIMUTH_348}, {application-record-element=DET_AZIMUTH_ERR_345, system-signal=DET_AZIMUTH_ERR_345}, {application-record-element=DET_AZIMUTH_ERR_346, system-signal=DET_AZIMUTH_ERR_346}, {application-record-element=DET_AZIMUTH_ERR_347, system-signal=DET_AZIMUTH_ERR_347}, {application-record-element=DET_AZIMUTH_ERR_348, system-signal=DET_AZIMUTH_ERR_348}, {application-record-element=DET_BELOW_RAIN_THOLD_345, system-signal=DET_BELOW_RAIN_THOLD_345}, {application-record-element=DET_BELOW_RAIN_THOLD_346, system-signal=DET_BELOW_RAIN_THOLD_346}, {application-record-element=DET_BELOW_RAIN_THOLD_347, system-signal=DET_BELOW_RAIN_THOLD_347}, {application-record-element=DET_BELOW_RAIN_THOLD_348, system-signal=DET_BELOW_RAIN_THOLD_348}, {application-record-element=DET_BI_STATIC_FLAG_345, system-signal=DET_BI_STATIC_FLAG_345}, {application-record-element=DET_BI_STATIC_FLAG_346, system-signal=DET_BI_STATIC_FLAG_346}, {application-record-element=DET_BI_STATIC_FLAG_347, system-signal=DET_BI_STATIC_FLAG_347}, {application-record-element=DET_BI_STATIC_FLAG_348, system-signal=DET_BI_STATIC_FLAG_348}, {application-record-element=DET_CONFD_AZIMUTH_345, system-signal=DET_CONFD_AZIMUTH_345}, {application-record-element=DET_CONFD_AZIMUTH_346, system-signal=DET_CONFD_AZIMUTH_346}, {application-record-element=DET_CONFD_AZIMUTH_347, system-signal=DET_CONFD_AZIMUTH_347}, {application-record-element=DET_CONFD_AZIMUTH_348, system-signal=DET_CONFD_AZIMUTH_348}, {application-record-element=DET_CONFD_ELEVATION_345, system-signal=DET_CONFD_ELEVATION_345}, {application-record-element=DET_CONFD_ELEVATION_346, system-signal=DET_CONFD_ELEVATION_346}, {application-record-element=DET_CONFD_ELEVATION_347, system-signal=DET_CONFD_ELEVATION_347}, {application-record-element=DET_CONFD_ELEVATION_348, system-signal=DET_CONFD_ELEVATION_348}, {application-record-element=DET_ELEVATION_345, system-signal=DET_ELEVATION_345}, {application-record-element=DET_ELEVATION_346, system-signal=DET_ELEVATION_346}, {application-record-element=DET_ELEVATION_347, system-signal=DET_ELEVATION_347}, {application-record-element=DET_ELEVATION_348, system-signal=DET_ELEVATION_348}, {application-record-element=DET_ELEVATION_ERR_345, system-signal=DET_ELEVATION_ERR_345}, {application-record-element=DET_ELEVATION_ERR_346, system-signal=DET_ELEVATION_ERR_346}, {application-record-element=DET_ELEVATION_ERR_347, system-signal=DET_ELEVATION_ERR_347}, {application-record-element=DET_ELEVATION_ERR_348, system-signal=DET_ELEVATION_ERR_348}, {application-record-element=DET_EXISTENCE_PROB_345, system-signal=DET_EXISTENCE_PROB_345}, {application-record-element=DET_EXISTENCE_PROB_346, system-signal=DET_EXISTENCE_PROB_346}, {application-record-element=DET_EXISTENCE_PROB_347, system-signal=DET_EXISTENCE_PROB_347}, {application-record-element=DET_EXISTENCE_PROB_348, system-signal=DET_EXISTENCE_PROB_348}, {application-record-element=DET_HVC_FLAG_345, system-signal=DET_HVC_FLAG_345}, {application-record-element=DET_HVC_FLAG_346, system-signal=DET_HVC_FLAG_346}, {application-record-element=DET_HVC_FLAG_347, system-signal=DET_HVC_FLAG_347}, {application-record-element=DET_HVC_FLAG_348, system-signal=DET_HVC_FLAG_348}, {application-record-element=DET_IDM_345, system-signal=DET_IDM_345}, {application-record-element=DET_IDM_346, system-signal=DET_IDM_346}, {application-record-element=DET_IDM_347, system-signal=DET_IDM_347}, {application-record-element=DET_IDM_348, system-signal=DET_IDM_348}, {application-record-element=DET_MH_CRC16_345_348, system-signal=DET_MH_CRC16_345_348}, {application-record-element=DET_MH_CYCLE_COUNTER_345_348, system-signal=DET_MH_CYCLE_COUNTER_345_348}, {application-record-element=DET_MH_SCAN_INDEX_4LSB_345_348, system-signal=DET_MH_SCAN_INDEX_4LSB_345_348}, {application-record-element=DET_MTD_345, system-signal=DET_MTD_345}, {application-record-element=DET_MTD_346, system-signal=DET_MTD_346}, {application-record-element=DET_MTD_347, system-signal=DET_MTD_347}, {application-record-element=DET_MTD_348, system-signal=DET_MTD_348}, {application-record-element=DET_PROB_1STAZHYPO_345, system-signal=DET_PROB_1STAZHYPO_345}, {application-record-element=DET_PROB_1STAZHYPO_346, system-signal=DET_PROB_1STAZHYPO_346}, {application-record-element=DET_PROB_1STAZHYPO_347, system-signal=DET_PROB_1STAZHYPO_347}, {application-record-element=DET_PROB_1STAZHYPO_348, system-signal=DET_PROB_1STAZHYPO_348}, {application-record-element=DET_RANGE_345, system-signal=DET_RANGE_345}, {application-record-element=DET_RANGE_346, system-signal=DET_RANGE_346}, {application-record-element=DET_RANGE_347, system-signal=DET_RANGE_347}, {application-record-element=DET_RANGE_348, system-signal=DET_RANGE_348}, {application-record-element=DET_RANGE_ERR_345, system-signal=DET_RANGE_ERR_345}, {application-record-element=DET_RANGE_ERR_346, system-signal=DET_RANGE_ERR_346}, {application-record-element=DET_RANGE_ERR_347, system-signal=DET_RANGE_ERR_347}, {application-record-element=DET_RANGE_ERR_348, system-signal=DET_RANGE_ERR_348}, {application-record-element=DET_RANGE_VELOCITY_345, system-signal=DET_RANGE_VELOCITY_345}, {application-record-element=DET_RANGE_VELOCITY_346, system-signal=DET_RANGE_VELOCITY_346}, {application-record-element=DET_RANGE_VELOCITY_347, system-signal=DET_RANGE_VELOCITY_347}, {application-record-element=DET_RANGE_VELOCITY_348, system-signal=DET_RANGE_VELOCITY_348}, {application-record-element=DET_RANGE_VELOCITY_ERR_345, system-signal=DET_RANGE_VELOCITY_ERR_345}, {application-record-element=DET_RANGE_VELOCITY_ERR_346, system-signal=DET_RANGE_VELOCITY_ERR_346}, {application-record-element=DET_RANGE_VELOCITY_ERR_347, system-signal=DET_RANGE_VELOCITY_ERR_347}, {application-record-element=DET_RANGE_VELOCITY_ERR_348, system-signal=DET_RANGE_VELOCITY_ERR_348}, {application-record-element=DET_RCS_345, system-signal=DET_RCS_345}, {application-record-element=DET_RCS_346, system-signal=DET_RCS_346}, {application-record-element=DET_RCS_347, system-signal=DET_RCS_347}, {application-record-element=DET_RCS_348, system-signal=DET_RCS_348}, {application-record-element=DET_SNR_345, system-signal=DET_SNR_345}, {application-record-element=DET_SNR_346, system-signal=DET_SNR_346}, {application-record-element=DET_SNR_347, system-signal=DET_SNR_347}, {application-record-element=DET_SNR_348, system-signal=DET_SNR_348}, {application-record-element=DET_SUPER_RES_TARGET_345, system-signal=DET_SUPER_RES_TARGET_345}, {application-record-element=DET_SUPER_RES_TARGET_346, system-signal=DET_SUPER_RES_TARGET_346}, {application-record-element=DET_SUPER_RES_TARGET_347, system-signal=DET_SUPER_RES_TARGET_347}, {application-record-element=DET_SUPER_RES_TARGET_348, system-signal=DET_SUPER_RES_TARGET_348}]}
        sender-receiver-to-signal-group-mapping={data-element=Pp_SG_Detections_349_352_AL.Vdp_SG_Detections_349_352_AL, signal-group=SG_Detections_349_352, type-mapping=sender-rec-record-type-mapping=record-element-mappings=[{application-record-element=DET_AZIMUTH_349, system-signal=DET_AZIMUTH_349}, {application-record-element=DET_AZIMUTH_350, system-signal=DET_AZIMUTH_350}, {application-record-element=DET_AZIMUTH_351, system-signal=DET_AZIMUTH_351}, {application-record-element=DET_AZIMUTH_352, system-signal=DET_AZIMUTH_352}, {application-record-element=DET_AZIMUTH_ERR_349, system-signal=DET_AZIMUTH_ERR_349}, {application-record-element=DET_AZIMUTH_ERR_350, system-signal=DET_AZIMUTH_ERR_350}, {application-record-element=DET_AZIMUTH_ERR_351, system-signal=DET_AZIMUTH_ERR_351}, {application-record-element=DET_AZIMUTH_ERR_352, system-signal=DET_AZIMUTH_ERR_352}, {application-record-element=DET_BELOW_RAIN_THOLD_349, system-signal=DET_BELOW_RAIN_THOLD_349}, {application-record-element=DET_BELOW_RAIN_THOLD_350, system-signal=DET_BELOW_RAIN_THOLD_350}, {application-record-element=DET_BELOW_RAIN_THOLD_351, system-signal=DET_BELOW_RAIN_THOLD_351}, {application-record-element=DET_BELOW_RAIN_THOLD_352, system-signal=DET_BELOW_RAIN_THOLD_352}, {application-record-element=DET_BI_STATIC_FLAG_349, system-signal=DET_BI_STATIC_FLAG_349}, {application-record-element=DET_BI_STATIC_FLAG_350, system-signal=DET_BI_STATIC_FLAG_350}, {application-record-element=DET_BI_STATIC_FLAG_351, system-signal=DET_BI_STATIC_FLAG_351}, {application-record-element=DET_BI_STATIC_FLAG_352, system-signal=DET_BI_STATIC_FLAG_352}, {application-record-element=DET_CONFD_AZIMUTH_349, system-signal=DET_CONFD_AZIMUTH_349}, {application-record-element=DET_CONFD_AZIMUTH_350, system-signal=DET_CONFD_AZIMUTH_350}, {application-record-element=DET_CONFD_AZIMUTH_351, system-signal=DET_CONFD_AZIMUTH_351}, {application-record-element=DET_CONFD_AZIMUTH_352, system-signal=DET_CONFD_AZIMUTH_352}, {application-record-element=DET_CONFD_ELEVATION_349, system-signal=DET_CONFD_ELEVATION_349}, {application-record-element=DET_CONFD_ELEVATION_350, system-signal=DET_CONFD_ELEVATION_350}, {application-record-element=DET_CONFD_ELEVATION_351, system-signal=DET_CONFD_ELEVATION_351}, {application-record-element=DET_CONFD_ELEVATION_352, system-signal=DET_CONFD_ELEVATION_352}, {application-record-element=DET_ELEVATION_349, system-signal=DET_ELEVATION_349}, {application-record-element=DET_ELEVATION_350, system-signal=DET_ELEVATION_350}, {application-record-element=DET_ELEVATION_351, system-signal=DET_ELEVATION_351}, {application-record-element=DET_ELEVATION_352, system-signal=DET_ELEVATION_352}, {application-record-element=DET_ELEVATION_ERR_349, system-signal=DET_ELEVATION_ERR_349}, {application-record-element=DET_ELEVATION_ERR_350, system-signal=DET_ELEVATION_ERR_350}, {application-record-element=DET_ELEVATION_ERR_351, system-signal=DET_ELEVATION_ERR_351}, {application-record-element=DET_ELEVATION_ERR_352, system-signal=DET_ELEVATION_ERR_352}, {application-record-element=DET_EXISTENCE_PROB_349, system-signal=DET_EXISTENCE_PROB_349}, {application-record-element=DET_EXISTENCE_PROB_350, system-signal=DET_EXISTENCE_PROB_350}, {application-record-element=DET_EXISTENCE_PROB_351, system-signal=DET_EXISTENCE_PROB_351}, {application-record-element=DET_EXISTENCE_PROB_352, system-signal=DET_EXISTENCE_PROB_352}, {application-record-element=DET_HVC_FLAG_349, system-signal=DET_HVC_FLAG_349}, {application-record-element=DET_HVC_FLAG_350, system-signal=DET_HVC_FLAG_350}, {application-record-element=DET_HVC_FLAG_351, system-signal=DET_HVC_FLAG_351}, {application-record-element=DET_HVC_FLAG_352, system-signal=DET_HVC_FLAG_352}, {application-record-element=DET_IDM_349, system-signal=DET_IDM_349}, {application-record-element=DET_IDM_350, system-signal=DET_IDM_350}, {application-record-element=DET_IDM_351, system-signal=DET_IDM_351}, {application-record-element=DET_IDM_352, system-signal=DET_IDM_352}, {application-record-element=DET_MH_CRC16_349_352, system-signal=DET_MH_CRC16_349_352}, {application-record-element=DET_MH_CYCLE_COUNTER_349_352, system-signal=DET_MH_CYCLE_COUNTER_349_352}, {application-record-element=DET_MH_SCAN_INDEX_4LSB_349_352, system-signal=DET_MH_SCAN_INDEX_4LSB_349_352}, {application-record-element=DET_MTD_349, system-signal=DET_MTD_349}, {application-record-element=DET_MTD_350, system-signal=DET_MTD_350}, {application-record-element=DET_MTD_351, system-signal=DET_MTD_351}, {application-record-element=DET_MTD_352, system-signal=DET_MTD_352}, {application-record-element=DET_PROB_1STAZHYPO_349, system-signal=DET_PROB_1STAZHYPO_349}, {application-record-element=DET_PROB_1STAZHYPO_350, system-signal=DET_PROB_1STAZHYPO_350}, {application-record-element=DET_PROB_1STAZHYPO_351, system-signal=DET_PROB_1STAZHYPO_351}, {application-record-element=DET_PROB_1STAZHYPO_352, system-signal=DET_PROB_1STAZHYPO_352}, {application-record-element=DET_RANGE_349, system-signal=DET_RANGE_349}, {application-record-element=DET_RANGE_350, system-signal=DET_RANGE_350}, {application-record-element=DET_RANGE_351, system-signal=DET_RANGE_351}, {application-record-element=DET_RANGE_352, system-signal=DET_RANGE_352}, {application-record-element=DET_RANGE_ERR_349, system-signal=DET_RANGE_ERR_349}, {application-record-element=DET_RANGE_ERR_350, system-signal=DET_RANGE_ERR_350}, {application-record-element=DET_RANGE_ERR_351, system-signal=DET_RANGE_ERR_351}, {application-record-element=DET_RANGE_ERR_352, system-signal=DET_RANGE_ERR_352}, {application-record-element=DET_RANGE_VELOCITY_349, system-signal=DET_RANGE_VELOCITY_349}, {application-record-element=DET_RANGE_VELOCITY_350, system-signal=DET_RANGE_VELOCITY_350}, {application-record-element=DET_RANGE_VELOCITY_351, system-signal=DET_RANGE_VELOCITY_351}, {application-record-element=DET_RANGE_VELOCITY_352, system-signal=DET_RANGE_VELOCITY_352}, {application-record-element=DET_RANGE_VELOCITY_ERR_349, system-signal=DET_RANGE_VELOCITY_ERR_349}, {application-record-element=DET_RANGE_VELOCITY_ERR_350, system-signal=DET_RANGE_VELOCITY_ERR_350}, {application-record-element=DET_RANGE_VELOCITY_ERR_351, system-signal=DET_RANGE_VELOCITY_ERR_351}, {application-record-element=DET_RANGE_VELOCITY_ERR_352, system-signal=DET_RANGE_VELOCITY_ERR_352}, {application-record-element=DET_RCS_349, system-signal=DET_RCS_349}, {application-record-element=DET_RCS_350, system-signal=DET_RCS_350}, {application-record-element=DET_RCS_351, system-signal=DET_RCS_351}, {application-record-element=DET_RCS_352, system-signal=DET_RCS_352}, {application-record-element=DET_SNR_349, system-signal=DET_SNR_349}, {application-record-element=DET_SNR_350, system-signal=DET_SNR_350}, {application-record-element=DET_SNR_351, system-signal=DET_SNR_351}, {application-record-element=DET_SNR_352, system-signal=DET_SNR_352}, {application-record-element=DET_SUPER_RES_TARGET_349, system-signal=DET_SUPER_RES_TARGET_349}, {application-record-element=DET_SUPER_RES_TARGET_350, system-signal=DET_SUPER_RES_TARGET_350}, {application-record-element=DET_SUPER_RES_TARGET_351, system-signal=DET_SUPER_RES_TARGET_351}, {application-record-element=DET_SUPER_RES_TARGET_352, system-signal=DET_SUPER_RES_TARGET_352}]}
        sender-receiver-to-signal-group-mapping={data-element=Pp_SG_Detections_353_356_AL.Vdp_SG_Detections_353_356_AL, signal-group=SG_Detections_353_356, type-mapping=sender-rec-record-type-mapping=record-element-mappings=[{application-record-element=DET_AZIMUTH_353, system-signal=DET_AZIMUTH_353}, {application-record-element=DET_AZIMUTH_354, system-signal=DET_AZIMUTH_354}, {application-record-element=DET_AZIMUTH_355, system-signal=DET_AZIMUTH_355}, {application-record-element=DET_AZIMUTH_356, system-signal=DET_AZIMUTH_356}, {application-record-element=DET_AZIMUTH_ERR_353, system-signal=DET_AZIMUTH_ERR_353}, {application-record-element=DET_AZIMUTH_ERR_354, system-signal=DET_AZIMUTH_ERR_354}, {application-record-element=DET_AZIMUTH_ERR_355, system-signal=DET_AZIMUTH_ERR_355}, {application-record-element=DET_AZIMUTH_ERR_356, system-signal=DET_AZIMUTH_ERR_356}, {application-record-element=DET_BELOW_RAIN_THOLD_353, system-signal=DET_BELOW_RAIN_THOLD_353}, {application-record-element=DET_BELOW_RAIN_THOLD_354, system-signal=DET_BELOW_RAIN_THOLD_354}, {application-record-element=DET_BELOW_RAIN_THOLD_355, system-signal=DET_BELOW_RAIN_THOLD_355}, {application-record-element=DET_BELOW_RAIN_THOLD_356, system-signal=DET_BELOW_RAIN_THOLD_356}, {application-record-element=DET_BI_STATIC_FLAG_353, system-signal=DET_BI_STATIC_FLAG_353}, {application-record-element=DET_BI_STATIC_FLAG_354, system-signal=DET_BI_STATIC_FLAG_354}, {application-record-element=DET_BI_STATIC_FLAG_355, system-signal=DET_BI_STATIC_FLAG_355}, {application-record-element=DET_BI_STATIC_FLAG_356, system-signal=DET_BI_STATIC_FLAG_356}, {application-record-element=DET_CONFD_AZIMUTH_353, system-signal=DET_CONFD_AZIMUTH_353}, {application-record-element=DET_CONFD_AZIMUTH_354, system-signal=DET_CONFD_AZIMUTH_354}, {application-record-element=DET_CONFD_AZIMUTH_355, system-signal=DET_CONFD_AZIMUTH_355}, {application-record-element=DET_CONFD_AZIMUTH_356, system-signal=DET_CONFD_AZIMUTH_356}, {application-record-element=DET_CONFD_ELEVATION_353, system-signal=DET_CONFD_ELEVATION_353}, {application-record-element=DET_CONFD_ELEVATION_354, system-signal=DET_CONFD_ELEVATION_354}, {application-record-element=DET_CONFD_ELEVATION_355, system-signal=DET_CONFD_ELEVATION_355}, {application-record-element=DET_CONFD_ELEVATION_356, system-signal=DET_CONFD_ELEVATION_356}, {application-record-element=DET_ELEVATION_353, system-signal=DET_ELEVATION_353}, {application-record-element=DET_ELEVATION_354, system-signal=DET_ELEVATION_354}, {application-record-element=DET_ELEVATION_355, system-signal=DET_ELEVATION_355}, {application-record-element=DET_ELEVATION_356, system-signal=DET_ELEVATION_356}, {application-record-element=DET_ELEVATION_ERR_353, system-signal=DET_ELEVATION_ERR_353}, {application-record-element=DET_ELEVATION_ERR_354, system-signal=DET_ELEVATION_ERR_354}, {application-record-element=DET_ELEVATION_ERR_355, system-signal=DET_ELEVATION_ERR_355}, {application-record-element=DET_ELEVATION_ERR_356, system-signal=DET_ELEVATION_ERR_356}, {application-record-element=DET_EXISTENCE_PROB_353, system-signal=DET_EXISTENCE_PROB_353}, {application-record-element=DET_EXISTENCE_PROB_354, system-signal=DET_EXISTENCE_PROB_354}, {application-record-element=DET_EXISTENCE_PROB_355, system-signal=DET_EXISTENCE_PROB_355}, {application-record-element=DET_EXISTENCE_PROB_356, system-signal=DET_EXISTENCE_PROB_356}, {application-record-element=DET_HVC_FLAG_353, system-signal=DET_HVC_FLAG_353}, {application-record-element=DET_HVC_FLAG_354, system-signal=DET_HVC_FLAG_354}, {application-record-element=DET_HVC_FLAG_355, system-signal=DET_HVC_FLAG_355}, {application-record-element=DET_HVC_FLAG_356, system-signal=DET_HVC_FLAG_356}, {application-record-element=DET_IDM_353, system-signal=DET_IDM_353}, {application-record-element=DET_IDM_354, system-signal=DET_IDM_354}, {application-record-element=DET_IDM_355, system-signal=DET_IDM_355}, {application-record-element=DET_IDM_356, system-signal=DET_IDM_356}, {application-record-element=DET_MH_CRC16_353_356, system-signal=DET_MH_CRC16_353_356}, {application-record-element=DET_MH_CYCLE_COUNTER_353_356, system-signal=DET_MH_CYCLE_COUNTER_353_356}, {application-record-element=DET_MH_SCAN_INDEX_4LSB_353_356, system-signal=DET_MH_SCAN_INDEX_4LSB_353_356}, {application-record-element=DET_MTD_353, system-signal=DET_MTD_353}, {application-record-element=DET_MTD_354, system-signal=DET_MTD_354}, {application-record-element=DET_MTD_355, system-signal=DET_MTD_355}, {application-record-element=DET_MTD_356, system-signal=DET_MTD_356}, {application-record-element=DET_PROB_1STAZHYPO_353, system-signal=DET_PROB_1STAZHYPO_353}, {application-record-element=DET_PROB_1STAZHYPO_354, system-signal=DET_PROB_1STAZHYPO_354}, {application-record-element=DET_PROB_1STAZHYPO_355, system-signal=DET_PROB_1STAZHYPO_355}, {application-record-element=DET_PROB_1STAZHYPO_356, system-signal=DET_PROB_1STAZHYPO_356}, {application-record-element=DET_RANGE_353, system-signal=DET_RANGE_353}, {application-record-element=DET_RANGE_354, system-signal=DET_RANGE_354}, {application-record-element=DET_RANGE_355, system-signal=DET_RANGE_355}, {application-record-element=DET_RANGE_356, system-signal=DET_RANGE_356}, {application-record-element=DET_RANGE_ERR_353, system-signal=DET_RANGE_ERR_353}, {application-record-element=DET_RANGE_ERR_354, system-signal=DET_RANGE_ERR_354}, {application-record-element=DET_RANGE_ERR_355, system-signal=DET_RANGE_ERR_355}, {application-record-element=DET_RANGE_ERR_356, system-signal=DET_RANGE_ERR_356}, {application-record-element=DET_RANGE_VELOCITY_353, system-signal=DET_RANGE_VELOCITY_353}, {application-record-element=DET_RANGE_VELOCITY_354, system-signal=DET_RANGE_VELOCITY_354}, {application-record-element=DET_RANGE_VELOCITY_355, system-signal=DET_RANGE_VELOCITY_355}, {application-record-element=DET_RANGE_VELOCITY_356, system-signal=DET_RANGE_VELOCITY_356}, {application-record-element=DET_RANGE_VELOCITY_ERR_353, system-signal=DET_RANGE_VELOCITY_ERR_353}, {application-record-element=DET_RANGE_VELOCITY_ERR_354, system-signal=DET_RANGE_VELOCITY_ERR_354}, {application-record-element=DET_RANGE_VELOCITY_ERR_355, system-signal=DET_RANGE_VELOCITY_ERR_355}, {application-record-element=DET_RANGE_VELOCITY_ERR_356, system-signal=DET_RANGE_VELOCITY_ERR_356}, {application-record-element=DET_RCS_353, system-signal=DET_RCS_353}, {application-record-element=DET_RCS_354, system-signal=DET_RCS_354}, {application-record-element=DET_RCS_355, system-signal=DET_RCS_355}, {application-record-element=DET_RCS_356, system-signal=DET_RCS_356}, {application-record-element=DET_SNR_353, system-signal=DET_SNR_353}, {application-record-element=DET_SNR_354, system-signal=DET_SNR_354}, {application-record-element=DET_SNR_355, system-signal=DET_SNR_355}, {application-record-element=DET_SNR_356, system-signal=DET_SNR_356}, {application-record-element=DET_SUPER_RES_TARGET_353, system-signal=DET_SUPER_RES_TARGET_353}, {application-record-element=DET_SUPER_RES_TARGET_354, system-signal=DET_SUPER_RES_TARGET_354}, {application-record-element=DET_SUPER_RES_TARGET_355, system-signal=DET_SUPER_RES_TARGET_355}, {application-record-element=DET_SUPER_RES_TARGET_356, system-signal=DET_SUPER_RES_TARGET_356}]}
        sender-receiver-to-signal-group-mapping={data-element=Pp_SG_Detections_357_360_AL.Vdp_SG_Detections_357_360_AL, signal-group=SG_Detections_357_360, type-mapping=sender-rec-record-type-mapping=record-element-mappings=[{application-record-element=DET_AZIMUTH_357, system-signal=DET_AZIMUTH_357}, {application-record-element=DET_AZIMUTH_358, system-signal=DET_AZIMUTH_358}, {application-record-element=DET_AZIMUTH_359, system-signal=DET_AZIMUTH_359}, {application-record-element=DET_AZIMUTH_360, system-signal=DET_AZIMUTH_360}, {application-record-element=DET_AZIMUTH_ERR_357, system-signal=DET_AZIMUTH_ERR_357}, {application-record-element=DET_AZIMUTH_ERR_358, system-signal=DET_AZIMUTH_ERR_358}, {application-record-element=DET_AZIMUTH_ERR_359, system-signal=DET_AZIMUTH_ERR_359}, {application-record-element=DET_AZIMUTH_ERR_360, system-signal=DET_AZIMUTH_ERR_360}, {application-record-element=DET_BELOW_RAIN_THOLD_357, system-signal=DET_BELOW_RAIN_THOLD_357}, {application-record-element=DET_BELOW_RAIN_THOLD_358, system-signal=DET_BELOW_RAIN_THOLD_358}, {application-record-element=DET_BELOW_RAIN_THOLD_359, system-signal=DET_BELOW_RAIN_THOLD_359}, {application-record-element=DET_BELOW_RAIN_THOLD_360, system-signal=DET_BELOW_RAIN_THOLD_360}, {application-record-element=DET_BI_STATIC_FLAG_357, system-signal=DET_BI_STATIC_FLAG_357}, {application-record-element=DET_BI_STATIC_FLAG_358, system-signal=DET_BI_STATIC_FLAG_358}, {application-record-element=DET_BI_STATIC_FLAG_359, system-signal=DET_BI_STATIC_FLAG_359}, {application-record-element=DET_BI_STATIC_FLAG_360, system-signal=DET_BI_STATIC_FLAG_360}, {application-record-element=DET_CONFD_AZIMUTH_357, system-signal=DET_CONFD_AZIMUTH_357}, {application-record-element=DET_CONFD_AZIMUTH_358, system-signal=DET_CONFD_AZIMUTH_358}, {application-record-element=DET_CONFD_AZIMUTH_359, system-signal=DET_CONFD_AZIMUTH_359}, {application-record-element=DET_CONFD_AZIMUTH_360, system-signal=DET_CONFD_AZIMUTH_360}, {application-record-element=DET_CONFD_ELEVATION_357, system-signal=DET_CONFD_ELEVATION_357}, {application-record-element=DET_CONFD_ELEVATION_358, system-signal=DET_CONFD_ELEVATION_358}, {application-record-element=DET_CONFD_ELEVATION_359, system-signal=DET_CONFD_ELEVATION_359}, {application-record-element=DET_CONFD_ELEVATION_360, system-signal=DET_CONFD_ELEVATION_360}, {application-record-element=DET_ELEVATION_357, system-signal=DET_ELEVATION_357}, {application-record-element=DET_ELEVATION_358, system-signal=DET_ELEVATION_358}, {application-record-element=DET_ELEVATION_359, system-signal=DET_ELEVATION_359}, {application-record-element=DET_ELEVATION_360, system-signal=DET_ELEVATION_360}, {application-record-element=DET_ELEVATION_ERR_357, system-signal=DET_ELEVATION_ERR_357}, {application-record-element=DET_ELEVATION_ERR_358, system-signal=DET_ELEVATION_ERR_358}, {application-record-element=DET_ELEVATION_ERR_359, system-signal=DET_ELEVATION_ERR_359}, {application-record-element=DET_ELEVATION_ERR_360, system-signal=DET_ELEVATION_ERR_360}, {application-record-element=DET_EXISTENCE_PROB_357, system-signal=DET_EXISTENCE_PROB_357}, {application-record-element=DET_EXISTENCE_PROB_358, system-signal=DET_EXISTENCE_PROB_358}, {application-record-element=DET_EXISTENCE_PROB_359, system-signal=DET_EXISTENCE_PROB_359}, {application-record-element=DET_EXISTENCE_PROB_360, system-signal=DET_EXISTENCE_PROB_360}, {application-record-element=DET_HVC_FLAG_357, system-signal=DET_HVC_FLAG_357}, {application-record-element=DET_HVC_FLAG_358, system-signal=DET_HVC_FLAG_358}, {application-record-element=DET_HVC_FLAG_359, system-signal=DET_HVC_FLAG_359}, {application-record-element=DET_HVC_FLAG_360, system-signal=DET_HVC_FLAG_360}, {application-record-element=DET_IDM_357, system-signal=DET_IDM_357}, {application-record-element=DET_IDM_358, system-signal=DET_IDM_358}, {application-record-element=DET_IDM_359, system-signal=DET_IDM_359}, {application-record-element=DET_IDM_360, system-signal=DET_IDM_360}, {application-record-element=DET_MH_CRC16_357_360, system-signal=DET_MH_CRC16_357_360}, {application-record-element=DET_MH_CYCLE_COUNTER_357_360, system-signal=DET_MH_CYCLE_COUNTER_357_360}, {application-record-element=DET_MH_SCAN_INDEX_4LSB_357_360, system-signal=DET_MH_SCAN_INDEX_4LSB_357_360}, {application-record-element=DET_MTD_357, system-signal=DET_MTD_357}, {application-record-element=DET_MTD_358, system-signal=DET_MTD_358}, {application-record-element=DET_MTD_359, system-signal=DET_MTD_359}, {application-record-element=DET_MTD_360, system-signal=DET_MTD_360}, {application-record-element=DET_PROB_1STAZHYPO_357, system-signal=DET_PROB_1STAZHYPO_357}, {application-record-element=DET_PROB_1STAZHYPO_358, system-signal=DET_PROB_1STAZHYPO_358}, {application-record-element=DET_PROB_1STAZHYPO_359, system-signal=DET_PROB_1STAZHYPO_359}, {application-record-element=DET_PROB_1STAZHYPO_360, system-signal=DET_PROB_1STAZHYPO_360}, {application-record-element=DET_RANGE_357, system-signal=DET_RANGE_357}, {application-record-element=DET_RANGE_358, system-signal=DET_RANGE_358}, {application-record-element=DET_RANGE_359, system-signal=DET_RANGE_359}, {application-record-element=DET_RANGE_360, system-signal=DET_RANGE_360}, {application-record-element=DET_RANGE_ERR_357, system-signal=DET_RANGE_ERR_357}, {application-record-element=DET_RANGE_ERR_358, system-signal=DET_RANGE_ERR_358}, {application-record-element=DET_RANGE_ERR_359, system-signal=DET_RANGE_ERR_359}, {application-record-element=DET_RANGE_ERR_360, system-signal=DET_RANGE_ERR_360}, {application-record-element=DET_RANGE_VELOCITY_357, system-signal=DET_RANGE_VELOCITY_357}, {application-record-element=DET_RANGE_VELOCITY_358, system-signal=DET_RANGE_VELOCITY_358}, {application-record-element=DET_RANGE_VELOCITY_359, system-signal=DET_RANGE_VELOCITY_359}, {application-record-element=DET_RANGE_VELOCITY_360, system-signal=DET_RANGE_VELOCITY_360}, {application-record-element=DET_RANGE_VELOCITY_ERR_357, system-signal=DET_RANGE_VELOCITY_ERR_357}, {application-record-element=DET_RANGE_VELOCITY_ERR_358, system-signal=DET_RANGE_VELOCITY_ERR_358}, {application-record-element=DET_RANGE_VELOCITY_ERR_359, system-signal=DET_RANGE_VELOCITY_ERR_359}, {application-record-element=DET_RANGE_VELOCITY_ERR_360, system-signal=DET_RANGE_VELOCITY_ERR_360}, {application-record-element=DET_RCS_357, system-signal=DET_RCS_357}, {application-record-element=DET_RCS_358, system-signal=DET_RCS_358}, {application-record-element=DET_RCS_359, system-signal=DET_RCS_359}, {application-record-element=DET_RCS_360, system-signal=DET_RCS_360}, {application-record-element=DET_SNR_357, system-signal=DET_SNR_357}, {application-record-element=DET_SNR_358, system-signal=DET_SNR_358}, {application-record-element=DET_SNR_359, system-signal=DET_SNR_359}, {application-record-element=DET_SNR_360, system-signal=DET_SNR_360}, {application-record-element=DET_SUPER_RES_TARGET_357, system-signal=DET_SUPER_RES_TARGET_357}, {application-record-element=DET_SUPER_RES_TARGET_358, system-signal=DET_SUPER_RES_TARGET_358}, {application-record-element=DET_SUPER_RES_TARGET_359, system-signal=DET_SUPER_RES_TARGET_359}, {application-record-element=DET_SUPER_RES_TARGET_360, system-signal=DET_SUPER_RES_TARGET_360}]}
        sender-receiver-to-signal-group-mapping={data-element=Pp_SG_Detections_361_364_AL.Vdp_SG_Detections_361_364_AL, signal-group=SG_Detections_361_364, type-mapping=sender-rec-record-type-mapping=record-element-mappings=[{application-record-element=DET_AZIMUTH_361, system-signal=DET_AZIMUTH_361}, {application-record-element=DET_AZIMUTH_362, system-signal=DET_AZIMUTH_362}, {application-record-element=DET_AZIMUTH_363, system-signal=DET_AZIMUTH_363}, {application-record-element=DET_AZIMUTH_364, system-signal=DET_AZIMUTH_364}, {application-record-element=DET_AZIMUTH_ERR_361, system-signal=DET_AZIMUTH_ERR_361}, {application-record-element=DET_AZIMUTH_ERR_362, system-signal=DET_AZIMUTH_ERR_362}, {application-record-element=DET_AZIMUTH_ERR_363, system-signal=DET_AZIMUTH_ERR_363}, {application-record-element=DET_AZIMUTH_ERR_364, system-signal=DET_AZIMUTH_ERR_364}, {application-record-element=DET_BELOW_RAIN_THOLD_361, system-signal=DET_BELOW_RAIN_THOLD_361}, {application-record-element=DET_BELOW_RAIN_THOLD_362, system-signal=DET_BELOW_RAIN_THOLD_362}, {application-record-element=DET_BELOW_RAIN_THOLD_363, system-signal=DET_BELOW_RAIN_THOLD_363}, {application-record-element=DET_BELOW_RAIN_THOLD_364, system-signal=DET_BELOW_RAIN_THOLD_364}, {application-record-element=DET_BI_STATIC_FLAG_361, system-signal=DET_BI_STATIC_FLAG_361}, {application-record-element=DET_BI_STATIC_FLAG_362, system-signal=DET_BI_STATIC_FLAG_362}, {application-record-element=DET_BI_STATIC_FLAG_363, system-signal=DET_BI_STATIC_FLAG_363}, {application-record-element=DET_BI_STATIC_FLAG_364, system-signal=DET_BI_STATIC_FLAG_364}, {application-record-element=DET_CONFD_AZIMUTH_361, system-signal=DET_CONFD_AZIMUTH_361}, {application-record-element=DET_CONFD_AZIMUTH_362, system-signal=DET_CONFD_AZIMUTH_362}, {application-record-element=DET_CONFD_AZIMUTH_363, system-signal=DET_CONFD_AZIMUTH_363}, {application-record-element=DET_CONFD_AZIMUTH_364, system-signal=DET_CONFD_AZIMUTH_364}, {application-record-element=DET_CONFD_ELEVATION_361, system-signal=DET_CONFD_ELEVATION_361}, {application-record-element=DET_CONFD_ELEVATION_362, system-signal=DET_CONFD_ELEVATION_362}, {application-record-element=DET_CONFD_ELEVATION_363, system-signal=DET_CONFD_ELEVATION_363}, {application-record-element=DET_CONFD_ELEVATION_364, system-signal=DET_CONFD_ELEVATION_364}, {application-record-element=DET_ELEVATION_361, system-signal=DET_ELEVATION_361}, {application-record-element=DET_ELEVATION_362, system-signal=DET_ELEVATION_362}, {application-record-element=DET_ELEVATION_363, system-signal=DET_ELEVATION_363}, {application-record-element=DET_ELEVATION_364, system-signal=DET_ELEVATION_364}, {application-record-element=DET_ELEVATION_ERR_361, system-signal=DET_ELEVATION_ERR_361}, {application-record-element=DET_ELEVATION_ERR_362, system-signal=DET_ELEVATION_ERR_362}, {application-record-element=DET_ELEVATION_ERR_363, system-signal=DET_ELEVATION_ERR_363}, {application-record-element=DET_ELEVATION_ERR_364, system-signal=DET_ELEVATION_ERR_364}, {application-record-element=DET_EXISTENCE_PROB_361, system-signal=DET_EXISTENCE_PROB_361}, {application-record-element=DET_EXISTENCE_PROB_362, system-signal=DET_EXISTENCE_PROB_362}, {application-record-element=DET_EXISTENCE_PROB_363, system-signal=DET_EXISTENCE_PROB_363}, {application-record-element=DET_EXISTENCE_PROB_364, system-signal=DET_EXISTENCE_PROB_364}, {application-record-element=DET_HVC_FLAG_361, system-signal=DET_HVC_FLAG_361}, {application-record-element=DET_HVC_FLAG_362, system-signal=DET_HVC_FLAG_362}, {application-record-element=DET_HVC_FLAG_363, system-signal=DET_HVC_FLAG_363}, {application-record-element=DET_HVC_FLAG_364, system-signal=DET_HVC_FLAG_364}, {application-record-element=DET_IDM_361, system-signal=DET_IDM_361}, {application-record-element=DET_IDM_362, system-signal=DET_IDM_362}, {application-record-element=DET_IDM_363, system-signal=DET_IDM_363}, {application-record-element=DET_IDM_364, system-signal=DET_IDM_364}, {application-record-element=DET_MH_CRC16_361_364, system-signal=DET_MH_CRC16_361_364}, {application-record-element=DET_MH_CYCLE_COUNTER_361_364, system-signal=DET_MH_CYCLE_COUNTER_361_364}, {application-record-element=DET_MH_SCAN_INDEX_4LSB_361_364, system-signal=DET_MH_SCAN_INDEX_4LSB_361_364}, {application-record-element=DET_MTD_361, system-signal=DET_MTD_361}, {application-record-element=DET_MTD_362, system-signal=DET_MTD_362}, {application-record-element=DET_MTD_363, system-signal=DET_MTD_363}, {application-record-element=DET_MTD_364, system-signal=DET_MTD_364}, {application-record-element=DET_PROB_1STAZHYPO_361, system-signal=DET_PROB_1STAZHYPO_361}, {application-record-element=DET_PROB_1STAZHYPO_362, system-signal=DET_PROB_1STAZHYPO_362}, {application-record-element=DET_PROB_1STAZHYPO_363, system-signal=DET_PROB_1STAZHYPO_363}, {application-record-element=DET_PROB_1STAZHYPO_364, system-signal=DET_PROB_1STAZHYPO_364}, {application-record-element=DET_RANGE_361, system-signal=DET_RANGE_361}, {application-record-element=DET_RANGE_362, system-signal=DET_RANGE_362}, {application-record-element=DET_RANGE_363, system-signal=DET_RANGE_363}, {application-record-element=DET_RANGE_364, system-signal=DET_RANGE_364}, {application-record-element=DET_RANGE_ERR_361, system-signal=DET_RANGE_ERR_361}, {application-record-element=DET_RANGE_ERR_362, system-signal=DET_RANGE_ERR_362}, {application-record-element=DET_RANGE_ERR_363, system-signal=DET_RANGE_ERR_363}, {application-record-element=DET_RANGE_ERR_364, system-signal=DET_RANGE_ERR_364}, {application-record-element=DET_RANGE_VELOCITY_361, system-signal=DET_RANGE_VELOCITY_361}, {application-record-element=DET_RANGE_VELOCITY_362, system-signal=DET_RANGE_VELOCITY_362}, {application-record-element=DET_RANGE_VELOCITY_363, system-signal=DET_RANGE_VELOCITY_363}, {application-record-element=DET_RANGE_VELOCITY_364, system-signal=DET_RANGE_VELOCITY_364}, {application-record-element=DET_RANGE_VELOCITY_ERR_361, system-signal=DET_RANGE_VELOCITY_ERR_361}, {application-record-element=DET_RANGE_VELOCITY_ERR_362, system-signal=DET_RANGE_VELOCITY_ERR_362}, {application-record-element=DET_RANGE_VELOCITY_ERR_363, system-signal=DET_RANGE_VELOCITY_ERR_363}, {application-record-element=DET_RANGE_VELOCITY_ERR_364, system-signal=DET_RANGE_VELOCITY_ERR_364}, {application-record-element=DET_RCS_361, system-signal=DET_RCS_361}, {application-record-element=DET_RCS_362, system-signal=DET_RCS_362}, {application-record-element=DET_RCS_363, system-signal=DET_RCS_363}, {application-record-element=DET_RCS_364, system-signal=DET_RCS_364}, {application-record-element=DET_SNR_361, system-signal=DET_SNR_361}, {application-record-element=DET_SNR_362, system-signal=DET_SNR_362}, {application-record-element=DET_SNR_363, system-signal=DET_SNR_363}, {application-record-element=DET_SNR_364, system-signal=DET_SNR_364}, {application-record-element=DET_SUPER_RES_TARGET_361, system-signal=DET_SUPER_RES_TARGET_361}, {application-record-element=DET_SUPER_RES_TARGET_362, system-signal=DET_SUPER_RES_TARGET_362}, {application-record-element=DET_SUPER_RES_TARGET_363, system-signal=DET_SUPER_RES_TARGET_363}, {application-record-element=DET_SUPER_RES_TARGET_364, system-signal=DET_SUPER_RES_TARGET_364}]}
