[part 1 of 10: package /System]
AUTOSAR XML (schema 00053)
package /System
  system System
    system mapping System_MPPNG
      data-mappings:
        sender-receiver-to-signal-mapping={data-element=Pp_RDR_NM_CAN_NM_State.Vdp_RDR_NM_CAN_NM_State, system-signal=RDR_NM_CAN_NM_State}
        sender-receiver-to-signal-mapping={data-element=Pp_RDR_NM_CBV_ActWakeBit_4.Vdp_RDR_NM_CBV_ActWakeBit_4, system-signal=RDR_NM_CBV_ActWakeBit_4}
        sender-receiver-to-signal-mapping={data-element=Pp_RDR_NM_CBV_NMCoordBit_3.Vdp_RDR_NM_CBV_NMCoordBit_3, system-signal=RDR_NM_CBV_NMCoordBit_3}
        sender-receiver-to-signal-mapping={data-element=Pp_RDR_NM_CBV_PNIBit_6.Vdp_RDR_NM_CBV_PNIBit_6, system-signal=RDR_NM_CBV_PNIBit_6}
        sender-receiver-to-signal-mapping={data-element=Pp_RDR_NM_CBV_ReptMsgBit0.Vdp_RDR_NM_CBV_ReptMsgBit0, system-signal=RDR_NM_CBV_ReptMsgBit0}
        sender-receiver-to-signal-mapping={data-element=Pp_RDR_NM_CBV_ResdBit_1.Vdp_RDR_NM_CBV_ResdBit_1, system-signal=RDR_NM_CBV_ResdBit_1}
        sender-receiver-to-signal-mapping={data-element=Pp_RDR_NM_CBV_ResdBit_2.Vdp_RDR_NM_CBV_ResdBit_2, system-signal=RDR_NM_CBV_ResdBit_2}
        sender-receiver-to-signal-mapping={data-element=Pp_RDR_NM_CBV_ResdBit_5.Vdp_RDR_NM_CBV_ResdBit_5, system-signal=RDR_NM_CBV_ResdBit_5}
        sender-receiver-to-signal-mapping={data-element=Pp_RDR_NM_CBV_ResdBit_7.Vdp_RDR_NM_CBV_ResdBit_7, system-signal=RDR_NM_CBV_ResdBit_7}
        sender-receiver-to-signal-mapping={data-element=Pp_RDR_NM_PN_User_Data.Vdp_RDR_NM_PN_User_Data, system-signal=RDR_NM_PN_User_Data}
        sender-receiver-to-signal-mapping={data-element=Pp_RDR_NM_PNC_Reserved{1..3}.Vdp_RDR_NM_PNC_Reserved{1..3}, system-signal=RDR_NM_PNC_Reserved{1..3}}
        sender-receiver-to-signal-mapping={data-element=Pp_RDR_NM_Wakeup_And_Reason.Vdp_RDR_NM_Wakeup_And_Reason, system-signal=RDR_NM_Wakeup_And_Reason}
        sender-receiver-to-signal-group-mapping={data-element=Pp_SG_TrackerHeader.Vdp_SG_TrackerHeader, signal-group=SG_TrackerHeader, type-mapping=sender-rec-record-type-mapping=record-element-mappings=[{implementation-record-element=HED_MH_002_CRC16, system-signal=HED_MH_002_CRC16}, {implementation-record-element=HED_MH_002_CYCLE_COUNTER, system-signal=HED_MH_002_CYCLE_COUNTER}, {implementation-record-element=HED_TRKR_DATA_QUALIFIER, system-signal=HED_TRKR_DATA_QUALIFIER}, {implementation-record-element=HED_TRKR_IDX, system-signal=HED_TRKR_IDX}, {implementation-record-element=HED_TRKR_NUM_OF_ACTIV_OBJS, system-signal=HED_TRKR_NUM_OF_ACTIV_OBJS}, {implementation-record-element=HED_TRKR_OBJLST_TIME_STAMP_NS, system-signal=HED_TRKR_OBJLST_TIME_STAMP_NS}, {implementation-record-element=HED_TRKR_OBJLST_TIME_STAMP_SC, system-signal=HED_TRKR_OBJLST_TIME_STAMP_SC}, {implementation-record-element=HED_TRKR_TIME_INST, system-signal=HED_TRKR_TIME_INST}, {implementation-record-element=HED_TRKR_TIME_PEAK, system-signal=HED_TRKR_TIME_PEAK}, {implementation-record-element=HED_TRKR_VEHICLE_IDX, system-signal=HED_TRKR_VEHICLE_IDX}, {implementation-record-element=HED_TRKR_VEH_COORD_TYPE, system-signal=HED_TRKR_VEH_COORD_TYPE}]}
        sender-receiver-to-signal-group-mapping={data-element=Pp_SG_TrackerStatus.Vdp_SG_TrackerStatus, signal-group=SG_TrackerStatus, type-mapping=sender-rec-record-type-mapping=record-element-mappings=[{implementation-record-element=STS_MH_003_CRC16, system-signal=STS_MH_003_CRC16}, {implementation-record-element=STS_MH_003_CYCLE_COUNTER, system-signal=STS_MH_003_CYCLE_COUNTER}, {implementation-record-element=STS_OBJ_DBC_BASE_VER_MAJOR, system-signal=STS_OBJ_DBC_BASE_VER_MAJOR}, {implementation-record-element=STS_OBJ_DBC_BASE_VER_MINOR, system-signal=STS_OBJ_DBC_BASE_VER_MINOR}, {implementation-record-element=STS_PERCEPTION_MODULE_ID, system-signal=STS_PERCEPTION_MODULE_ID}, {implementation-record-element=STS_TRKR_MAJOR_VERSION, system-signal=STS_TRKR_MAJOR_VERSION}, {implementation-record-element=STS_TRKR_MINOR_VERSION, system-signal=STS_TRKR_MINOR_VERSION}, {implementation-record-element=STS_TRKR_PATCH_VERSION, system-signal=STS_TRKR_PATCH_VERSION}]}
        sender-receiver-to-signal-mapping={variation-point=post-build-variant-condition{matching-criterion=RDR_POS, value=1}, data-element=Rp_TSYN_OVS.Vdp_TSYN_OVS, system-signal=TSYN_OVS}
        sender-receiver-to-signal-mapping={variation-point=post-build-variant-condition{matching-criterion=RDR_POS, value=1}, data-element=Rp_TSYN_PDU.Vdp_TSYN_PDU, system-signal=TSYN_PDU}
        sender-receiver-to-signal-mapping={variation-point=post-build-variant-condition{matching-criterion=RDR_POS, value=1}, data-element=Rp_TSYN_RESERVED.Vdp_TSYN_RESERVED, system-signal=TSYN_RESERVED}
        sender-receiver-to-signal-mapping={variation-point=post-build-variant-condition{matching-criterion=RDR_POS, value=1}, data-element=Rp_TSYN_SEQUENCE_COUNTER.Vdp_TSYN_SEQUENCE_COUNTER, system-signal=TSYN_SEQUENCE_COUNTER}
        sender-receiver-to-signal-mapping={variation-point=post-build-variant-condition{matching-criterion=RDR_POS, value=1}, data-element=Rp_TSYN_SGW.Vdp_TSYN_SGW, system-signal=TSYN_SGW}
        sender-receiver-to-signal-mapping={variation-point=post-build-variant-condition{matching-criterion=RDR_POS, value=1}, data-element=Rp_TSYN_SYNCTIME_NANOSEC.Vdp_TSYN_SYNCTIME_NANOSEC, system-signal=TSYN_SYNCTIME_NANOSEC}
        sender-receiver-to-signal-mapping={variation-point=post-build-variant-condition{matching-criterion=RDR_POS, value=1}, data-element=Rp_TSYN_SYNCTIME_SEC.Vdp_TSYN_SYNCTIME_SEC, system-signal=TSYN_SYNCTIME_SEC}
        sender-receiver-to-signal-mapping={variation-point=post-build-variant-condition{matching-criterion=RDR_POS, value=1}, data-element=Rp_TSYN_TIMEDOMAIN.Vdp_TSYN_TIMEDOMAIN, system-signal=TSYN_TIMEDOMAIN}
        sender-receiver-to-signal-mapping={variation-point=post-build-variant-condition{matching-criterion=RDR_POS, value=1}, data-element=Rp_TSYN_USERBYTE.Vdp_TSYN_USERBYTE, system-signal=TSYN_USERBYTE}
        sender-receiver-to-signal-mapping={variation-point=post-build-variant-condition{matching-criterion=RDR_POS, value=1}, data-element=Rp_TSYNC_CRC.Vdp_TSYNC_CRC, system-signal=TSYNC_CRC}
        sender-receiver-to-signal-group-mapping={data-element=Pp_SG_TrackerObject001.Vdp_SG_TrackerObject001, signal-group=SG_TrackerObject001, type-mapping=sender-rec-record-type-mapping=record-element-mappings=[{implementation-record-element=OBJ_ACCEL_ERR_CRR_COEF_001, system-signal=OBJ_ACCEL_ERR_CRR_COEF_001}, {implementation-record-element=OBJ_ACCELERATION_LAT_001, system-signal=OBJ_ACCELERATION_LAT_001}, {implementation-record-element=OBJ_ACCELERATION_LAT_ERR_001, system-signal=OBJ_ACCELERATION_LAT_ERR_001}, {implementation-record-element=OBJ_ACCELERATION_LONG_001, system-signal=OBJ_ACCELERATION_LONG_001}, {implementation-record-element=OBJ_ACCELERATION_LONG_ERR_001, system-signal=OBJ_ACCELERATION_LONG_ERR_001}, {implementation-record-element=OBJ_ALIVE_TIME_001, system-signal=OBJ_ALIVE_TIME_001}, {implementation-record-element=OBJ_CLS_TYPE1_001, system-signal=OBJ_CLS_TYPE1_001}, {implementation-record-element=OBJ_CLS_TYPE1_PROB_001, system-signal=OBJ_CLS_TYPE1_PROB_001}, {implementation-record-element=OBJ_CLS_TYPE2_001, system-signal=OBJ_CLS_TYPE2_001}, {implementation-record-element=OBJ_CLS_TYPE2_PROB_001, system-signal=OBJ_CLS_TYPE2_PROB_001}, {implementation-record-element=OBJ_CLS_TYPE3_001, system-signal=OBJ_CLS_TYPE3_001}, {implementation-record-element=OBJ_CLS_TYPE3_PROB_001, system-signal=OBJ_CLS_TYPE3_PROB_001}, {implementation-record-element=OBJ_CLS_TYPE4_001, system-signal=OBJ_CLS_TYPE4_001}, {implementation-record-element=OBJ_CLS_TYPE4_PROB_001, system-signal=OBJ_CLS_TYPE4_PROB_001}, {implementation-record-element=OBJ_CLS_TYPE5_001, system-signal=OBJ_CLS_TYPE5_001}, {implementation-record-element=OBJ_CLS_TYPE5_PROB_001, system-signal=OBJ_CLS_TYPE5_PROB_001}, {implementation-record-element=OBJ_CLS_TYPE6_001, system-signal=OBJ_CLS_TYPE6_001}, {implementation-record-element=OBJ_CLS_TYPE6_PROB_001, system-signal=OBJ_CLS_TYPE6_PROB_001}, {implementation-record-element=OBJ_DIMENSION_LENGTH_001, system-signal=OBJ_DIMENSION_LENGTH_001}, {implementation-record-element=OBJ_DIMENSION_LENGTH_ERR_001, system-signal=OBJ_DIMENSION_LENGTH_ERR_001}, {implementation-record-element=OBJ_DIMENSION_WIDTH_001, system-signal=OBJ_DIMENSION_WIDTH_001}, {implementation-record-element=OBJ_DIMENSION_WIDTH_ERR_001, system-signal=OBJ_DIMENSION_WIDTH_ERR_001}, {implementation-record-element=OBJ_EXISTENCE_PROB_001, system-signal=OBJ_EXISTENCE_PROB_001}, {implementation-record-element=OBJ_GROUP_ID_001, system-signal=OBJ_GROUP_ID_001}, {implementation-record-element=OBJ_ID_001, system-signal=OBJ_ID_001}, {implementation-record-element=OBJ_MEASUREMENT_STATUS_001, system-signal=OBJ_MEASUREMENT_STATUS_001}, {implementation-record-element=OBJ_MH_CRC16_001, system-signal=OBJ_MH_CRC16_001}, {implementation-record-element=OBJ_MH_CYCLE_COUNTER_001, system-signal=OBJ_MH_CYCLE_COUNTER_001}, {implementation-record-element=OBJ_MOVEMENT_STATUS_001, system-signal=OBJ_MOVEMENT_STATUS_001}, {implementation-record-element=OBJ_POS_ERR_CRR_COEF_001, system-signal=OBJ_POS_ERR_CRR_COEF_001}, {implementation-record-element=OBJ_POS_LAT_001, system-signal=OBJ_POS_LAT_001}, {implementation-record-element=OBJ_POS_LAT_ERR_001, system-signal=OBJ_POS_LAT_ERR_001}, {implementation-record-element=OBJ_POS_LONG_001, system-signal=OBJ_POS_LONG_001}, {implementation-record-element=OBJ_POS_LONG_ERR_001, system-signal=OBJ_POS_LONG_ERR_001}, {implementation-record-element=OBJ_RCS_001, system-signal=OBJ_RCS_001}, {implementation-record-element=OBJ_REF_PT_LAT_OFFSET_001, system-signal=OBJ_REF_PT_LAT_OFFSET_001}, {implementation-record-element=OBJ_REF_PT_LONG_OFFSET_001, system-signal=OBJ_REF_PT_LONG_OFFSET_001}, {implementation-record-element=OBJ_TIMESTAMP_OFFSET_001, system-signal=OBJ_TIMESTAMP_OFFSET_001}, {implementation-record-element=OBJ_TRACK_MOTION_MODEL_001, system-signal=OBJ_TRACK_MOTION_MODEL_001}, {implementation-record-element=OBJ_VEH_TRACK_FLAG_001, system-signal=OBJ_VEH_TRACK_FLAG_001}, {implementation-record-element=OBJ_VELOCITY_ERR_CRR_COEF_001, system-signal=OBJ_VELOCITY_ERR_CRR_COEF_001}, {implementation-record-element=OBJ_VELOCITY_LAT_001, system-signal=OBJ_VELOCITY_LAT_001}, {implementation-record-element=OBJ_VELOCITY_LAT_ERR_001, system-signal=OBJ_VELOCITY_LAT_ERR_001}, {implementation-record-element=OBJ_VELOCITY_LONG_001, system-signal=OBJ_VELOCITY_LONG_001}, {implementation-record-element=OBJ_VELOCITY_LONG_ERR_001, system-signal=OBJ_VELOCITY_LONG_ERR_001}, {implementation-record-element=OBJ_YAW_ANGLE_001, system-signal=OBJ_YAW_ANGLE_001}, {implementation-record-element=OBJ_YAW_ANGLE_ERR_001, system-signal=OBJ_YAW_ANGLE_ERR_001}, {implementation-record-element=OBJ_YAW_RATE_001, system-signal=OBJ_YAW_RATE_001}, {implementation-record-element=OBJ_YAW_RATE_ERR_001, system-signal=OBJ_YAW_RATE_ERR_001}]}
        sender-receiver-to-signal-group-mapping={data-element=Pp_SG_TrackerObject031.Vdp_SG_TrackerObject031, signal-group=SG_TrackerObject031, type-mapping=sender-rec-record-type-mapping=record-element-mappings=[{implementation-record-element=OBJ_POS_LAT_001, system-signal=OBJ_POS_LAT_031}, {implementation-record-element=OBJ_ACCELERATION_LAT_001, system-signal=OBJ_ACCELERATION_LAT_031}, {implementation-record-element=OBJ_CLS_TYPE1_PROB_001, system-signal=OBJ_CLS_TYPE1_PROB_031}, {implementation-record-element=OBJ_CLS_TYPE2_001, system-signal=OBJ_CLS_TYPE2_031}, {implementation-record-element=OBJ_CLS_TYPE3_PROB_001, system-signal=OBJ_CLS_TYPE3_PROB_031}, {implementation-record-element=OBJ_CLS_TYPE6_001, system-signal=OBJ_CLS_TYPE6_031}, {implementation-record-element=OBJ_EXISTENCE_PROB_001, system-signal=OBJ_EXISTENCE_PROB_031}, {implementation-record-element=OBJ_CLS_TYPE2_PROB_001, system-signal=OBJ_CLS_TYPE2_PROB_031}, {implementation-record-element=OBJ_CLS_TYPE1_001, system-signal=OBJ_CLS_TYPE1_031}, {implementation-record-element=OBJ_CLS_TYPE4_PROB_001, system-signal=OBJ_CLS_TYPE4_PROB_031}, {implementation-record-element=OBJ_MEASUREMENT_STATUS_001, system-signal=OBJ_MEASUREMENT_STATUS_031}, {implementation-record-element=OBJ_MOVEMENT_STATUS_001, system-signal=OBJ_MOVEMENT_STATUS_031}, {implementation-record-element=OBJ_POS_ERR_CRR_COEF_001, system-signal=OBJ_POS_ERR_CRR_COEF_031}, {implementation-record-element=OBJ_ACCELERATION_LONG_001, system-signal=OBJ_ACCELERATION_LONG_031}, {implementation-record-element=OBJ_CLS_TYPE4_001, system-signal=OBJ_CLS_TYPE4_031}, {implementation-record-element=OBJ_ID_001, system-signal=OBJ_ID_031}, {implementation-record-element=OBJ_GROUP_ID_001, system-signal=OBJ_GROUP_ID_031}, {implementation-record-element=OBJ_DIMENSION_LENGTH_ERR_001, system-signal=OBJ_DIMENSION_LENGTH_ERR_031}, {implementation-record-element=OBJ_CLS_TYPE3_001, system-signal=OBJ_CLS_TYPE3_031}, {implementation-record-element=OBJ_ALIVE_TIME_001, system-signal=OBJ_ALIVE_TIME_031}, {implementation-record-element=OBJ_DIMENSION_LENGTH_001, system-signal=OBJ_DIMENSION_LENGTH_031}, {implementation-record-element=OBJ_ACCEL_ERR_CRR_COEF_001, system-signal=OBJ_ACCEL_ERR_CRR_COEF_031}, {implementation-record-element=OBJ_ACCELERATION_LAT_ERR_001, system-signal=OBJ_ACCELERATION_LAT_ERR_031}, {implementation-record-element=OBJ_DIMENSION_WIDTH_001, system-signal=OBJ_DIMENSION_WIDTH_031}, {implementation-record-element=OBJ_DIMENSION_WIDTH_ERR_001, system-signal=OBJ_DIMENSION_WIDTH_ERR_031}, {implementation-record-element=OBJ_MH_CRC16_001, system-signal=OBJ_MH_CRC16_031}, {implementation-record-element=OBJ_ACCELERATION_LONG_ERR_001, system-signal=OBJ_ACCELERATION_LONG_ERR_031}, {implementation-record-element=OBJ_CLS_TYPE5_001, system-signal=OBJ_CLS_TYPE5_031}, {implementation-record-element=OBJ_CLS_TYPE5_PROB_001, system-signal=OBJ_CLS_TYPE5_PROB_031}, {implementation-record-element=OBJ_CLS_TYPE6_PROB_001, system-signal=OBJ_CLS_TYPE6_PROB_031}, {implementation-record-element=OBJ_MH_CYCLE_COUNTER_001, system-signal=OBJ_MH_CYCLE_COUNTER_031}, {implementation-record-element=OBJ_VELOCITY_LAT_001, system-signal=OBJ_VELOCITY_LAT_031}, {implementation-record-element=OBJ_YAW_RATE_001, system-signal=OBJ_YAW_RATE_031}, {implementation-record-element=OBJ_RCS_001, system-signal=OBJ_RCS_031}, {implementation-record-element=OBJ_TIMESTAMP_OFFSET_001, system-signal=OBJ_TIMESTAMP_OFFSET_031}, {implementation-record-element=OBJ_YAW_RATE_ERR_001, system-signal=OBJ_YAW_RATE_ERR_031}, {implementation-record-element=OBJ_VELOCITY_ERR_CRR_COEF_001, system-signal=OBJ_VELOCITY_ERR_CRR_COEF_031}, {implementation-record-element=OBJ_REF_PT_LONG_OFFSET_001, system-signal=OBJ_REF_PT_LONG_OFFSET_031}, {implementation-record-element=OBJ_REF_PT_LAT_OFFSET_001, system-signal=OBJ_REF_PT_LAT_OFFSET_031}, {implementation-record-element=OBJ_VEH_TRACK_FLAG_001, system-signal=OBJ_VEH_TRACK_FLAG_031}, {implementation-record-element=OBJ_POS_LAT_ERR_001, system-signal=OBJ_POS_LAT_ERR_031}, {implementation-record-element=OBJ_VELOCITY_LONG_001, system-signal=OBJ_VELOCITY_LONG_031}, {implementation-record-element=OBJ_VELOCITY_LAT_ERR_001, system-signal=OBJ_VELOCITY_LAT_ERR_031}, {implementation-record-element=OBJ_VELOCITY_LONG_ERR_001, system-signal=OBJ_VELOCITY_LONG_ERR_031}, {implementation-record-element=OBJ_YAW_ANGLE_ERR_001, system-signal=OBJ_YAW_ANGLE_ERR_031}, {implementation-record-element=OBJ_POS_LONG_ERR_001, system-signal=OBJ_POS_LONG_ERR_031}, {implementation-record-element=OBJ_POS_LONG_001, system-signal=OBJ_POS_LONG_031}, {implementation-record-element=OBJ_YAW_ANGLE_001, system-signal=OBJ_YAW_ANGLE_031}, {implementation-record-element=OBJ_TRACK_MOTION_MODEL_001, system-signal=OBJ_TRACK_MOTION_MODEL_031}]}
        sender-receiver-to-signal-group-mapping={data-element=Pp_SG_TrackerObject032.Vdp_SG_TrackerObject032, signal-group=SG_TrackerObject032, type-mapping=sender-rec-record-type-mapping=record-element-mappings=[{implementation-record-element=OBJ_DIMENSION_LENGTH_ERR_001, system-signal=OBJ_DIMENSION_LENGTH_ERR_032}, {implementation-record-element=OBJ_CLS_TYPE2_001, system-signal=OBJ_CLS_TYPE2_032}, {implementation-record-element=OBJ_CLS_TYPE2_PROB_001, system-signal=OBJ_CLS_TYPE2_PROB_032}, {implementation-record-element=OBJ_CLS_TYPE3_001, system-signal=OBJ_CLS_TYPE3_032}, {implementation-record-element=OBJ_CLS_TYPE6_001, system-signal=OBJ_CLS_TYPE6_032}, {implementation-record-element=OBJ_MEASUREMENT_STATUS_001, system-signal=OBJ_MEASUREMENT_STATUS_032}, {implementation-record-element=OBJ_MH_CRC16_001, system-signal=OBJ_MH_CRC16_032}, {implementation-record-element=OBJ_MH_CYCLE_COUNTER_001, system-signal=OBJ_MH_CYCLE_COUNTER_032}, {implementation-record-element=OBJ_MOVEMENT_STATUS_001, system-signal=OBJ_MOVEMENT_STATUS_032}, {implementation-record-element=OBJ_POS_LONG_001, system-signal=OBJ_POS_LONG_032}, {implementation-record-element=OBJ_TRACK_MOTION_MODEL_001, system-signal=OBJ_TRACK_MOTION_MODEL_032}, {implementation-record-element=OBJ_VEH_TRACK_FLAG_001, system-signal=OBJ_VEH_TRACK_FLAG_032}, {implementation-record-element=OBJ_DIMENSION_WIDTH_ERR_001, system-signal=OBJ_DIMENSION_WIDTH_ERR_032}, {implementation-record-element=OBJ_DIMENSION_WIDTH_001, system-signal=OBJ_DIMENSION_WIDTH_032}, {implementation-record-element=OBJ_ACCEL_ERR_CRR_COEF_001, system-signal=OBJ_ACCEL_ERR_CRR_COEF_032}, {implementation-record-element=OBJ_VELOCITY_ERR_CRR_COEF_001, system-signal=OBJ_VELOCITY_ERR_CRR_COEF_032}, {implementation-record-element=OBJ_VELOCITY_LAT_001, system-signal=OBJ_VELOCITY_LAT_032}, {implementation-record-element=OBJ_VELOCITY_LAT_ERR_001, system-signal=OBJ_VELOCITY_LAT_ERR_032}, {implementation-record-element=OBJ_ALIVE_TIME_001, system-signal=OBJ_ALIVE_TIME_032}, {implementation-record-element=OBJ_CLS_TYPE4_PROB_001, system-signal=OBJ_CLS_TYPE4_PROB_032}, {implementation-record-element=OBJ_DIMENSION_LENGTH_001, system-signal=OBJ_DIMENSION_LENGTH_032}, {implementation-record-element=OBJ_RCS_001, system-signal=OBJ_RCS_032}, {implementation-record-element=OBJ_ACCELERATION_LAT_ERR_001, system-signal=OBJ_ACCELERATION_LAT_ERR_032}, {implementation-record-element=OBJ_CLS_TYPE4_001, system-signal=OBJ_CLS_TYPE4_032}, {implementation-record-element=OBJ_POS_LONG_ERR_001, system-signal=OBJ_POS_LONG_ERR_032}, {implementation-record-element=OBJ_REF_PT_LAT_OFFSET_001, system-signal=OBJ_REF_PT_LAT_OFFSET_032}, {implementation-record-element=OBJ_REF_PT_LONG_OFFSET_001, system-signal=OBJ_REF_PT_LONG_OFFSET_032}, {implementation-record-element=OBJ_VELOCITY_LONG_001, system-signal=OBJ_VELOCITY_LONG_032}, {implementation-record-element=OBJ_VELOCITY_LONG_ERR_001, system-signal=OBJ_VELOCITY_LONG_ERR_032}, {implementation-record-element=OBJ_ACCELERATION_LONG_ERR_001, system-signal=OBJ_ACCELERATION_LONG_ERR_032}, {implementation-record-element=OBJ_CLS_TYPE1_001, system-signal=OBJ_CLS_TYPE1_032}, {implementation-record-element=OBJ_EXISTENCE_PROB_001, system-signal=OBJ_EXISTENCE_PROB_032}, {implementation-record-element=OBJ_POS_ERR_CRR_COEF_001, system-signal=OBJ_POS_ERR_CRR_COEF_032}, {implementation-record-element=OBJ_ACCELERATION_LONG_001, system-signal=OBJ_ACCELERATION_LONG_032}, {implementation-record-element=OBJ_POS_LAT_001, system-signal=OBJ_POS_LAT_032}, {implementation-record-element=OBJ_CLS_TYPE1_PROB_001, system-signal=OBJ_CLS_TYPE1_PROB_032}, {implementation-record-element=OBJ_ACCELERATION_LAT_001, system-signal=OBJ_ACCELERATION_LAT_032}, {implementation-record-element=OBJ_CLS_TYPE5_001, system-signal=OBJ_CLS_TYPE5_032}, {implementation-record-element=OBJ_GROUP_ID_001, system-signal=OBJ_GROUP_ID_032}, {implementation-record-element=OBJ_CLS_TYPE6_PROB_001, system-signal=OBJ_CLS_TYPE6_PROB_032}, {implementation-record-element=OBJ_ID_001, system-signal=OBJ_ID_032}, {implementation-record-element=OBJ_POS_LAT_ERR_001, system-signal=OBJ_POS_LAT_ERR_032}, {implementation-record-element=OBJ_TIMESTAMP_OFFSET_001, system-signal=OBJ_TIMESTAMP_OFFSET_032}, {implementation-record-element=OBJ_CLS_TYPE5_PROB_001, system-signal=OBJ_CLS_TYPE5_PROB_032}, {implementation-record-element=OBJ_CLS_TYPE3_PROB_001, system-signal=OBJ_CLS_TYPE3_PROB_032}, {implementation-record-element=OBJ_YAW_ANGLE_001, system-signal=OBJ_YAW_ANGLE_032}, {implementation-record-element=OBJ_YAW_ANGLE_ERR_001, system-signal=OBJ_YAW_ANGLE_ERR_032}, {implementation-record-element=OBJ_YAW_RATE_ERR_001, system-signal=OBJ_YAW_RATE_ERR_032}, {implementation-record-element=OBJ_YAW_RATE_001, system-signal=OBJ_YAW_RATE_032}]}
        sender-receiver-to-signal-group-mapping={data-element=Pp_SG_TrackerObject034.Vdp_SG_TrackerObject034, signal-group=SG_TrackerObject034, type-mapping=sender-rec-record-type-mapping=record-element-mappings=[{implementation-record-element=OBJ_ACCEL_ERR_CRR_COEF_001, system-signal=OBJ_ACCEL_ERR_CRR_COEF_034}, {implementation-record-element=OBJ_ACCELERATION_LAT_ERR_001, system-signal=OBJ_ACCELERATION_LAT_ERR_034}, {implementation-record-element=OBJ_ACCELERATION_LONG_001, system-signal=OBJ_ACCELERATION_LONG_034}, {implementation-record-element=OBJ_ACCELERATION_LONG_ERR_001, system-signal=OBJ_ACCELERATION_LONG_ERR_034}, {implementation-record-element=OBJ_ALIVE_TIME_001, system-signal=OBJ_ALIVE_TIME_034}, {implementation-record-element=OBJ_CLS_TYPE1_001, system-signal=OBJ_CLS_TYPE1_034}, {implementation-record-element=OBJ_CLS_TYPE1_PROB_001, system-signal=OBJ_CLS_TYPE1_PROB_034}, {implementation-record-element=OBJ_CLS_TYPE2_001, system-signal=OBJ_CLS_TYPE2_034}, {implementation-record-element=OBJ_ACCELERATION_LAT_001, system-signal=OBJ_ACCELERATION_LAT_034}, {implementation-record-element=OBJ_MH_CYCLE_COUNTER_001, system-signal=OBJ_MH_CYCLE_COUNTER_034}, {implementation-record-element=OBJ_CLS_TYPE5_PROB_001, system-signal=OBJ_CLS_TYPE5_PROB_034}, {implementation-record-element=OBJ_POS_ERR_CRR_COEF_001, system-signal=OBJ_POS_ERR_CRR_COEF_034}, {implementation-record-element=OBJ_VELOCITY_LAT_001, system-signal=OBJ_VELOCITY_LAT_034}, {implementation-record-element=OBJ_EXISTENCE_PROB_001, system-signal=OBJ_EXISTENCE_PROB_034}, {implementation-record-element=OBJ_GROUP_ID_001, system-signal=OBJ_GROUP_ID_034}, {implementation-record-element=OBJ_YAW_ANGLE_ERR_001, system-signal=OBJ_YAW_ANGLE_ERR_034}, {implementation-record-element=OBJ_DIMENSION_WIDTH_001, system-signal=OBJ_DIMENSION_WIDTH_034}, {implementation-record-element=OBJ_VELOCITY_LONG_ERR_001, system-signal=OBJ_VELOCITY_LONG_ERR_034}, {implementation-record-element=OBJ_MH_CRC16_001, system-signal=OBJ_MH_CRC16_034}, {implementation-record-element=OBJ_YAW_RATE_001, system-signal=OBJ_YAW_RATE_034}, {implementation-record-element=OBJ_CLS_TYPE2_PROB_001, system-signal=OBJ_CLS_TYPE2_PROB_034}, {implementation-record-element=OBJ_CLS_TYPE3_001, system-signal=OBJ_CLS_TYPE3_034}, {implementation-record-element=OBJ_POS_LONG_ERR_001, system-signal=OBJ_POS_LONG_ERR_034}, {implementation-record-element=OBJ_POS_LONG_001, system-signal=OBJ_POS_LONG_034}, {implementation-record-element=OBJ_VEH_TRACK_FLAG_001, system-signal=OBJ_VEH_TRACK_FLAG_034}, {implementation-record-element=OBJ_CLS_TYPE6_001, system-signal=OBJ_CLS_TYPE6_034}, {implementation-record-element=OBJ_DIMENSION_LENGTH_001, system-signal=OBJ_DIMENSION_LENGTH_034}, {implementation-record-element=OBJ_MEASUREMENT_STATUS_001, system-signal=OBJ_MEASUREMENT_STATUS_034}, {implementation-record-element=OBJ_REF_PT_LONG_OFFSET_001, system-signal=OBJ_REF_PT_LONG_OFFSET_034}, {implementation-record-element=OBJ_TIMESTAMP_OFFSET_001, system-signal=OBJ_TIMESTAMP_OFFSET_034}, {implementation-record-element=OBJ_VELOCITY_ERR_CRR_COEF_001, system-signal=OBJ_VELOCITY_ERR_CRR_COEF_034}, {implementation-record-element=OBJ_CLS_TYPE4_001, system-signal=OBJ_CLS_TYPE4_034}, {implementation-record-element=OBJ_CLS_TYPE4_PROB_001, system-signal=OBJ_CLS_TYPE4_PROB_034}, {implementation-record-element=OBJ_CLS_TYPE5_001, system-signal=OBJ_CLS_TYPE5_034}, {implementation-record-element=OBJ_ID_001, system-signal=OBJ_ID_034}, {implementation-record-element=OBJ_REF_PT_LAT_OFFSET_001, system-signal=OBJ_REF_PT_LAT_OFFSET_034}, {implementation-record-element=OBJ_YAW_RATE_ERR_001, system-signal=OBJ_YAW_RATE_ERR_034}, {implementation-record-element=OBJ_DIMENSION_WIDTH_ERR_001, system-signal=OBJ_DIMENSION_WIDTH_ERR_034}, {implementation-record-element=OBJ_POS_LAT_001, system-signal=OBJ_POS_LAT_034}, {implementation-record-element=OBJ_POS_LAT_ERR_001, system-signal=OBJ_POS_LAT_ERR_034}, {implementation-record-element=OBJ_YAW_ANGLE_001, system-signal=OBJ_YAW_ANGLE_034}, {implementation-record-element=OBJ_MOVEMENT_STATUS_001, system-signal=OBJ_MOVEMENT_STATUS_034}, {implementation-record-element=OBJ_CLS_TYPE3_PROB_001, system-signal=OBJ_CLS_TYPE3_PROB_034}, {implementation-record-element=OBJ_TRACK_MOTION_MODEL_001, system-signal=OBJ_TRACK_MOTION_MODEL_034}, {implementation-record-element=OBJ_VELOCITY_LAT_ERR_001, system-signal=OBJ_VELOCITY_LAT_ERR_034}, {implementation-record-element=OBJ_DIMENSION_LENGTH_ERR_001, system-signal=OBJ_DIMENSION_LENGTH_ERR_034}, {implementation-record-element=OBJ_VELOCITY_LONG_001, system-signal=OBJ_VELOCITY_LONG_034}, {implementation-record-element=OBJ_CLS_TYPE6_PROB_001, system-signal=OBJ_CLS_TYPE6_PROB_034}, {implementation-record-element=OBJ_RCS_001, system-signal=OBJ_RCS_034}]}
        sender-receiver-to-signal-group-mapping={data-element=Pp_SG_TrackerObject033.Vdp_SG_TrackerObject033, signal-group=SG_TrackerObject033, type-mapping=sender-rec-record-type-mapping=record-element-mappings=[{implementation-record-element=OBJ_CLS_TYPE1_PROB_001, system-signal=OBJ_CLS_TYPE1_PROB_033}, {implementation-record-element=OBJ_CLS_TYPE5_PROB_001, system-signal=OBJ_CLS_TYPE5_PROB_033}, {implementation-record-element=OBJ_POS_LAT_ERR_001, system-signal=OBJ_POS_LAT_ERR_033}, {implementation-record-element=OBJ_YAW_RATE_ERR_001, system-signal=OBJ_YAW_RATE_ERR_033}, {implementation-record-element=OBJ_CLS_TYPE1_001, system-signal=OBJ_CLS_TYPE1_033}, {implementation-record-element=OBJ_CLS_TYPE3_001, system-signal=OBJ_CLS_TYPE3_033}, {implementation-record-element=OBJ_VELOCITY_LONG_001, system-signal=OBJ_VELOCITY_LONG_033}, {implementation-record-element=OBJ_ACCELERATION_LONG_ERR_001, system-signal=OBJ_ACCELERATION_LONG_ERR_033}, {implementation-record-element=OBJ_ACCELERATION_LAT_001, system-signal=OBJ_ACCELERATION_LAT_033}, {implementation-record-element=OBJ_CLS_TYPE4_PROB_001, system-signal=OBJ_CLS_TYPE4_PROB_033}, {implementation-record-element=OBJ_CLS_TYPE5_001, system-signal=OBJ_CLS_TYPE5_033}, {implementation-record-element=OBJ_MOVEMENT_STATUS_001, system-signal=OBJ_MOVEMENT_STATUS_033}, {implementation-record-element=OBJ_REF_PT_LONG_OFFSET_001, system-signal=OBJ_REF_PT_LONG_OFFSET_033}, {implementation-record-element=OBJ_POS_LONG_ERR_001, system-signal=OBJ_POS_LONG_ERR_033}, {implementation-record-element=OBJ_CLS_TYPE2_001, system-signal=OBJ_CLS_TYPE2_033}, {implementation-record-element=OBJ_TIMESTAMP_OFFSET_001, system-signal=OBJ_TIMESTAMP_OFFSET_033}, {implementation-record-element=OBJ_YAW_ANGLE_001, system-signal=OBJ_YAW_ANGLE_033}, {implementation-record-element=OBJ_ACCEL_ERR_CRR_COEF_001, system-signal=OBJ_ACCEL_ERR_CRR_COEF_033}, {implementation-record-element=OBJ_CLS_TYPE3_PROB_001, system-signal=OBJ_CLS_TYPE3_PROB_033}, {implementation-record-element=OBJ_EXISTENCE_PROB_001, system-signal=OBJ_EXISTENCE_PROB_033}, {implementation-record-element=OBJ_POS_LAT_001, system-signal=OBJ_POS_LAT_033}, {implementation-record-element=OBJ_ALIVE_TIME_001, system-signal=OBJ_ALIVE_TIME_033}, {implementation-record-element=OBJ_ID_001, system-signal=OBJ_ID_033}, {implementation-record-element=OBJ_VEH_TRACK_FLAG_001, system-signal=OBJ_VEH_TRACK_FLAG_033}, {implementation-record-element=OBJ_ACCELERATION_LONG_001, system-signal=OBJ_ACCELERATION_LONG_033}, {implementation-record-element=OBJ_RCS_001, system-signal=OBJ_RCS_033}, {implementation-record-element=OBJ_YAW_RATE_001, system-signal=OBJ_YAW_RATE_033}, {implementation-record-element=OBJ_ACCELERATION_LAT_ERR_001, system-signal=OBJ_ACCELERATION_LAT_ERR_033}, {implementation-record-element=OBJ_DIMENSION_WIDTH_ERR_001, system-signal=OBJ_DIMENSION_WIDTH_ERR_033}, {implementation-record-element=OBJ_MH_CRC16_001, system-signal=OBJ_MH_CRC16_033}, {implementation-record-element=OBJ_CLS_TYPE4_001, system-signal=OBJ_CLS_TYPE4_033}, {implementation-record-element=OBJ_CLS_TYPE6_001, system-signal=OBJ_CLS_TYPE6_033}, {implementation-record-element=OBJ_CLS_TYPE6_PROB_001, system-signal=OBJ_CLS_TYPE6_PROB_033}, {implementation-record-element=OBJ_MH_CYCLE_COUNTER_001, system-signal=OBJ_MH_CYCLE_COUNTER_033}, {implementation-record-element=OBJ_DIMENSION_LENGTH_001, system-signal=OBJ_DIMENSION_LENGTH_033}, {implementation-record-element=OBJ_DIMENSION_WIDTH_001, system-signal=OBJ_DIMENSION_WIDTH_033}, {implementation-record-element=OBJ_CLS_TYPE2_PROB_001, system-signal=OBJ_CLS_TYPE2_PROB_033}, {implementation-record-element=OBJ_GROUP_ID_001, system-signal=OBJ_GROUP_ID_033}, {implementation-record-element=OBJ_POS_LONG_001, system-signal=OBJ_POS_LONG_033}, {implementation-record-element=OBJ_MEASUREMENT_STATUS_001, system-signal=OBJ_MEASUREMENT_STATUS_033}, {implementation-record-element=OBJ_REF_PT_LAT_OFFSET_001, system-signal=OBJ_REF_PT_LAT_OFFSET_033}, {implementation-record-element=OBJ_DIMENSION_LENGTH_ERR_001, system-signal=OBJ_DIMENSION_LENGTH_ERR_033}, {implementation-record-element=OBJ_TRACK_MOTION_MODEL_001, system-signal=OBJ_TRACK_MOTION_MODEL_033}, {implementation-record-element=OBJ_VELOCITY_ERR_CRR_COEF_001, system-signal=OBJ_VELOCITY_ERR_CRR_COEF_033}, {implementation-record-element=OBJ_POS_ERR_CRR_COEF_001, system-signal=OBJ_POS_ERR_CRR_COEF_033}, {implementation-record-element=OBJ_VELOCITY_LAT_ERR_001, system-signal=OBJ_VELOCITY_LAT_ERR_033}, {implementation-record-element=OBJ_VELOCITY_LONG_ERR_001, system-signal=OBJ_VELOCITY_LONG_ERR_033}, {implementation-record-element=OBJ_VELOCITY_LAT_001, system-signal=OBJ_VELOCITY_LAT_033}, {implementation-record-element=OBJ_YAW_ANGLE_ERR_001, system-signal=OBJ_YAW_ANGLE_ERR_033}]}
        sender-receiver-to-signal-group-mapping={data-element=Pp_SG_TrackerObject035.Vdp_SG_TrackerObject035, signal-group=SG_TrackerObject035, type-mapping=sender-rec-record-type-mapping=record-element-mappings=[{implementation-record-element=OBJ_CLS_TYPE1_PROB_001, system-signal=OBJ_CLS_TYPE1_PROB_035}, {implementation-record-element=OBJ_CLS_TYPE2_001, system-signal=OBJ_CLS_TYPE2_035}, {implementation-record-element=OBJ_CLS_TYPE2_PROB_001, system-signal=OBJ_CLS_TYPE2_PROB_035}, {implementation-record-element=OBJ_CLS_TYPE3_001, system-signal=OBJ_CLS_TYPE3_035}, {implementation-record-element=OBJ_CLS_TYPE3_PROB_001, system-signal=OBJ_CLS_TYPE3_PROB_035}, {implementation-record-element=OBJ_CLS_TYPE4_PROB_001, system-signal=OBJ_CLS_TYPE4_PROB_035}, {implementation-record-element=OBJ_CLS_TYPE5_001, system-signal=OBJ_CLS_TYPE5_035}, {implementation-record-element=OBJ_CLS_TYPE6_001, system-signal=OBJ_CLS_TYPE6_035}, {implementation-record-element=OBJ_ACCEL_ERR_CRR_COEF_001, system-signal=OBJ_ACCEL_ERR_CRR_COEF_035}, {implementation-record-element=OBJ_CLS_TYPE6_PROB_001, system-signal=OBJ_CLS_TYPE6_PROB_035}, {implementation-record-element=OBJ_DIMENSION_LENGTH_001, system-signal=OBJ_DIMENSION_LENGTH_035}, {implementation-record-element=OBJ_DIMENSION_LENGTH_ERR_001, system-signal=OBJ_DIMENSION_LENGTH_ERR_035}, {implementation-record-element=OBJ_ACCELERATION_LONG_001, system-signal=OBJ_ACCELERATION_LONG_035}, {implementation-record-element=OBJ_DIMENSION_WIDTH_001, system-signal=OBJ_DIMENSION_WIDTH_035}, {implementation-record-element=OBJ_DIMENSION_WIDTH_ERR_001, system-signal=OBJ_DIMENSION_WIDTH_ERR_035}, {implementation-record-element=OBJ_EXISTENCE_PROB_001, system-signal=OBJ_EXISTENCE_PROB_035}, {implementation-record-element=OBJ_CLS_TYPE4_001, system-signal=OBJ_CLS_TYPE4_035}, {implementation-record-element=OBJ_CLS_TYPE5_PROB_001, system-signal=OBJ_CLS_TYPE5_PROB_035}, {implementation-record-element=OBJ_ACCELERATION_LAT_001, system-signal=OBJ_ACCELERATION_LAT_035}, {implementation-record-element=OBJ_ACCELERATION_LONG_ERR_001, system-signal=OBJ_ACCELERATION_LONG_ERR_035}, {implementation-record-element=OBJ_ALIVE_TIME_001, system-signal=OBJ_ALIVE_TIME_035}, {implementation-record-element=OBJ_ACCELERATION_LAT_ERR_001, system-signal=OBJ_ACCELERATION_LAT_ERR_035}, {implementation-record-element=OBJ_CLS_TYPE1_001, system-signal=OBJ_CLS_TYPE1_035}, {implementation-record-element=OBJ_VEH_TRACK_FLAG_001, system-signal=OBJ_VEH_TRACK_FLAG_035}, {implementation-record-element=OBJ_POS_LONG_001, system-signal=OBJ_POS_LONG_035}, {implementation-record-element=OBJ_VELOCITY_LONG_ERR_001, system-signal=OBJ_VELOCITY_LONG_ERR_035}, {implementation-record-element=OBJ_POS_ERR_CRR_COEF_001, system-signal=OBJ_POS_ERR_CRR_COEF_035}, {implementation-record-element=OBJ_TIMESTAMP_OFFSET_001, system-signal=OBJ_TIMESTAMP_OFFSET_035}, {implementation-record-element=OBJ_TRACK_MOTION_MODEL_001, system-signal=OBJ_TRACK_MOTION_MODEL_035}, {implementation-record-element=OBJ_RCS_001, system-signal=OBJ_RCS_035}, {implementation-record-element=OBJ_VELOCITY_LONG_001, system-signal=OBJ_VELOCITY_LONG_035}, {implementation-record-element=OBJ_VELOCITY_LAT_001, system-signal=OBJ_VELOCITY_LAT_035}, {implementation-record-element=OBJ_GROUP_ID_001, system-signal=OBJ_GROUP_ID_035}, {implementation-record-element=OBJ_POS_LAT_ERR_001, system-signal=OBJ_POS_LAT_ERR_035}, {implementation-record-element=OBJ_MEASUREMENT_STATUS_001, system-signal=OBJ_MEASUREMENT_STATUS_035}, {implementation-record-element=OBJ_REF_PT_LAT_OFFSET_001, system-signal=OBJ_REF_PT_LAT_OFFSET_035}, {implementation-record-element=OBJ_MH_CYCLE_COUNTER_001, system-signal=OBJ_MH_CYCLE_COUNTER_035}, {implementation-record-element=OBJ_MOVEMENT_STATUS_001, system-signal=OBJ_MOVEMENT_STATUS_035}, {implementation-record-element=OBJ_POS_LONG_ERR_001, system-signal=OBJ_POS_LONG_ERR_035}, {implementation-record-element=OBJ_YAW_ANGLE_001, system-signal=OBJ_YAW_ANGLE_035}, {implementation-record-element=OBJ_REF_PT_LONG_OFFSET_001, system-signal=OBJ_REF_PT_LONG_OFFSET_035}, {implementation-record-element=OBJ_ID_001, system-signal=OBJ_ID_035}, {implementation-record-element=OBJ_MH_CRC16_001, system-signal=OBJ_MH_CRC16_035}, {implementation-record-element=OBJ_YAW_ANGLE_ERR_001, system-signal=OBJ_YAW_ANGLE_ERR_035}, {implementation-record-element=OBJ_YAW_RATE_001, system-signal=OBJ_YAW_RATE_035}, {implementation-record-element=OBJ_POS_LAT_001, system-signal=OBJ_POS_LAT_035}, {implementation-record-element=OBJ_VELOCITY_ERR_CRR_COEF_001, system-signal=OBJ_VELOCITY_ERR_CRR_COEF_035}, {implementation-record-element=OBJ_VELOCITY_LAT_ERR_001, system-signal=OBJ_VELOCITY_LAT_ERR_035}, {implementation-record-element=OBJ_YAW_RATE_ERR_001, system-signal=OBJ_YAW_RATE_ERR_035}]}
        sender-receiver-to-signal-group-mapping={data-element=Pp_SG_TrackerObject036.Vdp_SG_TrackerObject036, signal-group=SG_TrackerObject036, type-mapping=sender-rec-record-type-mapping=record-element-mappings=[{implementation-record-element=OBJ_MH_CYCLE_COUNTER_001, system-signal=OBJ_MH_CYCLE_COUNTER_036}, {implementation-record-element=OBJ_REF_PT_LAT_OFFSET_001, system-signal=OBJ_REF_PT_LAT_OFFSET_036}, {implementation-record-element=OBJ_CLS_TYPE3_001, system-signal=OBJ_CLS_TYPE3_036}, {implementation-record-element=OBJ_CLS_TYPE3_PROB_001, system-signal=OBJ_CLS_TYPE3_PROB_036}, {implementation-record-element=OBJ_MH_CRC16_001, system-signal=OBJ_MH_CRC16_036}, {implementation-record-element=OBJ_CLS_TYPE2_001, system-signal=OBJ_CLS_TYPE2_036}, {implementation-record-element=OBJ_ACCELERATION_LAT_ERR_001, system-signal=OBJ_ACCELERATION_LAT_ERR_036}, {implementation-record-element=OBJ_ACCELERATION_LONG_001, system-signal=OBJ_ACCELERATION_LONG_036}, {implementation-record-element=OBJ_CLS_TYPE4_001, system-signal=OBJ_CLS_TYPE4_036}, {implementation-record-element=OBJ_ID_001, system-signal=OBJ_ID_036}, {implementation-record-element=OBJ_POS_LAT_001, system-signal=OBJ_POS_LAT_036}, {implementation-record-element=OBJ_ALIVE_TIME_001, system-signal=OBJ_ALIVE_TIME_036}, {implementation-record-element=OBJ_CLS_TYPE1_001, system-signal=OBJ_CLS_TYPE1_036}, {implementation-record-element=OBJ_REF_PT_LONG_OFFSET_001, system-signal=OBJ_REF_PT_LONG_OFFSET_036}, {implementation-record-element=OBJ_DIMENSION_WIDTH_ERR_001, system-signal=OBJ_DIMENSION_WIDTH_ERR_036}, {implementation-record-element=OBJ_ACCELERATION_LONG_ERR_001, system-signal=OBJ_ACCELERATION_LONG_ERR_036}, {implementation-record-element=OBJ_ACCELERATION_LAT_001, system-signal=OBJ_ACCELERATION_LAT_036}, {implementation-record-element=OBJ_CLS_TYPE6_001, system-signal=OBJ_CLS_TYPE6_036}, {implementation-record-element=OBJ_CLS_TYPE6_PROB_001, system-signal=OBJ_CLS_TYPE6_PROB_036}, {implementation-record-element=OBJ_DIMENSION_LENGTH_ERR_001, system-signal=OBJ_DIMENSION_LENGTH_ERR_036}, {implementation-record-element=OBJ_DIMENSION_WIDTH_001, system-signal=OBJ_DIMENSION_WIDTH_036}, {implementation-record-element=OBJ_MEASUREMENT_STATUS_001, system-signal=OBJ_MEASUREMENT_STATUS_036}, {implementation-record-element=OBJ_GROUP_ID_001, system-signal=OBJ_GROUP_ID_036}, {implementation-record-element=OBJ_MOVEMENT_STATUS_001, system-signal=OBJ_MOVEMENT_STATUS_036}, {implementation-record-element=OBJ_CLS_TYPE5_PROB_001, system-signal=OBJ_CLS_TYPE5_PROB_036}, {implementation-record-element=OBJ_DIMENSION_LENGTH_001, system-signal=OBJ_DIMENSION_LENGTH_036}, {implementation-record-element=OBJ_EXISTENCE_PROB_001, system-signal=OBJ_EXISTENCE_PROB_036}, {implementation-record-element=OBJ_POS_LAT_ERR_001, system-signal=OBJ_POS_LAT_ERR_036}, {implementation-record-element=OBJ_POS_LONG_001, system-signal=OBJ_POS_LONG_036}, {implementation-record-element=OBJ_POS_LONG_ERR_001, system-signal=OBJ_POS_LONG_ERR_036}, {implementation-record-element=OBJ_RCS_001, system-signal=OBJ_RCS_036}, {implementation-record-element=OBJ_CLS_TYPE2_PROB_001, system-signal=OBJ_CLS_TYPE2_PROB_036}, {implementation-record-element=OBJ_POS_ERR_CRR_COEF_001, system-signal=OBJ_POS_ERR_CRR_COEF_036}, {implementation-record-element=OBJ_CLS_TYPE4_PROB_001, system-signal=OBJ_CLS_TYPE4_PROB_036}, {implementation-record-element=OBJ_CLS_TYPE5_001, system-signal=OBJ_CLS_TYPE5_036}, {implementation-record-element=OBJ_ACCEL_ERR_CRR_COEF_001, system-signal=OBJ_ACCEL_ERR_CRR_COEF_036}, {implementation-record-element=OBJ_CLS_TYPE1_PROB_001, system-signal=OBJ_CLS_TYPE1_PROB_036}, {implementation-record-element=OBJ_YAW_RATE_001, system-signal=OBJ_YAW_RATE_036}, {implementation-record-element=OBJ_YAW_ANGLE_ERR_001, system-signal=OBJ_YAW_ANGLE_ERR_036}, {implementation-record-element=OBJ_VELOCITY_LONG_ERR_001, system-signal=OBJ_VELOCITY_LONG_ERR_036}, {implementation-record-element=OBJ_VELOCITY_LAT_001, system-signal=OBJ_VELOCITY_LAT_036}, {implementation-record-element=OBJ_YAW_RATE_ERR_001, system-signal=OBJ_YAW_RATE_ERR_036}, {implementation-record-element=OBJ_VEH_TRACK_FLAG_001, system-signal=OBJ_VEH_TRACK_FLAG_036}, {implementation-record-element=OBJ_TIMESTAMP_OFFSET_001, system-signal=OBJ_TIMESTAMP_OFFSET_036}, {implementation-record-element=OBJ_VELOCITY_ERR_CRR_COEF_001, system-signal=OBJ_VELOCITY_ERR_CRR_COEF_036}, {implementation-record-element=OBJ_YAW_ANGLE_001, system-signal=OBJ_YAW_ANGLE_036}, {implementation-record-element=OBJ_VELOCITY_LONG_001, system-signal=OBJ_VELOCITY_LONG_036}, {implementation-record-element=OBJ_VELOCITY_LAT_ERR_001, system-signal=OBJ_VELOCITY_LAT_ERR_036}, {implementation-record-element=OBJ_TRACK_MOTION_MODEL_001, system-signal=OBJ_TRACK_MOTION_MODEL_036}]}
        sender-receiver-to-signal-group-mapping={data-element=Pp_SG_TrackerObject037.Vdp_SG_TrackerObject037, signal-group=SG_TrackerObject037, type-mapping=sender-rec-record-type-mapping=record-element-mappings=[{implementation-record-element=OBJ_CLS_TYPE2_001, system-signal=OBJ_CLS_TYPE2_037}, {implementation-record-element=OBJ_ACCELERATION_LAT_ERR_001, system-signal=OBJ_ACCELERATION_LAT_ERR_037}, {implementation-record-element=OBJ_REF_PT_LONG_OFFSET_001, system-signal=OBJ_REF_PT_LONG_OFFSET_037}, {implementation-record-element=OBJ_ACCELERATION_LONG_ERR_001, system-signal=OBJ_ACCELERATION_LONG_ERR_037}, {implementation-record-element=OBJ_ACCEL_ERR_CRR_COEF_001, system-signal=OBJ_ACCEL_ERR_CRR_COEF_037}, {implementation-record-element=OBJ_ACCELERATION_LONG_001, system-signal=OBJ_ACCELERATION_LONG_037}, {implementation-record-element=OBJ_POS_ERR_CRR_COEF_001, system-signal=OBJ_POS_ERR_CRR_COEF_037}, {implementation-record-element=OBJ_ACCELERATION_LAT_001, system-signal=OBJ_ACCELERATION_LAT_037}, {implementation-record-element=OBJ_REF_PT_LAT_OFFSET_001, system-signal=OBJ_REF_PT_LAT_OFFSET_037}, {implementation-record-element=OBJ_DIMENSION_LENGTH_001, system-signal=OBJ_DIMENSION_LENGTH_037}, {implementation-record-element=OBJ_TIMESTAMP_OFFSET_001, system-signal=OBJ_TIMESTAMP_OFFSET_037}, {implementation-record-element=OBJ_VELOCITY_LAT_001, system-signal=OBJ_VELOCITY_LAT_037}, {implementation-record-element=OBJ_RCS_001, system-signal=OBJ_RCS_037}, {implementation-record-element=OBJ_DIMENSION_WIDTH_001, system-signal=OBJ_DIMENSION_WIDTH_037}, {implementation-record-element=OBJ_CLS_TYPE1_PROB_001, system-signal=OBJ_CLS_TYPE1_PROB_037}, {implementation-record-element=OBJ_CLS_TYPE4_001, system-signal=OBJ_CLS_TYPE4_037}, {implementation-record-element=OBJ_CLS_TYPE4_PROB_001, system-signal=OBJ_CLS_TYPE4_PROB_037}, {implementation-record-element=OBJ_EXISTENCE_PROB_001, system-signal=OBJ_EXISTENCE_PROB_037}, {implementation-record-element=OBJ_CLS_TYPE1_001, system-signal=OBJ_CLS_TYPE1_037}, {implementation-record-element=OBJ_DIMENSION_WIDTH_ERR_001, system-signal=OBJ_DIMENSION_WIDTH_ERR_037}, {implementation-record-element=OBJ_CLS_TYPE3_001, system-signal=OBJ_CLS_TYPE3_037}, {implementation-record-element=OBJ_GROUP_ID_001, system-signal=OBJ_GROUP_ID_037}, {implementation-record-element=OBJ_DIMENSION_LENGTH_ERR_001, system-signal=OBJ_DIMENSION_LENGTH_ERR_037}, {implementation-record-element=OBJ_ID_001, system-signal=OBJ_ID_037}, {implementation-record-element=OBJ_MOVEMENT_STATUS_001, system-signal=OBJ_MOVEMENT_STATUS_037}, {implementation-record-element=OBJ_MH_CYCLE_COUNTER_001, system-signal=OBJ_MH_CYCLE_COUNTER_037}, {implementation-record-element=OBJ_MH_CRC16_001, system-signal=OBJ_MH_CRC16_037}, {implementation-record-element=OBJ_ALIVE_TIME_001, system-signal=OBJ_ALIVE_TIME_037}, {implementation-record-element=OBJ_POS_LAT_001, system-signal=OBJ_POS_LAT_037}, {implementation-record-element=OBJ_CLS_TYPE5_001, system-signal=OBJ_CLS_TYPE5_037}, {implementation-record-element=OBJ_POS_LAT_ERR_001, system-signal=OBJ_POS_LAT_ERR_037}, {implementation-record-element=OBJ_POS_LONG_ERR_001, system-signal=OBJ_POS_LONG_ERR_037}, {implementation-record-element=OBJ_TRACK_MOTION_MODEL_001, system-signal=OBJ_TRACK_MOTION_MODEL_037}, {implementation-record-element=OBJ_VELOCITY_LAT_ERR_001, system-signal=OBJ_VELOCITY_LAT_ERR_037}, {implementation-record-element=OBJ_MEASUREMENT_STATUS_001, system-signal=OBJ_MEASUREMENT_STATUS_037}, {implementation-record-element=OBJ_VELOCITY_LONG_ERR_001, system-signal=OBJ_VELOCITY_LONG_ERR_037}, {implementation-record-element=OBJ_VEH_TRACK_FLAG_001, system-signal=OBJ_VEH_TRACK_FLAG_037}, {implementation-record-element=OBJ_VELOCITY_LONG_001, system-signal=OBJ_VELOCITY_LONG_037}, {implementation-record-element=OBJ_YAW_ANGLE_001, system-signal=OBJ_YAW_ANGLE_037}, {implementation-record-element=OBJ_CLS_TYPE5_PROB_001, system-signal=OBJ_CLS_TYPE5_PROB_037}, {implementation-record-element=OBJ_CLS_TYPE6_001, system-signal=OBJ_CLS_TYPE6_037}, {implementation-record-element=OBJ_VELOCITY_ERR_CRR_COEF_001, system-signal=OBJ_VELOCITY_ERR_CRR_COEF_037}, {implementation-record-element=OBJ_YAW_ANGLE_ERR_001, system-signal=OBJ_YAW_ANGLE_ERR_037}, {implementation-record-element=OBJ_YAW_RATE_001, system-signal=OBJ_YAW_RATE_037}, {implementation-record-element=OBJ_CLS_TYPE2_PROB_001, system-signal=OBJ_CLS_TYPE2_PROB_037}, {implementation-record-element=OBJ_POS_LONG_001, system-signal=OBJ_POS_LONG_037}, {implementation-record-element=OBJ_YAW_RATE_ERR_001, system-signal=OBJ_YAW_RATE_ERR_037}, {implementation-record-element=OBJ_CLS_TYPE3_PROB_001, system-signal=OBJ_CLS_TYPE3_PROB_037}, {implementation-record-element=OBJ_CLS_TYPE6_PROB_001, system-signal=OBJ_CLS_TYPE6_PROB_037}]}
        sender-receiver-to-signal-group-mapping={data-element=Pp_SG_TrackerObject038.Vdp_SG_TrackerObject038, signal-group=SG_TrackerObject038, type-mapping=sender-rec-record-type-mapping=record-element-mappings=[{implementation-record-element=OBJ_ACCEL_ERR_CRR_COEF_001, system-signal=OBJ_ACCEL_ERR_CRR_COEF_038}, {implementation-record-element=OBJ_YAW_ANGLE_001, system-signal=OBJ_YAW_ANGLE_038}, {implementation-record-element=OBJ_MOVEMENT_STATUS_001, system-signal=OBJ_MOVEMENT_STATUS_038}, {implementation-record-element=OBJ_CLS_TYPE3_PROB_001, system-signal=OBJ_CLS_TYPE3_PROB_038}, {implementation-record-element=OBJ_ACCELERATION_LAT_ERR_001, system-signal=OBJ_ACCELERATION_LAT_ERR_038}, {implementation-record-element=OBJ_ACCELERATION_LONG_001, system-signal=OBJ_ACCELERATION_LONG_038}, {implementation-record-element=OBJ_CLS_TYPE4_001, system-signal=OBJ_CLS_TYPE4_038}, {implementation-record-element=OBJ_POS_ERR_CRR_COEF_001, system-signal=OBJ_POS_ERR_CRR_COEF_038}, {implementation-record-element=OBJ_CLS_TYPE4_PROB_001, system-signal=OBJ_CLS_TYPE4_PROB_038}, {implementation-record-element=OBJ_ACCELERATION_LONG_ERR_001, system-signal=OBJ_ACCELERATION_LONG_ERR_038}, {implementation-record-element=OBJ_MH_CYCLE_COUNTER_001, system-signal=OBJ_MH_CYCLE_COUNTER_038}, {implementation-record-element=OBJ_POS_LAT_001, system-signal=OBJ_POS_LAT_038}, {implementation-record-element=OBJ_MEASUREMENT_STATUS_001, system-signal=OBJ_MEASUREMENT_STATUS_038}, {implementation-record-element=OBJ_REF_PT_LONG_OFFSET_001, system-signal=OBJ_REF_PT_LONG_OFFSET_038}, {implementation-record-element=OBJ_TIMESTAMP_OFFSET_001, system-signal=OBJ_TIMESTAMP_OFFSET_038}, {implementation-record-element=OBJ_CLS_TYPE3_001, system-signal=OBJ_CLS_TYPE3_038}, {implementation-record-element=OBJ_TRACK_MOTION_MODEL_001, system-signal=OBJ_TRACK_MOTION_MODEL_038}, {implementation-record-element=OBJ_EXISTENCE_PROB_001, system-signal=OBJ_EXISTENCE_PROB_038}, {implementation-record-element=OBJ_REF_PT_LAT_OFFSET_001, system-signal=OBJ_REF_PT_LAT_OFFSET_038}, {implementation-record-element=OBJ_ACCELERATION_LAT_001, system-signal=OBJ_ACCELERATION_LAT_038}, {implementation-record-element=OBJ_POS_LONG_ERR_001, system-signal=OBJ_POS_LONG_ERR_038}, {implementation-record-element=OBJ_YAW_ANGLE_ERR_001, system-signal=OBJ_YAW_ANGLE_ERR_038}, {implementation-record-element=OBJ_YAW_RATE_001, system-signal=OBJ_YAW_RATE_038}, {implementation-record-element=OBJ_POS_LONG_001, system-signal=OBJ_POS_LONG_038}, {implementation-record-element=OBJ_CLS_TYPE6_PROB_001, system-signal=OBJ_CLS_TYPE6_PROB_038}, {implementation-record-element=OBJ_DIMENSION_WIDTH_001, system-signal=OBJ_DIMENSION_WIDTH_038}, {implementation-record-element=OBJ_VELOCITY_LAT_ERR_001, system-signal=OBJ_VELOCITY_LAT_ERR_038}, {implementation-record-element=OBJ_DIMENSION_LENGTH_001, system-signal=OBJ_DIMENSION_LENGTH_038}, {implementation-record-element=OBJ_DIMENSION_WIDTH_ERR_001, system-signal=OBJ_DIMENSION_WIDTH_ERR_038}, {implementation-record-element=OBJ_VELOCITY_ERR_CRR_COEF_001, system-signal=OBJ_VELOCITY_ERR_CRR_COEF_038}, {implementation-record-element=OBJ_YAW_RATE_ERR_001, system-signal=OBJ_YAW_RATE_ERR_038}, {implementation-record-element=OBJ_MH_CRC16_001, system-signal=OBJ_MH_CRC16_038}, {implementation-record-element=OBJ_CLS_TYPE1_001, system-signal=OBJ_CLS_TYPE1_038}, {implementation-record-element=OBJ_ID_001, system-signal=OBJ_ID_038}, {implementation-record-element=OBJ_CLS_TYPE2_PROB_001, system-signal=OBJ_CLS_TYPE2_PROB_038}, {implementation-record-element=OBJ_POS_LAT_ERR_001, system-signal=OBJ_POS_LAT_ERR_038}, {implementation-record-element=OBJ_GROUP_ID_001, system-signal=OBJ_GROUP_ID_038}, {implementation-record-element=OBJ_CLS_TYPE6_001, system-signal=OBJ_CLS_TYPE6_038}, {implementation-record-element=OBJ_DIMENSION_LENGTH_ERR_001, system-signal=OBJ_DIMENSION_LENGTH_ERR_038}, {implementation-record-element=OBJ_VEH_TRACK_FLAG_001, system-signal=OBJ_VEH_TRACK_FLAG_038}, {implementation-record-element=OBJ_VELOCITY_LAT_001, system-signal=OBJ_VELOCITY_LAT_038}, {implementation-record-element=OBJ_CLS_TYPE2_001, system-signal=OBJ_CLS_TYPE2_038}, {implementation-record-element=OBJ_VELOCITY_LONG_001, system-signal=OBJ_VELOCITY_LONG_038}, {implementation-record-element=OBJ_RCS_001, system-signal=OBJ_RCS_038}, {implementation-record-element=OBJ_CLS_TYPE1_PROB_001, system-signal=OBJ_CLS_TYPE1_PROB_038}, {implementation-record-element=OBJ_CLS_TYPE5_PROB_001, system-signal=OBJ_CLS_TYPE5_PROB_038}, {implementation-record-element=OBJ_CLS_TYPE5_001, system-signal=OBJ_CLS_TYPE5_038}, {implementation-record-element=OBJ_VELOCITY_LONG_ERR_001, system-signal=OBJ_VELOCITY_LONG_ERR_038}, {implementation-record-element=OBJ_ALIVE_TIME_001, system-signal=OBJ_ALIVE_TIME_038}]}
        sender-receiver-to-signal-group-mapping={data-element=Pp_SG_TrackerObject039.Vdp_SG_TrackerObject039, signal-group=SG_TrackerObject039, type-mapping=sender-rec-record-type-mapping=record-element-mappings=[{implementation-record-element=OBJ_ACCELERATION_LONG_ERR_001, system-signal=OBJ_ACCELERATION_LONG_ERR_039}, {implementation-record-element=OBJ_ACCELERATION_LAT_001, system-signal=OBJ_ACCELERATION_LAT_039}, {implementation-record-element=OBJ_ACCELERATION_LAT_ERR_001, system-signal=OBJ_ACCELERATION_LAT_ERR_039}, {implementation-record-element=OBJ_ACCEL_ERR_CRR_COEF_001, system-signal=OBJ_ACCEL_ERR_CRR_COEF_039}, {implementation-record-element=OBJ_ACCELERATION_LONG_001, system-signal=OBJ_ACCELERATION_LONG_039}, {implementation-record-element=OBJ_ALIVE_TIME_001, system-signal=OBJ_ALIVE_TIME_039}, {implementation-record-element=OBJ_CLS_TYPE1_PROB_001, system-signal=OBJ_CLS_TYPE1_PROB_039}, {implementation-record-element=OBJ_CLS_TYPE1_001, system-signal=OBJ_CLS_TYPE1_039}, {implementation-record-element=OBJ_CLS_TYPE2_001, system-signal=OBJ_CLS_TYPE2_039}, {implementation-record-element=OBJ_CLS_TYPE2_PROB_001, system-signal=OBJ_CLS_TYPE2_PROB_039}, {implementation-record-element=OBJ_CLS_TYPE3_001, system-signal=OBJ_CLS_TYPE3_039}, {implementation-record-element=OBJ_CLS_TYPE3_PROB_001, system-signal=OBJ_CLS_TYPE3_PROB_039}, {implementation-record-element=OBJ_CLS_TYPE4_001, system-signal=OBJ_CLS_TYPE4_039}, {implementation-record-element=OBJ_CLS_TYPE4_PROB_001, system-signal=OBJ_CLS_TYPE4_PROB_039}, {implementation-record-element=OBJ_CLS_TYPE5_001, system-signal=OBJ_CLS_TYPE5_039}, {implementation-record-element=OBJ_YAW_ANGLE_ERR_001, system-signal=OBJ_YAW_ANGLE_ERR_039}, {implementation-record-element=OBJ_POS_ERR_CRR_COEF_001, system-signal=OBJ_POS_ERR_CRR_COEF_039}, {implementation-record-element=OBJ_TIMESTAMP_OFFSET_001, system-signal=OBJ_TIMESTAMP_OFFSET_039}, {implementation-record-element=OBJ_POS_LAT_001, system-signal=OBJ_POS_LAT_039}, {implementation-record-element=OBJ_POS_LAT_ERR_001, system-signal=OBJ_POS_LAT_ERR_039}, {implementation-record-element=OBJ_GROUP_ID_001, system-signal=OBJ_GROUP_ID_039}, {implementation-record-element=OBJ_VELOCITY_LAT_ERR_001, system-signal=OBJ_VELOCITY_LAT_ERR_039}, {implementation-record-element=OBJ_VELOCITY_LAT_001, system-signal=OBJ_VELOCITY_LAT_039}, {implementation-record-element=OBJ_MH_CRC16_001, system-signal=OBJ_MH_CRC16_039}, {implementation-record-element=OBJ_RCS_001, system-signal=OBJ_RCS_039}, {implementation-record-element=OBJ_VEH_TRACK_FLAG_001, system-signal=OBJ_VEH_TRACK_FLAG_039}, {implementation-record-element=OBJ_DIMENSION_LENGTH_ERR_001, system-signal=OBJ_DIMENSION_LENGTH_ERR_039}, {implementation-record-element=OBJ_ID_001, system-signal=OBJ_ID_039}, {implementation-record-element=OBJ_POS_LONG_001, system-signal=OBJ_POS_LONG_039}, {implementation-record-element=OBJ_DIMENSION_WIDTH_ERR_001, system-signal=OBJ_DIMENSION_WIDTH_ERR_039}, {implementation-record-element=OBJ_POS_LONG_ERR_001, system-signal=OBJ_POS_LONG_ERR_039}, {implementation-record-element=OBJ_EXISTENCE_PROB_001, system-signal=OBJ_EXISTENCE_PROB_039}, {implementation-record-element=OBJ_DIMENSION_LENGTH_001, system-signal=OBJ_DIMENSION_LENGTH_039}, {implementation-record-element=OBJ_MEASUREMENT_STATUS_001, system-signal=OBJ_MEASUREMENT_STATUS_039}, {implementation-record-element=OBJ_MH_CYCLE_COUNTER_001, system-signal=OBJ_MH_CYCLE_COUNTER_039}, {implementation-record-element=OBJ_VELOCITY_LONG_001, system-signal=OBJ_VELOCITY_LONG_039}, {implementation-record-element=OBJ_YAW_RATE_001, system-signal=OBJ_YAW_RATE_039}, {implementation-record-element=OBJ_YAW_RATE_ERR_001, system-signal=OBJ_YAW_RATE_ERR_039}, {implementation-record-element=OBJ_CLS_TYPE5_PROB_001, system-signal=OBJ_CLS_TYPE5_PROB_039}, {implementation-record-element=OBJ_CLS_TYPE6_PROB_001, system-signal=OBJ_CLS_TYPE6_PROB_039}, {implementation-record-element=OBJ_DIMENSION_WIDTH_001, system-signal=OBJ_DIMENSION_WIDTH_039}, {implementation-record-element=OBJ_MOVEMENT_STATUS_001, system-signal=OBJ_MOVEMENT_STATUS_039}, {implementation-record-element=OBJ_REF_PT_LAT_OFFSET_001, system-signal=OBJ_REF_PT_LAT_OFFSET_039}, {implementation-record-element=OBJ_CLS_TYPE6_001, system-signal=OBJ_CLS_TYPE6_039}, {implementation-record-element=OBJ_VELOCITY_LONG_ERR_001, system-signal=OBJ_VELOCITY_LONG_ERR_039}, {implementation-record-element=OBJ_YAW_ANGLE_001, system-signal=OBJ_YAW_ANGLE_039}, {implementation-record-element=OBJ_TRACK_MOTION_MODEL_001, system-signal=OBJ_TRACK_MOTION_MODEL_039}, {implementation-record-element=OBJ_REF_PT_LONG_OFFSET_001, system-signal=OBJ_REF_PT_LONG_OFFSET_039}, {implementation-record-element=OBJ_VELOCITY_ERR_CRR_COEF_001, system-signal=OBJ_VELOCITY_ERR_CRR_COEF_039}]}
        sender-receiver-to-signal-group-mapping={data-element=Pp_SG_TrackerObject040.Vdp_SG_TrackerObject040, signal-group=SG_TrackerObject040, type-mapping=sender-rec-record-type-mapping=record-element-mappings=[{implementation-record-element=OBJ_CLS_TYPE2_PROB_001, system-signal=OBJ_CLS_TYPE2_PROB_040}, {implementation-record-element=OBJ_ACCELERATION_LONG_001, system-signal=OBJ_ACCELERATION_LONG_040}, {implementation-record-element=OBJ_CLS_TYPE1_001, system-signal=OBJ_CLS_TYPE1_040}, {implementation-record-element=OBJ_DIMENSION_LENGTH_001, system-signal=OBJ_DIMENSION_LENGTH_040}, {implementation-record-element=OBJ_DIMENSION_LENGTH_ERR_001, system-signal=OBJ_DIMENSION_LENGTH_ERR_040}, {implementation-record-element=OBJ_DIMENSION_WIDTH_001, system-signal=OBJ_DIMENSION_WIDTH_040}, {implementation-record-element=OBJ_CLS_TYPE5_001, system-signal=OBJ_CLS_TYPE5_040}, {implementation-record-element=OBJ_DIMENSION_WIDTH_ERR_001, system-signal=OBJ_DIMENSION_WIDTH_ERR_040}, {implementation-record-element=OBJ_EXISTENCE_PROB_001, system-signal=OBJ_EXISTENCE_PROB_040}, {implementation-record-element=OBJ_ACCELERATION_LAT_001, system-signal=OBJ_ACCELERATION_LAT_040}, {implementation-record-element=OBJ_CLS_TYPE1_PROB_001, system-signal=OBJ_CLS_TYPE1_PROB_040}, {implementation-record-element=OBJ_GROUP_ID_001, system-signal=OBJ_GROUP_ID_040}, {implementation-record-element=OBJ_CLS_TYPE3_PROB_001, system-signal=OBJ_CLS_TYPE3_PROB_040}, {implementation-record-element=OBJ_ID_001, system-signal=OBJ_ID_040}, {implementation-record-element=OBJ_MH_CRC16_001, system-signal=OBJ_MH_CRC16_040}, {implementation-record-element=OBJ_MOVEMENT_STATUS_001, system-signal=OBJ_MOVEMENT_STATUS_040}, {implementation-record-element=OBJ_MEASUREMENT_STATUS_001, system-signal=OBJ_MEASUREMENT_STATUS_040}, {implementation-record-element=OBJ_ACCEL_ERR_CRR_COEF_001, system-signal=OBJ_ACCEL_ERR_CRR_COEF_040}, {implementation-record-element=OBJ_ALIVE_TIME_001, system-signal=OBJ_ALIVE_TIME_040}, {implementation-record-element=OBJ_CLS_TYPE3_001, system-signal=OBJ_CLS_TYPE3_040}, {implementation-record-element=OBJ_CLS_TYPE6_PROB_001, system-signal=OBJ_CLS_TYPE6_PROB_040}, {implementation-record-element=OBJ_MH_CYCLE_COUNTER_001, system-signal=OBJ_MH_CYCLE_COUNTER_040}, {implementation-record-element=OBJ_ACCELERATION_LONG_ERR_001, system-signal=OBJ_ACCELERATION_LONG_ERR_040}, {implementation-record-element=OBJ_ACCELERATION_LAT_ERR_001, system-signal=OBJ_ACCELERATION_LAT_ERR_040}, {implementation-record-element=OBJ_CLS_TYPE2_001, system-signal=OBJ_CLS_TYPE2_040}, {implementation-record-element=OBJ_CLS_TYPE6_001, system-signal=OBJ_CLS_TYPE6_040}, {implementation-record-element=OBJ_CLS_TYPE4_001, system-signal=OBJ_CLS_TYPE4_040}, {implementation-record-element=OBJ_CLS_TYPE4_PROB_001, system-signal=OBJ_CLS_TYPE4_PROB_040}, {implementation-record-element=OBJ_CLS_TYPE5_PROB_001, system-signal=OBJ_CLS_TYPE5_PROB_040}, {implementation-record-element=OBJ_POS_LAT_001, system-signal=OBJ_POS_LAT_040}, {implementation-record-element=OBJ_POS_ERR_CRR_COEF_001, system-signal=OBJ_POS_ERR_CRR_COEF_040}, {implementation-record-element=OBJ_REF_PT_LAT_OFFSET_001, system-signal=OBJ_REF_PT_LAT_OFFSET_040}, {implementation-record-element=OBJ_VELOCITY_LONG_001, system-signal=OBJ_VELOCITY_LONG_040}, {implementation-record-element=OBJ_VELOCITY_LAT_001, system-signal=OBJ_VELOCITY_LAT_040}, {implementation-record-element=OBJ_VELOCITY_ERR_CRR_COEF_001, system-signal=OBJ_VELOCITY_ERR_CRR_COEF_040}, {implementation-record-element=OBJ_TRACK_MOTION_MODEL_001, system-signal=OBJ_TRACK_MOTION_MODEL_040}, {implementation-record-element=OBJ_REF_PT_LONG_OFFSET_001, system-signal=OBJ_REF_PT_LONG_OFFSET_040}, {implementation-record-element=OBJ_YAW_ANGLE_ERR_001, system-signal=OBJ_YAW_ANGLE_ERR_040}, {implementation-record-element=OBJ_YAW_RATE_001, system-signal=OBJ_YAW_RATE_040}, {implementation-record-element=OBJ_POS_LONG_001, system-signal=OBJ_POS_LONG_040}, {implementation-record-element=OBJ_YAW_ANGLE_001, system-signal=OBJ_YAW_ANGLE_040}, {implementation-record-element=OBJ_VEH_TRACK_FLAG_001, system-signal=OBJ_VEH_TRACK_FLAG_040}, {implementation-record-element=OBJ_POS_LONG_ERR_001, system-signal=OBJ_POS_LONG_ERR_040}, {implementation-record-element=OBJ_TIMESTAMP_OFFSET_001, system-signal=OBJ_TIMESTAMP_OFFSET_040}, {implementation-record-element=OBJ_VELOCITY_LAT_ERR_001, system-signal=OBJ_VELOCITY_LAT_ERR_040}, {implementation-record-element=OBJ_RCS_001, system-signal=OBJ_RCS_040}, {implementation-record-element=OBJ_YAW_RATE_ERR_001, system-signal=OBJ_YAW_RATE_ERR_040}, {implementation-record-element=OBJ_POS_LAT_ERR_001, system-signal=OBJ_POS_LAT_ERR_040}, {implementation-record-element=OBJ_VELOCITY_LONG_ERR_001, system-signal=OBJ_VELOCITY_LONG_ERR_040}]}
        sender-receiver-to-signal-group-mapping={data-element=Pp_SG_TrackerObject041.Vdp_SG_TrackerObject041, signal-group=SG_TrackerObject041, type-mapping=sender-rec-record-type-mapping=record-element-mappings=[{implementation-record-element=OBJ_MOVEMENT_STATUS_001, system-signal=OBJ_MOVEMENT_STATUS_041}, {implementation-record-element=OBJ_POS_LONG_ERR_001, system-signal=OBJ_POS_LONG_ERR_041}, {implementation-record-element=OBJ_CLS_TYPE1_001, system-signal=OBJ_CLS_TYPE1_041}, {implementation-record-element=OBJ_CLS_TYPE1_PROB_001, system-signal=OBJ_CLS_TYPE1_PROB_041}, {implementation-record-element=OBJ_MH_CYCLE_COUNTER_001, system-signal=OBJ_MH_CYCLE_COUNTER_041}, {implementation-record-element=OBJ_REF_PT_LONG_OFFSET_001, system-signal=OBJ_REF_PT_LONG_OFFSET_041}, {implementation-record-element=OBJ_POS_LAT_ERR_001, system-signal=OBJ_POS_LAT_ERR_041}, {implementation-record-element=OBJ_CLS_TYPE2_001, system-signal=OBJ_CLS_TYPE2_041}, {implementation-record-element=OBJ_TIMESTAMP_OFFSET_001, system-signal=OBJ_TIMESTAMP_OFFSET_041}, {implementation-record-element=OBJ_MEASUREMENT_STATUS_001, system-signal=OBJ_MEASUREMENT_STATUS_041}, {implementation-record-element=OBJ_TRACK_MOTION_MODEL_001, system-signal=OBJ_TRACK_MOTION_MODEL_041}, {implementation-record-element=OBJ_VEH_TRACK_FLAG_001, system-signal=OBJ_VEH_TRACK_FLAG_041}, {implementation-record-element=OBJ_ALIVE_TIME_001, system-signal=OBJ_ALIVE_TIME_041}, {implementation-record-element=OBJ_EXISTENCE_PROB_001, system-signal=OBJ_EXISTENCE_PROB_041}, {implementation-record-element=OBJ_VELOCITY_ERR_CRR_COEF_001, system-signal=OBJ_VELOCITY_ERR_CRR_COEF_041}, {implementation-record-element=OBJ_RCS_001, system-signal=OBJ_RCS_041}, {implementation-record-element=OBJ_REF_PT_LAT_OFFSET_001, system-signal=OBJ_REF_PT_LAT_OFFSET_041}, {implementation-record-element=OBJ_VELOCITY_LAT_001, system-signal=OBJ_VELOCITY_LAT_041}, {implementation-record-element=OBJ_VELOCITY_LAT_ERR_001, system-signal=OBJ_VELOCITY_LAT_ERR_041}, {implementation-record-element=OBJ_POS_ERR_CRR_COEF_001, system-signal=OBJ_POS_ERR_CRR_COEF_041}, {implementation-record-element=OBJ_CLS_TYPE4_001, system-signal=OBJ_CLS_TYPE4_041}, {implementation-record-element=OBJ_CLS_TYPE5_PROB_001, system-signal=OBJ_CLS_TYPE5_PROB_041}, {implementation-record-element=OBJ_CLS_TYPE6_PROB_001, system-signal=OBJ_CLS_TYPE6_PROB_041}, {implementation-record-element=OBJ_CLS_TYPE4_PROB_001, system-signal=OBJ_CLS_TYPE4_PROB_041}, {implementation-record-element=OBJ_DIMENSION_LENGTH_001, system-signal=OBJ_DIMENSION_LENGTH_041}, {implementation-record-element=OBJ_DIMENSION_WIDTH_001, system-signal=OBJ_DIMENSION_WIDTH_041}, {implementation-record-element=OBJ_DIMENSION_WIDTH_ERR_001, system-signal=OBJ_DIMENSION_WIDTH_ERR_041}, {implementation-record-element=OBJ_MH_CRC16_001, system-signal=OBJ_MH_CRC16_041}, {implementation-record-element=OBJ_ACCELERATION_LAT_001, system-signal=OBJ_ACCELERATION_LAT_041}, {implementation-record-element=OBJ_ACCELERATION_LONG_ERR_001, system-signal=OBJ_ACCELERATION_LONG_ERR_041}, {implementation-record-element=OBJ_ACCELERATION_LONG_001, system-signal=OBJ_ACCELERATION_LONG_041}, {implementation-record-element=OBJ_CLS_TYPE3_PROB_001, system-signal=OBJ_CLS_TYPE3_PROB_041}, {implementation-record-element=OBJ_CLS_TYPE5_001, system-signal=OBJ_CLS_TYPE5_041}, {implementation-record-element=OBJ_CLS_TYPE6_001, system-signal=OBJ_CLS_TYPE6_041}, {implementation-record-element=OBJ_DIMENSION_LENGTH_ERR_001, system-signal=OBJ_DIMENSION_LENGTH_ERR_041}, {implementation-record-element=OBJ_ACCELERATION_LAT_ERR_001, system-signal=OBJ_ACCELERATION_LAT_ERR_041}, {implementation-record-element=OBJ_CLS_TYPE3_001, system-signal=OBJ_CLS_TYPE3_041}, {implementation-record-element=OBJ_CLS_TYPE2_PROB_001, system-signal=OBJ_CLS_TYPE2_PROB_041}, {implementation-record-element=OBJ_GROUP_ID_001, system-signal=OBJ_GROUP_ID_041}, {implementation-record-element=OBJ_ID_001, system-signal=OBJ_ID_041}, {implementation-record-element=OBJ_ACCEL_ERR_CRR_COEF_001, system-signal=OBJ_ACCEL_ERR_CRR_COEF_041}, {implementation-record-element=OBJ_POS_LAT_001, system-signal=OBJ_POS_LAT_041}, {implementation-record-element=OBJ_POS_LONG_001, system-signal=OBJ_POS_LONG_041}, {implementation-record-element=OBJ_YAW_RATE_001, system-signal=OBJ_YAW_RATE_041}, {implementation-record-element=OBJ_YAW_RATE_ERR_001, system-signal=OBJ_YAW_RATE_ERR_041}, {implementation-record-element=OBJ_VELOCITY_LONG_ERR_001, system-signal=OBJ_VELOCITY_LONG_ERR_041}, {implementation-record-element=OBJ_VELOCITY_LONG_001, system-signal=OBJ_VELOCITY_LONG_041}, {implementation-record-element=OBJ_YAW_ANGLE_ERR_001, system-signal=OBJ_YAW_ANGLE_ERR_041}, {implementation-record-element=OBJ_YAW_ANGLE_001, system-signal=OBJ_YAW_ANGLE_041}]}
        sender-receiver-to-signal-group-mapping={data-element=Pp_SG_TrackerObject042.Vdp_SG_TrackerObject042, signal-group=SG_TrackerObject042, type-mapping=sender-rec-record-type-mapping=record-element-mappings=[{implementation-record-element=OBJ_VELOCITY_ERR_CRR_COEF_001, system-signal=OBJ_VELOCITY_ERR_CRR_COEF_042}, {implementation-record-element=OBJ_CLS_TYPE1_PROB_001, system-signal=OBJ_CLS_TYPE1_PROB_042}, {implementation-record-element=OBJ_CLS_TYPE4_001, system-signal=OBJ_CLS_TYPE4_042}, {implementation-record-element=OBJ_DIMENSION_WIDTH_001, system-signal=OBJ_DIMENSION_WIDTH_042}, {implementation-record-element=OBJ_ID_001, system-signal=OBJ_ID_042}, {implementation-record-element=OBJ_MH_CYCLE_COUNTER_001, system-signal=OBJ_MH_CYCLE_COUNTER_042}, {implementation-record-element=OBJ_DIMENSION_WIDTH_ERR_001, system-signal=OBJ_DIMENSION_WIDTH_ERR_042}, {implementation-record-element=OBJ_MOVEMENT_STATUS_001, system-signal=OBJ_MOVEMENT_STATUS_042}, {implementation-record-element=OBJ_POS_LONG_ERR_001, system-signal=OBJ_POS_LONG_ERR_042}, {implementation-record-element=OBJ_POS_LAT_001, system-signal=OBJ_POS_LAT_042}, {implementation-record-element=OBJ_POS_LAT_ERR_001, system-signal=OBJ_POS_LAT_ERR_042}, {implementation-record-element=OBJ_VEH_TRACK_FLAG_001, system-signal=OBJ_VEH_TRACK_FLAG_042}, {implementation-record-element=OBJ_YAW_ANGLE_001, system-signal=OBJ_YAW_ANGLE_042}, {implementation-record-element=OBJ_DIMENSION_LENGTH_ERR_001, system-signal=OBJ_DIMENSION_LENGTH_ERR_042}, {implementation-record-element=OBJ_CLS_TYPE5_001, system-signal=OBJ_CLS_TYPE5_042}, {implementation-record-element=OBJ_ACCELERATION_LONG_ERR_001, system-signal=OBJ_ACCELERATION_LONG_ERR_042}, {implementation-record-element=OBJ_CLS_TYPE6_001, system-signal=OBJ_CLS_TYPE6_042}, {implementation-record-element=OBJ_GROUP_ID_001, system-signal=OBJ_GROUP_ID_042}, {implementation-record-element=OBJ_CLS_TYPE2_PROB_001, system-signal=OBJ_CLS_TYPE2_PROB_042}, {implementation-record-element=OBJ_CLS_TYPE6_PROB_001, system-signal=OBJ_CLS_TYPE6_PROB_042}, {implementation-record-element=OBJ_MH_CRC16_001, system-signal=OBJ_MH_CRC16_042}, {implementation-record-element=OBJ_POS_ERR_CRR_COEF_001, system-signal=OBJ_POS_ERR_CRR_COEF_042}, {implementation-record-element=OBJ_REF_PT_LAT_OFFSET_001, system-signal=OBJ_REF_PT_LAT_OFFSET_042}, {implementation-record-element=OBJ_TRACK_MOTION_MODEL_001, system-signal=OBJ_TRACK_MOTION_MODEL_042}, {implementation-record-element=OBJ_CLS_TYPE1_001, system-signal=OBJ_CLS_TYPE1_042}, {implementation-record-element=OBJ_ACCEL_ERR_CRR_COEF_001, system-signal=OBJ_ACCEL_ERR_CRR_COEF_042}, {implementation-record-element=OBJ_CLS_TYPE3_001, system-signal=OBJ_CLS_TYPE3_042}, {implementation-record-element=OBJ_CLS_TYPE4_PROB_001, system-signal=OBJ_CLS_TYPE4_PROB_042}, {implementation-record-element=OBJ_ACCELERATION_LAT_ERR_001, system-signal=OBJ_ACCELERATION_LAT_ERR_042}, {implementation-record-element=OBJ_ACCELERATION_LONG_001, system-signal=OBJ_ACCELERATION_LONG_042}, {implementation-record-element=OBJ_CLS_TYPE2_001, system-signal=OBJ_CLS_TYPE2_042}, {implementation-record-element=OBJ_TIMESTAMP_OFFSET_001, system-signal=OBJ_TIMESTAMP_OFFSET_042}, {implementation-record-element=OBJ_VELOCITY_LAT_ERR_001, system-signal=OBJ_VELOCITY_LAT_ERR_042}, {implementation-record-element=OBJ_YAW_ANGLE_ERR_001, system-signal=OBJ_YAW_ANGLE_ERR_042}, {implementation-record-element=OBJ_ACCELERATION_LAT_001, system-signal=OBJ_ACCELERATION_LAT_042}, {implementation-record-element=OBJ_YAW_RATE_ERR_001, system-signal=OBJ_YAW_RATE_ERR_042}, {implementation-record-element=OBJ_CLS_TYPE3_PROB_001, system-signal=OBJ_CLS_TYPE3_PROB_042}, {implementation-record-element=OBJ_CLS_TYPE5_PROB_001, system-signal=OBJ_CLS_TYPE5_PROB_042}, {implementation-record-element=OBJ_RCS_001, system-signal=OBJ_RCS_042}, {implementation-record-element=OBJ_VELOCITY_LONG_001, system-signal=OBJ_VELOCITY_LONG_042}, {implementation-record-element=OBJ_EXISTENCE_PROB_001, system-signal=OBJ_EXISTENCE_PROB_042}, {implementation-record-element=OBJ_YAW_RATE_001, system-signal=OBJ_YAW_RATE_042}, {implementation-record-element=OBJ_VELOCITY_LONG_ERR_001, system-signal=OBJ_VELOCITY_LONG_ERR_042}, {implementation-record-element=OBJ_ALIVE_TIME_001, system-signal=OBJ_ALIVE_TIME_042}, {implementation-record-element=OBJ_DIMENSION_LENGTH_001, system-signal=OBJ_DIMENSION_LENGTH_042}, {implementation-record-element=OBJ_MEASUREMENT_STATUS_001, system-signal=OBJ_MEASUREMENT_STATUS_042}, {implementation-record-element=OBJ_POS_LONG_001, system-signal=OBJ_POS_LONG_042}, {implementation-record-element=OBJ_REF_PT_LONG_OFFSET_001, system-signal=OBJ_REF_PT_LONG_OFFSET_042}, {implementation-record-element=OBJ_VELOCITY_LAT_001, system-signal=OBJ_VELOCITY_LAT_042}]}
        sender-receiver-to-signal-group-mapping={data-element=Pp_SG_TrackerObject043.Vdp_SG_TrackerObject043, signal-group=SG_TrackerObject043, type-mapping=sender-rec-record-type-mapping=record-element-mappings=[{implementation-record-element=OBJ_ACCELERATION_LAT_001, system-signal=OBJ_ACCELERATION_LAT_043}, {implementation-record-element=OBJ_ACCELERATION_LONG_ERR_001, system-signal=OBJ_ACCELERATION_LONG_ERR_043}, {implementation-record-element=OBJ_ALIVE_TIME_001, system-signal=OBJ_ALIVE_TIME_043}, {implementation-record-element=OBJ_CLS_TYPE1_001, system-signal=OBJ_CLS_TYPE1_043}, {implementation-record-element=OBJ_ACCELERATION_LAT_ERR_001, system-signal=OBJ_ACCELERATION_LAT_ERR_043}, {implementation-record-element=OBJ_ACCELERATION_LONG_001, system-signal=OBJ_ACCELERATION_LONG_043}, {implementation-record-element=OBJ_ACCEL_ERR_CRR_COEF_001, system-signal=OBJ_ACCEL_ERR_CRR_COEF_043}, {implementation-record-element=OBJ_CLS_TYPE2_PROB_001, system-signal=OBJ_CLS_TYPE2_PROB_043}, {implementation-record-element=OBJ_CLS_TYPE3_PROB_001, system-signal=OBJ_CLS_TYPE3_PROB_043}, {implementation-record-element=OBJ_POS_LAT_ERR_001, system-signal=OBJ_POS_LAT_ERR_043}, {implementation-record-element=OBJ_POS_LONG_001, system-signal=OBJ_POS_LONG_043}, {implementation-record-element=OBJ_CLS_TYPE1_PROB_001, system-signal=OBJ_CLS_TYPE1_PROB_043}, {implementation-record-element=OBJ_REF_PT_LONG_OFFSET_001, system-signal=OBJ_REF_PT_LONG_OFFSET_043}, {implementation-record-element=OBJ_TIMESTAMP_OFFSET_001, system-signal=OBJ_TIMESTAMP_OFFSET_043}, {implementation-record-element=OBJ_VEH_TRACK_FLAG_001, system-signal=OBJ_VEH_TRACK_FLAG_043}, {implementation-record-element=OBJ_CLS_TYPE2_001, system-signal=OBJ_CLS_TYPE2_043}, {implementation-record-element=OBJ_VELOCITY_ERR_CRR_COEF_001, system-signal=OBJ_VELOCITY_ERR_CRR_COEF_043}, {implementation-record-element=OBJ_YAW_ANGLE_001, system-signal=OBJ_YAW_ANGLE_043}, {implementation-record-element=OBJ_MEASUREMENT_STATUS_001, system-signal=OBJ_MEASUREMENT_STATUS_043}, {implementation-record-element=OBJ_POS_LONG_ERR_001, system-signal=OBJ_POS_LONG_ERR_043}, {implementation-record-element=OBJ_CLS_TYPE5_PROB_001, system-signal=OBJ_CLS_TYPE5_PROB_043}, {implementation-record-element=OBJ_MH_CRC16_001, system-signal=OBJ_MH_CRC16_043}, {implementation-record-element=OBJ_RCS_001, system-signal=OBJ_RCS_043}, {implementation-record-element=OBJ_VELOCITY_LAT_001, system-signal=OBJ_VELOCITY_LAT_043}, {implementation-record-element=OBJ_YAW_RATE_ERR_001, system-signal=OBJ_YAW_RATE_ERR_043}, {implementation-record-element=OBJ_VELOCITY_LONG_001, system-signal=OBJ_VELOCITY_LONG_043}, {implementation-record-element=OBJ_YAW_RATE_001, system-signal=OBJ_YAW_RATE_043}, {implementation-record-element=OBJ_VELOCITY_LAT_ERR_001, system-signal=OBJ_VELOCITY_LAT_ERR_043}, {implementation-record-element=OBJ_CLS_TYPE5_001, system-signal=OBJ_CLS_TYPE5_043}, {implementation-record-element=OBJ_DIMENSION_WIDTH_ERR_001, system-signal=OBJ_DIMENSION_WIDTH_ERR_043}, {implementation-record-element=OBJ_DIMENSION_LENGTH_001, system-signal=OBJ_DIMENSION_LENGTH_043}, {implementation-record-element=OBJ_DIMENSION_LENGTH_ERR_001, system-signal=OBJ_DIMENSION_LENGTH_ERR_043}, {implementation-record-element=OBJ_EXISTENCE_PROB_001, system-signal=OBJ_EXISTENCE_PROB_043}, {implementation-record-element=OBJ_MH_CYCLE_COUNTER_001, system-signal=OBJ_MH_CYCLE_COUNTER_043}, {implementation-record-element=OBJ_REF_PT_LAT_OFFSET_001, system-signal=OBJ_REF_PT_LAT_OFFSET_043}, {implementation-record-element=OBJ_CLS_TYPE6_PROB_001, system-signal=OBJ_CLS_TYPE6_PROB_043}, {implementation-record-element=OBJ_VELOCITY_LONG_ERR_001, system-signal=OBJ_VELOCITY_LONG_ERR_043}, {implementation-record-element=OBJ_CLS_TYPE4_001, system-signal=OBJ_CLS_TYPE4_043}, {implementation-record-element=OBJ_CLS_TYPE4_PROB_001, system-signal=OBJ_CLS_TYPE4_PROB_043}, {implementation-record-element=OBJ_YAW_ANGLE_ERR_001, system-signal=OBJ_YAW_ANGLE_ERR_043}, {implementation-record-element=OBJ_CLS_TYPE3_001, system-signal=OBJ_CLS_TYPE3_043}, {implementation-record-element=OBJ_POS_LAT_001, system-signal=OBJ_POS_LAT_043}, {implementation-record-element=OBJ_TRACK_MOTION_MODEL_001, system-signal=OBJ_TRACK_MOTION_MODEL_043}, {implementation-record-element=OBJ_DIMENSION_WIDTH_001, system-signal=OBJ_DIMENSION_WIDTH_043}, {implementation-record-element=OBJ_ID_001, system-signal=OBJ_ID_043}, {implementation-record-element=OBJ_MOVEMENT_STATUS_001, system-signal=OBJ_MOVEMENT_STATUS_043}, {implementation-record-element=OBJ_POS_ERR_CRR_COEF_001, system-signal=OBJ_POS_ERR_CRR_COEF_043}, {implementation-record-element=OBJ_CLS_TYPE6_001, system-signal=OBJ_CLS_TYPE6_043}, {implementation-record-element=OBJ_GROUP_ID_001, system-signal=OBJ_GROUP_ID_043}]}
        sender-receiver-to-signal-group-mapping={data-element=Pp_SG_TrackerObject044.Vdp_SG_TrackerObject044, signal-group=SG_TrackerObject044, type-mapping=sender-rec-record-type-mapping=record-element-mappings=[{implementation-record-element=OBJ_ACCELERATION_LAT_ERR_001, system-signal=OBJ_ACCELERATION_LAT_ERR_044}, {implementation-record-element=OBJ_ACCELERATION_LONG_001, system-signal=OBJ_ACCELERATION_LONG_044}, {implementation-record-element=OBJ_ACCEL_ERR_CRR_COEF_001, system-signal=OBJ_ACCEL_ERR_CRR_COEF_044}, {implementation-record-element=OBJ_CLS_TYPE1_001, system-signal=OBJ_CLS_TYPE1_044}, {implementation-record-element=OBJ_CLS_TYPE2_PROB_001, system-signal=OBJ_CLS_TYPE2_PROB_044}, {implementation-record-element=OBJ_CLS_TYPE3_001, system-signal=OBJ_CLS_TYPE3_044}, {implementation-record-element=OBJ_ALIVE_TIME_001, system-signal=OBJ_ALIVE_TIME_044}, {implementation-record-element=OBJ_CLS_TYPE5_001, system-signal=OBJ_CLS_TYPE5_044}, {implementation-record-element=OBJ_ACCELERATION_LONG_ERR_001, system-signal=OBJ_ACCELERATION_LONG_ERR_044}, {implementation-record-element=OBJ_ACCELERATION_LAT_001, system-signal=OBJ_ACCELERATION_LAT_044}, {implementation-record-element=OBJ_CLS_TYPE6_001, system-signal=OBJ_CLS_TYPE6_044}, {implementation-record-element=OBJ_CLS_TYPE2_001, system-signal=OBJ_CLS_TYPE2_044}, {implementation-record-element=OBJ_CLS_TYPE6_PROB_001, system-signal=OBJ_CLS_TYPE6_PROB_044}, {implementation-record-element=OBJ_DIMENSION_LENGTH_001, system-signal=OBJ_DIMENSION_LENGTH_044}, {implementation-record-element=OBJ_CLS_TYPE3_PROB_001, system-signal=OBJ_CLS_TYPE3_PROB_044}, {implementation-record-element=OBJ_CLS_TYPE4_001, system-signal=OBJ_CLS_TYPE4_044}, {implementation-record-element=OBJ_CLS_TYPE4_PROB_001, system-signal=OBJ_CLS_TYPE4_PROB_044}, {implementation-record-element=OBJ_CLS_TYPE5_PROB_001, system-signal=OBJ_CLS_TYPE5_PROB_044}, {implementation-record-element=OBJ_DIMENSION_LENGTH_ERR_001, system-signal=OBJ_DIMENSION_LENGTH_ERR_044}, {implementation-record-element=OBJ_DIMENSION_WIDTH_001, system-signal=OBJ_DIMENSION_WIDTH_044}, {implementation-record-element=OBJ_CLS_TYPE1_PROB_001, system-signal=OBJ_CLS_TYPE1_PROB_044}, {implementation-record-element=OBJ_POS_LAT_ERR_001, system-signal=OBJ_POS_LAT_ERR_044}, {implementation-record-element=OBJ_MH_CYCLE_COUNTER_001, system-signal=OBJ_MH_CYCLE_COUNTER_044}, {implementation-record-element=OBJ_YAW_RATE_ERR_001, system-signal=OBJ_YAW_RATE_ERR_044}, {implementation-record-element=OBJ_POS_LAT_001, system-signal=OBJ_POS_LAT_044}, {implementation-record-element=OBJ_REF_PT_LONG_OFFSET_001, system-signal=OBJ_REF_PT_LONG_OFFSET_044}, {implementation-record-element=OBJ_MH_CRC16_001, system-signal=OBJ_MH_CRC16_044}, {implementation-record-element=OBJ_MEASUREMENT_STATUS_001, system-signal=OBJ_MEASUREMENT_STATUS_044}, {implementation-record-element=OBJ_GROUP_ID_001, system-signal=OBJ_GROUP_ID_044}, {implementation-record-element=OBJ_VELOCITY_LAT_ERR_001, system-signal=OBJ_VELOCITY_LAT_ERR_044}, {implementation-record-element=OBJ_VELOCITY_LONG_ERR_001, system-signal=OBJ_VELOCITY_LONG_ERR_044}, {implementation-record-element=OBJ_YAW_RATE_001, system-signal=OBJ_YAW_RATE_044}, {implementation-record-element=OBJ_EXISTENCE_PROB_001, system-signal=OBJ_EXISTENCE_PROB_044}, {implementation-record-element=OBJ_YAW_ANGLE_001, system-signal=OBJ_YAW_ANGLE_044}, {implementation-record-element=OBJ_POS_ERR_CRR_COEF_001, system-signal=OBJ_POS_ERR_CRR_COEF_044}, {implementation-record-element=OBJ_VEH_TRACK_FLAG_001, system-signal=OBJ_VEH_TRACK_FLAG_044}, {implementation-record-element=OBJ_MOVEMENT_STATUS_001, system-signal=OBJ_MOVEMENT_STATUS_044}, {implementation-record-element=OBJ_DIMENSION_WIDTH_ERR_001, system-signal=OBJ_DIMENSION_WIDTH_ERR_044}, {implementation-record-element=OBJ_TIMESTAMP_OFFSET_001, system-signal=OBJ_TIMESTAMP_OFFSET_044}, {implementation-record-element=OBJ_POS_LONG_ERR_001, system-signal=OBJ_POS_LONG_ERR_044}, {implementation-record-element=OBJ_VELOCITY_LAT_001, system-signal=OBJ_VELOCITY_LAT_044}, {implementation-record-element=OBJ_VELOCITY_ERR_CRR_COEF_001, system-signal=OBJ_VELOCITY_ERR_CRR_COEF_044}, {implementation-record-element=OBJ_RCS_001, system-signal=OBJ_RCS_044}, {implementation-record-element=OBJ_TRACK_MOTION_MODEL_001, system-signal=OBJ_TRACK_MOTION_MODEL_044}, {implementation-record-element=OBJ_ID_001, system-signal=OBJ_ID_044}, {implementation-record-element=OBJ_VELOCITY_LONG_001, system-signal=OBJ_VELOCITY_LONG_044}, {implementation-record-element=OBJ_REF_PT_LAT_OFFSET_001, system-signal=OBJ_REF_PT_LAT_OFFSET_044}, {implementation-record-element=OBJ_YAW_ANGLE_ERR_001, system-signal=OBJ_YAW_ANGLE_ERR_044}, {implementation-record-element=OBJ_POS_LONG_001, system-signal=OBJ_POS_LONG_044}]}
        sender-receiver-to-signal-group-mapping={data-element=Pp_SG_TrackerObject045.Vdp_SG_TrackerObject045, signal-group=SG_TrackerObject045, type-mapping=sender-rec-record-type-mapping=record-element-mappings=[{implementation-record-element=OBJ_MEASUREMENT_STATUS_001, system-signal=OBJ_MEASUREMENT_STATUS_045}, {implementation-record-element=OBJ_CLS_TYPE2_PROB_001, system-signal=OBJ_CLS_TYPE2_PROB_045}, {implementation-record-element=OBJ_CLS_TYPE3_001, system-signal=OBJ_CLS_TYPE3_045}, {implementation-record-element=OBJ_POS_LONG_001, system-signal=OBJ_POS_LONG_045}, {implementation-record-element=OBJ_POS_LONG_ERR_001, system-signal=OBJ_POS_LONG_ERR_045}, {implementation-record-element=OBJ_ACCELERATION_LAT_ERR_001, system-signal=OBJ_ACCELERATION_LAT_ERR_045}, {implementation-record-element=OBJ_CLS_TYPE3_PROB_001, system-signal=OBJ_CLS_TYPE3_PROB_045}, {implementation-record-element=OBJ_GROUP_ID_001, system-signal=OBJ_GROUP_ID_045}, {implementation-record-element=OBJ_CLS_TYPE2_001, system-signal=OBJ_CLS_TYPE2_045}, {implementation-record-element=OBJ_RCS_001, system-signal=OBJ_RCS_045}, {implementation-record-element=OBJ_DIMENSION_WIDTH_001, system-signal=OBJ_DIMENSION_WIDTH_045}, {implementation-record-element=OBJ_ACCEL_ERR_CRR_COEF_001, system-signal=OBJ_ACCEL_ERR_CRR_COEF_045}, {implementation-record-element=OBJ_CLS_TYPE5_PROB_001, system-signal=OBJ_CLS_TYPE5_PROB_045}, {implementation-record-element=OBJ_CLS_TYPE6_001, system-signal=OBJ_CLS_TYPE6_045}, {implementation-record-element=OBJ_DIMENSION_LENGTH_001, system-signal=OBJ_DIMENSION_LENGTH_045}, {implementation-record-element=OBJ_DIMENSION_LENGTH_ERR_001, system-signal=OBJ_DIMENSION_LENGTH_ERR_045}, {implementation-record-element=OBJ_ACCELERATION_LAT_001, system-signal=OBJ_ACCELERATION_LAT_045}, {implementation-record-element=OBJ_ID_001, system-signal=OBJ_ID_045}, {implementation-record-element=OBJ_MH_CYCLE_COUNTER_001, system-signal=OBJ_MH_CYCLE_COUNTER_045}, {implementation-record-element=OBJ_POS_ERR_CRR_COEF_001, system-signal=OBJ_POS_ERR_CRR_COEF_045}, {implementation-record-element=OBJ_ACCELERATION_LONG_ERR_001, system-signal=OBJ_ACCELERATION_LONG_ERR_045}, {implementation-record-element=OBJ_CLS_TYPE1_PROB_001, system-signal=OBJ_CLS_TYPE1_PROB_045}, {implementation-record-element=OBJ_CLS_TYPE1_001, system-signal=OBJ_CLS_TYPE1_045}, {implementation-record-element=OBJ_CLS_TYPE5_001, system-signal=OBJ_CLS_TYPE5_045}, {implementation-record-element=OBJ_CLS_TYPE6_PROB_001, system-signal=OBJ_CLS_TYPE6_PROB_045}, {implementation-record-element=OBJ_DIMENSION_WIDTH_ERR_001, system-signal=OBJ_DIMENSION_WIDTH_ERR_045}, {implementation-record-element=OBJ_EXISTENCE_PROB_001, system-signal=OBJ_EXISTENCE_PROB_045}, {implementation-record-element=OBJ_ALIVE_TIME_001, system-signal=OBJ_ALIVE_TIME_045}, {implementation-record-element=OBJ_CLS_TYPE4_001, system-signal=OBJ_CLS_TYPE4_045}, {implementation-record-element=OBJ_CLS_TYPE4_PROB_001, system-signal=OBJ_CLS_TYPE4_PROB_045}, {implementation-record-element=OBJ_POS_LAT_001, system-signal=OBJ_POS_LAT_045}, {implementation-record-element=OBJ_MH_CRC16_001, system-signal=OBJ_MH_CRC16_045}, {implementation-record-element=OBJ_ACCELERATION_LONG_001, system-signal=OBJ_ACCELERATION_LONG_045}, {implementation-record-element=OBJ_POS_LAT_ERR_001, system-signal=OBJ_POS_LAT_ERR_045}, {implementation-record-element=OBJ_MOVEMENT_STATUS_001, system-signal=OBJ_MOVEMENT_STATUS_045}, {implementation-record-element=OBJ_YAW_ANGLE_ERR_001, system-signal=OBJ_YAW_ANGLE_ERR_045}, {implementation-record-element=OBJ_REF_PT_LAT_OFFSET_001, system-signal=OBJ_REF_PT_LAT_OFFSET_045}, {implementation-record-element=OBJ_YAW_RATE_ERR_001, system-signal=OBJ_YAW_RATE_ERR_045}, {implementation-record-element=OBJ_TIMESTAMP_OFFSET_001, system-signal=OBJ_TIMESTAMP_OFFSET_045}, {implementation-record-element=OBJ_VEH_TRACK_FLAG_001, system-signal=OBJ_VEH_TRACK_FLAG_045}, {implementation-record-element=OBJ_YAW_ANGLE_001, system-signal=OBJ_YAW_ANGLE_045}, {implementation-record-element=OBJ_VELOCITY_LAT_001, system-signal=OBJ_VELOCITY_LAT_045}, {implementation-record-element=OBJ_TRACK_MOTION_MODEL_001, system-signal=OBJ_TRACK_MOTION_MODEL_045}, {implementation-record-element=OBJ_VELOCITY_ERR_CRR_COEF_001, system-signal=OBJ_VELOCITY_ERR_CRR_COEF_045}, {implementation-record-element=OBJ_VELOCITY_LONG_ERR_001, system-signal=OBJ_VELOCITY_LONG_ERR_045}, {implementation-record-element=OBJ_VELOCITY_LONG_001, system-signal=OBJ_VELOCITY_LONG_045}, {implementation-record-element=OBJ_REF_PT_LONG_OFFSET_001, system-signal=OBJ_REF_PT_LONG_OFFSET_045}, {implementation-record-element=OBJ_YAW_RATE_001, system-signal=OBJ_YAW_RATE_045}, {implementation-record-element=OBJ_VELOCITY_LAT_ERR_001, system-signal=OBJ_VELOCITY_LAT_ERR_045}]}
        sender-receiver-to-signal-group-mapping={data-element=Pp_SG_TrackerObject046.Vdp_SG_TrackerObject046, signal-group=SG_TrackerObject046, type-mapping=sender-rec-record-type-mapping=record-element-mappings=[{implementation-record-element=OBJ_CLS_TYPE1_001, system-signal=OBJ_CLS_TYPE1_046}, {implementation-record-element=OBJ_CLS_TYPE5_001, system-signal=OBJ_CLS_TYPE5_046}, {implementation-record-element=OBJ_REF_PT_LONG_OFFSET_001, system-signal=OBJ_REF_PT_LONG_OFFSET_046}, {implementation-record-element=OBJ_CLS_TYPE4_001, system-signal=OBJ_CLS_TYPE4_046}, {implementation-record-element=OBJ_VELOCITY_LONG_001, system-signal=OBJ_VELOCITY_LONG_046}, {implementation-record-element=OBJ_ALIVE_TIME_001, system-signal=OBJ_ALIVE_TIME_046}, {implementation-record-element=OBJ_CLS_TYPE2_PROB_001, system-signal=OBJ_CLS_TYPE2_PROB_046}, {implementation-record-element=OBJ_POS_LAT_001, system-signal=OBJ_POS_LAT_046}, {implementation-record-element=OBJ_REF_PT_LAT_OFFSET_001, system-signal=OBJ_REF_PT_LAT_OFFSET_046}, {implementation-record-element=OBJ_VELOCITY_LAT_001, system-signal=OBJ_VELOCITY_LAT_046}, {implementation-record-element=OBJ_ACCELERATION_LONG_001, system-signal=OBJ_ACCELERATION_LONG_046}, {implementation-record-element=OBJ_ID_001, system-signal=OBJ_ID_046}, {implementation-record-element=OBJ_YAW_RATE_001, system-signal=OBJ_YAW_RATE_046}, {implementation-record-element=OBJ_YAW_RATE_ERR_001, system-signal=OBJ_YAW_RATE_ERR_046}, {implementation-record-element=OBJ_ACCEL_ERR_CRR_COEF_001, system-signal=OBJ_ACCEL_ERR_CRR_COEF_046}, {implementation-record-element=OBJ_CLS_TYPE4_PROB_001, system-signal=OBJ_CLS_TYPE4_PROB_046}, {implementation-record-element=OBJ_DIMENSION_WIDTH_ERR_001, system-signal=OBJ_DIMENSION_WIDTH_ERR_046}, {implementation-record-element=OBJ_CLS_TYPE1_PROB_001, system-signal=OBJ_CLS_TYPE1_PROB_046}, {implementation-record-element=OBJ_DIMENSION_WIDTH_001, system-signal=OBJ_DIMENSION_WIDTH_046}, {implementation-record-element=OBJ_CLS_TYPE3_001, system-signal=OBJ_CLS_TYPE3_046}, {implementation-record-element=OBJ_POS_LONG_001, system-signal=OBJ_POS_LONG_046}, {implementation-record-element=OBJ_POS_LAT_ERR_001, system-signal=OBJ_POS_LAT_ERR_046}, {implementation-record-element=OBJ_RCS_001, system-signal=OBJ_RCS_046}, {implementation-record-element=OBJ_ACCELERATION_LONG_ERR_001, system-signal=OBJ_ACCELERATION_LONG_ERR_046}, {implementation-record-element=OBJ_VELOCITY_LONG_ERR_001, system-signal=OBJ_VELOCITY_LONG_ERR_046}, {implementation-record-element=OBJ_YAW_ANGLE_001, system-signal=OBJ_YAW_ANGLE_046}, {implementation-record-element=OBJ_ACCELERATION_LAT_ERR_001, system-signal=OBJ_ACCELERATION_LAT_ERR_046}, {implementation-record-element=OBJ_ACCELERATION_LAT_001, system-signal=OBJ_ACCELERATION_LAT_046}, {implementation-record-element=OBJ_MH_CRC16_001, system-signal=OBJ_MH_CRC16_046}, {implementation-record-element=OBJ_MH_CYCLE_COUNTER_001, system-signal=OBJ_MH_CYCLE_COUNTER_046}, {implementation-record-element=OBJ_POS_LONG_ERR_001, system-signal=OBJ_POS_LONG_ERR_046}, {implementation-record-element=OBJ_CLS_TYPE3_PROB_001, system-signal=OBJ_CLS_TYPE3_PROB_046}, {implementation-record-element=OBJ_CLS_TYPE5_PROB_001, system-signal=OBJ_CLS_TYPE5_PROB_046}, {implementation-record-element=OBJ_CLS_TYPE6_001, system-signal=OBJ_CLS_TYPE6_046}, {implementation-record-element=OBJ_CLS_TYPE6_PROB_001, system-signal=OBJ_CLS_TYPE6_PROB_046}, {implementation-record-element=OBJ_DIMENSION_LENGTH_ERR_001, system-signal=OBJ_DIMENSION_LENGTH_ERR_046}, {implementation-record-element=OBJ_CLS_TYPE2_001, system-signal=OBJ_CLS_TYPE2_046}, {implementation-record-element=OBJ_MOVEMENT_STATUS_001, system-signal=OBJ_MOVEMENT_STATUS_046}, {implementation-record-element=OBJ_POS_ERR_CRR_COEF_001, system-signal=OBJ_POS_ERR_CRR_COEF_046}, {implementation-record-element=OBJ_TRACK_MOTION_MODEL_001, system-signal=OBJ_TRACK_MOTION_MODEL_046}, {implementation-record-element=OBJ_DIMENSION_LENGTH_001, system-signal=OBJ_DIMENSION_LENGTH_046}, {implementation-record-element=OBJ_VEH_TRACK_FLAG_001, system-signal=OBJ_VEH_TRACK_FLAG_046}, {implementation-record-element=OBJ_VELOCITY_ERR_CRR_COEF_001, system-signal=OBJ_VELOCITY_ERR_CRR_COEF_046}, {implementation-record-element=OBJ_VELOCITY_LAT_ERR_001, system-signal=OBJ_VELOCITY_LAT_ERR_046}, {implementation-record-element=OBJ_EXISTENCE_PROB_001, system-signal=OBJ_EXISTENCE_PROB_046}, {implementation-record-element=OBJ_GROUP_ID_001, system-signal=OBJ_GROUP_ID_046}, {implementation-record-element=OBJ_MEASUREMENT_STATUS_001, system-signal=OBJ_MEASUREMENT_STATUS_046}, {implementation-record-element=OBJ_TIMESTAMP_OFFSET_001, system-signal=OBJ_TIMESTAMP_OFFSET_046}, {implementation-record-element=OBJ_YAW_ANGLE_ERR_001, system-signal=OBJ_YAW_ANGLE_ERR_046}]}
        sender-receiver-to-signal-group-mapping={data-element=Pp_SG_TrackerObject047.Vdp_SG_TrackerObject047, signal-group=SG_TrackerObject047, type-mapping=sender-rec-record-type-mapping=record-element-mappings=[{implementation-record-element=OBJ_RCS_001, system-signal=OBJ_RCS_047}, {implementation-record-element=OBJ_ALIVE_TIME_001, system-signal=OBJ_ALIVE_TIME_047}, {implementation-record-element=OBJ_CLS_TYPE2_PROB_001, system-signal=OBJ_CLS_TYPE2_PROB_047}, {implementation-record-element=OBJ_CLS_TYPE4_001, system-signal=OBJ_CLS_TYPE4_047}, {implementation-record-element=OBJ_CLS_TYPE4_PROB_001, system-signal=OBJ_CLS_TYPE4_PROB_047}, {implementation-record-element=OBJ_CLS_TYPE1_001, system-signal=OBJ_CLS_TYPE1_047}, {implementation-record-element=OBJ_GROUP_ID_001, system-signal=OBJ_GROUP_ID_047}, {implementation-record-element=OBJ_REF_PT_LAT_OFFSET_001, system-signal=OBJ_REF_PT_LAT_OFFSET_047}, {implementation-record-element=OBJ_CLS_TYPE5_PROB_001, system-signal=OBJ_CLS_TYPE5_PROB_047}, {implementation-record-element=OBJ_YAW_ANGLE_001, system-signal=OBJ_YAW_ANGLE_047}, {implementation-record-element=OBJ_MEASUREMENT_STATUS_001, system-signal=OBJ_MEASUREMENT_STATUS_047}, {implementation-record-element=OBJ_ACCELERATION_LONG_ERR_001, system-signal=OBJ_ACCELERATION_LONG_ERR_047}, {implementation-record-element=OBJ_ACCELERATION_LAT_001, system-signal=OBJ_ACCELERATION_LAT_047}, {implementation-record-element=OBJ_CLS_TYPE5_001, system-signal=OBJ_CLS_TYPE5_047}, {implementation-record-element=OBJ_CLS_TYPE6_PROB_001, system-signal=OBJ_CLS_TYPE6_PROB_047}, {implementation-record-element=OBJ_CLS_TYPE3_PROB_001, system-signal=OBJ_CLS_TYPE3_PROB_047}, {implementation-record-element=OBJ_ACCELERATION_LAT_ERR_001, system-signal=OBJ_ACCELERATION_LAT_ERR_047}, {implementation-record-element=OBJ_DIMENSION_LENGTH_001, system-signal=OBJ_DIMENSION_LENGTH_047}, {implementation-record-element=OBJ_CLS_TYPE2_001, system-signal=OBJ_CLS_TYPE2_047}, {implementation-record-element=OBJ_MH_CRC16_001, system-signal=OBJ_MH_CRC16_047}, {implementation-record-element=OBJ_MH_CYCLE_COUNTER_001, system-signal=OBJ_MH_CYCLE_COUNTER_047}, {implementation-record-element=OBJ_MOVEMENT_STATUS_001, system-signal=OBJ_MOVEMENT_STATUS_047}, {implementation-record-element=OBJ_POS_ERR_CRR_COEF_001, system-signal=OBJ_POS_ERR_CRR_COEF_047}, {implementation-record-element=OBJ_POS_LONG_ERR_001, system-signal=OBJ_POS_LONG_ERR_047}, {implementation-record-element=OBJ_TRACK_MOTION_MODEL_001, system-signal=OBJ_TRACK_MOTION_MODEL_047}, {implementation-record-element=OBJ_VEH_TRACK_FLAG_001, system-signal=OBJ_VEH_TRACK_FLAG_047}, {implementation-record-element=OBJ_VELOCITY_LAT_001, system-signal=OBJ_VELOCITY_LAT_047}, {implementation-record-element=OBJ_YAW_RATE_001, system-signal=OBJ_YAW_RATE_047}, {implementation-record-element=OBJ_POS_LONG_001, system-signal=OBJ_POS_LONG_047}, {implementation-record-element=OBJ_POS_LAT_ERR_001, system-signal=OBJ_POS_LAT_ERR_047}, {implementation-record-element=OBJ_ID_001, system-signal=OBJ_ID_047}, {implementation-record-element=OBJ_DIMENSION_LENGTH_ERR_001, system-signal=OBJ_DIMENSION_LENGTH_ERR_047}, {implementation-record-element=OBJ_YAW_ANGLE_ERR_001, system-signal=OBJ_YAW_ANGLE_ERR_047}, {implementation-record-element=OBJ_TIMESTAMP_OFFSET_001, system-signal=OBJ_TIMESTAMP_OFFSET_047}, {implementation-record-element=OBJ_POS_LAT_001, system-signal=OBJ_POS_LAT_047}, {implementation-record-element=OBJ_ACCEL_ERR_CRR_COEF_001, system-signal=OBJ_ACCEL_ERR_CRR_COEF_047}, {implementation-record-element=OBJ_VELOCITY_LAT_ERR_001, system-signal=OBJ_VELOCITY_LAT_ERR_047}, {implementation-record-element=OBJ_VELOCITY_LONG_ERR_001, system-signal=OBJ_VELOCITY_LONG_ERR_047}, {implementation-record-element=OBJ_EXISTENCE_PROB_001, system-signal=OBJ_EXISTENCE_PROB_047}, {implementation-record-element=OBJ_CLS_TYPE1_PROB_001, system-signal=OBJ_CLS_TYPE1_PROB_047}, {implementation-record-element=OBJ_DIMENSION_WIDTH_001, system-signal=OBJ_DIMENSION_WIDTH_047}, {implementation-record-element=OBJ_DIMENSION_WIDTH_ERR_001, system-signal=OBJ_DIMENSION_WIDTH_ERR_047}, {implementation-record-element=OBJ_REF_PT_LONG_OFFSET_001, system-signal=OBJ_REF_PT_LONG_OFFSET_047}, {implementation-record-element=OBJ_VELOCITY_ERR_CRR_COEF_001, system-signal=OBJ_VELOCITY_ERR_CRR_COEF_047}, {implementation-record-element=OBJ_ACCELERATION_LONG_001, system-signal=OBJ_ACCELERATION_LONG_047}, {implementation-record-element=OBJ_CLS_TYPE3_001, system-signal=OBJ_CLS_TYPE3_047}, {implementation-record-element=OBJ_YAW_RATE_ERR_001, system-signal=OBJ_YAW_RATE_ERR_047}, {implementation-record-element=OBJ_CLS_TYPE6_001, system-signal=OBJ_CLS_TYPE6_047}, {implementation-record-element=OBJ_VELOCITY_LONG_001, system-signal=OBJ_VELOCITY_LONG_047}]}
        sender-receiver-to-signal-group-mapping={data-element=Pp_SG_TrackerObject048.Vdp_SG_TrackerObject048, signal-group=SG_TrackerObject048, type-mapping=sender-rec-record-type-mapping=record-element-mappings=[{implementation-record-element=OBJ_CLS_TYPE1_PROB_001, system-signal=OBJ_CLS_TYPE1_PROB_048}, {implementation-record-element=OBJ_CLS_TYPE2_001, system-signal=OBJ_CLS_TYPE2_048}, {implementation-record-element=OBJ_CLS_TYPE2_PROB_001, system-signal=OBJ_CLS_TYPE2_PROB_048}, {implementation-record-element=OBJ_CLS_TYPE3_PROB_001, system-signal=OBJ_CLS_TYPE3_PROB_048}, {implementation-record-element=OBJ_CLS_TYPE4_001, system-signal=OBJ_CLS_TYPE4_048}, {implementation-record-element=OBJ_CLS_TYPE3_001, system-signal=OBJ_CLS_TYPE3_048}, {implementation-record-element=OBJ_ACCELERATION_LAT_001, system-signal=OBJ_ACCELERATION_LAT_048}, {implementation-record-element=OBJ_ACCEL_ERR_CRR_COEF_001, system-signal=OBJ_ACCEL_ERR_CRR_COEF_048}, {implementation-record-element=OBJ_ACCELERATION_LAT_ERR_001, system-signal=OBJ_ACCELERATION_LAT_ERR_048}, {implementation-record-element=OBJ_ACCELERATION_LONG_001, system-signal=OBJ_ACCELERATION_LONG_048}, {implementation-record-element=OBJ_ACCELERATION_LONG_ERR_001, system-signal=OBJ_ACCELERATION_LONG_ERR_048}, {implementation-record-element=OBJ_ALIVE_TIME_001, system-signal=OBJ_ALIVE_TIME_048}, {implementation-record-element=OBJ_CLS_TYPE1_001, system-signal=OBJ_CLS_TYPE1_048}, {implementation-record-element=OBJ_ID_001, system-signal=OBJ_ID_048}, {implementation-record-element=OBJ_VELOCITY_LAT_001, system-signal=OBJ_VELOCITY_LAT_048}, {implementation-record-element=OBJ_CLS_TYPE5_001, system-signal=OBJ_CLS_TYPE5_048}, {implementation-record-element=OBJ_CLS_TYPE5_PROB_001, system-signal=OBJ_CLS_TYPE5_PROB_048}, {implementation-record-element=OBJ_VEH_TRACK_FLAG_001, system-signal=OBJ_VEH_TRACK_FLAG_048}, {implementation-record-element=OBJ_VELOCITY_LONG_001, system-signal=OBJ_VELOCITY_LONG_048}, {implementation-record-element=OBJ_VELOCITY_ERR_CRR_COEF_001, system-signal=OBJ_VELOCITY_ERR_CRR_COEF_048}, {implementation-record-element=OBJ_DIMENSION_LENGTH_ERR_001, system-signal=OBJ_DIMENSION_LENGTH_ERR_048}, {implementation-record-element=OBJ_DIMENSION_LENGTH_001, system-signal=OBJ_DIMENSION_LENGTH_048}, {implementation-record-element=OBJ_YAW_RATE_ERR_001, system-signal=OBJ_YAW_RATE_ERR_048}, {implementation-record-element=OBJ_CLS_TYPE4_PROB_001, system-signal=OBJ_CLS_TYPE4_PROB_048}, {implementation-record-element=OBJ_YAW_ANGLE_ERR_001, system-signal=OBJ_YAW_ANGLE_ERR_048}, {implementation-record-element=OBJ_CLS_TYPE6_PROB_001, system-signal=OBJ_CLS_TYPE6_PROB_048}, {implementation-record-element=OBJ_RCS_001, system-signal=OBJ_RCS_048}, {implementation-record-element=OBJ_YAW_ANGLE_001, system-signal=OBJ_YAW_ANGLE_048}, {implementation-record-element=OBJ_POS_ERR_CRR_COEF_001, system-signal=OBJ_POS_ERR_CRR_COEF_048}, {implementation-record-element=OBJ_MOVEMENT_STATUS_001, system-signal=OBJ_MOVEMENT_STATUS_048}, {implementation-record-element=OBJ_VELOCITY_LAT_ERR_001, system-signal=OBJ_VELOCITY_LAT_ERR_048}, {implementation-record-element=OBJ_MEASUREMENT_STATUS_001, system-signal=OBJ_MEASUREMENT_STATUS_048}, {implementation-record-element=OBJ_MH_CYCLE_COUNTER_001, system-signal=OBJ_MH_CYCLE_COUNTER_048}, {implementation-record-element=OBJ_POS_LAT_001, system-signal=OBJ_POS_LAT_048}, {implementation-record-element=OBJ_VELOCITY_LONG_ERR_001, system-signal=OBJ_VELOCITY_LONG_ERR_048}, {implementation-record-element=OBJ_DIMENSION_WIDTH_ERR_001, system-signal=OBJ_DIMENSION_WIDTH_ERR_048}, {implementation-record-element=OBJ_EXISTENCE_PROB_001, system-signal=OBJ_EXISTENCE_PROB_048}, {implementation-record-element=OBJ_GROUP_ID_001, system-signal=OBJ_GROUP_ID_048}, {implementation-record-element=OBJ_POS_LONG_ERR_001, system-signal=OBJ_POS_LONG_ERR_048}, {implementation-record-element=OBJ_REF_PT_LAT_OFFSET_001, system-signal=OBJ_REF_PT_LAT_OFFSET_048}, {implementation-record-element=OBJ_REF_PT_LONG_OFFSET_001, system-signal=OBJ_REF_PT_LONG_OFFSET_048}, {implementation-record-element=OBJ_TRACK_MOTION_MODEL_001, system-signal=OBJ_TRACK_MOTION_MODEL_048}, {implementation-record-element=OBJ_POS_LONG_001, system-signal=OBJ_POS_LONG_048}, {implementation-record-element=OBJ_YAW_RATE_001, system-signal=OBJ_YAW_RATE_048}, {implementation-record-element=OBJ_TIMESTAMP_OFFSET_001, system-signal=OBJ_TIMESTAMP_OFFSET_048}, {implementation-record-element=OBJ_CLS_TYPE6_001, system-signal=OBJ_CLS_TYPE6_048}, {implementation-record-element=OBJ_DIMENSION_WIDTH_001, system-signal=OBJ_DIMENSION_WIDTH_048}, {implementation-record-element=OBJ_POS_LAT_ERR_001, system-signal=OBJ_POS_LAT_ERR_048}, {implementation-record-element=OBJ_MH_CRC16_001, system-signal=OBJ_MH_CRC16_048}]}
        sender-receiver-to-signal-group-mapping={data-element=Pp_SG_TrackerObject049.Vdp_SG_TrackerObject049, signal-group=SG_TrackerObject049, type-mapping=sender-rec-record-type-mapping=record-element-mappings=[{implementation-record-element=OBJ_ALIVE_TIME_001, system-signal=OBJ_ALIVE_TIME_049}, {implementation-record-element=OBJ_CLS_TYPE3_001, system-signal=OBJ_CLS_TYPE3_049}, {implementation-record-element=OBJ_ACCELERATION_LONG_ERR_001, system-signal=OBJ_ACCELERATION_LONG_ERR_049}, {implementation-record-element=OBJ_CLS_TYPE4_001, system-signal=OBJ_CLS_TYPE4_049}, {implementation-record-element=OBJ_DIMENSION_LENGTH_001, system-signal=OBJ_DIMENSION_LENGTH_049}, {implementation-record-element=OBJ_DIMENSION_LENGTH_ERR_001, system-signal=OBJ_DIMENSION_LENGTH_ERR_049}, {implementation-record-element=OBJ_DIMENSION_WIDTH_001, system-signal=OBJ_DIMENSION_WIDTH_049}, {implementation-record-element=OBJ_ID_001, system-signal=OBJ_ID_049}, {implementation-record-element=OBJ_ACCEL_ERR_CRR_COEF_001, system-signal=OBJ_ACCEL_ERR_CRR_COEF_049}, {implementation-record-element=OBJ_ACCELERATION_LONG_001, system-signal=OBJ_ACCELERATION_LONG_049}, {implementation-record-element=OBJ_CLS_TYPE5_001, system-signal=OBJ_CLS_TYPE5_049}, {implementation-record-element=OBJ_CLS_TYPE6_PROB_001, system-signal=OBJ_CLS_TYPE6_PROB_049}, {implementation-record-element=OBJ_MEASUREMENT_STATUS_001, system-signal=OBJ_MEASUREMENT_STATUS_049}, {implementation-record-element=OBJ_CLS_TYPE2_001, system-signal=OBJ_CLS_TYPE2_049}, {implementation-record-element=OBJ_MH_CRC16_001, system-signal=OBJ_MH_CRC16_049}, {implementation-record-element=OBJ_ACCELERATION_LAT_ERR_001, system-signal=OBJ_ACCELERATION_LAT_ERR_049}, {implementation-record-element=OBJ_CLS_TYPE6_001, system-signal=OBJ_CLS_TYPE6_049}, {implementation-record-element=OBJ_CLS_TYPE1_PROB_001, system-signal=OBJ_CLS_TYPE1_PROB_049}, {implementation-record-element=OBJ_CLS_TYPE4_PROB_001, system-signal=OBJ_CLS_TYPE4_PROB_049}, {implementation-record-element=OBJ_DIMENSION_WIDTH_ERR_001, system-signal=OBJ_DIMENSION_WIDTH_ERR_049}, {implementation-record-element=OBJ_CLS_TYPE2_PROB_001, system-signal=OBJ_CLS_TYPE2_PROB_049}, {implementation-record-element=OBJ_CLS_TYPE3_PROB_001, system-signal=OBJ_CLS_TYPE3_PROB_049}, {implementation-record-element=OBJ_EXISTENCE_PROB_001, system-signal=OBJ_EXISTENCE_PROB_049}, {implementation-record-element=OBJ_ACCELERATION_LAT_001, system-signal=OBJ_ACCELERATION_LAT_049}, {implementation-record-element=OBJ_CLS_TYPE5_PROB_001, system-signal=OBJ_CLS_TYPE5_PROB_049}, {implementation-record-element=OBJ_GROUP_ID_001, system-signal=OBJ_GROUP_ID_049}, {implementation-record-element=OBJ_CLS_TYPE1_001, system-signal=OBJ_CLS_TYPE1_049}, {implementation-record-element=OBJ_VELOCITY_LONG_001, system-signal=OBJ_VELOCITY_LONG_049}, {implementation-record-element=OBJ_VELOCITY_LAT_ERR_001, system-signal=OBJ_VELOCITY_LAT_ERR_049}, {implementation-record-element=OBJ_YAW_ANGLE_ERR_001, system-signal=OBJ_YAW_ANGLE_ERR_049}, {implementation-record-element=OBJ_VELOCITY_ERR_CRR_COEF_001, system-signal=OBJ_VELOCITY_ERR_CRR_COEF_049}, {implementation-record-element=OBJ_TIMESTAMP_OFFSET_001, system-signal=OBJ_TIMESTAMP_OFFSET_049}, {implementation-record-element=OBJ_POS_LAT_001, system-signal=OBJ_POS_LAT_049}, {implementation-record-element=OBJ_VELOCITY_LONG_ERR_001, system-signal=OBJ_VELOCITY_LONG_ERR_049}, {implementation-record-element=OBJ_POS_LONG_001, system-signal=OBJ_POS_LONG_049}, {implementation-record-element=OBJ_REF_PT_LAT_OFFSET_001, system-signal=OBJ_REF_PT_LAT_OFFSET_049}, {implementation-record-element=OBJ_POS_LONG_ERR_001, system-signal=OBJ_POS_LONG_ERR_049}, {implementation-record-element=OBJ_YAW_RATE_001, system-signal=OBJ_YAW_RATE_049}, {implementation-record-element=OBJ_VELOCITY_LAT_001, system-signal=OBJ_VELOCITY_LAT_049}, {implementation-record-element=OBJ_VEH_TRACK_FLAG_001, system-signal=OBJ_VEH_TRACK_FLAG_049}, {implementation-record-element=OBJ_MH_CYCLE_COUNTER_001, system-signal=OBJ_MH_CYCLE_COUNTER_049}, {implementation-record-element=OBJ_POS_ERR_CRR_COEF_001, system-signal=OBJ_POS_ERR_CRR_COEF_049}, {implementation-record-element=OBJ_TRACK_MOTION_MODEL_001, system-signal=OBJ_TRACK_MOTION_MODEL_049}, {implementation-record-element=OBJ_RCS_001, system-signal=OBJ_RCS_049}, {implementation-record-element=OBJ_REF_PT_LONG_OFFSET_001, system-signal=OBJ_REF_PT_LONG_OFFSET_049}, {implementation-record-element=OBJ_MOVEMENT_STATUS_001, system-signal=OBJ_MOVEMENT_STATUS_049}, {implementation-record-element=OBJ_YAW_RATE_ERR_001, system-signal=OBJ_YAW_RATE_ERR_049}, {implementation-record-element=OBJ_POS_LAT_ERR_001, system-signal=OBJ_POS_LAT_ERR_049}, {implementation-record-element=OBJ_YAW_ANGLE_001, system-signal=OBJ_YAW_ANGLE_049}]}
        sender-receiver-to-signal-group-mapping={data-element=Pp_SG_TrackerObject050.Vdp_SG_TrackerObject050, signal-group=SG_TrackerObject050, type-mapping=sender-rec-record-type-mapping=record-element-mappings=[{implementation-record-element=OBJ_POS_ERR_CRR_COEF_001, system-signal=OBJ_POS_ERR_CRR_COEF_050}, {implementation-record-element=OBJ_TIMESTAMP_OFFSET_001, system-signal=OBJ_TIMESTAMP_OFFSET_050}, {implementation-record-element=OBJ_ACCEL_ERR_CRR_COEF_001, system-signal=OBJ_ACCEL_ERR_CRR_COEF_050}, {implementation-record-element=OBJ_MOVEMENT_STATUS_001, system-signal=OBJ_MOVEMENT_STATUS_050}, {implementation-record-element=OBJ_CLS_TYPE6_PROB_001, system-signal=OBJ_CLS_TYPE6_PROB_050}, {implementation-record-element=OBJ_DIMENSION_WIDTH_ERR_001, system-signal=OBJ_DIMENSION_WIDTH_ERR_050}, {implementation-record-element=OBJ_ALIVE_TIME_001, system-signal=OBJ_ALIVE_TIME_050}, {implementation-record-element=OBJ_DIMENSION_LENGTH_001, system-signal=OBJ_DIMENSION_LENGTH_050}, {implementation-record-element=OBJ_ID_001, system-signal=OBJ_ID_050}, {implementation-record-element=OBJ_MEASUREMENT_STATUS_001, system-signal=OBJ_MEASUREMENT_STATUS_050}, {implementation-record-element=OBJ_MH_CYCLE_COUNTER_001, system-signal=OBJ_MH_CYCLE_COUNTER_050}, {implementation-record-element=OBJ_POS_LONG_001, system-signal=OBJ_POS_LONG_050}, {implementation-record-element=OBJ_CLS_TYPE6_001, system-signal=OBJ_CLS_TYPE6_050}, {implementation-record-element=OBJ_ACCELERATION_LONG_001, system-signal=OBJ_ACCELERATION_LONG_050}, {implementation-record-element=OBJ_CLS_TYPE3_PROB_001, system-signal=OBJ_CLS_TYPE3_PROB_050}, {implementation-record-element=OBJ_CLS_TYPE4_PROB_001, system-signal=OBJ_CLS_TYPE4_PROB_050}, {implementation-record-element=OBJ_ACCELERATION_LAT_ERR_001, system-signal=OBJ_ACCELERATION_LAT_ERR_050}, {implementation-record-element=OBJ_CLS_TYPE5_001, system-signal=OBJ_CLS_TYPE5_050}, {implementation-record-element=OBJ_DIMENSION_WIDTH_001, system-signal=OBJ_DIMENSION_WIDTH_050}, {implementation-record-element=OBJ_GROUP_ID_001, system-signal=OBJ_GROUP_ID_050}, {implementation-record-element=OBJ_MH_CRC16_001, system-signal=OBJ_MH_CRC16_050}, {implementation-record-element=OBJ_POS_LAT_001, system-signal=OBJ_POS_LAT_050}, {implementation-record-element=OBJ_ACCELERATION_LAT_001, system-signal=OBJ_ACCELERATION_LAT_050}, {implementation-record-element=OBJ_CLS_TYPE1_001, system-signal=OBJ_CLS_TYPE1_050}, {implementation-record-element=OBJ_CLS_TYPE2_001, system-signal=OBJ_CLS_TYPE2_050}, {implementation-record-element=OBJ_CLS_TYPE2_PROB_001, system-signal=OBJ_CLS_TYPE2_PROB_050}, {implementation-record-element=OBJ_CLS_TYPE3_001, system-signal=OBJ_CLS_TYPE3_050}, {implementation-record-element=OBJ_POS_LONG_ERR_001, system-signal=OBJ_POS_LONG_ERR_050}, {implementation-record-element=OBJ_ACCELERATION_LONG_ERR_001, system-signal=OBJ_ACCELERATION_LONG_ERR_050}, {implementation-record-element=OBJ_CLS_TYPE1_PROB_001, system-signal=OBJ_CLS_TYPE1_PROB_050}, {implementation-record-element=OBJ_CLS_TYPE4_001, system-signal=OBJ_CLS_TYPE4_050}, {implementation-record-element=OBJ_DIMENSION_LENGTH_ERR_001, system-signal=OBJ_DIMENSION_LENGTH_ERR_050}, {implementation-record-element=OBJ_POS_LAT_ERR_001, system-signal=OBJ_POS_LAT_ERR_050}, {implementation-record-element=OBJ_RCS_001, system-signal=OBJ_RCS_050}, {implementation-record-element=OBJ_REF_PT_LAT_OFFSET_001, system-signal=OBJ_REF_PT_LAT_OFFSET_050}, {implementation-record-element=OBJ_REF_PT_LONG_OFFSET_001, system-signal=OBJ_REF_PT_LONG_OFFSET_050}, {implementation-record-element=OBJ_CLS_TYPE5_PROB_001, system-signal=OBJ_CLS_TYPE5_PROB_050}, {implementation-record-element=OBJ_EXISTENCE_PROB_001, system-signal=OBJ_EXISTENCE_PROB_050}, {implementation-record-element=OBJ_TRACK_MOTION_MODEL_001, system-signal=OBJ_TRACK_MOTION_MODEL_050}, {implementation-record-element=OBJ_VEH_TRACK_FLAG_001, system-signal=OBJ_VEH_TRACK_FLAG_050}, {implementation-record-element=OBJ_VELOCITY_ERR_CRR_COEF_001, system-signal=OBJ_VELOCITY_ERR_CRR_COEF_050}, {implementation-record-element=OBJ_VELOCITY_LONG_ERR_001, system-signal=OBJ_VELOCITY_LONG_ERR_050}, {implementation-record-element=OBJ_YAW_ANGLE_ERR_001, system-signal=OBJ_YAW_ANGLE_ERR_050}, {implementation-record-element=OBJ_YAW_RATE_ERR_001, system-signal=OBJ_YAW_RATE_ERR_050}, {implementation-record-element=OBJ_VELOCITY_LONG_001, system-signal=OBJ_VELOCITY_LONG_050}, {implementation-record-element=OBJ_YAW_ANGLE_001, system-signal=OBJ_YAW_ANGLE_050}, {implementation-record-element=OBJ_YAW_RATE_001, system-signal=OBJ_YAW_RATE_050}, {implementation-record-element=OBJ_VELOCITY_LAT_ERR_001, system-signal=OBJ_VELOCITY_LAT_ERR_050}, {implementation-record-element=OBJ_VELOCITY_LAT_001, system-signal=OBJ_VELOCITY_LAT_050}]}
        sender-receiver-to-signal-group-mapping={data-element=Pp_SG_TrackerObject052.Vdp_SG_TrackerObject052, signal-group=SG_TrackerObject052, type-mapping=sender-rec-record-type-mapping=record-element-mappings=[{implementation-record-element=OBJ_ACCEL_ERR_CRR_COEF_001, system-signal=OBJ_ACCEL_ERR_CRR_COEF_052}, {implementation-record-element=OBJ_ACCELERATION_LAT_001, system-signal=OBJ_ACCELERATION_LAT_052}, {implementation-record-element=OBJ_ACCELERATION_LAT_ERR_001, system-signal=OBJ_ACCELERATION_LAT_ERR_052}, {implementation-record-element=OBJ_ACCELERATION_LONG_001, system-signal=OBJ_ACCELERATION_LONG_052}, {implementation-record-element=OBJ_ACCELERATION_LONG_ERR_001, system-signal=OBJ_ACCELERATION_LONG_ERR_052}, {implementation-record-element=OBJ_DIMENSION_WIDTH_001, system-signal=OBJ_DIMENSION_WIDTH_052}, {implementation-record-element=OBJ_CLS_TYPE2_001, system-signal=OBJ_CLS_TYPE2_052}, {implementation-record-element=OBJ_CLS_TYPE4_001, system-signal=OBJ_CLS_TYPE4_052}, {implementation-record-element=OBJ_CLS_TYPE5_PROB_001, system-signal=OBJ_CLS_TYPE5_PROB_052}, {implementation-record-element=OBJ_CLS_TYPE6_001, system-signal=OBJ_CLS_TYPE6_052}, {implementation-record-element=OBJ_CLS_TYPE2_PROB_001, system-signal=OBJ_CLS_TYPE2_PROB_052}, {implementation-record-element=OBJ_TIMESTAMP_OFFSET_001, system-signal=OBJ_TIMESTAMP_OFFSET_052}, {implementation-record-element=OBJ_TRACK_MOTION_MODEL_001, system-signal=OBJ_TRACK_MOTION_MODEL_052}, {implementation-record-element=OBJ_DIMENSION_LENGTH_001, system-signal=OBJ_DIMENSION_LENGTH_052}, {implementation-record-element=OBJ_DIMENSION_LENGTH_ERR_001, system-signal=OBJ_DIMENSION_LENGTH_ERR_052}, {implementation-record-element=OBJ_VEH_TRACK_FLAG_001, system-signal=OBJ_VEH_TRACK_FLAG_052}, {implementation-record-element=OBJ_VELOCITY_LONG_001, system-signal=OBJ_VELOCITY_LONG_052}, {implementation-record-element=OBJ_CLS_TYPE1_PROB_001, system-signal=OBJ_CLS_TYPE1_PROB_052}, {implementation-record-element=OBJ_CLS_TYPE6_PROB_001, system-signal=OBJ_CLS_TYPE6_PROB_052}, {implementation-record-element=OBJ_CLS_TYPE5_001, system-signal=OBJ_CLS_TYPE5_052}, {implementation-record-element=OBJ_ALIVE_TIME_001, system-signal=OBJ_ALIVE_TIME_052}, {implementation-record-element=OBJ_POS_LAT_001, system-signal=OBJ_POS_LAT_052}, {implementation-record-element=OBJ_CLS_TYPE3_PROB_001, system-signal=OBJ_CLS_TYPE3_PROB_052}, {implementation-record-element=OBJ_MEASUREMENT_STATUS_001, system-signal=OBJ_MEASUREMENT_STATUS_052}, {implementation-record-element=OBJ_POS_LONG_ERR_001, system-signal=OBJ_POS_LONG_ERR_052}, {implementation-record-element=OBJ_ID_001, system-signal=OBJ_ID_052}, {implementation-record-element=OBJ_VELOCITY_LONG_ERR_001, system-signal=OBJ_VELOCITY_LONG_ERR_052}, {implementation-record-element=OBJ_VELOCITY_LAT_ERR_001, system-signal=OBJ_VELOCITY_LAT_ERR_052}, {implementation-record-element=OBJ_DIMENSION_WIDTH_ERR_001, system-signal=OBJ_DIMENSION_WIDTH_ERR_052}, {implementation-record-element=OBJ_GROUP_ID_001, system-signal=OBJ_GROUP_ID_052}, {implementation-record-element=OBJ_MH_CRC16_001, system-signal=OBJ_MH_CRC16_052}, {implementation-record-element=OBJ_YAW_ANGLE_ERR_001, system-signal=OBJ_YAW_ANGLE_ERR_052}, {implementation-record-element=OBJ_REF_PT_LAT_OFFSET_001, system-signal=OBJ_REF_PT_LAT_OFFSET_052}, {implementation-record-element=OBJ_YAW_RATE_ERR_001, system-signal=OBJ_YAW_RATE_ERR_052}, {implementation-record-element=OBJ_POS_ERR_CRR_COEF_001, system-signal=OBJ_POS_ERR_CRR_COEF_052}, {implementation-record-element=OBJ_REF_PT_LONG_OFFSET_001, system-signal=OBJ_REF_PT_LONG_OFFSET_052}, {implementation-record-element=OBJ_YAW_ANGLE_001, system-signal=OBJ_YAW_ANGLE_052}, {implementation-record-element=OBJ_RCS_001, system-signal=OBJ_RCS_052}, {implementation-record-element=OBJ_POS_LAT_ERR_001, system-signal=OBJ_POS_LAT_ERR_052}, {implementation-record-element=OBJ_YAW_RATE_001, system-signal=OBJ_YAW_RATE_052}, {implementation-record-element=OBJ_MOVEMENT_STATUS_001, system-signal=OBJ_MOVEMENT_STATUS_052}, {implementation-record-element=OBJ_POS_LONG_001, system-signal=OBJ_POS_LONG_052}, {implementation-record-element=OBJ_VELOCITY_ERR_CRR_COEF_001, system-signal=OBJ_VELOCITY_ERR_CRR_COEF_052}, {implementation-record-element=OBJ_CLS_TYPE3_001, system-signal=OBJ_CLS_TYPE3_052}, {implementation-record-element=OBJ_MH_CYCLE_COUNTER_001, system-signal=OBJ_MH_CYCLE_COUNTER_052}, {implementation-record-element=OBJ_CLS_TYPE1_001, system-signal=OBJ_CLS_TYPE1_052}, {implementation-record-element=OBJ_CLS_TYPE4_PROB_001, system-signal=OBJ_CLS_TYPE4_PROB_052}, {implementation-record-element=OBJ_EXISTENCE_PROB_001, system-signal=OBJ_EXISTENCE_PROB_052}, {implementation-record-element=OBJ_VELOCITY_LAT_001, system-signal=OBJ_VELOCITY_LAT_052}]}
        sender-receiver-to-signal-group-mapping={data-element=Pp_SG_TrackerObject051.Vdp_SG_TrackerObject051, signal-group=SG_TrackerObject051, type-mapping=sender-rec-record-type-mapping=record-element-mappings=[{implementation-record-element=OBJ_CLS_TYPE4_PROB_001, system-signal=OBJ_CLS_TYPE4_PROB_051}, {implementation-record-element=OBJ_MOVEMENT_STATUS_001, system-signal=OBJ_MOVEMENT_STATUS_051}, {implementation-record-element=OBJ_POS_LAT_001, system-signal=OBJ_POS_LAT_051}, {implementation-record-element=OBJ_REF_PT_LAT_OFFSET_001, system-signal=OBJ_REF_PT_LAT_OFFSET_051}, {implementation-record-element=OBJ_REF_PT_LONG_OFFSET_001, system-signal=OBJ_REF_PT_LONG_OFFSET_051}, {implementation-record-element=OBJ_TIMESTAMP_OFFSET_001, system-signal=OBJ_TIMESTAMP_OFFSET_051}, {implementation-record-element=OBJ_VEH_TRACK_FLAG_001, system-signal=OBJ_VEH_TRACK_FLAG_051}, {implementation-record-element=OBJ_CLS_TYPE1_001, system-signal=OBJ_CLS_TYPE1_051}, {implementation-record-element=OBJ_CLS_TYPE4_001, system-signal=OBJ_CLS_TYPE4_051}, {implementation-record-element=OBJ_VELOCITY_ERR_CRR_COEF_001, system-signal=OBJ_VELOCITY_ERR_CRR_COEF_051}, {implementation-record-element=OBJ_DIMENSION_LENGTH_001, system-signal=OBJ_DIMENSION_LENGTH_051}, {implementation-record-element=OBJ_VELOCITY_LAT_ERR_001, system-signal=OBJ_VELOCITY_LAT_ERR_051}, {implementation-record-element=OBJ_VELOCITY_LONG_001, system-signal=OBJ_VELOCITY_LONG_051}, {implementation-record-element=OBJ_VELOCITY_LONG_ERR_001, system-signal=OBJ_VELOCITY_LONG_ERR_051}, {implementation-record-element=OBJ_YAW_ANGLE_001, system-signal=OBJ_YAW_ANGLE_051}, {implementation-record-element=OBJ_YAW_ANGLE_ERR_001, system-signal=OBJ_YAW_ANGLE_ERR_051}, {implementation-record-element=OBJ_YAW_RATE_001, system-signal=OBJ_YAW_RATE_051}, {implementation-record-element=OBJ_YAW_RATE_ERR_001, system-signal=OBJ_YAW_RATE_ERR_051}, {implementation-record-element=OBJ_TRACK_MOTION_MODEL_001, system-signal=OBJ_TRACK_MOTION_MODEL_051}, {implementation-record-element=OBJ_CLS_TYPE2_001, system-signal=OBJ_CLS_TYPE2_051}, {implementation-record-element=OBJ_POS_LONG_ERR_001, system-signal=OBJ_POS_LONG_ERR_051}, {implementation-record-element=OBJ_CLS_TYPE3_PROB_001, system-signal=OBJ_CLS_TYPE3_PROB_051}, {implementation-record-element=OBJ_VELOCITY_LAT_001, system-signal=OBJ_VELOCITY_LAT_051}, {implementation-record-element=OBJ_POS_LONG_001, system-signal=OBJ_POS_LONG_051}, {implementation-record-element=OBJ_ACCELERATION_LAT_ERR_001, system-signal=OBJ_ACCELERATION_LAT_ERR_051}, {implementation-record-element=OBJ_POS_ERR_CRR_COEF_001, system-signal=OBJ_POS_ERR_CRR_COEF_051}, {implementation-record-element=OBJ_POS_LAT_ERR_001, system-signal=OBJ_POS_LAT_ERR_051}, {implementation-record-element=OBJ_RCS_001, system-signal=OBJ_RCS_051}, {implementation-record-element=OBJ_DIMENSION_WIDTH_ERR_001, system-signal=OBJ_DIMENSION_WIDTH_ERR_051}, {implementation-record-element=OBJ_CLS_TYPE3_001, system-signal=OBJ_CLS_TYPE3_051}, {implementation-record-element=OBJ_CLS_TYPE5_PROB_001, system-signal=OBJ_CLS_TYPE5_PROB_051}, {implementation-record-element=OBJ_CLS_TYPE1_PROB_001, system-signal=OBJ_CLS_TYPE1_PROB_051}, {implementation-record-element=OBJ_DIMENSION_LENGTH_ERR_001, system-signal=OBJ_DIMENSION_LENGTH_ERR_051}, {implementation-record-element=OBJ_EXISTENCE_PROB_001, system-signal=OBJ_EXISTENCE_PROB_051}, {implementation-record-element=OBJ_GROUP_ID_001, system-signal=OBJ_GROUP_ID_051}, {implementation-record-element=OBJ_CLS_TYPE6_001, system-signal=OBJ_CLS_TYPE6_051}, {implementation-record-element=OBJ_ACCELERATION_LONG_001, system-signal=OBJ_ACCELERATION_LONG_051}, {implementation-record-element=OBJ_ALIVE_TIME_001, system-signal=OBJ_ALIVE_TIME_051}, {implementation-record-element=OBJ_DIMENSION_WIDTH_001, system-signal=OBJ_DIMENSION_WIDTH_051}, {implementation-record-element=OBJ_ACCEL_ERR_CRR_COEF_001, system-signal=OBJ_ACCEL_ERR_CRR_COEF_051}, {implementation-record-element=OBJ_MEASUREMENT_STATUS_001, system-signal=OBJ_MEASUREMENT_STATUS_051}, {implementation-record-element=OBJ_ACCELERATION_LAT_001, system-signal=OBJ_ACCELERATION_LAT_051}, {implementation-record-element=OBJ_CLS_TYPE6_PROB_001, system-signal=OBJ_CLS_TYPE6_PROB_051}, {implementation-record-element=OBJ_ID_001, system-signal=OBJ_ID_051}, {implementation-record-element=OBJ_CLS_TYPE2_PROB_001, system-signal=OBJ_CLS_TYPE2_PROB_051}, {implementation-record-element=OBJ_MH_CRC16_001, system-signal=OBJ_MH_CRC16_051}, {implementation-record-element=OBJ_MH_CYCLE_COUNTER_001, system-signal=OBJ_MH_CYCLE_COUNTER_051}, {implementation-record-element=OBJ_ACCELERATION_LONG_ERR_001, system-signal=OBJ_ACCELERATION_LONG_ERR_051}, {implementation-record-element=OBJ_CLS_TYPE5_001, system-signal=OBJ_CLS_TYPE5_051}]}
        sender-receiver-to-signal-group-mapping={data-element=Pp_SG_TrackerObject053.Vdp_SG_TrackerObject053, signal-group=SG_TrackerObject053, type-mapping=sender-rec-record-type-mapping=record-element-mappings=[{implementation-record-element=OBJ_CLS_TYPE4_001, system-signal=OBJ_CLS_TYPE4_053}, {implementation-record-element=OBJ_ACCELERATION_LAT_001, system-signal=OBJ_ACCELERATION_LAT_053}, {implementation-record-element=OBJ_CLS_TYPE2_PROB_001, system-signal=OBJ_CLS_TYPE2_PROB_053}, {implementation-record-element=OBJ_ACCELERATION_LAT_ERR_001, system-signal=OBJ_ACCELERATION_LAT_ERR_053}, {implementation-record-element=OBJ_ACCELERATION_LONG_001, system-signal=OBJ_ACCELERATION_LONG_053}, {implementation-record-element=OBJ_DIMENSION_LENGTH_001, system-signal=OBJ_DIMENSION_LENGTH_053}, {implementation-record-element=OBJ_CLS_TYPE4_PROB_001, system-signal=OBJ_CLS_TYPE4_PROB_053}, {implementation-record-element=OBJ_CLS_TYPE5_001, system-signal=OBJ_CLS_TYPE5_053}, {implementation-record-element=OBJ_CLS_TYPE1_001, system-signal=OBJ_CLS_TYPE1_053}, {implementation-record-element=OBJ_ACCELERATION_LONG_ERR_001, system-signal=OBJ_ACCELERATION_LONG_ERR_053}, {implementation-record-element=OBJ_ALIVE_TIME_001, system-signal=OBJ_ALIVE_TIME_053}, {implementation-record-element=OBJ_CLS_TYPE2_001, system-signal=OBJ_CLS_TYPE2_053}, {implementation-record-element=OBJ_CLS_TYPE3_PROB_001, system-signal=OBJ_CLS_TYPE3_PROB_053}, {implementation-record-element=OBJ_CLS_TYPE5_PROB_001, system-signal=OBJ_CLS_TYPE5_PROB_053}, {implementation-record-element=OBJ_ACCEL_ERR_CRR_COEF_001, system-signal=OBJ_ACCEL_ERR_CRR_COEF_053}, {implementation-record-element=OBJ_CLS_TYPE1_PROB_001, system-signal=OBJ_CLS_TYPE1_PROB_053}, {implementation-record-element=OBJ_CLS_TYPE6_001, system-signal=OBJ_CLS_TYPE6_053}, {implementation-record-element=OBJ_CLS_TYPE6_PROB_001, system-signal=OBJ_CLS_TYPE6_PROB_053}, {implementation-record-element=OBJ_CLS_TYPE3_001, system-signal=OBJ_CLS_TYPE3_053}, {implementation-record-element=OBJ_TIMESTAMP_OFFSET_001, system-signal=OBJ_TIMESTAMP_OFFSET_053}, {implementation-record-element=OBJ_TRACK_MOTION_MODEL_001, system-signal=OBJ_TRACK_MOTION_MODEL_053}, {implementation-record-element=OBJ_VELOCITY_ERR_CRR_COEF_001, system-signal=OBJ_VELOCITY_ERR_CRR_COEF_053}, {implementation-record-element=OBJ_ID_001, system-signal=OBJ_ID_053}, {implementation-record-element=OBJ_MEASUREMENT_STATUS_001, system-signal=OBJ_MEASUREMENT_STATUS_053}, {implementation-record-element=OBJ_POS_LAT_001, system-signal=OBJ_POS_LAT_053}, {implementation-record-element=OBJ_VEH_TRACK_FLAG_001, system-signal=OBJ_VEH_TRACK_FLAG_053}, {implementation-record-element=OBJ_YAW_RATE_ERR_001, system-signal=OBJ_YAW_RATE_ERR_053}, {implementation-record-element=OBJ_MH_CRC16_001, system-signal=OBJ_MH_CRC16_053}, {implementation-record-element=OBJ_REF_PT_LONG_OFFSET_001, system-signal=OBJ_REF_PT_LONG_OFFSET_053}, {implementation-record-element=OBJ_DIMENSION_WIDTH_001, system-signal=OBJ_DIMENSION_WIDTH_053}, {implementation-record-element=OBJ_VELOCITY_LONG_001, system-signal=OBJ_VELOCITY_LONG_053}, {implementation-record-element=OBJ_VELOCITY_LAT_001, system-signal=OBJ_VELOCITY_LAT_053}, {implementation-record-element=OBJ_POS_ERR_CRR_COEF_001, system-signal=OBJ_POS_ERR_CRR_COEF_053}, {implementation-record-element=OBJ_VELOCITY_LAT_ERR_001, system-signal=OBJ_VELOCITY_LAT_ERR_053}, {implementation-record-element=OBJ_YAW_ANGLE_001, system-signal=OBJ_YAW_ANGLE_053}, {implementation-record-element=OBJ_POS_LONG_001, system-signal=OBJ_POS_LONG_053}, {implementation-record-element=OBJ_YAW_RATE_001, system-signal=OBJ_YAW_RATE_053}, {implementation-record-element=OBJ_REF_PT_LAT_OFFSET_001, system-signal=OBJ_REF_PT_LAT_OFFSET_053}, {implementation-record-element=OBJ_EXISTENCE_PROB_001, system-signal=OBJ_EXISTENCE_PROB_053}, {implementation-record-element=OBJ_GROUP_ID_001, system-signal=OBJ_GROUP_ID_053}, {implementation-record-element=OBJ_DIMENSION_WIDTH_ERR_001, system-signal=OBJ_DIMENSION_WIDTH_ERR_053}, {implementation-record-element=OBJ_RCS_001, system-signal=OBJ_RCS_053}, {implementation-record-element=OBJ_YAW_ANGLE_ERR_001, system-signal=OBJ_YAW_ANGLE_ERR_053}, {implementation-record-element=OBJ_MH_CYCLE_COUNTER_001, system-signal=OBJ_MH_CYCLE_COUNTER_053}, {implementation-record-element=OBJ_DIMENSION_LENGTH_ERR_001, system-signal=OBJ_DIMENSION_LENGTH_ERR_053}, {implementation-record-element=OBJ_POS_LONG_ERR_001, system-signal=OBJ_POS_LONG_ERR_053}, {implementation-record-element=OBJ_VELOCITY_LONG_ERR_001, system-signal=OBJ_VELOCITY_LONG_ERR_053}, {implementation-record-element=OBJ_POS_LAT_ERR_001, system-signal=OBJ_POS_LAT_ERR_053}, {implementation-record-element=OBJ_MOVEMENT_STATUS_001, system-signal=OBJ_MOVEMENT_STATUS_053}]}
        sender-receiver-to-signal-group-mapping={data-element=Pp_SG_TrackerObject054.Vdp_SG_TrackerObject054, signal-group=SG_TrackerObject054, type-mapping=sender-rec-record-type-mapping=record-element-mappings=[{implementation-record-element=OBJ_CLS_TYPE2_PROB_001, system-signal=OBJ_CLS_TYPE2_PROB_054}, {implementation-record-element=OBJ_CLS_TYPE6_PROB_001, system-signal=OBJ_CLS_TYPE6_PROB_054}, {implementation-record-element=OBJ_MH_CRC16_001, system-signal=OBJ_MH_CRC16_054}, {implementation-record-element=OBJ_ALIVE_TIME_001, system-signal=OBJ_ALIVE_TIME_054}, {implementation-record-element=OBJ_CLS_TYPE1_001, system-signal=OBJ_CLS_TYPE1_054}, {implementation-record-element=OBJ_CLS_TYPE1_PROB_001, system-signal=OBJ_CLS_TYPE1_PROB_054}, {implementation-record-element=OBJ_CLS_TYPE3_PROB_001, system-signal=OBJ_CLS_TYPE3_PROB_054}, {implementation-record-element=OBJ_MH_CYCLE_COUNTER_001, system-signal=OBJ_MH_CYCLE_COUNTER_054}, {implementation-record-element=OBJ_EXISTENCE_PROB_001, system-signal=OBJ_EXISTENCE_PROB_054}, {implementation-record-element=OBJ_DIMENSION_WIDTH_ERR_001, system-signal=OBJ_DIMENSION_WIDTH_ERR_054}, {implementation-record-element=OBJ_MOVEMENT_STATUS_001, system-signal=OBJ_MOVEMENT_STATUS_054}, {implementation-record-element=OBJ_POS_ERR_CRR_COEF_001, system-signal=OBJ_POS_ERR_CRR_COEF_054}, {implementation-record-element=OBJ_POS_LAT_ERR_001, system-signal=OBJ_POS_LAT_ERR_054}, {implementation-record-element=OBJ_POS_LONG_001, system-signal=OBJ_POS_LONG_054}, {implementation-record-element=OBJ_POS_LAT_001, system-signal=OBJ_POS_LAT_054}, {implementation-record-element=OBJ_ACCELERATION_LAT_001, system-signal=OBJ_ACCELERATION_LAT_054}, {implementation-record-element=OBJ_CLS_TYPE5_001, system-signal=OBJ_CLS_TYPE5_054}, {implementation-record-element=OBJ_CLS_TYPE3_001, system-signal=OBJ_CLS_TYPE3_054}, {implementation-record-element=OBJ_ACCELERATION_LONG_001, system-signal=OBJ_ACCELERATION_LONG_054}, {implementation-record-element=OBJ_ACCELERATION_LONG_ERR_001, system-signal=OBJ_ACCELERATION_LONG_ERR_054}, {implementation-record-element=OBJ_CLS_TYPE4_PROB_001, system-signal=OBJ_CLS_TYPE4_PROB_054}, {implementation-record-element=OBJ_ACCELERATION_LAT_ERR_001, system-signal=OBJ_ACCELERATION_LAT_ERR_054}, {implementation-record-element=OBJ_CLS_TYPE6_001, system-signal=OBJ_CLS_TYPE6_054}, {implementation-record-element=OBJ_DIMENSION_LENGTH_ERR_001, system-signal=OBJ_DIMENSION_LENGTH_ERR_054}, {implementation-record-element=OBJ_GROUP_ID_001, system-signal=OBJ_GROUP_ID_054}, {implementation-record-element=OBJ_ACCEL_ERR_CRR_COEF_001, system-signal=OBJ_ACCEL_ERR_CRR_COEF_054}, {implementation-record-element=OBJ_CLS_TYPE2_001, system-signal=OBJ_CLS_TYPE2_054}, {implementation-record-element=OBJ_ID_001, system-signal=OBJ_ID_054}, {implementation-record-element=OBJ_MEASUREMENT_STATUS_001, system-signal=OBJ_MEASUREMENT_STATUS_054}, {implementation-record-element=OBJ_DIMENSION_LENGTH_001, system-signal=OBJ_DIMENSION_LENGTH_054}, {implementation-record-element=OBJ_CLS_TYPE4_001, system-signal=OBJ_CLS_TYPE4_054}, {implementation-record-element=OBJ_CLS_TYPE5_PROB_001, system-signal=OBJ_CLS_TYPE5_PROB_054}, {implementation-record-element=OBJ_DIMENSION_WIDTH_001, system-signal=OBJ_DIMENSION_WIDTH_054}, {implementation-record-element=OBJ_VELOCITY_LONG_ERR_001, system-signal=OBJ_VELOCITY_LONG_ERR_054}, {implementation-record-element=OBJ_YAW_ANGLE_001, system-signal=OBJ_YAW_ANGLE_054}, {implementation-record-element=OBJ_YAW_ANGLE_ERR_001, system-signal=OBJ_YAW_ANGLE_ERR_054}, {implementation-record-element=OBJ_TIMESTAMP_OFFSET_001, system-signal=OBJ_TIMESTAMP_OFFSET_054}, {implementation-record-element=OBJ_POS_LONG_ERR_001, system-signal=OBJ_POS_LONG_ERR_054}, {implementation-record-element=OBJ_REF_PT_LONG_OFFSET_001, system-signal=OBJ_REF_PT_LONG_OFFSET_054}, {implementation-record-element=OBJ_VEH_TRACK_FLAG_001, system-signal=OBJ_VEH_TRACK_FLAG_054}, {implementation-record-element=OBJ_REF_PT_LAT_OFFSET_001, system-signal=OBJ_REF_PT_LAT_OFFSET_054}, {implementation-record-element=OBJ_VELOCITY_LAT_ERR_001, system-signal=OBJ_VELOCITY_LAT_ERR_054}, {implementation-record-element=OBJ_VELOCITY_LAT_001, system-signal=OBJ_VELOCITY_LAT_054}, {implementation-record-element=OBJ_RCS_001, system-signal=OBJ_RCS_054}, {implementation-record-element=OBJ_VELOCITY_ERR_CRR_COEF_001, system-signal=OBJ_VELOCITY_ERR_CRR_COEF_054}, {implementation-record-element=OBJ_YAW_RATE_ERR_001, system-signal=OBJ_YAW_RATE_ERR_054}, {implementation-record-element=OBJ_YAW_RATE_001, system-signal=OBJ_YAW_RATE_054}, {implementation-record-element=OBJ_VELOCITY_LONG_001, system-signal=OBJ_VELOCITY_LONG_054}, {implementation-record-element=OBJ_TRACK_MOTION_MODEL_001, system-signal=OBJ_TRACK_MOTION_MODEL_054}]}
        sender-receiver-to-signal-group-mapping={data-element=Pp_SG_TrackerObject055.Vdp_SG_TrackerObject055, signal-group=SG_TrackerObject055, type-mapping=sender-rec-record-type-mapping=record-element-mappings=[{implementation-record-element=OBJ_REF_PT_LAT_OFFSET_001, system-signal=OBJ_REF_PT_LAT_OFFSET_055}, {implementation-record-element=OBJ_REF_PT_LONG_OFFSET_001, system-signal=OBJ_REF_PT_LONG_OFFSET_055}, {implementation-record-element=OBJ_CLS_TYPE2_001, system-signal=OBJ_CLS_TYPE2_055}, {implementation-record-element=OBJ_GROUP_ID_001, system-signal=OBJ_GROUP_ID_055}, {implementation-record-element=OBJ_ID_001, system-signal=OBJ_ID_055}, {implementation-record-element=OBJ_ACCELERATION_LAT_001, system-signal=OBJ_ACCELERATION_LAT_055}, {implementation-record-element=OBJ_CLS_TYPE3_001, system-signal=OBJ_CLS_TYPE3_055}, {implementation-record-element=OBJ_CLS_TYPE3_PROB_001, system-signal=OBJ_CLS_TYPE3_PROB_055}, {implementation-record-element=OBJ_CLS_TYPE6_001, system-signal=OBJ_CLS_TYPE6_055}, {implementation-record-element=OBJ_CLS_TYPE4_001, system-signal=OBJ_CLS_TYPE4_055}, {implementation-record-element=OBJ_MEASUREMENT_STATUS_001, system-signal=OBJ_MEASUREMENT_STATUS_055}, {implementation-record-element=OBJ_CLS_TYPE1_PROB_001, system-signal=OBJ_CLS_TYPE1_PROB_055}, {implementation-record-element=OBJ_TRACK_MOTION_MODEL_001, system-signal=OBJ_TRACK_MOTION_MODEL_055}, {implementation-record-element=OBJ_VELOCITY_LAT_001, system-signal=OBJ_VELOCITY_LAT_055}, {implementation-record-element=OBJ_VELOCITY_LAT_ERR_001, system-signal=OBJ_VELOCITY_LAT_ERR_055}, {implementation-record-element=OBJ_TIMESTAMP_OFFSET_001, system-signal=OBJ_TIMESTAMP_OFFSET_055}, {implementation-record-element=OBJ_VEH_TRACK_FLAG_001, system-signal=OBJ_VEH_TRACK_FLAG_055}, {implementation-record-element=OBJ_VELOCITY_LONG_001, system-signal=OBJ_VELOCITY_LONG_055}, {implementation-record-element=OBJ_VELOCITY_LONG_ERR_001, system-signal=OBJ_VELOCITY_LONG_ERR_055}, {implementation-record-element=OBJ_VELOCITY_ERR_CRR_COEF_001, system-signal=OBJ_VELOCITY_ERR_CRR_COEF_055}, {implementation-record-element=OBJ_POS_ERR_CRR_COEF_001, system-signal=OBJ_POS_ERR_CRR_COEF_055}, {implementation-record-element=OBJ_ACCELERATION_LONG_001, system-signal=OBJ_ACCELERATION_LONG_055}, {implementation-record-element=OBJ_ACCELERATION_LONG_ERR_001, system-signal=OBJ_ACCELERATION_LONG_ERR_055}, {implementation-record-element=OBJ_POS_LAT_001, system-signal=OBJ_POS_LAT_055}, {implementation-record-element=OBJ_YAW_ANGLE_001, system-signal=OBJ_YAW_ANGLE_055}, {implementation-record-element=OBJ_ACCELERATION_LAT_ERR_001, system-signal=OBJ_ACCELERATION_LAT_ERR_055}, {implementation-record-element=OBJ_CLS_TYPE5_PROB_001, system-signal=OBJ_CLS_TYPE5_PROB_055}, {implementation-record-element=OBJ_YAW_ANGLE_ERR_001, system-signal=OBJ_YAW_ANGLE_ERR_055}, {implementation-record-element=OBJ_CLS_TYPE1_001, system-signal=OBJ_CLS_TYPE1_055}, {implementation-record-element=OBJ_DIMENSION_LENGTH_001, system-signal=OBJ_DIMENSION_LENGTH_055}, {implementation-record-element=OBJ_DIMENSION_WIDTH_ERR_001, system-signal=OBJ_DIMENSION_WIDTH_ERR_055}, {implementation-record-element=OBJ_CLS_TYPE2_PROB_001, system-signal=OBJ_CLS_TYPE2_PROB_055}, {implementation-record-element=OBJ_MOVEMENT_STATUS_001, system-signal=OBJ_MOVEMENT_STATUS_055}, {implementation-record-element=OBJ_POS_LAT_ERR_001, system-signal=OBJ_POS_LAT_ERR_055}, {implementation-record-element=OBJ_DIMENSION_WIDTH_001, system-signal=OBJ_DIMENSION_WIDTH_055}, {implementation-record-element=OBJ_POS_LONG_001, system-signal=OBJ_POS_LONG_055}, {implementation-record-element=OBJ_ACCEL_ERR_CRR_COEF_001, system-signal=OBJ_ACCEL_ERR_CRR_COEF_055}, {implementation-record-element=OBJ_RCS_001, system-signal=OBJ_RCS_055}, {implementation-record-element=OBJ_CLS_TYPE4_PROB_001, system-signal=OBJ_CLS_TYPE4_PROB_055}, {implementation-record-element=OBJ_ALIVE_TIME_001, system-signal=OBJ_ALIVE_TIME_055}, {implementation-record-element=OBJ_DIMENSION_LENGTH_ERR_001, system-signal=OBJ_DIMENSION_LENGTH_ERR_055}, {implementation-record-element=OBJ_EXISTENCE_PROB_001, system-signal=OBJ_EXISTENCE_PROB_055}, {implementation-record-element=OBJ_MH_CRC16_001, system-signal=OBJ_MH_CRC16_055}, {implementation-record-element=OBJ_CLS_TYPE6_PROB_001, system-signal=OBJ_CLS_TYPE6_PROB_055}, {implementation-record-element=OBJ_MH_CYCLE_COUNTER_001, system-signal=OBJ_MH_CYCLE_COUNTER_055}, {implementation-record-element=OBJ_POS_LONG_ERR_001, system-signal=OBJ_POS_LONG_ERR_055}, {implementation-record-element=OBJ_CLS_TYPE5_001, system-signal=OBJ_CLS_TYPE5_055}, {implementation-record-element=OBJ_YAW_RATE_001, system-signal=OBJ_YAW_RATE_055}, {implementation-record-element=OBJ_YAW_RATE_ERR_001, system-signal=OBJ_YAW_RATE_ERR_055}]}
        sender-receiver-to-signal-group-mapping={data-element=Pp_SG_TrackerObject056.Vdp_SG_TrackerObject056, signal-group=SG_TrackerObject056, type-mapping=sender-rec-record-type-mapping=record-element-mappings=[{implementation-record-element=OBJ_CLS_TYPE2_001, system-signal=OBJ_CLS_TYPE2_056}, {implementation-record-element=OBJ_ACCELERATION_LAT_ERR_001, system-signal=OBJ_ACCELERATION_LAT_ERR_056}, {implementation-record-element=OBJ_CLS_TYPE6_001, system-signal=OBJ_CLS_TYPE6_056}, {implementation-record-element=OBJ_CLS_TYPE5_001, system-signal=OBJ_CLS_TYPE5_056}, {implementation-record-element=OBJ_POS_LAT_ERR_001, system-signal=OBJ_POS_LAT_ERR_056}, {implementation-record-element=OBJ_CLS_TYPE1_PROB_001, system-signal=OBJ_CLS_TYPE1_PROB_056}, {implementation-record-element=OBJ_POS_LONG_001, system-signal=OBJ_POS_LONG_056}, {implementation-record-element=OBJ_CLS_TYPE3_PROB_001, system-signal=OBJ_CLS_TYPE3_PROB_056}, {implementation-record-element=OBJ_POS_LONG_ERR_001, system-signal=OBJ_POS_LONG_ERR_056}, {implementation-record-element=OBJ_YAW_RATE_001, system-signal=OBJ_YAW_RATE_056}, {implementation-record-element=OBJ_YAW_RATE_ERR_001, system-signal=OBJ_YAW_RATE_ERR_056}, {implementation-record-element=OBJ_ALIVE_TIME_001, system-signal=OBJ_ALIVE_TIME_056}, {implementation-record-element=OBJ_YAW_ANGLE_001, system-signal=OBJ_YAW_ANGLE_056}, {implementation-record-element=OBJ_VELOCITY_LAT_ERR_001, system-signal=OBJ_VELOCITY_LAT_ERR_056}, {implementation-record-element=OBJ_CLS_TYPE5_PROB_001, system-signal=OBJ_CLS_TYPE5_PROB_056}, {implementation-record-element=OBJ_CLS_TYPE2_PROB_001, system-signal=OBJ_CLS_TYPE2_PROB_056}, {implementation-record-element=OBJ_TIMESTAMP_OFFSET_001, system-signal=OBJ_TIMESTAMP_OFFSET_056}, {implementation-record-element=OBJ_VELOCITY_ERR_CRR_COEF_001, system-signal=OBJ_VELOCITY_ERR_CRR_COEF_056}, {implementation-record-element=OBJ_CLS_TYPE4_001, system-signal=OBJ_CLS_TYPE4_056}, {implementation-record-element=OBJ_GROUP_ID_001, system-signal=OBJ_GROUP_ID_056}, {implementation-record-element=OBJ_TRACK_MOTION_MODEL_001, system-signal=OBJ_TRACK_MOTION_MODEL_056}, {implementation-record-element=OBJ_ACCELERATION_LONG_001, system-signal=OBJ_ACCELERATION_LONG_056}, {implementation-record-element=OBJ_CLS_TYPE1_001, system-signal=OBJ_CLS_TYPE1_056}, {implementation-record-element=OBJ_MEASUREMENT_STATUS_001, system-signal=OBJ_MEASUREMENT_STATUS_056}, {implementation-record-element=OBJ_VELOCITY_LONG_ERR_001, system-signal=OBJ_VELOCITY_LONG_ERR_056}, {implementation-record-element=OBJ_YAW_ANGLE_ERR_001, system-signal=OBJ_YAW_ANGLE_ERR_056}, {implementation-record-element=OBJ_POS_ERR_CRR_COEF_001, system-signal=OBJ_POS_ERR_CRR_COEF_056}, {implementation-record-element=OBJ_MH_CYCLE_COUNTER_001, system-signal=OBJ_MH_CYCLE_COUNTER_056}, {implementation-record-element=OBJ_EXISTENCE_PROB_001, system-signal=OBJ_EXISTENCE_PROB_056}, {implementation-record-element=OBJ_ACCEL_ERR_CRR_COEF_001, system-signal=OBJ_ACCEL_ERR_CRR_COEF_056}, {implementation-record-element=OBJ_ACCELERATION_LAT_001, system-signal=OBJ_ACCELERATION_LAT_056}, {implementation-record-element=OBJ_ID_001, system-signal=OBJ_ID_056}, {implementation-record-element=OBJ_CLS_TYPE4_PROB_001, system-signal=OBJ_CLS_TYPE4_PROB_056}, {implementation-record-element=OBJ_CLS_TYPE6_PROB_001, system-signal=OBJ_CLS_TYPE6_PROB_056}, {implementation-record-element=OBJ_DIMENSION_LENGTH_001, system-signal=OBJ_DIMENSION_LENGTH_056}, {implementation-record-element=OBJ_MH_CRC16_001, system-signal=OBJ_MH_CRC16_056}, {implementation-record-element=OBJ_DIMENSION_LENGTH_ERR_001, system-signal=OBJ_DIMENSION_LENGTH_ERR_056}, {implementation-record-element=OBJ_DIMENSION_WIDTH_ERR_001, system-signal=OBJ_DIMENSION_WIDTH_ERR_056}, {implementation-record-element=OBJ_MOVEMENT_STATUS_001, system-signal=OBJ_MOVEMENT_STATUS_056}, {implementation-record-element=OBJ_CLS_TYPE3_001, system-signal=OBJ_CLS_TYPE3_056}, {implementation-record-element=OBJ_REF_PT_LONG_OFFSET_001, system-signal=OBJ_REF_PT_LONG_OFFSET_056}, {implementation-record-element=OBJ_VEH_TRACK_FLAG_001, system-signal=OBJ_VEH_TRACK_FLAG_056}, {implementation-record-element=OBJ_REF_PT_LAT_OFFSET_001, system-signal=OBJ_REF_PT_LAT_OFFSET_056}, {implementation-record-element=OBJ_RCS_001, system-signal=OBJ_RCS_056}, {implementation-record-element=OBJ_DIMENSION_WIDTH_001, system-signal=OBJ_DIMENSION_WIDTH_056}, {implementation-record-element=OBJ_POS_LAT_001, system-signal=OBJ_POS_LAT_056}, {implementation-record-element=OBJ_VELOCITY_LAT_001, system-signal=OBJ_VELOCITY_LAT_056}, {implementation-record-element=OBJ_VELOCITY_LONG_001, system-signal=OBJ_VELOCITY_LONG_056}, {implementation-record-element=OBJ_ACCELERATION_LONG_ERR_001, system-signal=OBJ_ACCELERATION_LONG_ERR_056}]}
        sender-receiver-to-signal-group-mapping={data-element=Pp_SG_TrackerObject057.Vdp_SG_TrackerObject057, signal-group=SG_TrackerObject057, type-mapping=sender-rec-record-type-mapping=record-element-mappings=[{implementation-record-element=OBJ_ACCELERATION_LONG_ERR_001, system-signal=OBJ_ACCELERATION_LONG_ERR_057}, {implementation-record-element=OBJ_CLS_TYPE1_001, system-signal=OBJ_CLS_TYPE1_057}, {implementation-record-element=OBJ_CLS_TYPE2_001, system-signal=OBJ_CLS_TYPE2_057}, {implementation-record-element=OBJ_CLS_TYPE2_PROB_001, system-signal=OBJ_CLS_TYPE2_PROB_057}, {implementation-record-element=OBJ_CLS_TYPE3_001, system-signal=OBJ_CLS_TYPE3_057}, {implementation-record-element=OBJ_ALIVE_TIME_001, system-signal=OBJ_ALIVE_TIME_057}, {implementation-record-element=OBJ_ACCELERATION_LAT_001, system-signal=OBJ_ACCELERATION_LAT_057}, {implementation-record-element=OBJ_CLS_TYPE1_PROB_001, system-signal=OBJ_CLS_TYPE1_PROB_057}, {implementation-record-element=OBJ_ACCEL_ERR_CRR_COEF_001, system-signal=OBJ_ACCEL_ERR_CRR_COEF_057}, {implementation-record-element=OBJ_ACCELERATION_LAT_ERR_001, system-signal=OBJ_ACCELERATION_LAT_ERR_057}, {implementation-record-element=OBJ_ACCELERATION_LONG_001, system-signal=OBJ_ACCELERATION_LONG_057}, {implementation-record-element=OBJ_DIMENSION_LENGTH_001, system-signal=OBJ_DIMENSION_LENGTH_057}, {implementation-record-element=OBJ_POS_ERR_CRR_COEF_001, system-signal=OBJ_POS_ERR_CRR_COEF_057}, {implementation-record-element=OBJ_CLS_TYPE3_PROB_001, system-signal=OBJ_CLS_TYPE3_PROB_057}, {implementation-record-element=OBJ_CLS_TYPE6_PROB_001, system-signal=OBJ_CLS_TYPE6_PROB_057}, {implementation-record-element=OBJ_GROUP_ID_001, system-signal=OBJ_GROUP_ID_057}, {implementation-record-element=OBJ_VEH_TRACK_FLAG_001, system-signal=OBJ_VEH_TRACK_FLAG_057}, {implementation-record-element=OBJ_VELOCITY_LAT_001, system-signal=OBJ_VELOCITY_LAT_057}, {implementation-record-element=OBJ_VELOCITY_LONG_001, system-signal=OBJ_VELOCITY_LONG_057}, {implementation-record-element=OBJ_RCS_001, system-signal=OBJ_RCS_057}, {implementation-record-element=OBJ_POS_LONG_ERR_001, system-signal=OBJ_POS_LONG_ERR_057}, {implementation-record-element=OBJ_YAW_ANGLE_001, system-signal=OBJ_YAW_ANGLE_057}, {implementation-record-element=OBJ_CLS_TYPE4_PROB_001, system-signal=OBJ_CLS_TYPE4_PROB_057}, {implementation-record-element=OBJ_VELOCITY_LAT_ERR_001, system-signal=OBJ_VELOCITY_LAT_ERR_057}, {implementation-record-element=OBJ_CLS_TYPE6_001, system-signal=OBJ_CLS_TYPE6_057}, {implementation-record-element=OBJ_MH_CRC16_001, system-signal=OBJ_MH_CRC16_057}, {implementation-record-element=OBJ_MOVEMENT_STATUS_001, system-signal=OBJ_MOVEMENT_STATUS_057}, {implementation-record-element=OBJ_ID_001, system-signal=OBJ_ID_057}, {implementation-record-element=OBJ_POS_LAT_ERR_001, system-signal=OBJ_POS_LAT_ERR_057}, {implementation-record-element=OBJ_VELOCITY_LONG_ERR_001, system-signal=OBJ_VELOCITY_LONG_ERR_057}, {implementation-record-element=OBJ_MEASUREMENT_STATUS_001, system-signal=OBJ_MEASUREMENT_STATUS_057}, {implementation-record-element=OBJ_CLS_TYPE5_PROB_001, system-signal=OBJ_CLS_TYPE5_PROB_057}, {implementation-record-element=OBJ_VELOCITY_ERR_CRR_COEF_001, system-signal=OBJ_VELOCITY_ERR_CRR_COEF_057}, {implementation-record-element=OBJ_YAW_RATE_001, system-signal=OBJ_YAW_RATE_057}, {implementation-record-element=OBJ_DIMENSION_WIDTH_001, system-signal=OBJ_DIMENSION_WIDTH_057}, {implementation-record-element=OBJ_REF_PT_LAT_OFFSET_001, system-signal=OBJ_REF_PT_LAT_OFFSET_057}, {implementation-record-element=OBJ_CLS_TYPE4_001, system-signal=OBJ_CLS_TYPE4_057}, {implementation-record-element=OBJ_YAW_ANGLE_ERR_001, system-signal=OBJ_YAW_ANGLE_ERR_057}, {implementation-record-element=OBJ_DIMENSION_WIDTH_ERR_001, system-signal=OBJ_DIMENSION_WIDTH_ERR_057}, {implementation-record-element=OBJ_TRACK_MOTION_MODEL_001, system-signal=OBJ_TRACK_MOTION_MODEL_057}, {implementation-record-element=OBJ_REF_PT_LONG_OFFSET_001, system-signal=OBJ_REF_PT_LONG_OFFSET_057}, {implementation-record-element=OBJ_TIMESTAMP_OFFSET_001, system-signal=OBJ_TIMESTAMP_OFFSET_057}, {implementation-record-element=OBJ_EXISTENCE_PROB_001, system-signal=OBJ_EXISTENCE_PROB_057}, {implementation-record-element=OBJ_YAW_RATE_ERR_001, system-signal=OBJ_YAW_RATE_ERR_057}, {implementation-record-element=OBJ_POS_LAT_001, system-signal=OBJ_POS_LAT_057}, {implementation-record-element=OBJ_CLS_TYPE5_001, system-signal=OBJ_CLS_TYPE5_057}, {implementation-record-element=OBJ_MH_CYCLE_COUNTER_001, system-signal=OBJ_MH_CYCLE_COUNTER_057}, {implementation-record-element=OBJ_DIMENSION_LENGTH_ERR_001, system-signal=OBJ_DIMENSION_LENGTH_ERR_057}, {implementation-record-element=OBJ_POS_LONG_001, system-signal=OBJ_POS_LONG_057}]}
        sender-receiver-to-signal-group-mapping={data-element=Pp_SG_TrackerObject058.Vdp_SG_TrackerObject058, signal-group=SG_TrackerObject058, type-mapping=sender-rec-record-type-mapping=record-element-mappings=[{implementation-record-element=OBJ_CLS_TYPE5_PROB_001, system-signal=OBJ_CLS_TYPE5_PROB_058}, {implementation-record-element=OBJ_DIMENSION_LENGTH_001, system-signal=OBJ_DIMENSION_LENGTH_058}, {implementation-record-element=OBJ_DIMENSION_WIDTH_ERR_001, system-signal=OBJ_DIMENSION_WIDTH_ERR_058}, {implementation-record-element=OBJ_EXISTENCE_PROB_001, system-signal=OBJ_EXISTENCE_PROB_058}, {implementation-record-element=OBJ_CLS_TYPE4_PROB_001, system-signal=OBJ_CLS_TYPE4_PROB_058}, {implementation-record-element=OBJ_ACCELERATION_LAT_001, system-signal=OBJ_ACCELERATION_LAT_058}, {implementation-record-element=OBJ_CLS_TYPE5_001, system-signal=OBJ_CLS_TYPE5_058}, {implementation-record-element=OBJ_CLS_TYPE6_PROB_001, system-signal=OBJ_CLS_TYPE6_PROB_058}, {implementation-record-element=OBJ_DIMENSION_WIDTH_001, system-signal=OBJ_DIMENSION_WIDTH_058}, {implementation-record-element=OBJ_ID_001, system-signal=OBJ_ID_058}, {implementation-record-element=OBJ_CLS_TYPE1_PROB_001, system-signal=OBJ_CLS_TYPE1_PROB_058}, {implementation-record-element=OBJ_CLS_TYPE2_PROB_001, system-signal=OBJ_CLS_TYPE2_PROB_058}, {implementation-record-element=OBJ_CLS_TYPE3_001, system-signal=OBJ_CLS_TYPE3_058}, {implementation-record-element=OBJ_CLS_TYPE4_001, system-signal=OBJ_CLS_TYPE4_058}, {implementation-record-element=OBJ_ALIVE_TIME_001, system-signal=OBJ_ALIVE_TIME_058}, {implementation-record-element=OBJ_ACCELERATION_LONG_ERR_001, system-signal=OBJ_ACCELERATION_LONG_ERR_058}, {implementation-record-element=OBJ_ACCELERATION_LAT_ERR_001, system-signal=OBJ_ACCELERATION_LAT_ERR_058}, {implementation-record-element=OBJ_CLS_TYPE1_001, system-signal=OBJ_CLS_TYPE1_058}, {implementation-record-element=OBJ_CLS_TYPE6_001, system-signal=OBJ_CLS_TYPE6_058}, {implementation-record-element=OBJ_DIMENSION_LENGTH_ERR_001, system-signal=OBJ_DIMENSION_LENGTH_ERR_058}, {implementation-record-element=OBJ_GROUP_ID_001, system-signal=OBJ_GROUP_ID_058}, {implementation-record-element=OBJ_ACCELERATION_LONG_001, system-signal=OBJ_ACCELERATION_LONG_058}, {implementation-record-element=OBJ_CLS_TYPE2_001, system-signal=OBJ_CLS_TYPE2_058}, {implementation-record-element=OBJ_ACCEL_ERR_CRR_COEF_001, system-signal=OBJ_ACCEL_ERR_CRR_COEF_058}, {implementation-record-element=OBJ_CLS_TYPE3_PROB_001, system-signal=OBJ_CLS_TYPE3_PROB_058}, {implementation-record-element=OBJ_MOVEMENT_STATUS_001, system-signal=OBJ_MOVEMENT_STATUS_058}, {implementation-record-element=OBJ_YAW_RATE_001, system-signal=OBJ_YAW_RATE_058}, {implementation-record-element=OBJ_MEASUREMENT_STATUS_001, system-signal=OBJ_MEASUREMENT_STATUS_058}, {implementation-record-element=OBJ_VEH_TRACK_FLAG_001, system-signal=OBJ_VEH_TRACK_FLAG_058}, {implementation-record-element=OBJ_YAW_RATE_ERR_001, system-signal=OBJ_YAW_RATE_ERR_058}, {implementation-record-element=OBJ_POS_LONG_ERR_001, system-signal=OBJ_POS_LONG_ERR_058}, {implementation-record-element=OBJ_YAW_ANGLE_ERR_001, system-signal=OBJ_YAW_ANGLE_ERR_058}, {implementation-record-element=OBJ_MH_CRC16_001, system-signal=OBJ_MH_CRC16_058}, {implementation-record-element=OBJ_POS_LAT_001, system-signal=OBJ_POS_LAT_058}, {implementation-record-element=OBJ_YAW_ANGLE_001, system-signal=OBJ_YAW_ANGLE_058}, {implementation-record-element=OBJ_POS_ERR_CRR_COEF_001, system-signal=OBJ_POS_ERR_CRR_COEF_058}, {implementation-record-element=OBJ_VELOCITY_LAT_001, system-signal=OBJ_VELOCITY_LAT_058}, {implementation-record-element=OBJ_VELOCITY_LAT_ERR_001, system-signal=OBJ_VELOCITY_LAT_ERR_058}, {implementation-record-element=OBJ_VELOCITY_ERR_CRR_COEF_001, system-signal=OBJ_VELOCITY_ERR_CRR_COEF_058}, {implementation-record-element=OBJ_REF_PT_LONG_OFFSET_001, system-signal=OBJ_REF_PT_LONG_OFFSET_058}, {implementation-record-element=OBJ_REF_PT_LAT_OFFSET_001, system-signal=OBJ_REF_PT_LAT_OFFSET_058}, {implementation-record-element=OBJ_MH_CYCLE_COUNTER_001, system-signal=OBJ_MH_CYCLE_COUNTER_058}, {implementation-record-element=OBJ_TRACK_MOTION_MODEL_001, system-signal=OBJ_TRACK_MOTION_MODEL_058}, {implementation-record-element=OBJ_TIMESTAMP_OFFSET_001, system-signal=OBJ_TIMESTAMP_OFFSET_058}, {implementation-record-element=OBJ_VELOCITY_LONG_001, system-signal=OBJ_VELOCITY_LONG_058}, {implementation-record-element=OBJ_VELOCITY_LONG_ERR_001, system-signal=OBJ_VELOCITY_LONG_ERR_058}, {implementation-record-element=OBJ_POS_LAT_ERR_001, system-signal=OBJ_POS_LAT_ERR_058}, {implementation-record-element=OBJ_POS_LONG_001, system-signal=OBJ_POS_LONG_058}, {implementation-record-element=OBJ_RCS_001, system-signal=OBJ_RCS_058}]}
        sender-receiver-to-signal-group-mapping={data-element=Pp_SG_TrackerObject059.Vdp_SG_TrackerObject059, signal-group=SG_TrackerObject059, type-mapping=sender-rec-record-type-mapping=record-element-mappings=[{implementation-record-element=OBJ_ACCELERATION_LAT_ERR_001, system-signal=OBJ_ACCELERATION_LAT_ERR_059}, {implementation-record-element=OBJ_ID_001, system-signal=OBJ_ID_059}, {implementation-record-element=OBJ_POS_ERR_CRR_COEF_001, system-signal=OBJ_POS_ERR_CRR_COEF_059}, {implementation-record-element=OBJ_POS_LAT_001, system-signal=OBJ_POS_LAT_059}, {implementation-record-element=OBJ_POS_LAT_ERR_001, system-signal=OBJ_POS_LAT_ERR_059}, {implementation-record-element=OBJ_ACCELERATION_LAT_001, system-signal=OBJ_ACCELERATION_LAT_059}, {implementation-record-element=OBJ_CLS_TYPE1_PROB_001, system-signal=OBJ_CLS_TYPE1_PROB_059}, {implementation-record-element=OBJ_MH_CRC16_001, system-signal=OBJ_MH_CRC16_059}, {implementation-record-element=OBJ_MH_CYCLE_COUNTER_001, system-signal=OBJ_MH_CYCLE_COUNTER_059}, {implementation-record-element=OBJ_CLS_TYPE4_PROB_001, system-signal=OBJ_CLS_TYPE4_PROB_059}, {implementation-record-element=OBJ_CLS_TYPE5_PROB_001, system-signal=OBJ_CLS_TYPE5_PROB_059}, {implementation-record-element=OBJ_POS_LONG_001, system-signal=OBJ_POS_LONG_059}, {implementation-record-element=OBJ_POS_LONG_ERR_001, system-signal=OBJ_POS_LONG_ERR_059}, {implementation-record-element=OBJ_CLS_TYPE6_001, system-signal=OBJ_CLS_TYPE6_059}, {implementation-record-element=OBJ_RCS_001, system-signal=OBJ_RCS_059}, {implementation-record-element=OBJ_ACCEL_ERR_CRR_COEF_001, system-signal=OBJ_ACCEL_ERR_CRR_COEF_059}, {implementation-record-element=OBJ_REF_PT_LAT_OFFSET_001, system-signal=OBJ_REF_PT_LAT_OFFSET_059}, {implementation-record-element=OBJ_EXISTENCE_PROB_001, system-signal=OBJ_EXISTENCE_PROB_059}, {implementation-record-element=OBJ_REF_PT_LONG_OFFSET_001, system-signal=OBJ_REF_PT_LONG_OFFSET_059}, {implementation-record-element=OBJ_TIMESTAMP_OFFSET_001, system-signal=OBJ_TIMESTAMP_OFFSET_059}, {implementation-record-element=OBJ_TRACK_MOTION_MODEL_001, system-signal=OBJ_TRACK_MOTION_MODEL_059}, {implementation-record-element=OBJ_CLS_TYPE3_001, system-signal=OBJ_CLS_TYPE3_059}, {implementation-record-element=OBJ_CLS_TYPE2_001, system-signal=OBJ_CLS_TYPE2_059}, {implementation-record-element=OBJ_CLS_TYPE3_PROB_001, system-signal=OBJ_CLS_TYPE3_PROB_059}, {implementation-record-element=OBJ_ACCELERATION_LONG_ERR_001, system-signal=OBJ_ACCELERATION_LONG_ERR_059}, {implementation-record-element=OBJ_CLS_TYPE4_001, system-signal=OBJ_CLS_TYPE4_059}, {implementation-record-element=OBJ_DIMENSION_LENGTH_001, system-signal=OBJ_DIMENSION_LENGTH_059}, {implementation-record-element=OBJ_DIMENSION_LENGTH_ERR_001, system-signal=OBJ_DIMENSION_LENGTH_ERR_059}, {implementation-record-element=OBJ_DIMENSION_WIDTH_001, system-signal=OBJ_DIMENSION_WIDTH_059}, {implementation-record-element=OBJ_GROUP_ID_001, system-signal=OBJ_GROUP_ID_059}, {implementation-record-element=OBJ_ALIVE_TIME_001, system-signal=OBJ_ALIVE_TIME_059}, {implementation-record-element=OBJ_CLS_TYPE2_PROB_001, system-signal=OBJ_CLS_TYPE2_PROB_059}, {implementation-record-element=OBJ_CLS_TYPE1_001, system-signal=OBJ_CLS_TYPE1_059}, {implementation-record-element=OBJ_CLS_TYPE5_001, system-signal=OBJ_CLS_TYPE5_059}, {implementation-record-element=OBJ_MOVEMENT_STATUS_001, system-signal=OBJ_MOVEMENT_STATUS_059}, {implementation-record-element=OBJ_DIMENSION_WIDTH_ERR_001, system-signal=OBJ_DIMENSION_WIDTH_ERR_059}, {implementation-record-element=OBJ_MEASUREMENT_STATUS_001, system-signal=OBJ_MEASUREMENT_STATUS_059}, {implementation-record-element=OBJ_ACCELERATION_LONG_001, system-signal=OBJ_ACCELERATION_LONG_059}, {implementation-record-element=OBJ_CLS_TYPE6_PROB_001, system-signal=OBJ_CLS_TYPE6_PROB_059}, {implementation-record-element=OBJ_YAW_ANGLE_ERR_001, system-signal=OBJ_YAW_ANGLE_ERR_059}, {implementation-record-element=OBJ_YAW_RATE_001, system-signal=OBJ_YAW_RATE_059}, {implementation-record-element=OBJ_YAW_RATE_ERR_001, system-signal=OBJ_YAW_RATE_ERR_059}, {implementation-record-element=OBJ_VELOCITY_LAT_001, system-signal=OBJ_VELOCITY_LAT_059}, {implementation-record-element=OBJ_VELOCITY_LONG_ERR_001, system-signal=OBJ_VELOCITY_LONG_ERR_059}, {implementation-record-element=OBJ_VELOCITY_LONG_001, system-signal=OBJ_VELOCITY_LONG_059}, {implementation-record-element=OBJ_VELOCITY_LAT_ERR_001, system-signal=OBJ_VELOCITY_LAT_ERR_059}, {implementation-record-element=OBJ_VEH_TRACK_FLAG_001, system-signal=OBJ_VEH_TRACK_FLAG_059}, {implementation-record-element=OBJ_YAW_ANGLE_001, system-signal=OBJ_YAW_ANGLE_059}, {implementation-record-element=OBJ_VELOCITY_ERR_CRR_COEF_001, system-signal=OBJ_VELOCITY_ERR_CRR_COEF_059}]}
        sender-receiver-to-signal-group-mapping={data-element=Pp_SG_TrackerObject061.Vdp_SG_TrackerObject061, signal-group=SG_TrackerObject061, type-mapping=sender-rec-record-type-mapping=record-element-mappings=[{implementation-record-element=OBJ_ACCELERATION_LAT_001, system-signal=OBJ_ACCELERATION_LAT_061}, {implementation-record-element=OBJ_ACCELERATION_LAT_ERR_001, system-signal=OBJ_ACCELERATION_LAT_ERR_061}, {implementation-record-element=OBJ_ACCEL_ERR_CRR_COEF_001, system-signal=OBJ_ACCEL_ERR_CRR_COEF_061}, {implementation-record-element=OBJ_CLS_TYPE1_001, system-signal=OBJ_CLS_TYPE1_061}, {implementation-record-element=OBJ_ACCELERATION_LONG_001, system-signal=OBJ_ACCELERATION_LONG_061}, {implementation-record-element=OBJ_CLS_TYPE2_001, system-signal=OBJ_CLS_TYPE2_061}, {implementation-record-element=OBJ_ID_001, system-signal=OBJ_ID_061}, {implementation-record-element=OBJ_MH_CRC16_001, system-signal=OBJ_MH_CRC16_061}, {implementation-record-element=OBJ_VELOCITY_LAT_001, system-signal=OBJ_VELOCITY_LAT_061}, {implementation-record-element=OBJ_TIMESTAMP_OFFSET_001, system-signal=OBJ_TIMESTAMP_OFFSET_061}, {implementation-record-element=OBJ_CLS_TYPE6_PROB_001, system-signal=OBJ_CLS_TYPE6_PROB_061}, {implementation-record-element=OBJ_CLS_TYPE3_PROB_001, system-signal=OBJ_CLS_TYPE3_PROB_061}, {implementation-record-element=OBJ_CLS_TYPE4_001, system-signal=OBJ_CLS_TYPE4_061}, {implementation-record-element=OBJ_GROUP_ID_001, system-signal=OBJ_GROUP_ID_061}, {implementation-record-element=OBJ_YAW_RATE_ERR_001, system-signal=OBJ_YAW_RATE_ERR_061}, {implementation-record-element=OBJ_CLS_TYPE5_001, system-signal=OBJ_CLS_TYPE5_061}, {implementation-record-element=OBJ_CLS_TYPE5_PROB_001, system-signal=OBJ_CLS_TYPE5_PROB_061}, {implementation-record-element=OBJ_CLS_TYPE4_PROB_001, system-signal=OBJ_CLS_TYPE4_PROB_061}, {implementation-record-element=OBJ_CLS_TYPE3_001, system-signal=OBJ_CLS_TYPE3_061}, {implementation-record-element=OBJ_REF_PT_LONG_OFFSET_001, system-signal=OBJ_REF_PT_LONG_OFFSET_061}, {implementation-record-element=OBJ_VELOCITY_LONG_ERR_001, system-signal=OBJ_VELOCITY_LONG_ERR_061}, {implementation-record-element=OBJ_ALIVE_TIME_001, system-signal=OBJ_ALIVE_TIME_061}, {implementation-record-element=OBJ_POS_ERR_CRR_COEF_001, system-signal=OBJ_POS_ERR_CRR_COEF_061}, {implementation-record-element=OBJ_REF_PT_LAT_OFFSET_001, system-signal=OBJ_REF_PT_LAT_OFFSET_061}, {implementation-record-element=OBJ_DIMENSION_WIDTH_001, system-signal=OBJ_DIMENSION_WIDTH_061}, {implementation-record-element=OBJ_POS_LONG_001, system-signal=OBJ_POS_LONG_061}, {implementation-record-element=OBJ_RCS_001, system-signal=OBJ_RCS_061}, {implementation-record-element=OBJ_EXISTENCE_PROB_001, system-signal=OBJ_EXISTENCE_PROB_061}, {implementation-record-element=OBJ_YAW_ANGLE_ERR_001, system-signal=OBJ_YAW_ANGLE_ERR_061}, {implementation-record-element=OBJ_VELOCITY_ERR_CRR_COEF_001, system-signal=OBJ_VELOCITY_ERR_CRR_COEF_061}, {implementation-record-element=OBJ_YAW_RATE_001, system-signal=OBJ_YAW_RATE_061}, {implementation-record-element=OBJ_DIMENSION_WIDTH_ERR_001, system-signal=OBJ_DIMENSION_WIDTH_ERR_061}, {implementation-record-element=OBJ_DIMENSION_LENGTH_ERR_001, system-signal=OBJ_DIMENSION_LENGTH_ERR_061}, {implementation-record-element=OBJ_VELOCITY_LAT_ERR_001, system-signal=OBJ_VELOCITY_LAT_ERR_061}, {implementation-record-element=OBJ_POS_LAT_001, system-signal=OBJ_POS_LAT_061}, {implementation-record-element=OBJ_YAW_ANGLE_001, system-signal=OBJ_YAW_ANGLE_061}, {implementation-record-element=OBJ_DIMENSION_LENGTH_001, system-signal=OBJ_DIMENSION_LENGTH_061}, {implementation-record-element=OBJ_MH_CYCLE_COUNTER_001, system-signal=OBJ_MH_CYCLE_COUNTER_061}, {implementation-record-element=OBJ_MOVEMENT_STATUS_001, system-signal=OBJ_MOVEMENT_STATUS_061}, {implementation-record-element=OBJ_VEH_TRACK_FLAG_001, system-signal=OBJ_VEH_TRACK_FLAG_061}, {implementation-record-element=OBJ_CLS_TYPE1_PROB_001, system-signal=OBJ_CLS_TYPE1_PROB_061}, {implementation-record-element=OBJ_MEASUREMENT_STATUS_001, system-signal=OBJ_MEASUREMENT_STATUS_061}, {implementation-record-element=OBJ_VELOCITY_LONG_001, system-signal=OBJ_VELOCITY_LONG_061}, {implementation-record-element=OBJ_ACCELERATION_LONG_ERR_001, system-signal=OBJ_ACCELERATION_LONG_ERR_061}, {implementation-record-element=OBJ_TRACK_MOTION_MODEL_001, system-signal=OBJ_TRACK_MOTION_MODEL_061}, {implementation-record-element=OBJ_CLS_TYPE2_PROB_001, system-signal=OBJ_CLS_TYPE2_PROB_061}, {implementation-record-element=OBJ_CLS_TYPE6_001, system-signal=OBJ_CLS_TYPE6_061}, {implementation-record-element=OBJ_POS_LAT_ERR_001, system-signal=OBJ_POS_LAT_ERR_061}, {implementation-record-element=OBJ_POS_LONG_ERR_001, system-signal=OBJ_POS_LONG_ERR_061}]}
        sender-receiver-to-signal-group-mapping={data-element=Pp_SG_TrackerObject060.Vdp_SG_TrackerObject060, signal-group=SG_TrackerObject060, type-mapping=sender-rec-record-type-mapping=record-element-mappings=[{implementation-record-element=OBJ_CLS_TYPE5_001, system-signal=OBJ_CLS_TYPE5_060}, {implementation-record-element=OBJ_CLS_TYPE6_001, system-signal=OBJ_CLS_TYPE6_060}, {implementation-record-element=OBJ_CLS_TYPE3_001, system-signal=OBJ_CLS_TYPE3_060}, {implementation-record-element=OBJ_POS_LONG_ERR_001, system-signal=OBJ_POS_LONG_ERR_060}, {implementation-record-element=OBJ_RCS_001, system-signal=OBJ_RCS_060}, {implementation-record-element=OBJ_ACCELERATION_LONG_001, system-signal=OBJ_ACCELERATION_LONG_060}, {implementation-record-element=OBJ_CLS_TYPE4_PROB_001, system-signal=OBJ_CLS_TYPE4_PROB_060}, {implementation-record-element=OBJ_REF_PT_LAT_OFFSET_001, system-signal=OBJ_REF_PT_LAT_OFFSET_060}, {implementation-record-element=OBJ_VEH_TRACK_FLAG_001, system-signal=OBJ_VEH_TRACK_FLAG_060}, {implementation-record-element=OBJ_VELOCITY_LAT_001, system-signal=OBJ_VELOCITY_LAT_060}, {implementation-record-element=OBJ_VELOCITY_LAT_ERR_001, system-signal=OBJ_VELOCITY_LAT_ERR_060}, {implementation-record-element=OBJ_POS_LAT_001, system-signal=OBJ_POS_LAT_060}, {implementation-record-element=OBJ_CLS_TYPE2_PROB_001, system-signal=OBJ_CLS_TYPE2_PROB_060}, {implementation-record-element=OBJ_POS_LAT_ERR_001, system-signal=OBJ_POS_LAT_ERR_060}, {implementation-record-element=OBJ_VELOCITY_LONG_001, system-signal=OBJ_VELOCITY_LONG_060}, {implementation-record-element=OBJ_YAW_ANGLE_001, system-signal=OBJ_YAW_ANGLE_060}, {implementation-record-element=OBJ_YAW_ANGLE_ERR_001, system-signal=OBJ_YAW_ANGLE_ERR_060}, {implementation-record-element=OBJ_VELOCITY_LONG_ERR_001, system-signal=OBJ_VELOCITY_LONG_ERR_060}, {implementation-record-element=OBJ_YAW_RATE_001, system-signal=OBJ_YAW_RATE_060}, {implementation-record-element=OBJ_YAW_RATE_ERR_001, system-signal=OBJ_YAW_RATE_ERR_060}, {implementation-record-element=OBJ_ALIVE_TIME_001, system-signal=OBJ_ALIVE_TIME_060}, {implementation-record-element=OBJ_CLS_TYPE1_001, system-signal=OBJ_CLS_TYPE1_060}, {implementation-record-element=OBJ_DIMENSION_LENGTH_ERR_001, system-signal=OBJ_DIMENSION_LENGTH_ERR_060}, {implementation-record-element=OBJ_ACCELERATION_LONG_ERR_001, system-signal=OBJ_ACCELERATION_LONG_ERR_060}, {implementation-record-element=OBJ_MH_CRC16_001, system-signal=OBJ_MH_CRC16_060}, {implementation-record-element=OBJ_TRACK_MOTION_MODEL_001, system-signal=OBJ_TRACK_MOTION_MODEL_060}, {implementation-record-element=OBJ_VELOCITY_ERR_CRR_COEF_001, system-signal=OBJ_VELOCITY_ERR_CRR_COEF_060}, {implementation-record-element=OBJ_CLS_TYPE2_001, system-signal=OBJ_CLS_TYPE2_060}, {implementation-record-element=OBJ_ACCEL_ERR_CRR_COEF_001, system-signal=OBJ_ACCEL_ERR_CRR_COEF_060}, {implementation-record-element=OBJ_GROUP_ID_001, system-signal=OBJ_GROUP_ID_060}, {implementation-record-element=OBJ_ID_001, system-signal=OBJ_ID_060}, {implementation-record-element=OBJ_CLS_TYPE4_001, system-signal=OBJ_CLS_TYPE4_060}, {implementation-record-element=OBJ_MH_CYCLE_COUNTER_001, system-signal=OBJ_MH_CYCLE_COUNTER_060}, {implementation-record-element=OBJ_EXISTENCE_PROB_001, system-signal=OBJ_EXISTENCE_PROB_060}, {implementation-record-element=OBJ_POS_LONG_001, system-signal=OBJ_POS_LONG_060}, {implementation-record-element=OBJ_CLS_TYPE3_PROB_001, system-signal=OBJ_CLS_TYPE3_PROB_060}, {implementation-record-element=OBJ_DIMENSION_WIDTH_001, system-signal=OBJ_DIMENSION_WIDTH_060}, {implementation-record-element=OBJ_ACCELERATION_LAT_ERR_001, system-signal=OBJ_ACCELERATION_LAT_ERR_060}, {implementation-record-element=OBJ_ACCELERATION_LAT_001, system-signal=OBJ_ACCELERATION_LAT_060}, {implementation-record-element=OBJ_REF_PT_LONG_OFFSET_001, system-signal=OBJ_REF_PT_LONG_OFFSET_060}, {implementation-record-element=OBJ_TIMESTAMP_OFFSET_001, system-signal=OBJ_TIMESTAMP_OFFSET_060}, {implementation-record-element=OBJ_CLS_TYPE1_PROB_001, system-signal=OBJ_CLS_TYPE1_PROB_060}, {implementation-record-element=OBJ_CLS_TYPE5_PROB_001, system-signal=OBJ_CLS_TYPE5_PROB_060}, {implementation-record-element=OBJ_CLS_TYPE6_PROB_001, system-signal=OBJ_CLS_TYPE6_PROB_060}, {implementation-record-element=OBJ_DIMENSION_LENGTH_001, system-signal=OBJ_DIMENSION_LENGTH_060}, {implementation-record-element=OBJ_MEASUREMENT_STATUS_001, system-signal=OBJ_MEASUREMENT_STATUS_060}, {implementation-record-element=OBJ_POS_ERR_CRR_COEF_001, system-signal=OBJ_POS_ERR_CRR_COEF_060}, {implementation-record-element=OBJ_DIMENSION_WIDTH_ERR_001, system-signal=OBJ_DIMENSION_WIDTH_ERR_060}, {implementation-record-element=OBJ_MOVEMENT_STATUS_001, system-signal=OBJ_MOVEMENT_STATUS_060}]}
        sender-receiver-to-signal-group-mapping={data-element=Pp_SG_TrackerObject062.Vdp_SG_TrackerObject062, signal-group=SG_TrackerObject062, type-mapping=sender-rec-record-type-mapping=record-element-mappings=[{implementation-record-element=OBJ_ACCELERATION_LAT_001, system-signal=OBJ_ACCELERATION_LAT_062}, {implementation-record-element=OBJ_ACCELERATION_LONG_ERR_001, system-signal=OBJ_ACCELERATION_LONG_ERR_062}, {implementation-record-element=OBJ_CLS_TYPE1_001, system-signal=OBJ_CLS_TYPE1_062}, {implementation-record-element=OBJ_CLS_TYPE1_PROB_001, system-signal=OBJ_CLS_TYPE1_PROB_062}, {implementation-record-element=OBJ_CLS_TYPE3_001, system-signal=OBJ_CLS_TYPE3_062}, {implementation-record-element=OBJ_CLS_TYPE3_PROB_001, system-signal=OBJ_CLS_TYPE3_PROB_062}, {implementation-record-element=OBJ_CLS_TYPE4_001, system-signal=OBJ_CLS_TYPE4_062}, {implementation-record-element=OBJ_CLS_TYPE4_PROB_001, system-signal=OBJ_CLS_TYPE4_PROB_062}, {implementation-record-element=OBJ_ACCELERATION_LONG_001, system-signal=OBJ_ACCELERATION_LONG_062}, {implementation-record-element=OBJ_CLS_TYPE5_001, system-signal=OBJ_CLS_TYPE5_062}, {implementation-record-element=OBJ_ALIVE_TIME_001, system-signal=OBJ_ALIVE_TIME_062}, {implementation-record-element=OBJ_CLS_TYPE5_PROB_001, system-signal=OBJ_CLS_TYPE5_PROB_062}, {implementation-record-element=OBJ_CLS_TYPE6_001, system-signal=OBJ_CLS_TYPE6_062}, {implementation-record-element=OBJ_CLS_TYPE2_PROB_001, system-signal=OBJ_CLS_TYPE2_PROB_062}, {implementation-record-element=OBJ_ACCELERATION_LAT_ERR_001, system-signal=OBJ_ACCELERATION_LAT_ERR_062}, {implementation-record-element=OBJ_ACCEL_ERR_CRR_COEF_001, system-signal=OBJ_ACCEL_ERR_CRR_COEF_062}, {implementation-record-element=OBJ_CLS_TYPE2_001, system-signal=OBJ_CLS_TYPE2_062}, {implementation-record-element=OBJ_POS_ERR_CRR_COEF_001, system-signal=OBJ_POS_ERR_CRR_COEF_062}, {implementation-record-element=OBJ_CLS_TYPE6_PROB_001, system-signal=OBJ_CLS_TYPE6_PROB_062}, {implementation-record-element=OBJ_VEH_TRACK_FLAG_001, system-signal=OBJ_VEH_TRACK_FLAG_062}, {implementation-record-element=OBJ_ID_001, system-signal=OBJ_ID_062}, {implementation-record-element=OBJ_MEASUREMENT_STATUS_001, system-signal=OBJ_MEASUREMENT_STATUS_062}, {implementation-record-element=OBJ_REF_PT_LAT_OFFSET_001, system-signal=OBJ_REF_PT_LAT_OFFSET_062}, {implementation-record-element=OBJ_REF_PT_LONG_OFFSET_001, system-signal=OBJ_REF_PT_LONG_OFFSET_062}, {implementation-record-element=OBJ_YAW_ANGLE_ERR_001, system-signal=OBJ_YAW_ANGLE_ERR_062}, {implementation-record-element=OBJ_GROUP_ID_001, system-signal=OBJ_GROUP_ID_062}, {implementation-record-element=OBJ_YAW_ANGLE_001, system-signal=OBJ_YAW_ANGLE_062}, {implementation-record-element=OBJ_YAW_RATE_001, system-signal=OBJ_YAW_RATE_062}, {implementation-record-element=OBJ_MOVEMENT_STATUS_001, system-signal=OBJ_MOVEMENT_STATUS_062}, {implementation-record-element=OBJ_EXISTENCE_PROB_001, system-signal=OBJ_EXISTENCE_PROB_062}, {implementation-record-element=OBJ_DIMENSION_WIDTH_001, system-signal=OBJ_DIMENSION_WIDTH_062}, {implementation-record-element=OBJ_VELOCITY_LAT_ERR_001, system-signal=OBJ_VELOCITY_LAT_ERR_062}, {implementation-record-element=OBJ_VELOCITY_LONG_ERR_001, system-signal=OBJ_VELOCITY_LONG_ERR_062}, {implementation-record-element=OBJ_DIMENSION_LENGTH_ERR_001, system-signal=OBJ_DIMENSION_LENGTH_ERR_062}, {implementation-record-element=OBJ_VELOCITY_LAT_001, system-signal=OBJ_VELOCITY_LAT_062}, {implementation-record-element=OBJ_TIMESTAMP_OFFSET_001, system-signal=OBJ_TIMESTAMP_OFFSET_062}, {implementation-record-element=OBJ_MH_CYCLE_COUNTER_001, system-signal=OBJ_MH_CYCLE_COUNTER_062}, {implementation-record-element=OBJ_TRACK_MOTION_MODEL_001, system-signal=OBJ_TRACK_MOTION_MODEL_062}, {implementation-record-element=OBJ_DIMENSION_LENGTH_001, system-signal=OBJ_DIMENSION_LENGTH_062}, {implementation-record-element=OBJ_VELOCITY_ERR_CRR_COEF_001, system-signal=OBJ_VELOCITY_ERR_CRR_COEF_062}, {implementation-record-element=OBJ_POS_LAT_ERR_001, system-signal=OBJ_POS_LAT_ERR_062}, {implementation-record-element=OBJ_POS_LAT_001, system-signal=OBJ_POS_LAT_062}, {implementation-record-element=OBJ_POS_LONG_001, system-signal=OBJ_POS_LONG_062}, {implementation-record-element=OBJ_RCS_001, system-signal=OBJ_RCS_062}, {implementation-record-element=OBJ_MH_CRC16_001, system-signal=OBJ_MH_CRC16_062}, {implementation-record-element=OBJ_YAW_RATE_ERR_001, system-signal=OBJ_YAW_RATE_ERR_062}, {implementation-record-element=OBJ_DIMENSION_WIDTH_ERR_001, system-signal=OBJ_DIMENSION_WIDTH_ERR_062}, {implementation-record-element=OBJ_POS_LONG_ERR_001, system-signal=OBJ_POS_LONG_ERR_062}, {implementation-record-element=OBJ_VELOCITY_LONG_001, system-signal=OBJ_VELOCITY_LONG_062}]}
        sender-receiver-to-signal-group-mapping={data-element=Pp_SG_TrackerObject063.Vdp_SG_TrackerObject063, signal-group=SG_TrackerObject063, type-mapping=sender-rec-record-type-mapping=record-element-mappings=[{implementation-record-element=OBJ_CLS_TYPE5_001, system-signal=OBJ_CLS_TYPE5_063}, {implementation-record-element=OBJ_POS_ERR_CRR_COEF_001, system-signal=OBJ_POS_ERR_CRR_COEF_063}, {implementation-record-element=OBJ_POS_LAT_001, system-signal=OBJ_POS_LAT_063}, {implementation-record-element=OBJ_ACCEL_ERR_CRR_COEF_001, system-signal=OBJ_ACCEL_ERR_CRR_COEF_063}, {implementation-record-element=OBJ_ACCELERATION_LAT_001, system-signal=OBJ_ACCELERATION_LAT_063}, {implementation-record-element=OBJ_ACCELERATION_LAT_ERR_001, system-signal=OBJ_ACCELERATION_LAT_ERR_063}, {implementation-record-element=OBJ_ACCELERATION_LONG_001, system-signal=OBJ_ACCELERATION_LONG_063}, {implementation-record-element=OBJ_ACCELERATION_LONG_ERR_001, system-signal=OBJ_ACCELERATION_LONG_ERR_063}, {implementation-record-element=OBJ_ALIVE_TIME_001, system-signal=OBJ_ALIVE_TIME_063}, {implementation-record-element=OBJ_CLS_TYPE1_PROB_001, system-signal=OBJ_CLS_TYPE1_PROB_063}, {implementation-record-element=OBJ_CLS_TYPE4_PROB_001, system-signal=OBJ_CLS_TYPE4_PROB_063}, {implementation-record-element=OBJ_CLS_TYPE3_001, system-signal=OBJ_CLS_TYPE3_063}, {implementation-record-element=OBJ_CLS_TYPE6_PROB_001, system-signal=OBJ_CLS_TYPE6_PROB_063}, {implementation-record-element=OBJ_DIMENSION_LENGTH_ERR_001, system-signal=OBJ_DIMENSION_LENGTH_ERR_063}, {implementation-record-element=OBJ_CLS_TYPE4_001, system-signal=OBJ_CLS_TYPE4_063}, {implementation-record-element=OBJ_DIMENSION_WIDTH_ERR_001, system-signal=OBJ_DIMENSION_WIDTH_ERR_063}, {implementation-record-element=OBJ_DIMENSION_LENGTH_001, system-signal=OBJ_DIMENSION_LENGTH_063}, {implementation-record-element=OBJ_DIMENSION_WIDTH_001, system-signal=OBJ_DIMENSION_WIDTH_063}, {implementation-record-element=OBJ_CLS_TYPE3_PROB_001, system-signal=OBJ_CLS_TYPE3_PROB_063}, {implementation-record-element=OBJ_CLS_TYPE2_PROB_001, system-signal=OBJ_CLS_TYPE2_PROB_063}, {implementation-record-element=OBJ_CLS_TYPE2_001, system-signal=OBJ_CLS_TYPE2_063}, {implementation-record-element=OBJ_CLS_TYPE5_PROB_001, system-signal=OBJ_CLS_TYPE5_PROB_063}, {implementation-record-element=OBJ_CLS_TYPE6_001, system-signal=OBJ_CLS_TYPE6_063}, {implementation-record-element=OBJ_EXISTENCE_PROB_001, system-signal=OBJ_EXISTENCE_PROB_063}, {implementation-record-element=OBJ_GROUP_ID_001, system-signal=OBJ_GROUP_ID_063}, {implementation-record-element=OBJ_ID_001, system-signal=OBJ_ID_063}, {implementation-record-element=OBJ_MEASUREMENT_STATUS_001, system-signal=OBJ_MEASUREMENT_STATUS_063}, {implementation-record-element=OBJ_CLS_TYPE1_001, system-signal=OBJ_CLS_TYPE1_063}, {implementation-record-element=OBJ_MH_CRC16_001, system-signal=OBJ_MH_CRC16_063}, {implementation-record-element=OBJ_MH_CYCLE_COUNTER_001, system-signal=OBJ_MH_CYCLE_COUNTER_063}, {implementation-record-element=OBJ_MOVEMENT_STATUS_001, system-signal=OBJ_MOVEMENT_STATUS_063}, {implementation-record-element=OBJ_YAW_RATE_ERR_001, system-signal=OBJ_YAW_RATE_ERR_063}, {implementation-record-element=OBJ_REF_PT_LONG_OFFSET_001, system-signal=OBJ_REF_PT_LONG_OFFSET_063}, {implementation-record-element=OBJ_VELOCITY_LONG_ERR_001, system-signal=OBJ_VELOCITY_LONG_ERR_063}, {implementation-record-element=OBJ_TIMESTAMP_OFFSET_001, system-signal=OBJ_TIMESTAMP_OFFSET_063}, {implementation-record-element=OBJ_TRACK_MOTION_MODEL_001, system-signal=OBJ_TRACK_MOTION_MODEL_063}, {implementation-record-element=OBJ_POS_LONG_ERR_001, system-signal=OBJ_POS_LONG_ERR_063}, {implementation-record-element=OBJ_VELOCITY_LAT_001, system-signal=OBJ_VELOCITY_LAT_063}, {implementation-record-element=OBJ_VELOCITY_LONG_001, system-signal=OBJ_VELOCITY_LONG_063}, {implementation-record-element=OBJ_VEH_TRACK_FLAG_001, system-signal=OBJ_VEH_TRACK_FLAG_063}, {implementation-record-element=OBJ_POS_LAT_ERR_001, system-signal=OBJ_POS_LAT_ERR_063}, {implementation-record-element=OBJ_YAW_ANGLE_ERR_001, system-signal=OBJ_YAW_ANGLE_ERR_063}, {implementation-record-element=OBJ_VELOCITY_ERR_CRR_COEF_001, system-signal=OBJ_VELOCITY_ERR_CRR_COEF_063}, {implementation-record-element=OBJ_POS_LONG_001, system-signal=OBJ_POS_LONG_063}, {implementation-record-element=OBJ_RCS_001, system-signal=OBJ_RCS_063}, {implementation-record-element=OBJ_YAW_RATE_001, system-signal=OBJ_YAW_RATE_063}, {implementation-record-element=OBJ_REF_PT_LAT_OFFSET_001, system-signal=OBJ_REF_PT_LAT_OFFSET_063}, {implementation-record-element=OBJ_YAW_ANGLE_001, system-signal=OBJ_YAW_ANGLE_063}, {implementation-record-element=OBJ_VELOCITY_LAT_ERR_001, system-signal=OBJ_VELOCITY_LAT_ERR_063}]}
        sender-receiver-to-signal-group-mapping={data-element=Pp_SG_TrackerObject064.Vdp_SG_TrackerObject064, signal-group=SG_TrackerObject064, type-mapping=sender-rec-record-type-mapping=record-element-mappings=[{implementation-record-element=OBJ_VELOCITY_LAT_001, system-signal=OBJ_VELOCITY_LAT_064}, {implementation-record-element=OBJ_CLS_TYPE1_001, system-signal=OBJ_CLS_TYPE1_064}, {implementation-record-element=OBJ_CLS_TYPE5_001, system-signal=OBJ_CLS_TYPE5_064}, {implementation-record-element=OBJ_CLS_TYPE5_PROB_001, system-signal=OBJ_CLS_TYPE5_PROB_064}, {implementation-record-element=OBJ_REF_PT_LONG_OFFSET_001, system-signal=OBJ_REF_PT_LONG_OFFSET_064}, {implementation-record-element=OBJ_ID_001, system-signal=OBJ_ID_064}, {implementation-record-element=OBJ_CLS_TYPE3_PROB_001, system-signal=OBJ_CLS_TYPE3_PROB_064}, {implementation-record-element=OBJ_DIMENSION_LENGTH_ERR_001, system-signal=OBJ_DIMENSION_LENGTH_ERR_064}, {implementation-record-element=OBJ_CLS_TYPE1_PROB_001, system-signal=OBJ_CLS_TYPE1_PROB_064}, {implementation-record-element=OBJ_TIMESTAMP_OFFSET_001, system-signal=OBJ_TIMESTAMP_OFFSET_064}, {implementation-record-element=OBJ_DIMENSION_LENGTH_001, system-signal=OBJ_DIMENSION_LENGTH_064}, {implementation-record-element=OBJ_VELOCITY_ERR_CRR_COEF_001, system-signal=OBJ_VELOCITY_ERR_CRR_COEF_064}, {implementation-record-element=OBJ_ALIVE_TIME_001, system-signal=OBJ_ALIVE_TIME_064}, {implementation-record-element=OBJ_REF_PT_LAT_OFFSET_001, system-signal=OBJ_REF_PT_LAT_OFFSET_064}, {implementation-record-element=OBJ_POS_LAT_001, system-signal=OBJ_POS_LAT_064}, {implementation-record-element=OBJ_VELOCITY_LONG_001, system-signal=OBJ_VELOCITY_LONG_064}, {implementation-record-element=OBJ_CLS_TYPE6_PROB_001, system-signal=OBJ_CLS_TYPE6_PROB_064}, {implementation-record-element=OBJ_VELOCITY_LAT_ERR_001, system-signal=OBJ_VELOCITY_LAT_ERR_064}, {implementation-record-element=OBJ_ACCELERATION_LAT_001, system-signal=OBJ_ACCELERATION_LAT_064}, {implementation-record-element=OBJ_POS_LONG_ERR_001, system-signal=OBJ_POS_LONG_ERR_064}, {implementation-record-element=OBJ_CLS_TYPE3_001, system-signal=OBJ_CLS_TYPE3_064}, {implementation-record-element=OBJ_ACCEL_ERR_CRR_COEF_001, system-signal=OBJ_ACCEL_ERR_CRR_COEF_064}, {implementation-record-element=OBJ_CLS_TYPE4_PROB_001, system-signal=OBJ_CLS_TYPE4_PROB_064}, {implementation-record-element=OBJ_ACCELERATION_LONG_ERR_001, system-signal=OBJ_ACCELERATION_LONG_ERR_064}, {implementation-record-element=OBJ_MH_CYCLE_COUNTER_001, system-signal=OBJ_MH_CYCLE_COUNTER_064}, {implementation-record-element=OBJ_ACCELERATION_LONG_001, system-signal=OBJ_ACCELERATION_LONG_064}, {implementation-record-element=OBJ_CLS_TYPE4_001, system-signal=OBJ_CLS_TYPE4_064}, {implementation-record-element=OBJ_MEASUREMENT_STATUS_001, system-signal=OBJ_MEASUREMENT_STATUS_064}, {implementation-record-element=OBJ_DIMENSION_WIDTH_ERR_001, system-signal=OBJ_DIMENSION_WIDTH_ERR_064}, {implementation-record-element=OBJ_MOVEMENT_STATUS_001, system-signal=OBJ_MOVEMENT_STATUS_064}, {implementation-record-element=OBJ_POS_ERR_CRR_COEF_001, system-signal=OBJ_POS_ERR_CRR_COEF_064}, {implementation-record-element=OBJ_CLS_TYPE2_PROB_001, system-signal=OBJ_CLS_TYPE2_PROB_064}, {implementation-record-element=OBJ_VEH_TRACK_FLAG_001, system-signal=OBJ_VEH_TRACK_FLAG_064}, {implementation-record-element=OBJ_ACCELERATION_LAT_ERR_001, system-signal=OBJ_ACCELERATION_LAT_ERR_064}, {implementation-record-element=OBJ_VELOCITY_LONG_ERR_001, system-signal=OBJ_VELOCITY_LONG_ERR_064}, {implementation-record-element=OBJ_EXISTENCE_PROB_001, system-signal=OBJ_EXISTENCE_PROB_064}, {implementation-record-element=OBJ_MH_CRC16_001, system-signal=OBJ_MH_CRC16_064}, {implementation-record-element=OBJ_CLS_TYPE2_001, system-signal=OBJ_CLS_TYPE2_064}, {implementation-record-element=OBJ_POS_LAT_ERR_001, system-signal=OBJ_POS_LAT_ERR_064}, {implementation-record-element=OBJ_CLS_TYPE6_001, system-signal=OBJ_CLS_TYPE6_064}, {implementation-record-element=OBJ_GROUP_ID_001, system-signal=OBJ_GROUP_ID_064}, {implementation-record-element=OBJ_DIMENSION_WIDTH_001, system-signal=OBJ_DIMENSION_WIDTH_064}, {implementation-record-element=OBJ_POS_LONG_001, system-signal=OBJ_POS_LONG_064}, {implementation-record-element=OBJ_RCS_001, system-signal=OBJ_RCS_064}, {implementation-record-element=OBJ_TRACK_MOTION_MODEL_001, system-signal=OBJ_TRACK_MOTION_MODEL_064}, {implementation-record-element=OBJ_YAW_RATE_001, system-signal=OBJ_YAW_RATE_064}, {implementation-record-element=OBJ_YAW_RATE_ERR_001, system-signal=OBJ_YAW_RATE_ERR_064}, {implementation-record-element=OBJ_YAW_ANGLE_ERR_001, system-signal=OBJ_YAW_ANGLE_ERR_064}, {implementation-record-element=OBJ_YAW_ANGLE_001, system-signal=OBJ_YAW_ANGLE_064}]}
        sender-receiver-to-signal-group-mapping={data-element=Pp_SG_TrackerObject003.Vdp_SG_TrackerObject003, signal-group=SG_TrackerObject003, type-mapping=sender-rec-record-type-mapping=record-element-mappings=[{implementation-record-element=OBJ_CLS_TYPE4_PROB_001, system-signal=OBJ_CLS_TYPE4_PROB_003}, {implementation-record-element=OBJ_ACCELERATION_LAT_001, system-signal=OBJ_ACCELERATION_LAT_003}, {implementation-record-element=OBJ_ACCEL_ERR_CRR_COEF_001, system-signal=OBJ_ACCEL_ERR_CRR_COEF_003}, {implementation-record-element=OBJ_CLS_TYPE1_001, system-signal=OBJ_CLS_TYPE1_003}, {implementation-record-element=OBJ_CLS_TYPE2_001, system-signal=OBJ_CLS_TYPE2_003}, {implementation-record-element=OBJ_ACCELERATION_LONG_001, system-signal=OBJ_ACCELERATION_LONG_003}, {implementation-record-element=OBJ_ACCELERATION_LAT_ERR_001, system-signal=OBJ_ACCELERATION_LAT_ERR_003}, {implementation-record-element=OBJ_ACCELERATION_LONG_ERR_001, system-signal=OBJ_ACCELERATION_LONG_ERR_003}, {implementation-record-element=OBJ_CLS_TYPE2_PROB_001, system-signal=OBJ_CLS_TYPE2_PROB_003}, {implementation-record-element=OBJ_CLS_TYPE5_PROB_001, system-signal=OBJ_CLS_TYPE5_PROB_003}, {implementation-record-element=OBJ_DIMENSION_LENGTH_ERR_001, system-signal=OBJ_DIMENSION_LENGTH_ERR_003}, {implementation-record-element=OBJ_DIMENSION_WIDTH_001, system-signal=OBJ_DIMENSION_WIDTH_003}, {implementation-record-element=OBJ_EXISTENCE_PROB_001, system-signal=OBJ_EXISTENCE_PROB_003}, {implementation-record-element=OBJ_ID_001, system-signal=OBJ_ID_003}, {implementation-record-element=OBJ_MEASUREMENT_STATUS_001, system-signal=OBJ_MEASUREMENT_STATUS_003}, {implementation-record-element=OBJ_MH_CRC16_001, system-signal=OBJ_MH_CRC16_003}, {implementation-record-element=OBJ_MH_CYCLE_COUNTER_001, system-signal=OBJ_MH_CYCLE_COUNTER_003}, {implementation-record-element=OBJ_DIMENSION_LENGTH_001, system-signal=OBJ_DIMENSION_LENGTH_003}, {implementation-record-element=OBJ_GROUP_ID_001, system-signal=OBJ_GROUP_ID_003}, {implementation-record-element=OBJ_MOVEMENT_STATUS_001, system-signal=OBJ_MOVEMENT_STATUS_003}, {implementation-record-element=OBJ_POS_LAT_001, system-signal=OBJ_POS_LAT_003}, {implementation-record-element=OBJ_CLS_TYPE3_PROB_001, system-signal=OBJ_CLS_TYPE3_PROB_003}, {implementation-record-element=OBJ_POS_LAT_ERR_001, system-signal=OBJ_POS_LAT_ERR_003}, {implementation-record-element=OBJ_POS_LONG_001, system-signal=OBJ_POS_LONG_003}, {implementation-record-element=OBJ_CLS_TYPE3_001, system-signal=OBJ_CLS_TYPE3_003}, {implementation-record-element=OBJ_DIMENSION_WIDTH_ERR_001, system-signal=OBJ_DIMENSION_WIDTH_ERR_003}, {implementation-record-element=OBJ_CLS_TYPE4_001, system-signal=OBJ_CLS_TYPE4_003}, {implementation-record-element=OBJ_POS_ERR_CRR_COEF_001, system-signal=OBJ_POS_ERR_CRR_COEF_003}, {implementation-record-element=OBJ_POS_LONG_ERR_001, system-signal=OBJ_POS_LONG_ERR_003}, {implementation-record-element=OBJ_CLS_TYPE1_PROB_001, system-signal=OBJ_CLS_TYPE1_PROB_003}, {implementation-record-element=OBJ_CLS_TYPE5_001, system-signal=OBJ_CLS_TYPE5_003}, {implementation-record-element=OBJ_CLS_TYPE6_001, system-signal=OBJ_CLS_TYPE6_003}, {implementation-record-element=OBJ_CLS_TYPE6_PROB_001, system-signal=OBJ_CLS_TYPE6_PROB_003}, {implementation-record-element=OBJ_ALIVE_TIME_001, system-signal=OBJ_ALIVE_TIME_003}, {implementation-record-element=OBJ_YAW_RATE_ERR_001, system-signal=OBJ_YAW_RATE_ERR_003}, {implementation-record-element=OBJ_VELOCITY_LAT_001, system-signal=OBJ_VELOCITY_LAT_003}, {implementation-record-element=OBJ_TRACK_MOTION_MODEL_001, system-signal=OBJ_TRACK_MOTION_MODEL_003}, {implementation-record-element=OBJ_VELOCITY_LONG_001, system-signal=OBJ_VELOCITY_LONG_003}, {implementation-record-element=OBJ_VEH_TRACK_FLAG_001, system-signal=OBJ_VEH_TRACK_FLAG_003}, {implementation-record-element=OBJ_RCS_001, system-signal=OBJ_RCS_003}, {implementation-record-element=OBJ_VELOCITY_ERR_CRR_COEF_001, system-signal=OBJ_VELOCITY_ERR_CRR_COEF_003}, {implementation-record-element=OBJ_YAW_ANGLE_001, system-signal=OBJ_YAW_ANGLE_003}, {implementation-record-element=OBJ_YAW_RATE_001, system-signal=OBJ_YAW_RATE_003}, {implementation-record-element=OBJ_VELOCITY_LAT_ERR_001, system-signal=OBJ_VELOCITY_LAT_ERR_003}, {implementation-record-element=OBJ_REF_PT_LONG_OFFSET_001, system-signal=OBJ_REF_PT_LONG_OFFSET_003}, {implementation-record-element=OBJ_REF_PT_LAT_OFFSET_001, system-signal=OBJ_REF_PT_LAT_OFFSET_003}, {implementation-record-element=OBJ_VELOCITY_LONG_ERR_001, system-signal=OBJ_VELOCITY_LONG_ERR_003}, {implementation-record-element=OBJ_YAW_ANGLE_ERR_001, system-signal=OBJ_YAW_ANGLE_ERR_003}, {implementation-record-element=OBJ_TIMESTAMP_OFFSET_001, system-signal=OBJ_TIMESTAMP_OFFSET_003}]}
        sender-receiver-to-signal-group-mapping={data-element=Pp_SG_TrackerObject004.Vdp_SG_TrackerObject004, signal-group=SG_TrackerObject004, type-mapping=sender-rec-record-type-mapping=record-element-mappings=[{implementation-record-element=OBJ_CLS_TYPE3_PROB_001, system-signal=OBJ_CLS_TYPE3_PROB_004}, {implementation-record-element=OBJ_ACCEL_ERR_CRR_COEF_001, system-signal=OBJ_ACCEL_ERR_CRR_COEF_004}, {implementation-record-element=OBJ_ACCELERATION_LAT_001, system-signal=OBJ_ACCELERATION_LAT_004}, {implementation-record-element=OBJ_ACCELERATION_LAT_ERR_001, system-signal=OBJ_ACCELERATION_LAT_ERR_004}, {implementation-record-element=OBJ_CLS_TYPE2_001, system-signal=OBJ_CLS_TYPE2_004}, {implementation-record-element=OBJ_CLS_TYPE6_PROB_001, system-signal=OBJ_CLS_TYPE6_PROB_004}, {implementation-record-element=OBJ_DIMENSION_WIDTH_001, system-signal=OBJ_DIMENSION_WIDTH_004}, {implementation-record-element=OBJ_MOVEMENT_STATUS_001, system-signal=OBJ_MOVEMENT_STATUS_004}, {implementation-record-element=OBJ_POS_LONG_001, system-signal=OBJ_POS_LONG_004}, {implementation-record-element=OBJ_TIMESTAMP_OFFSET_001, system-signal=OBJ_TIMESTAMP_OFFSET_004}, {implementation-record-element=OBJ_VELOCITY_ERR_CRR_COEF_001, system-signal=OBJ_VELOCITY_ERR_CRR_COEF_004}, {implementation-record-element=OBJ_VELOCITY_LAT_001, system-signal=OBJ_VELOCITY_LAT_004}, {implementation-record-element=OBJ_DIMENSION_LENGTH_ERR_001, system-signal=OBJ_DIMENSION_LENGTH_ERR_004}, {implementation-record-element=OBJ_CLS_TYPE4_PROB_001, system-signal=OBJ_CLS_TYPE4_PROB_004}, {implementation-record-element=OBJ_CLS_TYPE4_001, system-signal=OBJ_CLS_TYPE4_004}, {implementation-record-element=OBJ_DIMENSION_WIDTH_ERR_001, system-signal=OBJ_DIMENSION_WIDTH_ERR_004}, {implementation-record-element=OBJ_MH_CYCLE_COUNTER_001, system-signal=OBJ_MH_CYCLE_COUNTER_004}, {implementation-record-element=OBJ_CLS_TYPE3_001, system-signal=OBJ_CLS_TYPE3_004}, {implementation-record-element=OBJ_GROUP_ID_001, system-signal=OBJ_GROUP_ID_004}, {implementation-record-element=OBJ_POS_ERR_CRR_COEF_001, system-signal=OBJ_POS_ERR_CRR_COEF_004}, {implementation-record-element=OBJ_ALIVE_TIME_001, system-signal=OBJ_ALIVE_TIME_004}, {implementation-record-element=OBJ_EXISTENCE_PROB_001, system-signal=OBJ_EXISTENCE_PROB_004}, {implementation-record-element=OBJ_POS_LONG_ERR_001, system-signal=OBJ_POS_LONG_ERR_004}, {implementation-record-element=OBJ_DIMENSION_LENGTH_001, system-signal=OBJ_DIMENSION_LENGTH_004}, {implementation-record-element=OBJ_ACCELERATION_LONG_ERR_001, system-signal=OBJ_ACCELERATION_LONG_ERR_004}, {implementation-record-element=OBJ_MEASUREMENT_STATUS_001, system-signal=OBJ_MEASUREMENT_STATUS_004}, {implementation-record-element=OBJ_MH_CRC16_001, system-signal=OBJ_MH_CRC16_004}, {implementation-record-element=OBJ_REF_PT_LAT_OFFSET_001, system-signal=OBJ_REF_PT_LAT_OFFSET_004}, {implementation-record-element=OBJ_RCS_001, system-signal=OBJ_RCS_004}, {implementation-record-element=OBJ_REF_PT_LONG_OFFSET_001, system-signal=OBJ_REF_PT_LONG_OFFSET_004}, {implementation-record-element=OBJ_VEH_TRACK_FLAG_001, system-signal=OBJ_VEH_TRACK_FLAG_004}, {implementation-record-element=OBJ_CLS_TYPE5_001, system-signal=OBJ_CLS_TYPE5_004}, {implementation-record-element=OBJ_VELOCITY_LAT_ERR_001, system-signal=OBJ_VELOCITY_LAT_ERR_004}, {implementation-record-element=OBJ_VELOCITY_LONG_001, system-signal=OBJ_VELOCITY_LONG_004}, {implementation-record-element=OBJ_POS_LAT_ERR_001, system-signal=OBJ_POS_LAT_ERR_004}, {implementation-record-element=OBJ_ID_001, system-signal=OBJ_ID_004}, {implementation-record-element=OBJ_VELOCITY_LONG_ERR_001, system-signal=OBJ_VELOCITY_LONG_ERR_004}, {implementation-record-element=OBJ_YAW_ANGLE_001, system-signal=OBJ_YAW_ANGLE_004}, {implementation-record-element=OBJ_YAW_ANGLE_ERR_001, system-signal=OBJ_YAW_ANGLE_ERR_004}, {implementation-record-element=OBJ_YAW_RATE_001, system-signal=OBJ_YAW_RATE_004}, {implementation-record-element=OBJ_CLS_TYPE1_001, system-signal=OBJ_CLS_TYPE1_004}, {implementation-record-element=OBJ_CLS_TYPE5_PROB_001, system-signal=OBJ_CLS_TYPE5_PROB_004}, {implementation-record-element=OBJ_CLS_TYPE2_PROB_001, system-signal=OBJ_CLS_TYPE2_PROB_004}, {implementation-record-element=OBJ_CLS_TYPE6_001, system-signal=OBJ_CLS_TYPE6_004}, {implementation-record-element=OBJ_POS_LAT_001, system-signal=OBJ_POS_LAT_004}, {implementation-record-element=OBJ_TRACK_MOTION_MODEL_001, system-signal=OBJ_TRACK_MOTION_MODEL_004}, {implementation-record-element=OBJ_CLS_TYPE1_PROB_001, system-signal=OBJ_CLS_TYPE1_PROB_004}, {implementation-record-element=OBJ_ACCELERATION_LONG_001, system-signal=OBJ_ACCELERATION_LONG_004}, {implementation-record-element=OBJ_YAW_RATE_ERR_001, system-signal=OBJ_YAW_RATE_ERR_004}]}
        sender-receiver-to-signal-group-mapping={data-element=Pp_SG_TrackerObject005.Vdp_SG_TrackerObject005, signal-group=SG_TrackerObject005, type-mapping=sender-rec-record-type-mapping=record-element-mappings=[{implementation-record-element=OBJ_RCS_001, system-signal=OBJ_RCS_005}, {implementation-record-element=OBJ_ACCELERATION_LAT_001, system-signal=OBJ_ACCELERATION_LAT_005}, {implementation-record-element=OBJ_REF_PT_LONG_OFFSET_001, system-signal=OBJ_REF_PT_LONG_OFFSET_005}, {implementation-record-element=OBJ_YAW_ANGLE_001, system-signal=OBJ_YAW_ANGLE_005}, {implementation-record-element=OBJ_POS_ERR_CRR_COEF_001, system-signal=OBJ_POS_ERR_CRR_COEF_005}, {implementation-record-element=OBJ_POS_LAT_001, system-signal=OBJ_POS_LAT_005}, {implementation-record-element=OBJ_YAW_ANGLE_ERR_001, system-signal=OBJ_YAW_ANGLE_ERR_005}, {implementation-record-element=OBJ_CLS_TYPE5_001, system-signal=OBJ_CLS_TYPE5_005}, {implementation-record-element=OBJ_EXISTENCE_PROB_001, system-signal=OBJ_EXISTENCE_PROB_005}, {implementation-record-element=OBJ_MH_CYCLE_COUNTER_001, system-signal=OBJ_MH_CYCLE_COUNTER_005}, {implementation-record-element=OBJ_CLS_TYPE5_PROB_001, system-signal=OBJ_CLS_TYPE5_PROB_005}, {implementation-record-element=OBJ_DIMENSION_WIDTH_ERR_001, system-signal=OBJ_DIMENSION_WIDTH_ERR_005}, {implementation-record-element=OBJ_ID_001, system-signal=OBJ_ID_005}, {implementation-record-element=OBJ_MEASUREMENT_STATUS_001, system-signal=OBJ_MEASUREMENT_STATUS_005}, {implementation-record-element=OBJ_YAW_RATE_001, system-signal=OBJ_YAW_RATE_005}, {implementation-record-element=OBJ_GROUP_ID_001, system-signal=OBJ_GROUP_ID_005}, {implementation-record-element=OBJ_VELOCITY_LAT_ERR_001, system-signal=OBJ_VELOCITY_LAT_ERR_005}, {implementation-record-element=OBJ_VELOCITY_LAT_001, system-signal=OBJ_VELOCITY_LAT_005}, {implementation-record-element=OBJ_CLS_TYPE3_PROB_001, system-signal=OBJ_CLS_TYPE3_PROB_005}, {implementation-record-element=OBJ_DIMENSION_WIDTH_001, system-signal=OBJ_DIMENSION_WIDTH_005}, {implementation-record-element=OBJ_CLS_TYPE1_001, system-signal=OBJ_CLS_TYPE1_005}, {implementation-record-element=OBJ_VEH_TRACK_FLAG_001, system-signal=OBJ_VEH_TRACK_FLAG_005}, {implementation-record-element=OBJ_POS_LONG_ERR_001, system-signal=OBJ_POS_LONG_ERR_005}, {implementation-record-element=OBJ_ALIVE_TIME_001, system-signal=OBJ_ALIVE_TIME_005}, {implementation-record-element=OBJ_ACCELERATION_LONG_001, system-signal=OBJ_ACCELERATION_LONG_005}, {implementation-record-element=OBJ_ACCELERATION_LAT_ERR_001, system-signal=OBJ_ACCELERATION_LAT_ERR_005}, {implementation-record-element=OBJ_ACCELERATION_LONG_ERR_001, system-signal=OBJ_ACCELERATION_LONG_ERR_005}, {implementation-record-element=OBJ_CLS_TYPE1_PROB_001, system-signal=OBJ_CLS_TYPE1_PROB_005}, {implementation-record-element=OBJ_YAW_RATE_ERR_001, system-signal=OBJ_YAW_RATE_ERR_005}, {implementation-record-element=OBJ_POS_LONG_001, system-signal=OBJ_POS_LONG_005}, {implementation-record-element=OBJ_CLS_TYPE3_001, system-signal=OBJ_CLS_TYPE3_005}, {implementation-record-element=OBJ_ACCEL_ERR_CRR_COEF_001, system-signal=OBJ_ACCEL_ERR_CRR_COEF_005}, {implementation-record-element=OBJ_VELOCITY_LONG_001, system-signal=OBJ_VELOCITY_LONG_005}, {implementation-record-element=OBJ_POS_LAT_ERR_001, system-signal=OBJ_POS_LAT_ERR_005}, {implementation-record-element=OBJ_CLS_TYPE4_001, system-signal=OBJ_CLS_TYPE4_005}, {implementation-record-element=OBJ_CLS_TYPE2_PROB_001, system-signal=OBJ_CLS_TYPE2_PROB_005}, {implementation-record-element=OBJ_CLS_TYPE4_PROB_001, system-signal=OBJ_CLS_TYPE4_PROB_005}, {implementation-record-element=OBJ_MOVEMENT_STATUS_001, system-signal=OBJ_MOVEMENT_STATUS_005}, {implementation-record-element=OBJ_CLS_TYPE6_001, system-signal=OBJ_CLS_TYPE6_005}, {implementation-record-element=OBJ_REF_PT_LAT_OFFSET_001, system-signal=OBJ_REF_PT_LAT_OFFSET_005}, {implementation-record-element=OBJ_TIMESTAMP_OFFSET_001, system-signal=OBJ_TIMESTAMP_OFFSET_005}, {implementation-record-element=OBJ_CLS_TYPE6_PROB_001, system-signal=OBJ_CLS_TYPE6_PROB_005}, {implementation-record-element=OBJ_DIMENSION_LENGTH_001, system-signal=OBJ_DIMENSION_LENGTH_005}, {implementation-record-element=OBJ_CLS_TYPE2_001, system-signal=OBJ_CLS_TYPE2_005}, {implementation-record-element=OBJ_TRACK_MOTION_MODEL_001, system-signal=OBJ_TRACK_MOTION_MODEL_005}, {implementation-record-element=OBJ_DIMENSION_LENGTH_ERR_001, system-signal=OBJ_DIMENSION_LENGTH_ERR_005}, {implementation-record-element=OBJ_MH_CRC16_001, system-signal=OBJ_MH_CRC16_005}, {implementation-record-element=OBJ_VELOCITY_ERR_CRR_COEF_001, system-signal=OBJ_VELOCITY_ERR_CRR_COEF_005}, {implementation-record-element=OBJ_VELOCITY_LONG_ERR_001, system-signal=OBJ_VELOCITY_LONG_ERR_005}]}
        sender-receiver-to-signal-group-mapping={data-element=Pp_SG_TrackerObject006.Vdp_SG_TrackerObject006, signal-group=SG_TrackerObject006, type-mapping=sender-rec-record-type-mapping=record-element-mappings=[{implementation-record-element=OBJ_ACCELERATION_LAT_001, system-signal=OBJ_ACCELERATION_LAT_006}, {implementation-record-element=OBJ_ACCEL_ERR_CRR_COEF_001, system-signal=OBJ_ACCEL_ERR_CRR_COEF_006}, {implementation-record-element=OBJ_ACCELERATION_LAT_ERR_001, system-signal=OBJ_ACCELERATION_LAT_ERR_006}, {implementation-record-element=OBJ_ACCELERATION_LONG_001, system-signal=OBJ_ACCELERATION_LONG_006}, {implementation-record-element=OBJ_ACCELERATION_LONG_ERR_001, system-signal=OBJ_ACCELERATION_LONG_ERR_006}, {implementation-record-element=OBJ_ALIVE_TIME_001, system-signal=OBJ_ALIVE_TIME_006}, {implementation-record-element=OBJ_CLS_TYPE1_001, system-signal=OBJ_CLS_TYPE1_006}, {implementation-record-element=OBJ_CLS_TYPE1_PROB_001, system-signal=OBJ_CLS_TYPE1_PROB_006}, {implementation-record-element=OBJ_CLS_TYPE2_001, system-signal=OBJ_CLS_TYPE2_006}, {implementation-record-element=OBJ_CLS_TYPE2_PROB_001, system-signal=OBJ_CLS_TYPE2_PROB_006}, {implementation-record-element=OBJ_CLS_TYPE3_001, system-signal=OBJ_CLS_TYPE3_006}, {implementation-record-element=OBJ_CLS_TYPE3_PROB_001, system-signal=OBJ_CLS_TYPE3_PROB_006}, {implementation-record-element=OBJ_MEASUREMENT_STATUS_001, system-signal=OBJ_MEASUREMENT_STATUS_006}, {implementation-record-element=OBJ_POS_LONG_ERR_001, system-signal=OBJ_POS_LONG_ERR_006}, {implementation-record-element=OBJ_VELOCITY_ERR_CRR_COEF_001, system-signal=OBJ_VELOCITY_ERR_CRR_COEF_006}, {implementation-record-element=OBJ_VELOCITY_LAT_001, system-signal=OBJ_VELOCITY_LAT_006}, {implementation-record-element=OBJ_ID_001, system-signal=OBJ_ID_006}, {implementation-record-element=OBJ_MOVEMENT_STATUS_001, system-signal=OBJ_MOVEMENT_STATUS_006}, {implementation-record-element=OBJ_VELOCITY_LAT_ERR_001, system-signal=OBJ_VELOCITY_LAT_ERR_006}, {implementation-record-element=OBJ_VEH_TRACK_FLAG_001, system-signal=OBJ_VEH_TRACK_FLAG_006}, {implementation-record-element=OBJ_DIMENSION_LENGTH_ERR_001, system-signal=OBJ_DIMENSION_LENGTH_ERR_006}, {implementation-record-element=OBJ_POS_LAT_ERR_001, system-signal=OBJ_POS_LAT_ERR_006}, {implementation-record-element=OBJ_POS_LONG_001, system-signal=OBJ_POS_LONG_006}, {implementation-record-element=OBJ_MH_CYCLE_COUNTER_001, system-signal=OBJ_MH_CYCLE_COUNTER_006}, {implementation-record-element=OBJ_VELOCITY_LONG_001, system-signal=OBJ_VELOCITY_LONG_006}, {implementation-record-element=OBJ_MH_CRC16_001, system-signal=OBJ_MH_CRC16_006}, {implementation-record-element=OBJ_CLS_TYPE5_001, system-signal=OBJ_CLS_TYPE5_006}, {implementation-record-element=OBJ_CLS_TYPE6_PROB_001, system-signal=OBJ_CLS_TYPE6_PROB_006}, {implementation-record-element=OBJ_YAW_ANGLE_ERR_001, system-signal=OBJ_YAW_ANGLE_ERR_006}, {implementation-record-element=OBJ_CLS_TYPE5_PROB_001, system-signal=OBJ_CLS_TYPE5_PROB_006}, {implementation-record-element=OBJ_EXISTENCE_PROB_001, system-signal=OBJ_EXISTENCE_PROB_006}, {implementation-record-element=OBJ_POS_ERR_CRR_COEF_001, system-signal=OBJ_POS_ERR_CRR_COEF_006}, {implementation-record-element=OBJ_YAW_RATE_001, system-signal=OBJ_YAW_RATE_006}, {implementation-record-element=OBJ_GROUP_ID_001, system-signal=OBJ_GROUP_ID_006}, {implementation-record-element=OBJ_DIMENSION_WIDTH_ERR_001, system-signal=OBJ_DIMENSION_WIDTH_ERR_006}, {implementation-record-element=OBJ_REF_PT_LAT_OFFSET_001, system-signal=OBJ_REF_PT_LAT_OFFSET_006}, {implementation-record-element=OBJ_TRACK_MOTION_MODEL_001, system-signal=OBJ_TRACK_MOTION_MODEL_006}, {implementation-record-element=OBJ_DIMENSION_WIDTH_001, system-signal=OBJ_DIMENSION_WIDTH_006}, {implementation-record-element=OBJ_CLS_TYPE4_PROB_001, system-signal=OBJ_CLS_TYPE4_PROB_006}, {implementation-record-element=OBJ_CLS_TYPE6_001, system-signal=OBJ_CLS_TYPE6_006}, {implementation-record-element=OBJ_YAW_ANGLE_001, system-signal=OBJ_YAW_ANGLE_006}, {implementation-record-element=OBJ_POS_LAT_001, system-signal=OBJ_POS_LAT_006}, {implementation-record-element=OBJ_TIMESTAMP_OFFSET_001, system-signal=OBJ_TIMESTAMP_OFFSET_006}, {implementation-record-element=OBJ_DIMENSION_LENGTH_001, system-signal=OBJ_DIMENSION_LENGTH_006}, {implementation-record-element=OBJ_YAW_RATE_ERR_001, system-signal=OBJ_YAW_RATE_ERR_006}, {implementation-record-element=OBJ_REF_PT_LONG_OFFSET_001, system-signal=OBJ_REF_PT_LONG_OFFSET_006}, {implementation-record-element=OBJ_CLS_TYPE4_001, system-signal=OBJ_CLS_TYPE4_006}, {implementation-record-element=OBJ_VELOCITY_LONG_ERR_001, system-signal=OBJ_VELOCITY_LONG_ERR_006}, {implementation-record-element=OBJ_RCS_001, system-signal=OBJ_RCS_006}]}
        sender-receiver-to-signal-group-mapping={data-element=Pp_SG_TrackerObject007.Vdp_SG_TrackerObject007, signal-group=SG_TrackerObject007, type-mapping=sender-rec-record-type-mapping=record-element-mappings=[{implementation-record-element=OBJ_DIMENSION_WIDTH_ERR_001, system-signal=OBJ_DIMENSION_WIDTH_ERR_007}, {implementation-record-element=OBJ_CLS_TYPE4_PROB_001, system-signal=OBJ_CLS_TYPE4_PROB_007}, {implementation-record-element=OBJ_ACCELERATION_LONG_ERR_001, system-signal=OBJ_ACCELERATION_LONG_ERR_007}, {implementation-record-element=OBJ_CLS_TYPE5_001, system-signal=OBJ_CLS_TYPE5_007}, {implementation-record-element=OBJ_CLS_TYPE4_001, system-signal=OBJ_CLS_TYPE4_007}, {implementation-record-element=OBJ_CLS_TYPE5_PROB_001, system-signal=OBJ_CLS_TYPE5_PROB_007}, {implementation-record-element=OBJ_EXISTENCE_PROB_001, system-signal=OBJ_EXISTENCE_PROB_007}, {implementation-record-element=OBJ_GROUP_ID_001, system-signal=OBJ_GROUP_ID_007}, {implementation-record-element=OBJ_ID_001, system-signal=OBJ_ID_007}, {implementation-record-element=OBJ_MEASUREMENT_STATUS_001, system-signal=OBJ_MEASUREMENT_STATUS_007}, {implementation-record-element=OBJ_ACCELERATION_LONG_001, system-signal=OBJ_ACCELERATION_LONG_007}, {implementation-record-element=OBJ_ACCELERATION_LAT_ERR_001, system-signal=OBJ_ACCELERATION_LAT_ERR_007}, {implementation-record-element=OBJ_ACCEL_ERR_CRR_COEF_001, system-signal=OBJ_ACCEL_ERR_CRR_COEF_007}, {implementation-record-element=OBJ_ALIVE_TIME_001, system-signal=OBJ_ALIVE_TIME_007}, {implementation-record-element=OBJ_CLS_TYPE1_001, system-signal=OBJ_CLS_TYPE1_007}, {implementation-record-element=OBJ_CLS_TYPE1_PROB_001, system-signal=OBJ_CLS_TYPE1_PROB_007}, {implementation-record-element=OBJ_CLS_TYPE2_PROB_001, system-signal=OBJ_CLS_TYPE2_PROB_007}, {implementation-record-element=OBJ_CLS_TYPE3_001, system-signal=OBJ_CLS_TYPE3_007}, {implementation-record-element=OBJ_ACCELERATION_LAT_001, system-signal=OBJ_ACCELERATION_LAT_007}, {implementation-record-element=OBJ_CLS_TYPE3_PROB_001, system-signal=OBJ_CLS_TYPE3_PROB_007}, {implementation-record-element=OBJ_CLS_TYPE6_001, system-signal=OBJ_CLS_TYPE6_007}, {implementation-record-element=OBJ_CLS_TYPE6_PROB_001, system-signal=OBJ_CLS_TYPE6_PROB_007}, {implementation-record-element=OBJ_CLS_TYPE2_001, system-signal=OBJ_CLS_TYPE2_007}, {implementation-record-element=OBJ_DIMENSION_LENGTH_001, system-signal=OBJ_DIMENSION_LENGTH_007}, {implementation-record-element=OBJ_DIMENSION_LENGTH_ERR_001, system-signal=OBJ_DIMENSION_LENGTH_ERR_007}, {implementation-record-element=OBJ_DIMENSION_WIDTH_001, system-signal=OBJ_DIMENSION_WIDTH_007}, {implementation-record-element=OBJ_VELOCITY_LAT_ERR_001, system-signal=OBJ_VELOCITY_LAT_ERR_007}, {implementation-record-element=OBJ_POS_ERR_CRR_COEF_001, system-signal=OBJ_POS_ERR_CRR_COEF_007}, {implementation-record-element=OBJ_VELOCITY_LONG_ERR_001, system-signal=OBJ_VELOCITY_LONG_ERR_007}, {implementation-record-element=OBJ_TIMESTAMP_OFFSET_001, system-signal=OBJ_TIMESTAMP_OFFSET_007}, {implementation-record-element=OBJ_TRACK_MOTION_MODEL_001, system-signal=OBJ_TRACK_MOTION_MODEL_007}, {implementation-record-element=OBJ_REF_PT_LAT_OFFSET_001, system-signal=OBJ_REF_PT_LAT_OFFSET_007}, {implementation-record-element=OBJ_POS_LAT_001, system-signal=OBJ_POS_LAT_007}, {implementation-record-element=OBJ_POS_LONG_001, system-signal=OBJ_POS_LONG_007}, {implementation-record-element=OBJ_POS_LONG_ERR_001, system-signal=OBJ_POS_LONG_ERR_007}, {implementation-record-element=OBJ_POS_LAT_ERR_001, system-signal=OBJ_POS_LAT_ERR_007}, {implementation-record-element=OBJ_MH_CRC16_001, system-signal=OBJ_MH_CRC16_007}, {implementation-record-element=OBJ_VELOCITY_LAT_001, system-signal=OBJ_VELOCITY_LAT_007}, {implementation-record-element=OBJ_YAW_RATE_001, system-signal=OBJ_YAW_RATE_007}, {implementation-record-element=OBJ_VELOCITY_ERR_CRR_COEF_001, system-signal=OBJ_VELOCITY_ERR_CRR_COEF_007}, {implementation-record-element=OBJ_VEH_TRACK_FLAG_001, system-signal=OBJ_VEH_TRACK_FLAG_007}, {implementation-record-element=OBJ_REF_PT_LONG_OFFSET_001, system-signal=OBJ_REF_PT_LONG_OFFSET_007}, {implementation-record-element=OBJ_YAW_ANGLE_001, system-signal=OBJ_YAW_ANGLE_007}, {implementation-record-element=OBJ_YAW_ANGLE_ERR_001, system-signal=OBJ_YAW_ANGLE_ERR_007}, {implementation-record-element=OBJ_MH_CYCLE_COUNTER_001, system-signal=OBJ_MH_CYCLE_COUNTER_007}, {implementation-record-element=OBJ_VELOCITY_LONG_001, system-signal=OBJ_VELOCITY_LONG_007}, {implementation-record-element=OBJ_RCS_001, system-signal=OBJ_RCS_007}, {implementation-record-element=OBJ_YAW_RATE_ERR_001, system-signal=OBJ_YAW_RATE_ERR_007}, {implementation-record-element=OBJ_MOVEMENT_STATUS_001, system-signal=OBJ_MOVEMENT_STATUS_007}]}
