[part 6 of 10: package /System]
AUTOSAR XML (schema 00053)
package /System  (continued)
  system System  (continued)
    system mapping System_MPPNG  (continued)
      data-mappings:  (continued)
        sender-receiver-to-signal-group-mapping={data-element=Pp_SG_Detections_365_368_AL.Vdp_SG_Detections_365_368_AL, signal-group=SG_Detections_365_368, type-mapping=sender-rec-record-type-mapping=record-element-mappings=[{application-record-element=DET_AZIMUTH_365, system-signal=DET_AZIMUTH_365}, {application-record-element=DET_AZIMUTH_366, system-signal=DET_AZIMUTH_366}, {application-record-element=DET_AZIMUTH_367, system-signal=DET_AZIMUTH_367}, {application-record-element=DET_AZIMUTH_368, system-signal=DET_AZIMUTH_368}, {application-record-element=DET_AZIMUTH_ERR_365, system-signal=DET_AZIMUTH_ERR_365}, {application-record-element=DET_AZIMUTH_ERR_366, system-signal=DET_AZIMUTH_ERR_366}, {application-record-element=DET_AZIMUTH_ERR_367, system-signal=DET_AZIMUTH_ERR_367}, {application-record-element=DET_AZIMUTH_ERR_368, system-signal=DET_AZIMUTH_ERR_368}, {application-record-element=DET_BELOW_RAIN_THOLD_365, system-signal=DET_BELOW_RAIN_THOLD_365}, {application-record-element=DET_BELOW_RAIN_THOLD_366, system-signal=DET_BELOW_RAIN_THOLD_366}, {application-record-element=DET_BELOW_RAIN_THOLD_367, system-signal=DET_BELOW_RAIN_THOLD_367}, {application-record-element=DET_BELOW_RAIN_THOLD_368, system-signal=DET_BELOW_RAIN_THOLD_368}, {application-record-element=DET_BI_STATIC_FLAG_365, system-signal=DET_BI_STATIC_FLAG_365}, {application-record-element=DET_BI_STATIC_FLAG_366, system-signal=DET_BI_STATIC_FLAG_366}, {application-record-element=DET_BI_STATIC_FLAG_367, system-signal=DET_BI_STATIC_FLAG_367}, {application-record-element=DET_BI_STATIC_FLAG_368, system-signal=DET_BI_STATIC_FLAG_368}, {application-record-element=DET_CONFD_AZIMUTH_365, system-signal=DET_CONFD_AZIMUTH_365}, {application-record-element=DET_CONFD_AZIMUTH_366, system-signal=DET_CONFD_AZIMUTH_366}, {application-record-element=DET_CONFD_AZIMUTH_367, system-signal=DET_CONFD_AZIMUTH_367}, {application-record-element=DET_CONFD_AZIMUTH_368, system-signal=DET_CONFD_AZIMUTH_368}, {application-record-element=DET_CONFD_ELEVATION_365, system-signal=DET_CONFD_ELEVATION_365}, {application-record-element=DET_CONFD_ELEVATION_366, system-signal=DET_CONFD_ELEVATION_366}, {application-record-element=DET_CONFD_ELEVATION_367, system-signal=DET_CONFD_ELEVATION_367}, {application-record-element=DET_CONFD_ELEVATION_368, system-signal=DET_CONFD_ELEVATION_368}, {application-record-element=DET_ELEVATION_365, system-signal=DET_ELEVATION_365}, {application-record-element=DET_ELEVATION_366, system-signal=DET_ELEVATION_366}, {application-record-element=DET_ELEVATION_367, system-signal=DET_ELEVATION_367}, {application-record-element=DET_ELEVATION_368, system-signal=DET_ELEVATION_368}, {application-record-element=DET_ELEVATION_ERR_365, system-signal=DET_ELEVATION_ERR_365}, {application-record-element=DET_ELEVATION_ERR_366, system-signal=DET_ELEVATION_ERR_366}, {application-record-element=DET_ELEVATION_ERR_367, system-signal=DET_ELEVATION_ERR_367}, {application-record-element=DET_ELEVATION_ERR_368, system-signal=DET_ELEVATION_ERR_368}, {application-record-element=DET_EXISTENCE_PROB_365, system-signal=DET_EXISTENCE_PROB_365}, {application-record-element=DET_EXISTENCE_PROB_366, system-signal=DET_EXISTENCE_PROB_366}, {application-record-element=DET_EXISTENCE_PROB_367, system-signal=DET_EXISTENCE_PROB_367}, {application-record-element=DET_EXISTENCE_PROB_368, system-signal=DET_EXISTENCE_PROB_368}, {application-record-element=DET_HVC_FLAG_365, system-signal=DET_HVC_FLAG_365}, {application-record-element=DET_HVC_FLAG_366, system-signal=DET_HVC_FLAG_366}, {application-record-element=DET_HVC_FLAG_367, system-signal=DET_HVC_FLAG_367}, {application-record-element=DET_HVC_FLAG_368, system-signal=DET_HVC_FLAG_368}, {application-record-element=DET_IDM_365, system-signal=DET_IDM_365}, {application-record-element=DET_IDM_366, system-signal=DET_IDM_366}, {application-record-element=DET_IDM_367, system-signal=DET_IDM_367}, {application-record-element=DET_IDM_368, system-signal=DET_IDM_368}, {application-record-element=DET_MH_CRC16_365_368, system-signal=DET_MH_CRC16_365_368}, {application-record-element=DET_MH_CYCLE_COUNTER_365_368, system-signal=DET_MH_CYCLE_COUNTER_365_368}, {application-record-element=DET_MH_SCAN_INDEX_4LSB_365_368, system-signal=DET_MH_SCAN_INDEX_4LSB_365_368}, {application-record-element=DET_MTD_365, system-signal=DET_MTD_365}, {application-record-element=DET_MTD_366, system-signal=DET_MTD_366}, {application-record-element=DET_MTD_367, system-signal=DET_MTD_367}, {application-record-element=DET_MTD_368, system-signal=DET_MTD_368}, {application-record-element=DET_PROB_1STAZHYPO_365, system-signal=DET_PROB_1STAZHYPO_365}, {application-record-element=DET_PROB_1STAZHYPO_366, system-signal=DET_PROB_1STAZHYPO_366}, {application-record-element=DET_PROB_1STAZHYPO_367, system-signal=DET_PROB_1STAZHYPO_367}, {application-record-element=DET_PROB_1STAZHYPO_368, system-signal=DET_PROB_1STAZHYPO_368}, {application-record-element=DET_RANGE_365, system-signal=DET_RANGE_365}, {application-record-element=DET_RANGE_366, system-signal=DET_RANGE_366}, {application-record-element=DET_RANGE_367, system-signal=DET_RANGE_367}, {application-record-element=DET_RANGE_368, system-signal=DET_RANGE_368}, {application-record-element=DET_RANGE_ERR_365, system-signal=DET_RANGE_ERR_365}, {application-record-element=DET_RANGE_ERR_366, system-signal=DET_RANGE_ERR_366}, {application-record-element=DET_RANGE_ERR_367, system-signal=DET_RANGE_ERR_367}, {application-record-element=DET_RANGE_ERR_368, system-signal=DET_RANGE_ERR_368}, {application-record-element=DET_RANGE_VELOCITY_365, system-signal=DET_RANGE_VELOCITY_365}, {application-record-element=DET_RANGE_VELOCITY_366, system-signal=DET_RANGE_VELOCITY_366}, {application-record-element=DET_RANGE_VELOCITY_367, system-signal=DET_RANGE_VELOCITY_367}, {application-record-element=DET_RANGE_VELOCITY_368, system-signal=DET_RANGE_VELOCITY_368}, {application-record-element=DET_RANGE_VELOCITY_ERR_365, system-signal=DET_RANGE_VELOCITY_ERR_365}, {application-record-element=DET_RANGE_VELOCITY_ERR_366, system-signal=DET_RANGE_VELOCITY_ERR_366}, {application-record-element=DET_RANGE_VELOCITY_ERR_367, system-signal=DET_RANGE_VELOCITY_ERR_367}, {application-record-element=DET_RANGE_VELOCITY_ERR_368, system-signal=DET_RANGE_VELOCITY_ERR_368}, {application-record-element=DET_RCS_365, system-signal=DET_RCS_365}, {application-record-element=DET_RCS_366, system-signal=DET_RCS_366}, {application-record-element=DET_RCS_367, system-signal=DET_RCS_367}, {application-record-element=DET_RCS_368, system-signal=DET_RCS_368}, {application-record-element=DET_SNR_365, system-signal=DET_SNR_365}, {application-record-element=DET_SNR_366, system-signal=DET_SNR_366}, {application-record-element=DET_SNR_367, system-signal=DET_SNR_367}, {application-record-element=DET_SNR_368, system-signal=DET_SNR_368}, {application-record-element=DET_SUPER_RES_TARGET_365, system-signal=DET_SUPER_RES_TARGET_365}, {application-record-element=DET_SUPER_RES_TARGET_366, system-signal=DET_SUPER_RES_TARGET_366}, {application-record-element=DET_SUPER_RES_TARGET_367, system-signal=DET_SUPER_RES_TARGET_367}, {application-record-element=DET_SUPER_RES_TARGET_368, system-signal=DET_SUPER_RES_TARGET_368}]}
        sender-receiver-to-signal-group-mapping={data-element=Pp_SG_Detections_369_372_AL.Vdp_SG_Detections_369_372_AL, signal-group=SG_Detections_369_372, type-mapping=sender-rec-record-type-mapping=record-element-mappings=[{application-record-element=DET_AZIMUTH_369, system-signal=DET_AZIMUTH_369}, {application-record-element=DET_AZIMUTH_370, system-signal=DET_AZIMUTH_370}, {application-record-element=DET_AZIMUTH_371, system-signal=DET_AZIMUTH_371}, {application-record-element=DET_AZIMUTH_372, system-signal=DET_AZIMUTH_372}, {application-record-element=DET_AZIMUTH_ERR_369, system-signal=DET_AZIMUTH_ERR_369}, {application-record-element=DET_AZIMUTH_ERR_370, system-signal=DET_AZIMUTH_ERR_370}, {application-record-element=DET_AZIMUTH_ERR_371, system-signal=DET_AZIMUTH_ERR_371}, {application-record-element=DET_AZIMUTH_ERR_372, system-signal=DET_AZIMUTH_ERR_372}, {application-record-element=DET_BELOW_RAIN_THOLD_369, system-signal=DET_BELOW_RAIN_THOLD_369}, {application-record-element=DET_BELOW_RAIN_THOLD_370, system-signal=DET_BELOW_RAIN_THOLD_370}, {application-record-element=DET_BELOW_RAIN_THOLD_371, system-signal=DET_BELOW_RAIN_THOLD_371}, {application-record-element=DET_BELOW_RAIN_THOLD_372, system-signal=DET_BELOW_RAIN_THOLD_372}, {application-record-element=DET_BI_STATIC_FLAG_369, system-signal=DET_BI_STATIC_FLAG_369}, {application-record-element=DET_BI_STATIC_FLAG_370, system-signal=DET_BI_STATIC_FLAG_370}, {application-record-element=DET_BI_STATIC_FLAG_371, system-signal=DET_BI_STATIC_FLAG_371}, {application-record-element=DET_BI_STATIC_FLAG_372, system-signal=DET_BI_STATIC_FLAG_372}, {application-record-element=DET_CONFD_AZIMUTH_369, system-signal=DET_CONFD_AZIMUTH_369}, {application-record-element=DET_CONFD_AZIMUTH_370, system-signal=DET_CONFD_AZIMUTH_370}, {application-record-element=DET_CONFD_AZIMUTH_371, system-signal=DET_CONFD_AZIMUTH_371}, {application-record-element=DET_CONFD_AZIMUTH_372, system-signal=DET_CONFD_AZIMUTH_372}, {application-record-element=DET_CONFD_ELEVATION_369, system-signal=DET_CONFD_ELEVATION_369}, {application-record-element=DET_CONFD_ELEVATION_370, system-signal=DET_CONFD_ELEVATION_370}, {application-record-element=DET_CONFD_ELEVATION_371, system-signal=DET_CONFD_ELEVATION_371}, {application-record-element=DET_CONFD_ELEVATION_372, system-signal=DET_CONFD_ELEVATION_372}, {application-record-element=DET_ELEVATION_369, system-signal=DET_ELEVATION_369}, {application-record-element=DET_ELEVATION_370, system-signal=DET_ELEVATION_370}, {application-record-element=DET_ELEVATION_371, system-signal=DET_ELEVATION_371}, {application-record-element=DET_ELEVATION_372, system-signal=DET_ELEVATION_372}, {application-record-element=DET_ELEVATION_ERR_369, system-signal=DET_ELEVATION_ERR_369}, {application-record-element=DET_ELEVATION_ERR_370, system-signal=DET_ELEVATION_ERR_370}, {application-record-element=DET_ELEVATION_ERR_371, system-signal=DET_ELEVATION_ERR_371}, {application-record-element=DET_ELEVATION_ERR_372, system-signal=DET_ELEVATION_ERR_372}, {application-record-element=DET_EXISTENCE_PROB_369, system-signal=DET_EXISTENCE_PROB_369}, {application-record-element=DET_EXISTENCE_PROB_370, system-signal=DET_EXISTENCE_PROB_370}, {application-record-element=DET_EXISTENCE_PROB_371, system-signal=DET_EXISTENCE_PROB_371}, {application-record-element=DET_EXISTENCE_PROB_372, system-signal=DET_EXISTENCE_PROB_372}, {application-record-element=DET_HVC_FLAG_369, system-signal=DET_HVC_FLAG_369}, {application-record-element=DET_HVC_FLAG_370, system-signal=DET_HVC_FLAG_370}, {application-record-element=DET_HVC_FLAG_371, system-signal=DET_HVC_FLAG_371}, {application-record-element=DET_HVC_FLAG_372, system-signal=DET_HVC_FLAG_372}, {application-record-element=DET_IDM_369, system-signal=DET_IDM_369}, {application-record-element=DET_IDM_370, system-signal=DET_IDM_370}, {application-record-element=DET_IDM_371, system-signal=DET_IDM_371}, {application-record-element=DET_IDM_372, system-signal=DET_IDM_372}, {application-record-element=DET_MH_CRC16_369_372, system-signal=DET_MH_CRC16_369_372}, {application-record-element=DET_MH_CYCLE_COUNTER_369_372, system-signal=DET_MH_CYCLE_COUNTER_369_372}, {application-record-element=DET_MH_SCAN_INDEX_4LSB_369_372, system-signal=DET_MH_SCAN_INDEX_4LSB_369_372}, {application-record-element=DET_MTD_369, system-signal=DET_MTD_369}, {application-record-element=DET_MTD_370, system-signal=DET_MTD_370}, {application-record-element=DET_MTD_371, system-signal=DET_MTD_371}, {application-record-element=DET_MTD_372, system-signal=DET_MTD_372}, {application-record-element=DET_PROB_1STAZHYPO_369, system-signal=DET_PROB_1STAZHYPO_369}, {application-record-element=DET_PROB_1STAZHYPO_370, system-signal=DET_PROB_1STAZHYPO_370}, {application-record-element=DET_PROB_1STAZHYPO_371, system-signal=DET_PROB_1STAZHYPO_371}, {application-record-element=DET_PROB_1STAZHYPO_372, system-signal=DET_PROB_1STAZHYPO_372}, {application-record-element=DET_RANGE_369, system-signal=DET_RANGE_369}, {application-record-element=DET_RANGE_370, system-signal=DET_RANGE_370}, {application-record-element=DET_RANGE_371, system-signal=DET_RANGE_371}, {application-record-element=DET_RANGE_372, system-signal=DET_RANGE_372}, {application-record-element=DET_RANGE_ERR_369, system-signal=DET_RANGE_ERR_369}, {application-record-element=DET_RANGE_ERR_370, system-signal=DET_RANGE_ERR_370}, {application-record-element=DET_RANGE_ERR_371, system-signal=DET_RANGE_ERR_371}, {application-record-element=DET_RANGE_ERR_372, system-signal=DET_RANGE_ERR_372}, {application-record-element=DET_RANGE_VELOCITY_369, system-signal=DET_RANGE_VELOCITY_369}, {application-record-element=DET_RANGE_VELOCITY_370, system-signal=DET_RANGE_VELOCITY_370}, {application-record-element=DET_RANGE_VELOCITY_371, system-signal=DET_RANGE_VELOCITY_371}, {application-record-element=DET_RANGE_VELOCITY_372, system-signal=DET_RANGE_VELOCITY_372}, {application-record-element=DET_RANGE_VELOCITY_ERR_369, system-signal=DET_RANGE_VELOCITY_ERR_369}, {application-record-element=DET_RANGE_VELOCITY_ERR_370, system-signal=DET_RANGE_VELOCITY_ERR_370}, {application-record-element=DET_RANGE_VELOCITY_ERR_371, system-signal=DET_RANGE_VELOCITY_ERR_371}, {application-record-element=DET_RANGE_VELOCITY_ERR_372, system-signal=DET_RANGE_VELOCITY_ERR_372}, {application-record-element=DET_RCS_369, system-signal=DET_RCS_369}, {application-record-element=DET_RCS_370, system-signal=DET_RCS_370}, {application-record-element=DET_RCS_371, system-signal=DET_RCS_371}, {application-record-element=DET_RCS_372, system-signal=DET_RCS_372}, {application-record-element=DET_SNR_369, system-signal=DET_SNR_369}, {application-record-element=DET_SNR_370, system-signal=DET_SNR_370}, {application-record-element=DET_SNR_371, system-signal=DET_SNR_371}, {application-record-element=DET_SNR_372, system-signal=DET_SNR_372}, {application-record-element=DET_SUPER_RES_TARGET_369, system-signal=DET_SUPER_RES_TARGET_369}, {application-record-element=DET_SUPER_RES_TARGET_370, system-signal=DET_SUPER_RES_TARGET_370}, {application-record-element=DET_SUPER_RES_TARGET_371, system-signal=DET_SUPER_RES_TARGET_371}, {application-record-element=DET_SUPER_RES_TARGET_372, system-signal=DET_SUPER_RES_TARGET_372}]}
        sender-receiver-to-signal-group-mapping={data-element=Pp_SG_Detections_373_376_AL.Vdp_SG_Detections_373_376_AL, signal-group=SG_Detections_373_376, type-mapping=sender-rec-record-type-mapping=record-element-mappings=[{application-record-element=DET_AZIMUTH_373, system-signal=DET_AZIMUTH_373}, {application-record-element=DET_AZIMUTH_374, system-signal=DET_AZIMUTH_374}, {application-record-element=DET_AZIMUTH_375, system-signal=DET_AZIMUTH_375}, {application-record-element=DET_AZIMUTH_376, system-signal=DET_AZIMUTH_376}, {application-record-element=DET_AZIMUTH_ERR_373, system-signal=DET_AZIMUTH_ERR_373}, {application-record-element=DET_AZIMUTH_ERR_374, system-signal=DET_AZIMUTH_ERR_374}, {application-record-element=DET_AZIMUTH_ERR_375, system-signal=DET_AZIMUTH_ERR_375}, {application-record-element=DET_AZIMUTH_ERR_376, system-signal=DET_AZIMUTH_ERR_376}, {application-record-element=DET_BELOW_RAIN_THOLD_373, system-signal=DET_BELOW_RAIN_THOLD_373}, {application-record-element=DET_BELOW_RAIN_THOLD_374, system-signal=DET_BELOW_RAIN_THOLD_374}, {application-record-element=DET_BELOW_RAIN_THOLD_375, system-signal=DET_BELOW_RAIN_THOLD_375}, {application-record-element=DET_BELOW_RAIN_THOLD_376, system-signal=DET_BELOW_RAIN_THOLD_376}, {application-record-element=DET_BI_STATIC_FLAG_373, system-signal=DET_BI_STATIC_FLAG_373}, {application-record-element=DET_BI_STATIC_FLAG_374, system-signal=DET_BI_STATIC_FLAG_374}, {application-record-element=DET_BI_STATIC_FLAG_375, system-signal=DET_BI_STATIC_FLAG_375}, {application-record-element=DET_BI_STATIC_FLAG_376, system-signal=DET_BI_STATIC_FLAG_376}, {application-record-element=DET_CONFD_AZIMUTH_373, system-signal=DET_CONFD_AZIMUTH_373}, {application-record-element=DET_CONFD_AZIMUTH_374, system-signal=DET_CONFD_AZIMUTH_374}, {application-record-element=DET_CONFD_AZIMUTH_375, system-signal=DET_CONFD_AZIMUTH_375}, {application-record-element=DET_CONFD_AZIMUTH_376, system-signal=DET_CONFD_AZIMUTH_376}, {application-record-element=DET_CONFD_ELEVATION_373, system-signal=DET_CONFD_ELEVATION_373}, {application-record-element=DET_CONFD_ELEVATION_374, system-signal=DET_CONFD_ELEVATION_374}, {application-record-element=DET_CONFD_ELEVATION_375, system-signal=DET_CONFD_ELEVATION_375}, {application-record-element=DET_CONFD_ELEVATION_376, system-signal=DET_CONFD_ELEVATION_376}, {application-record-element=DET_ELEVATION_373, system-signal=DET_ELEVATION_373}, {application-record-element=DET_ELEVATION_374, system-signal=DET_ELEVATION_374}, {application-record-element=DET_ELEVATION_375, system-signal=DET_ELEVATION_375}, {application-record-element=DET_ELEVATION_376, system-signal=DET_ELEVATION_376}, {application-record-element=DET_ELEVATION_ERR_373, system-signal=DET_ELEVATION_ERR_373}, {application-record-element=DET_ELEVATION_ERR_374, system-signal=DET_ELEVATION_ERR_374}, {application-record-element=DET_ELEVATION_ERR_375, system-signal=DET_ELEVATION_ERR_375}, {application-record-element=DET_ELEVATION_ERR_376, system-signal=DET_ELEVATION_ERR_376}, {application-record-element=DET_EXISTENCE_PROB_373, system-signal=DET_EXISTENCE_PROB_373}, {application-record-element=DET_EXISTENCE_PROB_374, system-signal=DET_EXISTENCE_PROB_374}, {application-record-element=DET_EXISTENCE_PROB_375, system-signal=DET_EXISTENCE_PROB_375}, {application-record-element=DET_EXISTENCE_PROB_376, system-signal=DET_EXISTENCE_PROB_376}, {application-record-element=DET_HVC_FLAG_373, system-signal=DET_HVC_FLAG_373}, {application-record-element=DET_HVC_FLAG_374, system-signal=DET_HVC_FLAG_374}, {application-record-element=DET_HVC_FLAG_375, system-signal=DET_HVC_FLAG_375}, {application-record-element=DET_HVC_FLAG_376, system-signal=DET_HVC_FLAG_376}, {application-record-element=DET_IDM_373, system-signal=DET_IDM_373}, {application-record-element=DET_IDM_374, system-signal=DET_IDM_374}, {application-record-element=DET_IDM_375, system-signal=DET_IDM_375}, {application-record-element=DET_IDM_376, system-signal=DET_IDM_376}, {application-record-element=DET_MH_CRC16_373_376, system-signal=DET_MH_CRC16_373_376}, {application-record-element=DET_MH_CYCLE_COUNTER_373_376, system-signal=DET_MH_CYCLE_COUNTER_373_376}, {application-record-element=DET_MH_SCAN_INDEX_4LSB_373_376, system-signal=DET_MH_SCAN_INDEX_4LSB_373_376}, {application-record-element=DET_MTD_373, system-signal=DET_MTD_373}, {application-record-element=DET_MTD_374, system-signal=DET_MTD_374}, {application-record-element=DET_MTD_375, system-signal=DET_MTD_375}, {application-record-element=DET_MTD_376, system-signal=DET_MTD_376}, {application-record-element=DET_PROB_1STAZHYPO_373, system-signal=DET_PROB_1STAZHYPO_373}, {application-record-element=DET_PROB_1STAZHYPO_374, system-signal=DET_PROB_1STAZHYPO_374}, {application-record-element=DET_PROB_1STAZHYPO_375, system-signal=DET_PROB_1STAZHYPO_375}, {application-record-element=DET_PROB_1STAZHYPO_376, system-signal=DET_PROB_1STAZHYPO_376}, {application-record-element=DET_RANGE_373, system-signal=DET_RANGE_373}, {application-record-element=DET_RANGE_374, system-signal=DET_RANGE_374}, {application-record-element=DET_RANGE_375, system-signal=DET_RANGE_375}, {application-record-element=DET_RANGE_376, system-signal=DET_RANGE_376}, {application-record-element=DET_RANGE_ERR_373, system-signal=DET_RANGE_ERR_373}, {application-record-element=DET_RANGE_ERR_374, system-signal=DET_RANGE_ERR_374}, {application-record-element=DET_RANGE_ERR_375, system-signal=DET_RANGE_ERR_375}, {application-record-element=DET_RANGE_ERR_376, system-signal=DET_RANGE_ERR_376}, {application-record-element=DET_RANGE_VELOCITY_373, system-signal=DET_RANGE_VELOCITY_373}, {application-record-element=DET_RANGE_VELOCITY_374, system-signal=DET_RANGE_VELOCITY_374}, {application-record-element=DET_RANGE_VELOCITY_375, system-signal=DET_RANGE_VELOCITY_375}, {application-record-element=DET_RANGE_VELOCITY_376, system-signal=DET_RANGE_VELOCITY_376}, {application-record-element=DET_RANGE_VELOCITY_ERR_373, system-signal=DET_RANGE_VELOCITY_ERR_373}, {application-record-element=DET_RANGE_VELOCITY_ERR_374, system-signal=DET_RANGE_VELOCITY_ERR_374}, {application-record-element=DET_RANGE_VELOCITY_ERR_375, system-signal=DET_RANGE_VELOCITY_ERR_375}, {application-record-element=DET_RANGE_VELOCITY_ERR_376, system-signal=DET_RANGE_VELOCITY_ERR_376}, {application-record-element=DET_RCS_373, system-signal=DET_RCS_373}, {application-record-element=DET_RCS_374, system-signal=DET_RCS_374}, {application-record-element=DET_RCS_375, system-signal=DET_RCS_375}, {application-record-element=DET_RCS_376, system-signal=DET_RCS_376}, {application-record-element=DET_SNR_373, system-signal=DET_SNR_373}, {application-record-element=DET_SNR_374, system-signal=DET_SNR_374}, {application-record-element=DET_SNR_375, system-signal=DET_SNR_375}, {application-record-element=DET_SNR_376, system-signal=DET_SNR_376}, {application-record-element=DET_SUPER_RES_TARGET_373, system-signal=DET_SUPER_RES_TARGET_373}, {application-record-element=DET_SUPER_RES_TARGET_374, system-signal=DET_SUPER_RES_TARGET_374}, {application-record-element=DET_SUPER_RES_TARGET_375, system-signal=DET_SUPER_RES_TARGET_375}, {application-record-element=DET_SUPER_RES_TARGET_376, system-signal=DET_SUPER_RES_TARGET_376}]}
        sender-receiver-to-signal-group-mapping={data-element=Pp_SG_Detections_377_380_AL.Vdp_SG_Detections_377_380_AL, signal-group=SG_Detections_377_380, type-mapping=sender-rec-record-type-mapping=record-element-mappings=[{application-record-element=DET_AZIMUTH_377, system-signal=DET_AZIMUTH_377}, {application-record-element=DET_AZIMUTH_378, system-signal=DET_AZIMUTH_378}, {application-record-element=DET_AZIMUTH_379, system-signal=DET_AZIMUTH_379}, {application-record-element=DET_AZIMUTH_380, system-signal=DET_AZIMUTH_380}, {application-record-element=DET_AZIMUTH_ERR_377, system-signal=DET_AZIMUTH_ERR_377}, {application-record-element=DET_AZIMUTH_ERR_378, system-signal=DET_AZIMUTH_ERR_378}, {application-record-element=DET_AZIMUTH_ERR_379, system-signal=DET_AZIMUTH_ERR_379}, {application-record-element=DET_AZIMUTH_ERR_380, system-signal=DET_AZIMUTH_ERR_380}, {application-record-element=DET_BELOW_RAIN_THOLD_377, system-signal=DET_BELOW_RAIN_THOLD_377}, {application-record-element=DET_BELOW_RAIN_THOLD_378, system-signal=DET_BELOW_RAIN_THOLD_378}, {application-record-element=DET_BELOW_RAIN_THOLD_379, system-signal=DET_BELOW_RAIN_THOLD_379}, {application-record-element=DET_BELOW_RAIN_THOLD_380, system-signal=DET_BELOW_RAIN_THOLD_380}, {application-record-element=DET_BI_STATIC_FLAG_377, system-signal=DET_BI_STATIC_FLAG_377}, {application-record-element=DET_BI_STATIC_FLAG_378, system-signal=DET_BI_STATIC_FLAG_378}, {application-record-element=DET_BI_STATIC_FLAG_379, system-signal=DET_BI_STATIC_FLAG_379}, {application-record-element=DET_BI_STATIC_FLAG_380, system-signal=DET_BI_STATIC_FLAG_380}, {application-record-element=DET_CONFD_AZIMUTH_377, system-signal=DET_CONFD_AZIMUTH_377}, {application-record-element=DET_CONFD_AZIMUTH_378, system-signal=DET_CONFD_AZIMUTH_378}, {application-record-element=DET_CONFD_AZIMUTH_379, system-signal=DET_CONFD_AZIMUTH_379}, {application-record-element=DET_CONFD_AZIMUTH_380, system-signal=DET_CONFD_AZIMUTH_380}, {application-record-element=DET_CONFD_ELEVATION_377, system-signal=DET_CONFD_ELEVATION_377}, {application-record-element=DET_CONFD_ELEVATION_378, system-signal=DET_CONFD_ELEVATION_378}, {application-record-element=DET_CONFD_ELEVATION_379, system-signal=DET_CONFD_ELEVATION_379}, {application-record-element=DET_CONFD_ELEVATION_380, system-signal=DET_CONFD_ELEVATION_380}, {application-record-element=DET_ELEVATION_377, system-signal=DET_ELEVATION_377}, {application-record-element=DET_ELEVATION_378, system-signal=DET_ELEVATION_378}, {application-record-element=DET_ELEVATION_379, system-signal=DET_ELEVATION_379}, {application-record-element=DET_ELEVATION_380, system-signal=DET_ELEVATION_380}, {application-record-element=DET_ELEVATION_ERR_377, system-signal=DET_ELEVATION_ERR_377}, {application-record-element=DET_ELEVATION_ERR_378, system-signal=DET_ELEVATION_ERR_378}, {application-record-element=DET_ELEVATION_ERR_379, system-signal=DET_ELEVATION_ERR_379}, {application-record-element=DET_ELEVATION_ERR_380, system-signal=DET_ELEVATION_ERR_380}, {application-record-element=DET_EXISTENCE_PROB_377, system-signal=DET_EXISTENCE_PROB_377}, {application-record-element=DET_EXISTENCE_PROB_378, system-signal=DET_EXISTENCE_PROB_378}, {application-record-element=DET_EXISTENCE_PROB_379, system-signal=DET_EXISTENCE_PROB_379}, {application-record-element=DET_EXISTENCE_PROB_380, system-signal=DET_EXISTENCE_PROB_380}, {application-record-element=DET_HVC_FLAG_377, system-signal=DET_HVC_FLAG_377}, {application-record-element=DET_HVC_FLAG_378, system-signal=DET_HVC_FLAG_378}, {application-record-element=DET_HVC_FLAG_379, system-signal=DET_HVC_FLAG_379}, {application-record-element=DET_HVC_FLAG_380, system-signal=DET_HVC_FLAG_380}, {application-record-element=DET_IDM_377, system-signal=DET_IDM_377}, {application-record-element=DET_IDM_378, system-signal=DET_IDM_378}, {application-record-element=DET_IDM_379, system-signal=DET_IDM_379}, {application-record-element=DET_IDM_380, system-signal=DET_IDM_380}, {application-record-element=DET_MH_CRC16_377_380, system-signal=DET_MH_CRC16_377_380}, {application-record-element=DET_MH_CYCLE_COUNTER_377_380, system-signal=DET_MH_CYCLE_COUNTER_377_380}, {application-record-element=DET_MH_SCAN_INDEX_4LSB_377_380, system-signal=DET_MH_SCAN_INDEX_4LSB_377_380}, {application-record-element=DET_MTD_377, system-signal=DET_MTD_377}, {application-record-element=DET_MTD_378, system-signal=DET_MTD_378}, {application-record-element=DET_MTD_379, system-signal=DET_MTD_379}, {application-record-element=DET_MTD_380, system-signal=DET_MTD_380}, {application-record-element=DET_PROB_1STAZHYPO_377, system-signal=DET_PROB_1STAZHYPO_377}, {application-record-element=DET_PROB_1STAZHYPO_378, system-signal=DET_PROB_1STAZHYPO_378}, {application-record-element=DET_PROB_1STAZHYPO_379, system-signal=DET_PROB_1STAZHYPO_379}, {application-record-element=DET_PROB_1STAZHYPO_380, system-signal=DET_PROB_1STAZHYPO_380}, {application-record-element=DET_RANGE_377, system-signal=DET_RANGE_377}, {application-record-element=DET_RANGE_378, system-signal=DET_RANGE_378}, {application-record-element=DET_RANGE_379, system-signal=DET_RANGE_379}, {application-record-element=DET_RANGE_380, system-signal=DET_RANGE_380}, {application-record-element=DET_RANGE_ERR_377, system-signal=DET_RANGE_ERR_377}, {application-record-element=DET_RANGE_ERR_378, system-signal=DET_RANGE_ERR_378}, {application-record-element=DET_RANGE_ERR_379, system-signal=DET_RANGE_ERR_379}, {application-record-element=DET_RANGE_ERR_380, system-signal=DET_RANGE_ERR_380}, {application-record-element=DET_RANGE_VELOCITY_377, system-signal=DET_RANGE_VELOCITY_377}, {application-record-element=DET_RANGE_VELOCITY_378, system-signal=DET_RANGE_VELOCITY_378}, {application-record-element=DET_RANGE_VELOCITY_379, system-signal=DET_RANGE_VELOCITY_379}, {application-record-element=DET_RANGE_VELOCITY_380, system-signal=DET_RANGE_VELOCITY_380}, {application-record-element=DET_RANGE_VELOCITY_ERR_377, system-signal=DET_RANGE_VELOCITY_ERR_377}, {application-record-element=DET_RANGE_VELOCITY_ERR_378, system-signal=DET_RANGE_VELOCITY_ERR_378}, {application-record-element=DET_RANGE_VELOCITY_ERR_379, system-signal=DET_RANGE_VELOCITY_ERR_379}, {application-record-element=DET_RANGE_VELOCITY_ERR_380, system-signal=DET_RANGE_VELOCITY_ERR_380}, {application-record-element=DET_RCS_377, system-signal=DET_RCS_377}, {application-record-element=DET_RCS_378, system-signal=DET_RCS_378}, {application-record-element=DET_RCS_379, system-signal=DET_RCS_379}, {application-record-element=DET_RCS_380, system-signal=DET_RCS_380}, {application-record-element=DET_SNR_377, system-signal=DET_SNR_377}, {application-record-element=DET_SNR_378, system-signal=DET_SNR_378}, {application-record-element=DET_SNR_379, system-signal=DET_SNR_379}, {application-record-element=DET_SNR_380, system-signal=DET_SNR_380}, {application-record-element=DET_SUPER_RES_TARGET_377, system-signal=DET_SUPER_RES_TARGET_377}, {application-record-element=DET_SUPER_RES_TARGET_378, system-signal=DET_SUPER_RES_TARGET_378}, {application-record-element=DET_SUPER_RES_TARGET_379, system-signal=DET_SUPER_RES_TARGET_379}, {application-record-element=DET_SUPER_RES_TARGET_380, system-signal=DET_SUPER_RES_TARGET_380}]}
        sender-receiver-to-signal-group-mapping={data-element=Pp_SG_Detections_381_384_AL.Vdp_SG_Detections_381_384_AL, signal-group=SG_Detections_381_384, type-mapping=sender-rec-record-type-mapping=record-element-mappings=[{application-record-element=DET_AZIMUTH_381, system-signal=DET_AZIMUTH_381}, {application-record-element=DET_AZIMUTH_382, system-signal=DET_AZIMUTH_382}, {application-record-element=DET_AZIMUTH_383, system-signal=DET_AZIMUTH_383}, {application-record-element=DET_AZIMUTH_384, system-signal=DET_AZIMUTH_384}, {application-record-element=DET_AZIMUTH_ERR_381, system-signal=DET_AZIMUTH_ERR_381}, {application-record-element=DET_AZIMUTH_ERR_382, system-signal=DET_AZIMUTH_ERR_382}, {application-record-element=DET_AZIMUTH_ERR_383, system-signal=DET_AZIMUTH_ERR_383}, {application-record-element=DET_AZIMUTH_ERR_384, system-signal=DET_AZIMUTH_ERR_384}, {application-record-element=DET_BELOW_RAIN_THOLD_381, system-signal=DET_BELOW_RAIN_THOLD_381}, {application-record-element=DET_BELOW_RAIN_THOLD_382, system-signal=DET_BELOW_RAIN_THOLD_382}, {application-record-element=DET_BELOW_RAIN_THOLD_383, system-signal=DET_BELOW_RAIN_THOLD_383}, {application-record-element=DET_BELOW_RAIN_THOLD_384, system-signal=DET_BELOW_RAIN_THOLD_384}, {application-record-element=DET_BI_STATIC_FLAG_381, system-signal=DET_BI_STATIC_FLAG_381}, {application-record-element=DET_BI_STATIC_FLAG_382, system-signal=DET_BI_STATIC_FLAG_382}, {application-record-element=DET_BI_STATIC_FLAG_383, system-signal=DET_BI_STATIC_FLAG_383}, {application-record-element=DET_BI_STATIC_FLAG_384, system-signal=DET_BI_STATIC_FLAG_384}, {application-record-element=DET_CONFD_AZIMUTH_381, system-signal=DET_CONFD_AZIMUTH_381}, {application-record-element=DET_CONFD_AZIMUTH_382, system-signal=DET_CONFD_AZIMUTH_382}, {application-record-element=DET_CONFD_AZIMUTH_383, system-signal=DET_CONFD_AZIMUTH_383}, {application-record-element=DET_CONFD_AZIMUTH_384, system-signal=DET_CONFD_AZIMUTH_384}, {application-record-element=DET_CONFD_ELEVATION_381, system-signal=DET_CONFD_ELEVATION_381}, {application-record-element=DET_CONFD_ELEVATION_382, system-signal=DET_CONFD_ELEVATION_382}, {application-record-element=DET_CONFD_ELEVATION_383, system-signal=DET_CONFD_ELEVATION_383}, {application-record-element=DET_CONFD_ELEVATION_384, system-signal=DET_CONFD_ELEVATION_384}, {application-record-element=DET_ELEVATION_381, system-signal=DET_ELEVATION_381}, {application-record-element=DET_ELEVATION_382, system-signal=DET_ELEVATION_382}, {application-record-element=DET_ELEVATION_383, system-signal=DET_ELEVATION_383}, {application-record-element=DET_ELEVATION_384, system-signal=DET_ELEVATION_384}, {application-record-element=DET_ELEVATION_ERR_381, system-signal=DET_ELEVATION_ERR_381}, {application-record-element=DET_ELEVATION_ERR_382, system-signal=DET_ELEVATION_ERR_382}, {application-record-element=DET_ELEVATION_ERR_383, system-signal=DET_ELEVATION_ERR_383}, {application-record-element=DET_ELEVATION_ERR_384, system-signal=DET_ELEVATION_ERR_384}, {application-record-element=DET_EXISTENCE_PROB_381, system-signal=DET_EXISTENCE_PROB_381}, {application-record-element=DET_EXISTENCE_PROB_382, system-signal=DET_EXISTENCE_PROB_382}, {application-record-element=DET_EXISTENCE_PROB_383, system-signal=DET_EXISTENCE_PROB_383}, {application-record-element=DET_EXISTENCE_PROB_384, system-signal=DET_EXISTENCE_PROB_384}, {application-record-element=DET_HVC_FLAG_381, system-signal=DET_HVC_FLAG_381}, {application-record-element=DET_HVC_FLAG_382, system-signal=DET_HVC_FLAG_382}, {application-record-element=DET_HVC_FLAG_383, system-signal=DET_HVC_FLAG_383}, {application-record-element=DET_HVC_FLAG_384, system-signal=DET_HVC_FLAG_384}, {application-record-element=DET_IDM_381, system-signal=DET_IDM_381}, {application-record-element=DET_IDM_382, system-signal=DET_IDM_382}, {application-record-element=DET_IDM_383, system-signal=DET_IDM_383}, {application-record-element=DET_IDM_384, system-signal=DET_IDM_384}, {application-record-element=DET_MH_CRC16_381_384, system-signal=DET_MH_CRC16_381_384}, {application-record-element=DET_MH_CYCLE_COUNTER_381_384, system-signal=DET_MH_CYCLE_COUNTER_381_384}, {application-record-element=DET_MH_SCAN_INDEX_4LSB_381_384, system-signal=DET_MH_SCAN_INDEX_4LSB_381_384}, {application-record-element=DET_MTD_381, system-signal=DET_MTD_381}, {application-record-element=DET_MTD_382, system-signal=DET_MTD_382}, {application-record-element=DET_MTD_383, system-signal=DET_MTD_383}, {application-record-element=DET_MTD_384, system-signal=DET_MTD_384}, {application-record-element=DET_PROB_1STAZHYPO_381, system-signal=DET_PROB_1STAZHYPO_381}, {application-record-element=DET_PROB_1STAZHYPO_382, system-signal=DET_PROB_1STAZHYPO_382}, {application-record-element=DET_PROB_1STAZHYPO_383, system-signal=DET_PROB_1STAZHYPO_383}, {application-record-element=DET_PROB_1STAZHYPO_384, system-signal=DET_PROB_1STAZHYPO_384}, {application-record-element=DET_RANGE_381, system-signal=DET_RANGE_381}, {application-record-element=DET_RANGE_382, system-signal=DET_RANGE_382}, {application-record-element=DET_RANGE_383, system-signal=DET_RANGE_383}, {application-record-element=DET_RANGE_384, system-signal=DET_RANGE_384}, {application-record-element=DET_RANGE_ERR_381, system-signal=DET_RANGE_ERR_381}, {application-record-element=DET_RANGE_ERR_382, system-signal=DET_RANGE_ERR_382}, {application-record-element=DET_RANGE_ERR_383, system-signal=DET_RANGE_ERR_383}, {application-record-element=DET_RANGE_ERR_384, system-signal=DET_RANGE_ERR_384}, {application-record-element=DET_RANGE_VELOCITY_381, system-signal=DET_RANGE_VELOCITY_381}, {application-record-element=DET_RANGE_VELOCITY_382, system-signal=DET_RANGE_VELOCITY_382}, {application-record-element=DET_RANGE_VELOCITY_383, system-signal=DET_RANGE_VELOCITY_383}, {application-record-element=DET_RANGE_VELOCITY_384, system-signal=DET_RANGE_VELOCITY_384}, {application-record-element=DET_RANGE_VELOCITY_ERR_381, system-signal=DET_RANGE_VELOCITY_ERR_381}, {application-record-element=DET_RANGE_VELOCITY_ERR_382, system-signal=DET_RANGE_VELOCITY_ERR_382}, {application-record-element=DET_RANGE_VELOCITY_ERR_383, system-signal=DET_RANGE_VELOCITY_ERR_383}, {application-record-element=DET_RANGE_VELOCITY_ERR_384, system-signal=DET_RANGE_VELOCITY_ERR_384}, {application-record-element=DET_RCS_381, system-signal=DET_RCS_381}, {application-record-element=DET_RCS_382, system-signal=DET_RCS_382}, {application-record-element=DET_RCS_383, system-signal=DET_RCS_383}, {application-record-element=DET_RCS_384, system-signal=DET_RCS_384}, {application-record-element=DET_SNR_381, system-signal=DET_SNR_381}, {application-record-element=DET_SNR_382, system-signal=DET_SNR_382}, {application-record-element=DET_SNR_383, system-signal=DET_SNR_383}, {application-record-element=DET_SNR_384, system-signal=DET_SNR_384}, {application-record-element=DET_SUPER_RES_TARGET_381, system-signal=DET_SUPER_RES_TARGET_381}, {application-record-element=DET_SUPER_RES_TARGET_382, system-signal=DET_SUPER_RES_TARGET_382}, {application-record-element=DET_SUPER_RES_TARGET_383, system-signal=DET_SUPER_RES_TARGET_383}, {application-record-element=DET_SUPER_RES_TARGET_384, system-signal=DET_SUPER_RES_TARGET_384}]}
        sender-receiver-to-signal-group-mapping={data-element=Pp_SG_Detections_385_388_AL.Vdp_SG_Detections_385_388_AL, signal-group=SG_Detections_385_388, type-mapping=sender-rec-record-type-mapping=record-element-mappings=[{application-record-element=DET_AZIMUTH_385, system-signal=DET_AZIMUTH_385}, {application-record-element=DET_AZIMUTH_386, system-signal=DET_AZIMUTH_386}, {application-record-element=DET_AZIMUTH_387, system-signal=DET_AZIMUTH_387}, {application-record-element=DET_AZIMUTH_388, system-signal=DET_AZIMUTH_388}, {application-record-element=DET_AZIMUTH_ERR_385, system-signal=DET_AZIMUTH_ERR_385}, {application-record-element=DET_AZIMUTH_ERR_386, system-signal=DET_AZIMUTH_ERR_386}, {application-record-element=DET_AZIMUTH_ERR_387, system-signal=DET_AZIMUTH_ERR_387}, {application-record-element=DET_AZIMUTH_ERR_388, system-signal=DET_AZIMUTH_ERR_388}, {application-record-element=DET_BELOW_RAIN_THOLD_385, system-signal=DET_BELOW_RAIN_THOLD_385}, {application-record-element=DET_BELOW_RAIN_THOLD_386, system-signal=DET_BELOW_RAIN_THOLD_386}, {application-record-element=DET_BELOW_RAIN_THOLD_387, system-signal=DET_BELOW_RAIN_THOLD_387}, {application-record-element=DET_BELOW_RAIN_THOLD_388, system-signal=DET_BELOW_RAIN_THOLD_388}, {application-record-element=DET_BI_STATIC_FLAG_385, system-signal=DET_BI_STATIC_FLAG_385}, {application-record-element=DET_BI_STATIC_FLAG_386, system-signal=DET_BI_STATIC_FLAG_386}, {application-record-element=DET_BI_STATIC_FLAG_387, system-signal=DET_BI_STATIC_FLAG_387}, {application-record-element=DET_BI_STATIC_FLAG_388, system-signal=DET_BI_STATIC_FLAG_388}, {application-record-element=DET_CONFD_AZIMUTH_385, system-signal=DET_CONFD_AZIMUTH_385}, {application-record-element=DET_CONFD_AZIMUTH_386, system-signal=DET_CONFD_AZIMUTH_386}, {application-record-element=DET_CONFD_AZIMUTH_387, system-signal=DET_CONFD_AZIMUTH_387}, {application-record-element=DET_CONFD_AZIMUTH_388, system-signal=DET_CONFD_AZIMUTH_388}, {application-record-element=DET_CONFD_ELEVATION_385, system-signal=DET_CONFD_ELEVATION_385}, {application-record-element=DET_CONFD_ELEVATION_386, system-signal=DET_CONFD_ELEVATION_386}, {application-record-element=DET_CONFD_ELEVATION_387, system-signal=DET_CONFD_ELEVATION_387}, {application-record-element=DET_CONFD_ELEVATION_388, system-signal=DET_CONFD_ELEVATION_388}, {application-record-element=DET_ELEVATION_385, system-signal=DET_ELEVATION_385}, {application-record-element=DET_ELEVATION_386, system-signal=DET_ELEVATION_386}, {application-record-element=DET_ELEVATION_387, system-signal=DET_ELEVATION_387}, {application-record-element=DET_ELEVATION_388, system-signal=DET_ELEVATION_388}, {application-record-element=DET_ELEVATION_ERR_385, system-signal=DET_ELEVATION_ERR_385}, {application-record-element=DET_ELEVATION_ERR_386, system-signal=DET_ELEVATION_ERR_386}, {application-record-element=DET_ELEVATION_ERR_387, system-signal=DET_ELEVATION_ERR_387}, {application-record-element=DET_ELEVATION_ERR_388, system-signal=DET_ELEVATION_ERR_388}, {application-record-element=DET_EXISTENCE_PROB_385, system-signal=DET_EXISTENCE_PROB_385}, {application-record-element=DET_EXISTENCE_PROB_386, system-signal=DET_EXISTENCE_PROB_386}, {application-record-element=DET_EXISTENCE_PROB_387, system-signal=DET_EXISTENCE_PROB_387}, {application-record-element=DET_EXISTENCE_PROB_388, system-signal=DET_EXISTENCE_PROB_388}, {application-record-element=DET_HVC_FLAG_385, system-signal=DET_HVC_FLAG_385}, {application-record-element=DET_HVC_FLAG_386, system-signal=DET_HVC_FLAG_386}, {application-record-element=DET_HVC_FLAG_387, system-signal=DET_HVC_FLAG_387}, {application-record-element=DET_HVC_FLAG_388, system-signal=DET_HVC_FLAG_388}, {application-record-element=DET_IDM_385, system-signal=DET_IDM_385}, {application-record-element=DET_IDM_386, system-signal=DET_IDM_386}, {application-record-element=DET_IDM_387, system-signal=DET_IDM_387}, {application-record-element=DET_IDM_388, system-signal=DET_IDM_388}, {application-record-element=DET_MH_CRC16_385_388, system-signal=DET_MH_CRC16_385_388}, {application-record-element=DET_MH_CYCLE_COUNTER_385_388, system-signal=DET_MH_CYCLE_COUNTER_385_388}, {application-record-element=DET_MH_SCAN_INDEX_4LSB_385_388, system-signal=DET_MH_SCAN_INDEX_4LSB_385_388}, {application-record-element=DET_MTD_385, system-signal=DET_MTD_385}, {application-record-element=DET_MTD_386, system-signal=DET_MTD_386}, {application-record-element=DET_MTD_387, system-signal=DET_MTD_387}, {application-record-element=DET_MTD_388, system-signal=DET_MTD_388}, {application-record-element=DET_PROB_1STAZHYPO_385, system-signal=DET_PROB_1STAZHYPO_385}, {application-record-element=DET_PROB_1STAZHYPO_386, system-signal=DET_PROB_1STAZHYPO_386}, {application-record-element=DET_PROB_1STAZHYPO_387, system-signal=DET_PROB_1STAZHYPO_387}, {application-record-element=DET_PROB_1STAZHYPO_388, system-signal=DET_PROB_1STAZHYPO_388}, {application-record-element=DET_RANGE_385, system-signal=DET_RANGE_385}, {application-record-element=DET_RANGE_386, system-signal=DET_RANGE_386}, {application-record-element=DET_RANGE_387, system-signal=DET_RANGE_387}, {application-record-element=DET_RANGE_388, system-signal=DET_RANGE_388}, {application-record-element=DET_RANGE_ERR_385, system-signal=DET_RANGE_ERR_385}, {application-record-element=DET_RANGE_ERR_386, system-signal=DET_RANGE_ERR_386}, {application-record-element=DET_RANGE_ERR_387, system-signal=DET_RANGE_ERR_387}, {application-record-element=DET_RANGE_ERR_388, system-signal=DET_RANGE_ERR_388}, {application-record-element=DET_RANGE_VELOCITY_385, system-signal=DET_RANGE_VELOCITY_385}, {application-record-element=DET_RANGE_VELOCITY_386, system-signal=DET_RANGE_VELOCITY_386}, {application-record-element=DET_RANGE_VELOCITY_387, system-signal=DET_RANGE_VELOCITY_387}, {application-record-element=DET_RANGE_VELOCITY_388, system-signal=DET_RANGE_VELOCITY_388}, {application-record-element=DET_RANGE_VELOCITY_ERR_385, system-signal=DET_RANGE_VELOCITY_ERR_385}, {application-record-element=DET_RANGE_VELOCITY_ERR_386, system-signal=DET_RANGE_VELOCITY_ERR_386}, {application-record-element=DET_RANGE_VELOCITY_ERR_387, system-signal=DET_RANGE_VELOCITY_ERR_387}, {application-record-element=DET_RANGE_VELOCITY_ERR_388, system-signal=DET_RANGE_VELOCITY_ERR_388}, {application-record-element=DET_RCS_385, system-signal=DET_RCS_385}, {application-record-element=DET_RCS_386, system-signal=DET_RCS_386}, {application-record-element=DET_RCS_387, system-signal=DET_RCS_387}, {application-record-element=DET_RCS_388, system-signal=DET_RCS_388}, {application-record-element=DET_SNR_385, system-signal=DET_SNR_385}, {application-record-element=DET_SNR_386, system-signal=DET_SNR_386}, {application-record-element=DET_SNR_387, system-signal=DET_SNR_387}, {application-record-element=DET_SNR_388, system-signal=DET_SNR_388}, {application-record-element=DET_SUPER_RES_TARGET_385, system-signal=DET_SUPER_RES_TARGET_385}, {application-record-element=DET_SUPER_RES_TARGET_386, system-signal=DET_SUPER_RES_TARGET_386}, {application-record-element=DET_SUPER_RES_TARGET_387, system-signal=DET_SUPER_RES_TARGET_387}, {application-record-element=DET_SUPER_RES_TARGET_388, system-signal=DET_SUPER_RES_TARGET_388}]}
        sender-receiver-to-signal-group-mapping={data-element=Pp_SG_Detections_389_392_AL.Vdp_SG_Detections_389_392_AL, signal-group=SG_Detections_389_392, type-mapping=sender-rec-record-type-mapping=record-element-mappings=[{application-record-element=DET_AZIMUTH_389, system-signal=DET_AZIMUTH_389}, {application-record-element=DET_AZIMUTH_390, system-signal=DET_AZIMUTH_390}, {application-record-element=DET_AZIMUTH_391, system-signal=DET_AZIMUTH_391}, {application-record-element=DET_AZIMUTH_392, system-signal=DET_AZIMUTH_392}, {application-record-element=DET_AZIMUTH_ERR_389, system-signal=DET_AZIMUTH_ERR_389}, {application-record-element=DET_AZIMUTH_ERR_390, system-signal=DET_AZIMUTH_ERR_390}, {application-record-element=DET_AZIMUTH_ERR_391, system-signal=DET_AZIMUTH_ERR_391}, {application-record-element=DET_AZIMUTH_ERR_392, system-signal=DET_AZIMUTH_ERR_392}, {application-record-element=DET_BELOW_RAIN_THOLD_389, system-signal=DET_BELOW_RAIN_THOLD_389}, {application-record-element=DET_BELOW_RAIN_THOLD_390, system-signal=DET_BELOW_RAIN_THOLD_390}, {application-record-element=DET_BELOW_RAIN_THOLD_391, system-signal=DET_BELOW_RAIN_THOLD_391}, {application-record-element=DET_BELOW_RAIN_THOLD_392, system-signal=DET_BELOW_RAIN_THOLD_392}, {application-record-element=DET_BI_STATIC_FLAG_389, system-signal=DET_BI_STATIC_FLAG_389}, {application-record-element=DET_BI_STATIC_FLAG_390, system-signal=DET_BI_STATIC_FLAG_390}, {application-record-element=DET_BI_STATIC_FLAG_391, system-signal=DET_BI_STATIC_FLAG_391}, {application-record-element=DET_BI_STATIC_FLAG_392, system-signal=DET_BI_STATIC_FLAG_392}, {application-record-element=DET_CONFD_AZIMUTH_389, system-signal=DET_CONFD_AZIMUTH_389}, {application-record-element=DET_CONFD_AZIMUTH_390, system-signal=DET_CONFD_AZIMUTH_390}, {application-record-element=DET_CONFD_AZIMUTH_391, system-signal=DET_CONFD_AZIMUTH_391}, {application-record-element=DET_CONFD_AZIMUTH_392, system-signal=DET_CONFD_AZIMUTH_392}, {application-record-element=DET_CONFD_ELEVATION_389, system-signal=DET_CONFD_ELEVATION_389}, {application-record-element=DET_CONFD_ELEVATION_390, system-signal=DET_CONFD_ELEVATION_390}, {application-record-element=DET_CONFD_ELEVATION_391, system-signal=DET_CONFD_ELEVATION_391}, {application-record-element=DET_CONFD_ELEVATION_392, system-signal=DET_CONFD_ELEVATION_392}, {application-record-element=DET_ELEVATION_389, system-signal=DET_ELEVATION_389}, {application-record-element=DET_ELEVATION_390, system-signal=DET_ELEVATION_390}, {application-record-element=DET_ELEVATION_391, system-signal=DET_ELEVATION_391}, {application-record-element=DET_ELEVATION_392, system-signal=DET_ELEVATION_392}, {application-record-element=DET_ELEVATION_ERR_389, system-signal=DET_ELEVATION_ERR_389}, {application-record-element=DET_ELEVATION_ERR_390, system-signal=DET_ELEVATION_ERR_390}, {application-record-element=DET_ELEVATION_ERR_391, system-signal=DET_ELEVATION_ERR_391}, {application-record-element=DET_ELEVATION_ERR_392, system-signal=DET_ELEVATION_ERR_392}, {application-record-element=DET_EXISTENCE_PROB_389, system-signal=DET_EXISTENCE_PROB_389}, {application-record-element=DET_EXISTENCE_PROB_390, system-signal=DET_EXISTENCE_PROB_390}, {application-record-element=DET_EXISTENCE_PROB_391, system-signal=DET_EXISTENCE_PROB_391}, {application-record-element=DET_EXISTENCE_PROB_392, system-signal=DET_EXISTENCE_PROB_392}, {application-record-element=DET_HVC_FLAG_389, system-signal=DET_HVC_FLAG_389}, {application-record-element=DET_HVC_FLAG_390, system-signal=DET_HVC_FLAG_390}, {application-record-element=DET_HVC_FLAG_391, system-signal=DET_HVC_FLAG_391}, {application-record-element=DET_HVC_FLAG_392, system-signal=DET_HVC_FLAG_392}, {application-record-element=DET_IDM_389, system-signal=DET_IDM_389}, {application-record-element=DET_IDM_390, system-signal=DET_IDM_390}, {application-record-element=DET_IDM_391, system-signal=DET_IDM_391}, {application-record-element=DET_IDM_392, system-signal=DET_IDM_392}, {application-record-element=DET_MH_CRC16_389_392, system-signal=DET_MH_CRC16_389_392}, {application-record-element=DET_MH_CYCLE_COUNTER_389_392, system-signal=DET_MH_CYCLE_COUNTER_389_392}, {application-record-element=DET_MH_SCAN_INDEX_4LSB_389_392, system-signal=DET_MH_SCAN_INDEX_4LSB_389_392}, {application-record-element=DET_MTD_389, system-signal=DET_MTD_389}, {application-record-element=DET_MTD_390, system-signal=DET_MTD_390}, {application-record-element=DET_MTD_391, system-signal=DET_MTD_391}, {application-record-element=DET_MTD_392, system-signal=DET_MTD_392}, {application-record-element=DET_PROB_1STAZHYPO_389, system-signal=DET_PROB_1STAZHYPO_389}, {application-record-element=DET_PROB_1STAZHYPO_390, system-signal=DET_PROB_1STAZHYPO_390}, {application-record-element=DET_PROB_1STAZHYPO_391, system-signal=DET_PROB_1STAZHYPO_391}, {application-record-element=DET_PROB_1STAZHYPO_392, system-signal=DET_PROB_1STAZHYPO_392}, {application-record-element=DET_RANGE_389, system-signal=DET_RANGE_389}, {application-record-element=DET_RANGE_390, system-signal=DET_RANGE_390}, {application-record-element=DET_RANGE_391, system-signal=DET_RANGE_391}, {application-record-element=DET_RANGE_392, system-signal=DET_RANGE_392}, {application-record-element=DET_RANGE_ERR_389, system-signal=DET_RANGE_ERR_389}, {application-record-element=DET_RANGE_ERR_390, system-signal=DET_RANGE_ERR_390}, {application-record-element=DET_RANGE_ERR_391, system-signal=DET_RANGE_ERR_391}, {application-record-element=DET_RANGE_ERR_392, system-signal=DET_RANGE_ERR_392}, {application-record-element=DET_RANGE_VELOCITY_389, system-signal=DET_RANGE_VELOCITY_389}, {application-record-element=DET_RANGE_VELOCITY_390, system-signal=DET_RANGE_VELOCITY_390}, {application-record-element=DET_RANGE_VELOCITY_391, system-signal=DET_RANGE_VELOCITY_391}, {application-record-element=DET_RANGE_VELOCITY_392, system-signal=DET_RANGE_VELOCITY_392}, {application-record-element=DET_RANGE_VELOCITY_ERR_389, system-signal=DET_RANGE_VELOCITY_ERR_389}, {application-record-element=DET_RANGE_VELOCITY_ERR_390, system-signal=DET_RANGE_VELOCITY_ERR_390}, {application-record-element=DET_RANGE_VELOCITY_ERR_391, system-signal=DET_RANGE_VELOCITY_ERR_391}, {application-record-element=DET_RANGE_VELOCITY_ERR_392, system-signal=DET_RANGE_VELOCITY_ERR_392}, {application-record-element=DET_RCS_389, system-signal=DET_RCS_389}, {application-record-element=DET_RCS_390, system-signal=DET_RCS_390}, {application-record-element=DET_RCS_391, system-signal=DET_RCS_391}, {application-record-element=DET_RCS_392, system-signal=DET_RCS_392}, {application-record-element=DET_SNR_389, system-signal=DET_SNR_389}, {application-record-element=DET_SNR_390, system-signal=DET_SNR_390}, {application-record-element=DET_SNR_391, system-signal=DET_SNR_391}, {application-record-element=DET_SNR_392, system-signal=DET_SNR_392}, {application-record-element=DET_SUPER_RES_TARGET_389, system-signal=DET_SUPER_RES_TARGET_389}, {application-record-element=DET_SUPER_RES_TARGET_390, system-signal=DET_SUPER_RES_TARGET_390}, {application-record-element=DET_SUPER_RES_TARGET_391, system-signal=DET_SUPER_RES_TARGET_391}, {application-record-element=DET_SUPER_RES_TARGET_392, system-signal=DET_SUPER_RES_TARGET_392}]}
        sender-receiver-to-signal-group-mapping={data-element=Pp_SG_Detections_393_396_AL.Vdp_SG_Detections_393_396_AL, signal-group=SG_Detections_393_396, type-mapping=sender-rec-record-type-mapping=record-element-mappings=[{application-record-element=DET_AZIMUTH_393, system-signal=DET_AZIMUTH_393}, {application-record-element=DET_AZIMUTH_394, system-signal=DET_AZIMUTH_394}, {application-record-element=DET_AZIMUTH_395, system-signal=DET_AZIMUTH_395}, {application-record-element=DET_AZIMUTH_396, system-signal=DET_AZIMUTH_396}, {application-record-element=DET_AZIMUTH_ERR_393, system-signal=DET_AZIMUTH_ERR_393}, {application-record-element=DET_AZIMUTH_ERR_394, system-signal=DET_AZIMUTH_ERR_394}, {application-record-element=DET_AZIMUTH_ERR_395, system-signal=DET_AZIMUTH_ERR_395}, {application-record-element=DET_AZIMUTH_ERR_396, system-signal=DET_AZIMUTH_ERR_396}, {application-record-element=DET_BELOW_RAIN_THOLD_393, system-signal=DET_BELOW_RAIN_THOLD_393}, {application-record-element=DET_BELOW_RAIN_THOLD_394, system-signal=DET_BELOW_RAIN_THOLD_394}, {application-record-element=DET_BELOW_RAIN_THOLD_395, system-signal=DET_BELOW_RAIN_THOLD_395}, {application-record-element=DET_BELOW_RAIN_THOLD_396, system-signal=DET_BELOW_RAIN_THOLD_396}, {application-record-element=DET_BI_STATIC_FLAG_393, system-signal=DET_BI_STATIC_FLAG_393}, {application-record-element=DET_BI_STATIC_FLAG_394, system-signal=DET_BI_STATIC_FLAG_394}, {application-record-element=DET_BI_STATIC_FLAG_395, system-signal=DET_BI_STATIC_FLAG_395}, {application-record-element=DET_BI_STATIC_FLAG_396, system-signal=DET_BI_STATIC_FLAG_396}, {application-record-element=DET_CONFD_AZIMUTH_393, system-signal=DET_CONFD_AZIMUTH_393}, {application-record-element=DET_CONFD_AZIMUTH_394, system-signal=DET_CONFD_AZIMUTH_394}, {application-record-element=DET_CONFD_AZIMUTH_395, system-signal=DET_CONFD_AZIMUTH_395}, {application-record-element=DET_CONFD_AZIMUTH_396, system-signal=DET_CONFD_AZIMUTH_396}, {application-record-element=DET_CONFD_ELEVATION_393, system-signal=DET_CONFD_ELEVATION_393}, {application-record-element=DET_CONFD_ELEVATION_394, system-signal=DET_CONFD_ELEVATION_394}, {application-record-element=DET_CONFD_ELEVATION_395, system-signal=DET_CONFD_ELEVATION_395}, {application-record-element=DET_CONFD_ELEVATION_396, system-signal=DET_CONFD_ELEVATION_396}, {application-record-element=DET_ELEVATION_393, system-signal=DET_ELEVATION_393}, {application-record-element=DET_ELEVATION_394, system-signal=DET_ELEVATION_394}, {application-record-element=DET_ELEVATION_395, system-signal=DET_ELEVATION_395}, {application-record-element=DET_ELEVATION_396, system-signal=DET_ELEVATION_396}, {application-record-element=DET_ELEVATION_ERR_393, system-signal=DET_ELEVATION_ERR_393}, {application-record-element=DET_ELEVATION_ERR_394, system-signal=DET_ELEVATION_ERR_394}, {application-record-element=DET_ELEVATION_ERR_395, system-signal=DET_ELEVATION_ERR_395}, {application-record-element=DET_ELEVATION_ERR_396, system-signal=DET_ELEVATION_ERR_396}, {application-record-element=DET_EXISTENCE_PROB_393, system-signal=DET_EXISTENCE_PROB_393}, {application-record-element=DET_EXISTENCE_PROB_394, system-signal=DET_EXISTENCE_PROB_394}, {application-record-element=DET_EXISTENCE_PROB_395, system-signal=DET_EXISTENCE_PROB_395}, {application-record-element=DET_EXISTENCE_PROB_396, system-signal=DET_EXISTENCE_PROB_396}, {application-record-element=DET_HVC_FLAG_393, system-signal=DET_HVC_FLAG_393}, {application-record-element=DET_HVC_FLAG_394, system-signal=DET_HVC_FLAG_394}, {application-record-element=DET_HVC_FLAG_395, system-signal=DET_HVC_FLAG_395}, {application-record-element=DET_HVC_FLAG_396, system-signal=DET_HVC_FLAG_396}, {application-record-element=DET_IDM_393, system-signal=DET_IDM_393}, {application-record-element=DET_IDM_394, system-signal=DET_IDM_394}, {application-record-element=DET_IDM_395, system-signal=DET_IDM_395}, {application-record-element=DET_IDM_396, system-signal=DET_IDM_396}, {application-record-element=DET_MH_CRC16_393_396, system-signal=DET_MH_CRC16_393_396}, {application-record-element=DET_MH_CYCLE_COUNTER_393_396, system-signal=DET_MH_CYCLE_COUNTER_393_396}, {application-record-element=DET_MH_SCAN_INDEX_4LSB_393_396, system-signal=DET_MH_SCAN_INDEX_4LSB_393_396}, {application-record-element=DET_MTD_393, system-signal=DET_MTD_393}, {application-record-element=DET_MTD_394, system-signal=DET_MTD_394}, {application-record-element=DET_MTD_395, system-signal=DET_MTD_395}, {application-record-element=DET_MTD_396, system-signal=DET_MTD_396}, {application-record-element=DET_PROB_1STAZHYPO_393, system-signal=DET_PROB_1STAZHYPO_393}, {application-record-element=DET_PROB_1STAZHYPO_394, system-signal=DET_PROB_1STAZHYPO_394}, {application-record-element=DET_PROB_1STAZHYPO_395, system-signal=DET_PROB_1STAZHYPO_395}, {application-record-element=DET_PROB_1STAZHYPO_396, system-signal=DET_PROB_1STAZHYPO_396}, {application-record-element=DET_RANGE_393, system-signal=DET_RANGE_393}, {application-record-element=DET_RANGE_394, system-signal=DET_RANGE_394}, {application-record-element=DET_RANGE_395, system-signal=DET_RANGE_395}, {application-record-element=DET_RANGE_396, system-signal=DET_RANGE_396}, {application-record-element=DET_RANGE_ERR_393, system-signal=DET_RANGE_ERR_393}, {application-record-element=DET_RANGE_ERR_394, system-signal=DET_RANGE_ERR_394}, {application-record-element=DET_RANGE_ERR_395, system-signal=DET_RANGE_ERR_395}, {application-record-element=DET_RANGE_ERR_396, system-signal=DET_RANGE_ERR_396}, {application-record-element=DET_RANGE_VELOCITY_393, system-signal=DET_RANGE_VELOCITY_393}, {application-record-element=DET_RANGE_VELOCITY_394, system-signal=DET_RANGE_VELOCITY_394}, {application-record-element=DET_RANGE_VELOCITY_395, system-signal=DET_RANGE_VELOCITY_395}, {application-record-element=DET_RANGE_VELOCITY_396, system-signal=DET_RANGE_VELOCITY_396}, {application-record-element=DET_RANGE_VELOCITY_ERR_393, system-signal=DET_RANGE_VELOCITY_ERR_393}, {application-record-element=DET_RANGE_VELOCITY_ERR_394, system-signal=DET_RANGE_VELOCITY_ERR_394}, {application-record-element=DET_RANGE_VELOCITY_ERR_395, system-signal=DET_RANGE_VELOCITY_ERR_395}, {application-record-element=DET_RANGE_VELOCITY_ERR_396, system-signal=DET_RANGE_VELOCITY_ERR_396}, {application-record-element=DET_RCS_393, system-signal=DET_RCS_393}, {application-record-element=DET_RCS_394, system-signal=DET_RCS_394}, {application-record-element=DET_RCS_395, system-signal=DET_RCS_395}, {application-record-element=DET_RCS_396, system-signal=DET_RCS_396}, {application-record-element=DET_SNR_393, system-signal=DET_SNR_393}, {application-record-element=DET_SNR_394, system-signal=DET_SNR_394}, {application-record-element=DET_SNR_395, system-signal=DET_SNR_395}, {application-record-element=DET_SNR_396, system-signal=DET_SNR_396}, {application-record-element=DET_SUPER_RES_TARGET_393, system-signal=DET_SUPER_RES_TARGET_393}, {application-record-element=DET_SUPER_RES_TARGET_394, system-signal=DET_SUPER_RES_TARGET_394}, {application-record-element=DET_SUPER_RES_TARGET_395, system-signal=DET_SUPER_RES_TARGET_395}, {application-record-element=DET_SUPER_RES_TARGET_396, system-signal=DET_SUPER_RES_TARGET_396}]}
        sender-receiver-to-signal-group-mapping={data-element=Pp_SG_Detections_397_400_AL.Vdp_SG_Detections_397_400_AL, signal-group=SG_Detections_397_400, type-mapping=sender-rec-record-type-mapping=record-element-mappings=[{application-record-element=DET_AZIMUTH_397, system-signal=DET_AZIMUTH_397}, {application-record-element=DET_AZIMUTH_398, system-signal=DET_AZIMUTH_398}, {application-record-element=DET_AZIMUTH_399, system-signal=DET_AZIMUTH_399}, {application-record-element=DET_AZIMUTH_400, system-signal=DET_AZIMUTH_400}, {application-record-element=DET_AZIMUTH_ERR_397, system-signal=DET_AZIMUTH_ERR_397}, {application-record-element=DET_AZIMUTH_ERR_398, system-signal=DET_AZIMUTH_ERR_398}, {application-record-element=DET_AZIMUTH_ERR_399, system-signal=DET_AZIMUTH_ERR_399}, {application-record-element=DET_AZIMUTH_ERR_400, system-signal=DET_AZIMUTH_ERR_400}, {application-record-element=DET_BELOW_RAIN_THOLD_397, system-signal=DET_BELOW_RAIN_THOLD_397}, {application-record-element=DET_BELOW_RAIN_THOLD_398, system-signal=DET_BELOW_RAIN_THOLD_398}, {application-record-element=DET_BELOW_RAIN_THOLD_399, system-signal=DET_BELOW_RAIN_THOLD_399}, {application-record-element=DET_BELOW_RAIN_THOLD_400, system-signal=DET_BELOW_RAIN_THOLD_400}, {application-record-element=DET_BI_STATIC_FLAG_397, system-signal=DET_BI_STATIC_FLAG_397}, {application-record-element=DET_BI_STATIC_FLAG_398, system-signal=DET_BI_STATIC_FLAG_398}, {application-record-element=DET_BI_STATIC_FLAG_399, system-signal=DET_BI_STATIC_FLAG_399}, {application-record-element=DET_BI_STATIC_FLAG_400, system-signal=DET_BI_STATIC_FLAG_400}, {application-record-element=DET_CONFD_AZIMUTH_397, system-signal=DET_CONFD_AZIMUTH_397}, {application-record-element=DET_CONFD_AZIMUTH_398, system-signal=DET_CONFD_AZIMUTH_398}, {application-record-element=DET_CONFD_AZIMUTH_399, system-signal=DET_CONFD_AZIMUTH_399}, {application-record-element=DET_CONFD_AZIMUTH_400, system-signal=DET_CONFD_AZIMUTH_400}, {application-record-element=DET_CONFD_ELEVATION_397, system-signal=DET_CONFD_ELEVATION_397}, {application-record-element=DET_CONFD_ELEVATION_398, system-signal=DET_CONFD_ELEVATION_398}, {application-record-element=DET_CONFD_ELEVATION_399, system-signal=DET_CONFD_ELEVATION_399}, {application-record-element=DET_CONFD_ELEVATION_400, system-signal=DET_CONFD_ELEVATION_400}, {application-record-element=DET_ELEVATION_397, system-signal=DET_ELEVATION_397}, {application-record-element=DET_ELEVATION_398, system-signal=DET_ELEVATION_398}, {application-record-element=DET_ELEVATION_399, system-signal=DET_ELEVATION_399}, {application-record-element=DET_ELEVATION_400, system-signal=DET_ELEVATION_400}, {application-record-element=DET_ELEVATION_ERR_397, system-signal=DET_ELEVATION_ERR_397}, {application-record-element=DET_ELEVATION_ERR_398, system-signal=DET_ELEVATION_ERR_398}, {application-record-element=DET_ELEVATION_ERR_399, system-signal=DET_ELEVATION_ERR_399}, {application-record-element=DET_ELEVATION_ERR_400, system-signal=DET_ELEVATION_ERR_400}, {application-record-element=DET_EXISTENCE_PROB_397, system-signal=DET_EXISTENCE_PROB_397}, {application-record-element=DET_EXISTENCE_PROB_398, system-signal=DET_EXISTENCE_PROB_398}, {application-record-element=DET_EXISTENCE_PROB_399, system-signal=DET_EXISTENCE_PROB_399}, {application-record-element=DET_EXISTENCE_PROB_400, system-signal=DET_EXISTENCE_PROB_400}, {application-record-element=DET_HVC_FLAG_397, system-signal=DET_HVC_FLAG_397}, {application-record-element=DET_HVC_FLAG_398, system-signal=DET_HVC_FLAG_398}, {application-record-element=DET_HVC_FLAG_399, system-signal=DET_HVC_FLAG_399}, {application-record-element=DET_HVC_FLAG_400, system-signal=DET_HVC_FLAG_400}, {application-record-element=DET_IDM_397, system-signal=DET_IDM_397}, {application-record-element=DET_IDM_398, system-signal=DET_IDM_398}, {application-record-element=DET_IDM_399, system-signal=DET_IDM_399}, {application-record-element=DET_IDM_400, system-signal=DET_IDM_400}, {application-record-element=DET_MH_CRC16_397_400, system-signal=DET_MH_CRC16_397_400}, {application-record-element=DET_MH_CYCLE_COUNTER_397_400, system-signal=DET_MH_CYCLE_COUNTER_397_400}, {application-record-element=DET_MH_SCAN_INDEX_4LSB_397_400, system-signal=DET_MH_SCAN_INDEX_4LSB_397_400}, {application-record-element=DET_MTD_397, system-signal=DET_MTD_397}, {application-record-element=DET_MTD_398, system-signal=DET_MTD_398}, {application-record-element=DET_MTD_399, system-signal=DET_MTD_399}, {application-record-element=DET_MTD_400, system-signal=DET_MTD_400}, {application-record-element=DET_PROB_1STAZHYPO_397, system-signal=DET_PROB_1STAZHYPO_397}, {application-record-element=DET_PROB_1STAZHYPO_398, system-signal=DET_PROB_1STAZHYPO_398}, {application-record-element=DET_PROB_1STAZHYPO_399, system-signal=DET_PROB_1STAZHYPO_399}, {application-record-element=DET_PROB_1STAZHYPO_400, system-signal=DET_PROB_1STAZHYPO_400}, {application-record-element=DET_RANGE_397, system-signal=DET_RANGE_397}, {application-record-element=DET_RANGE_398, system-signal=DET_RANGE_398}, {application-record-element=DET_RANGE_399, system-signal=DET_RANGE_399}, {application-record-element=DET_RANGE_400, system-signal=DET_RANGE_400}, {application-record-element=DET_RANGE_ERR_397, system-signal=DET_RANGE_ERR_397}, {application-record-element=DET_RANGE_ERR_398, system-signal=DET_RANGE_ERR_398}, {application-record-element=DET_RANGE_ERR_399, system-signal=DET_RANGE_ERR_399}, {application-record-element=DET_RANGE_ERR_400, system-signal=DET_RANGE_ERR_400}, {application-record-element=DET_RANGE_VELOCITY_397, system-signal=DET_RANGE_VELOCITY_397}, {application-record-element=DET_RANGE_VELOCITY_398, system-signal=DET_RANGE_VELOCITY_398}, {application-record-element=DET_RANGE_VELOCITY_399, system-signal=DET_RANGE_VELOCITY_399}, {application-record-element=DET_RANGE_VELOCITY_400, system-signal=DET_RANGE_VELOCITY_400}, {application-record-element=DET_RANGE_VELOCITY_ERR_397, system-signal=DET_RANGE_VELOCITY_ERR_397}, {application-record-element=DET_RANGE_VELOCITY_ERR_398, system-signal=DET_RANGE_VELOCITY_ERR_398}, {application-record-element=DET_RANGE_VELOCITY_ERR_399, system-signal=DET_RANGE_VELOCITY_ERR_399}, {application-record-element=DET_RANGE_VELOCITY_ERR_400, system-signal=DET_RANGE_VELOCITY_ERR_400}, {application-record-element=DET_RCS_397, system-signal=DET_RCS_397}, {application-record-element=DET_RCS_398, system-signal=DET_RCS_398}, {application-record-element=DET_RCS_399, system-signal=DET_RCS_399}, {application-record-element=DET_RCS_400, system-signal=DET_RCS_400}, {application-record-element=DET_SNR_397, system-signal=DET_SNR_397}, {application-record-element=DET_SNR_398, system-signal=DET_SNR_398}, {application-record-element=DET_SNR_399, system-signal=DET_SNR_399}, {application-record-element=DET_SNR_400, system-signal=DET_SNR_400}, {application-record-element=DET_SUPER_RES_TARGET_397, system-signal=DET_SUPER_RES_TARGET_397}, {application-record-element=DET_SUPER_RES_TARGET_398, system-signal=DET_SUPER_RES_TARGET_398}, {application-record-element=DET_SUPER_RES_TARGET_399, system-signal=DET_SUPER_RES_TARGET_399}, {application-record-element=DET_SUPER_RES_TARGET_400, system-signal=DET_SUPER_RES_TARGET_400}]}
        sender-receiver-to-signal-group-mapping={data-element=Rp_SG_Fusion_Detections_001_004_AL.Vdp_SG_Fusion_Detections_001_004_AL, signal-group=SG_Fusion_Detections_001_004, type-mapping=sender-rec-record-type-mapping=record-element-mappings=[{application-record-element=DET_AZIMUTH_001_Rx, system-signal=DET_AZIMUTH_001_Rx}, {application-record-element=DET_AZIMUTH_002_Rx, system-signal=DET_AZIMUTH_002_Rx}, {application-record-element=DET_AZIMUTH_003_Rx, system-signal=DET_AZIMUTH_003_Rx}, {application-record-element=DET_AZIMUTH_004_Rx, system-signal=DET_AZIMUTH_004_Rx}, {application-record-element=DET_AZIMUTH_ERR_001_Rx, system-signal=DET_AZIMUTH_ERR_001_Rx}, {application-record-element=DET_AZIMUTH_ERR_002_Rx, system-signal=DET_AZIMUTH_ERR_002_Rx}, {application-record-element=DET_AZIMUTH_ERR_003_Rx, system-signal=DET_AZIMUTH_ERR_003_Rx}, {application-record-element=DET_AZIMUTH_ERR_004_Rx, system-signal=DET_AZIMUTH_ERR_004_Rx}, {application-record-element=DET_BELOW_RAIN_THOLD_001_Rx, system-signal=DET_BELOW_RAIN_THOLD_001_Rx}, {application-record-element=DET_BELOW_RAIN_THOLD_002_Rx, system-signal=DET_BELOW_RAIN_THOLD_002_Rx}, {application-record-element=DET_BELOW_RAIN_THOLD_003_Rx, system-signal=DET_BELOW_RAIN_THOLD_003_Rx}, {application-record-element=DET_BELOW_RAIN_THOLD_004_Rx, system-signal=DET_BELOW_RAIN_THOLD_004_Rx}, {application-record-element=DET_BI_STATIC_FLAG_001_Rx, system-signal=DET_BI_STATIC_FLAG_001_Rx}, {application-record-element=DET_BI_STATIC_FLAG_002_Rx, system-signal=DET_BI_STATIC_FLAG_002_Rx}, {application-record-element=DET_BI_STATIC_FLAG_003_Rx, system-signal=DET_BI_STATIC_FLAG_003_Rx}, {application-record-element=DET_BI_STATIC_FLAG_004_Rx, system-signal=DET_BI_STATIC_FLAG_004_Rx}, {application-record-element=DET_CONFD_AZIMUTH_001_Rx, system-signal=DET_CONFD_AZIMUTH_001_Rx}, {application-record-element=DET_CONFD_AZIMUTH_002_Rx, system-signal=DET_CONFD_AZIMUTH_002_Rx}, {application-record-element=DET_CONFD_AZIMUTH_003_Rx, system-signal=DET_CONFD_AZIMUTH_003_Rx}, {application-record-element=DET_CONFD_AZIMUTH_004_Rx, system-signal=DET_CONFD_AZIMUTH_004_Rx}, {application-record-element=DET_CONFD_ELEVATION_001_Rx, system-signal=DET_CONFD_ELEVATION_001_Rx}, {application-record-element=DET_CONFD_ELEVATION_002_Rx, system-signal=DET_CONFD_ELEVATION_002_Rx}, {application-record-element=DET_CONFD_ELEVATION_003_Rx, system-signal=DET_CONFD_ELEVATION_003_Rx}, {application-record-element=DET_CONFD_ELEVATION_004_Rx, system-signal=DET_CONFD_ELEVATION_004_Rx}, {application-record-element=DET_ELEVATION_001_Rx, system-signal=DET_ELEVATION_001_Rx}, {application-record-element=DET_ELEVATION_002_Rx, system-signal=DET_ELEVATION_002_Rx}, {application-record-element=DET_ELEVATION_003_Rx, system-signal=DET_ELEVATION_003_Rx}, {application-record-element=DET_ELEVATION_004_Rx, system-signal=DET_ELEVATION_004_Rx}, {application-record-element=DET_ELEVATION_ERR_001_Rx, system-signal=DET_ELEVATION_ERR_001_Rx}, {application-record-element=DET_ELEVATION_ERR_002_Rx, system-signal=DET_ELEVATION_ERR_002_Rx}, {application-record-element=DET_ELEVATION_ERR_003_Rx, system-signal=DET_ELEVATION_ERR_003_Rx}, {application-record-element=DET_ELEVATION_ERR_004_Rx, system-signal=DET_ELEVATION_ERR_004_Rx}, {application-record-element=DET_EXISTENCE_PROB_001_Rx, system-signal=DET_EXISTENCE_PROB_001_Rx}, {application-record-element=DET_EXISTENCE_PROB_002_Rx, system-signal=DET_EXISTENCE_PROB_002_Rx}, {application-record-element=DET_EXISTENCE_PROB_003_Rx, system-signal=DET_EXISTENCE_PROB_003_Rx}, {application-record-element=DET_EXISTENCE_PROB_004_Rx, system-signal=DET_EXISTENCE_PROB_004_Rx}, {application-record-element=DET_HVC_FLAG_001_Rx, system-signal=DET_HVC_FLAG_001_Rx}, {application-record-element=DET_HVC_FLAG_002_Rx, system-signal=DET_HVC_FLAG_002_Rx}, {application-record-element=DET_HVC_FLAG_003_Rx, system-signal=DET_HVC_FLAG_003_Rx}, {application-record-element=DET_HVC_FLAG_004_Rx, system-signal=DET_HVC_FLAG_004_Rx}, {application-record-element=DET_IDM_001_Rx, system-signal=DET_IDM_001_Rx}, {application-record-element=DET_IDM_002_Rx, system-signal=DET_IDM_002_Rx}, {application-record-element=DET_IDM_003_Rx, system-signal=DET_IDM_003_Rx}, {application-record-element=DET_IDM_004_Rx, system-signal=DET_IDM_004_Rx}, {application-record-element=DET_MH_CRC16_001_004_Rx, system-signal=DET_MH_CRC16_001_004_Rx}, {application-record-element=DET_MH_CYCLE_COUNTER_001_004_Rx, system-signal=DET_MH_CYCLE_COUNTER_001_004_Rx}, {application-record-element=DET_MH_SCAN_INDEX_4LSB_001_004_Rx, system-signal=DET_MH_SCAN_INDEX_4LSB_001_004_Rx}, {application-record-element=DET_MTD_001_Rx, system-signal=DET_MTD_001_Rx}, {application-record-element=DET_MTD_002_Rx, system-signal=DET_MTD_002_Rx}, {application-record-element=DET_MTD_003_Rx, system-signal=DET_MTD_003_Rx}, {application-record-element=DET_MTD_004_Rx, system-signal=DET_MTD_004_Rx}, {application-record-element=DET_PROB_1STAZHYPO_001_Rx, system-signal=DET_PROB_1STAZHYPO_001_Rx}, {application-record-element=DET_PROB_1STAZHYPO_002_Rx, system-signal=DET_PROB_1STAZHYPO_002_Rx}, {application-record-element=DET_PROB_1STAZHYPO_003_Rx, system-signal=DET_PROB_1STAZHYPO_003_Rx}, {application-record-element=DET_PROB_1STAZHYPO_004_Rx, system-signal=DET_PROB_1STAZHYPO_004_Rx}, {application-record-element=DET_RANGE_001_Rx, system-signal=DET_RANGE_001_Rx}, {application-record-element=DET_RANGE_002_Rx, system-signal=DET_RANGE_002_Rx}, {application-record-element=DET_RANGE_003_Rx, system-signal=DET_RANGE_003_Rx}, {application-record-element=DET_RANGE_004_Rx, system-signal=DET_RANGE_004_Rx}, {application-record-element=DET_RANGE_ERR_001_Rx, system-signal=DET_RANGE_ERR_001_Rx}, {application-record-element=DET_RANGE_ERR_002_Rx, system-signal=DET_RANGE_ERR_002_Rx}, {application-record-element=DET_RANGE_ERR_003_Rx, system-signal=DET_RANGE_ERR_003_Rx}, {application-record-element=DET_RANGE_ERR_004_Rx, system-signal=DET_RANGE_ERR_004_Rx}, {application-record-element=DET_RANGE_VELOCITY_001_Rx, system-signal=DET_RANGE_VELOCITY_001_Rx}, {application-record-element=DET_RANGE_VELOCITY_002_Rx, system-signal=DET_RANGE_VELOCITY_002_Rx}, {application-record-element=DET_RANGE_VELOCITY_003_Rx, system-signal=DET_RANGE_VELOCITY_003_Rx}, {application-record-element=DET_RANGE_VELOCITY_004_Rx, system-signal=DET_RANGE_VELOCITY_004_Rx}, {application-record-element=DET_RANGE_VELOCITY_ERR_001_Rx, system-signal=DET_RANGE_VELOCITY_ERR_001_Rx}, {application-record-element=DET_RANGE_VELOCITY_ERR_002_Rx, system-signal=DET_RANGE_VELOCITY_ERR_002_Rx}, {application-record-element=DET_RANGE_VELOCITY_ERR_003_Rx, system-signal=DET_RANGE_VELOCITY_ERR_003_Rx}, {application-record-element=DET_RANGE_VELOCITY_ERR_004_Rx, system-signal=DET_RANGE_VELOCITY_ERR_004_Rx}, {application-record-element=DET_RCS_001_Rx, system-signal=DET_RCS_001_Rx}, {application-record-element=DET_RCS_002_Rx, system-signal=DET_RCS_002_Rx}, {application-record-element=DET_RCS_003_Rx, system-signal=DET_RCS_003_Rx}, {application-record-element=DET_RCS_004_Rx, system-signal=DET_RCS_004_Rx}, {application-record-element=DET_SNR_001_Rx, system-signal=DET_SNR_001_Rx}, {application-record-element=DET_SNR_002_Rx, system-signal=DET_SNR_002_Rx}, {application-record-element=DET_SNR_003_Rx, system-signal=DET_SNR_003_Rx}, {application-record-element=DET_SNR_004_Rx, system-signal=DET_SNR_004_Rx}, {application-record-element=DET_SUPER_RES_TARGET_001_Rx, system-signal=DET_SUPER_RES_TARGET_001_Rx}, {application-record-element=DET_SUPER_RES_TARGET_002_Rx, system-signal=DET_SUPER_RES_TARGET_002_Rx}, {application-record-element=DET_SUPER_RES_TARGET_003_Rx, system-signal=DET_SUPER_RES_TARGET_003_Rx}, {application-record-element=DET_SUPER_RES_TARGET_004_Rx, system-signal=DET_SUPER_RES_TARGET_004_Rx}]}
        sender-receiver-to-signal-group-mapping={data-element=Rp_SG_Fusion_Detections_005_008_AL.Vdp_SG_Fusion_Detections_005_008_AL, signal-group=SG_Fusion_Detections_005_008, type-mapping=sender-rec-record-type-mapping=record-element-mappings=[{application-record-element=DET_AZIMUTH_005_Rx, system-signal=DET_AZIMUTH_005_Rx}, {application-record-element=DET_AZIMUTH_006_Rx, system-signal=DET_AZIMUTH_006_Rx}, {application-record-element=DET_AZIMUTH_007_Rx, system-signal=DET_AZIMUTH_007_Rx}, {application-record-element=DET_AZIMUTH_008_Rx, system-signal=DET_AZIMUTH_008_Rx}, {application-record-element=DET_AZIMUTH_ERR_005_Rx, system-signal=DET_AZIMUTH_ERR_005_Rx}, {application-record-element=DET_AZIMUTH_ERR_006_Rx, system-signal=DET_AZIMUTH_ERR_006_Rx}, {application-record-element=DET_AZIMUTH_ERR_007_Rx, system-signal=DET_AZIMUTH_ERR_007_Rx}, {application-record-element=DET_AZIMUTH_ERR_008_Rx, system-signal=DET_AZIMUTH_ERR_008_Rx}, {application-record-element=DET_BELOW_RAIN_THOLD_005_Rx, system-signal=DET_BELOW_RAIN_THOLD_005_Rx}, {application-record-element=DET_BELOW_RAIN_THOLD_006_Rx, system-signal=DET_BELOW_RAIN_THOLD_006_Rx}, {application-record-element=DET_BELOW_RAIN_THOLD_007_Rx, system-signal=DET_BELOW_RAIN_THOLD_007_Rx}, {application-record-element=DET_BELOW_RAIN_THOLD_008_Rx, system-signal=DET_BELOW_RAIN_THOLD_008_Rx}, {application-record-element=DET_BI_STATIC_FLAG_005_Rx, system-signal=DET_BI_STATIC_FLAG_005_Rx}, {application-record-element=DET_BI_STATIC_FLAG_006_Rx, system-signal=DET_BI_STATIC_FLAG_006_Rx}, {application-record-element=DET_BI_STATIC_FLAG_007_Rx, system-signal=DET_BI_STATIC_FLAG_007_Rx}, {application-record-element=DET_BI_STATIC_FLAG_008_Rx, system-signal=DET_BI_STATIC_FLAG_008_Rx}, {application-record-element=DET_CONFD_AZIMUTH_005_Rx, system-signal=DET_CONFD_AZIMUTH_005_Rx}, {application-record-element=DET_CONFD_AZIMUTH_006_Rx, system-signal=DET_CONFD_AZIMUTH_006_Rx}, {application-record-element=DET_CONFD_AZIMUTH_007_Rx, system-signal=DET_CONFD_AZIMUTH_007_Rx}, {application-record-element=DET_CONFD_AZIMUTH_008_Rx, system-signal=DET_CONFD_AZIMUTH_008_Rx}, {application-record-element=DET_CONFD_ELEVATION_005_Rx, system-signal=DET_CONFD_ELEVATION_005_Rx}, {application-record-element=DET_CONFD_ELEVATION_006_Rx, system-signal=DET_CONFD_ELEVATION_006_Rx}, {application-record-element=DET_CONFD_ELEVATION_007_Rx, system-signal=DET_CONFD_ELEVATION_007_Rx}, {application-record-element=DET_CONFD_ELEVATION_008_Rx, system-signal=DET_CONFD_ELEVATION_008_Rx}, {application-record-element=DET_ELEVATION_005_Rx, system-signal=DET_ELEVATION_005_Rx}, {application-record-element=DET_ELEVATION_006_Rx, system-signal=DET_ELEVATION_006_Rx}, {application-record-element=DET_ELEVATION_007_Rx, system-signal=DET_ELEVATION_007_Rx}, {application-record-element=DET_ELEVATION_008_Rx, system-signal=DET_ELEVATION_008_Rx}, {application-record-element=DET_ELEVATION_ERR_005_Rx, system-signal=DET_ELEVATION_ERR_005_Rx}, {application-record-element=DET_ELEVATION_ERR_006_Rx, system-signal=DET_ELEVATION_ERR_006_Rx}, {application-record-element=DET_ELEVATION_ERR_007_Rx, system-signal=DET_ELEVATION_ERR_007_Rx}, {application-record-element=DET_ELEVATION_ERR_008_Rx, system-signal=DET_ELEVATION_ERR_008_Rx}, {application-record-element=DET_EXISTENCE_PROB_005_Rx, system-signal=DET_EXISTENCE_PROB_005_Rx}, {application-record-element=DET_EXISTENCE_PROB_006_Rx, system-signal=DET_EXISTENCE_PROB_006_Rx}, {application-record-element=DET_EXISTENCE_PROB_007_Rx, system-signal=DET_EXISTENCE_PROB_007_Rx}, {application-record-element=DET_EXISTENCE_PROB_008_Rx, system-signal=DET_EXISTENCE_PROB_008_Rx}, {application-record-element=DET_HVC_FLAG_005_Rx, system-signal=DET_HVC_FLAG_005_Rx}, {application-record-element=DET_HVC_FLAG_006_Rx, system-signal=DET_HVC_FLAG_006_Rx}, {application-record-element=DET_HVC_FLAG_007_Rx, system-signal=DET_HVC_FLAG_007_Rx}, {application-record-element=DET_HVC_FLAG_008_Rx, system-signal=DET_HVC_FLAG_008_Rx}, {application-record-element=DET_IDM_005_Rx, system-signal=DET_IDM_005_Rx}, {application-record-element=DET_IDM_006_Rx, system-signal=DET_IDM_006_Rx}, {application-record-element=DET_IDM_007_Rx, system-signal=DET_IDM_007_Rx}, {application-record-element=DET_IDM_008_Rx, system-signal=DET_IDM_008_Rx}, {application-record-element=DET_MH_CRC16_005_008_Rx, system-signal=DET_MH_CRC16_005_008_Rx}, {application-record-element=DET_MH_CYCLE_COUNTER_005_008_Rx, system-signal=DET_MH_CYCLE_COUNTER_005_008_Rx}, {application-record-element=DET_MH_SCAN_INDEX_4LSB_005_008_Rx, system-signal=DET_MH_SCAN_INDEX_4LSB_005_008_Rx}, {application-record-element=DET_MTD_005_Rx, system-signal=DET_MTD_005_Rx}, {application-record-element=DET_MTD_006_Rx, system-signal=DET_MTD_006_Rx}, {application-record-element=DET_MTD_007_Rx, system-signal=DET_MTD_007_Rx}, {application-record-element=DET_MTD_008_Rx, system-signal=DET_MTD_008_Rx}, {application-record-element=DET_PROB_1STAZHYPO_005_Rx, system-signal=DET_PROB_1STAZHYPO_005_Rx}, {application-record-element=DET_PROB_1STAZHYPO_006_Rx, system-signal=DET_PROB_1STAZHYPO_006_Rx}, {application-record-element=DET_PROB_1STAZHYPO_007_Rx, system-signal=DET_PROB_1STAZHYPO_007_Rx}, {application-record-element=DET_PROB_1STAZHYPO_008_Rx, system-signal=DET_PROB_1STAZHYPO_008_Rx}, {application-record-element=DET_RANGE_005_Rx, system-signal=DET_RANGE_005_Rx}, {application-record-element=DET_RANGE_006_Rx, system-signal=DET_RANGE_006_Rx}, {application-record-element=DET_RANGE_007_Rx, system-signal=DET_RANGE_007_Rx}, {application-record-element=DET_RANGE_008_Rx, system-signal=DET_RANGE_008_Rx}, {application-record-element=DET_RANGE_ERR_005_Rx, system-signal=DET_RANGE_ERR_005_Rx}, {application-record-element=DET_RANGE_ERR_006_Rx, system-signal=DET_RANGE_ERR_006_Rx}, {application-record-element=DET_RANGE_ERR_007_Rx, system-signal=DET_RANGE_ERR_007_Rx}, {application-record-element=DET_RANGE_ERR_008_Rx, system-signal=DET_RANGE_ERR_008_Rx}, {application-record-element=DET_RANGE_VELOCITY_005_Rx, system-signal=DET_RANGE_VELOCITY_005_Rx}, {application-record-element=DET_RANGE_VELOCITY_006_Rx, system-signal=DET_RANGE_VELOCITY_006_Rx}, {application-record-element=DET_RANGE_VELOCITY_007_Rx, system-signal=DET_RANGE_VELOCITY_007_Rx}, {application-record-element=DET_RANGE_VELOCITY_008_Rx, system-signal=DET_RANGE_VELOCITY_008_Rx}, {application-record-element=DET_RANGE_VELOCITY_ERR_005_Rx, system-signal=DET_RANGE_VELOCITY_ERR_005_Rx}, {application-record-element=DET_RANGE_VELOCITY_ERR_006_Rx, system-signal=DET_RANGE_VELOCITY_ERR_006_Rx}, {application-record-element=DET_RANGE_VELOCITY_ERR_007_Rx, system-signal=DET_RANGE_VELOCITY_ERR_007_Rx}, {application-record-element=DET_RANGE_VELOCITY_ERR_008_Rx, system-signal=DET_RANGE_VELOCITY_ERR_008_Rx}, {application-record-element=DET_RCS_005_Rx, system-signal=DET_RCS_005_Rx}, {application-record-element=DET_RCS_006_Rx, system-signal=DET_RCS_006_Rx}, {application-record-element=DET_RCS_007_Rx, system-signal=DET_RCS_007_Rx}, {application-record-element=DET_RCS_008_Rx, system-signal=DET_RCS_008_Rx}, {application-record-element=DET_SNR_005_Rx, system-signal=DET_SNR_005_Rx}, {application-record-element=DET_SNR_006_Rx, system-signal=DET_SNR_006_Rx}, {application-record-element=DET_SNR_007_Rx, system-signal=DET_SNR_007_Rx}, {application-record-element=DET_SNR_008_Rx, system-signal=DET_SNR_008_Rx}, {application-record-element=DET_SUPER_RES_TARGET_005_Rx, system-signal=DET_SUPER_RES_TARGET_005_Rx}, {application-record-element=DET_SUPER_RES_TARGET_006_Rx, system-signal=DET_SUPER_RES_TARGET_006_Rx}, {application-record-element=DET_SUPER_RES_TARGET_007_Rx, system-signal=DET_SUPER_RES_TARGET_007_Rx}, {application-record-element=DET_SUPER_RES_TARGET_008_Rx, system-signal=DET_SUPER_RES_TARGET_008_Rx}]}
        sender-receiver-to-signal-group-mapping={data-element=Rp_SG_Fusion_Detections_009_012_AL.Vdp_SG_Fusion_Detections_009_012_AL, signal-group=SG_Fusion_Detections_009_012, type-mapping=sender-rec-record-type-mapping=record-element-mappings=[{application-record-element=DET_AZIMUTH_009_Rx, system-signal=DET_AZIMUTH_009_Rx}, {application-record-element=DET_AZIMUTH_010_Rx, system-signal=DET_AZIMUTH_010_Rx}, {application-record-element=DET_AZIMUTH_011_Rx, system-signal=DET_AZIMUTH_011_Rx}, {application-record-element=DET_AZIMUTH_012_Rx, system-signal=DET_AZIMUTH_012_Rx}, {application-record-element=DET_AZIMUTH_ERR_009_Rx, system-signal=DET_AZIMUTH_ERR_009_Rx}, {application-record-element=DET_AZIMUTH_ERR_010_Rx, system-signal=DET_AZIMUTH_ERR_010_Rx}, {application-record-element=DET_AZIMUTH_ERR_011_Rx, system-signal=DET_AZIMUTH_ERR_011_Rx}, {application-record-element=DET_AZIMUTH_ERR_012_Rx, system-signal=DET_AZIMUTH_ERR_012_Rx}, {application-record-element=DET_BELOW_RAIN_THOLD_009_Rx, system-signal=DET_BELOW_RAIN_THOLD_009_Rx}, {application-record-element=DET_BELOW_RAIN_THOLD_010_Rx, system-signal=DET_BELOW_RAIN_THOLD_010_Rx}, {application-record-element=DET_BELOW_RAIN_THOLD_011_Rx, system-signal=DET_BELOW_RAIN_THOLD_011_Rx}, {application-record-element=DET_BELOW_RAIN_THOLD_012_Rx, system-signal=DET_BELOW_RAIN_THOLD_012_Rx}, {application-record-element=DET_BI_STATIC_FLAG_009_Rx, system-signal=DET_BI_STATIC_FLAG_009_Rx}, {application-record-element=DET_BI_STATIC_FLAG_010_Rx, system-signal=DET_BI_STATIC_FLAG_010_Rx}, {application-record-element=DET_BI_STATIC_FLAG_011_Rx, system-signal=DET_BI_STATIC_FLAG_011_Rx}, {application-record-element=DET_BI_STATIC_FLAG_012_Rx, system-signal=DET_BI_STATIC_FLAG_012_Rx}, {application-record-element=DET_CONFD_AZIMUTH_009_Rx, system-signal=DET_CONFD_AZIMUTH_009_Rx}, {application-record-element=DET_CONFD_AZIMUTH_010_Rx, system-signal=DET_CONFD_AZIMUTH_010_Rx}, {application-record-element=DET_CONFD_AZIMUTH_011_Rx, system-signal=DET_CONFD_AZIMUTH_011_Rx}, {application-record-element=DET_CONFD_AZIMUTH_012_Rx, system-signal=DET_CONFD_AZIMUTH_012_Rx}, {application-record-element=DET_CONFD_ELEVATION_009_Rx, system-signal=DET_CONFD_ELEVATION_009_Rx}, {application-record-element=DET_CONFD_ELEVATION_010_Rx, system-signal=DET_CONFD_ELEVATION_010_Rx}, {application-record-element=DET_CONFD_ELEVATION_011_Rx, system-signal=DET_CONFD_ELEVATION_011_Rx}, {application-record-element=DET_CONFD_ELEVATION_012_Rx, system-signal=DET_CONFD_ELEVATION_012_Rx}, {application-record-element=DET_ELEVATION_009_Rx, system-signal=DET_ELEVATION_009_Rx}, {application-record-element=DET_ELEVATION_010_Rx, system-signal=DET_ELEVATION_010_Rx}, {application-record-element=DET_ELEVATION_011_Rx, system-signal=DET_ELEVATION_011_Rx}, {application-record-element=DET_ELEVATION_012_Rx, system-signal=DET_ELEVATION_012_Rx}, {application-record-element=DET_ELEVATION_ERR_009_Rx, system-signal=DET_ELEVATION_ERR_009_Rx}, {application-record-element=DET_ELEVATION_ERR_010_Rx, system-signal=DET_ELEVATION_ERR_010_Rx}, {application-record-element=DET_ELEVATION_ERR_011_Rx, system-signal=DET_ELEVATION_ERR_011_Rx}, {application-record-element=DET_ELEVATION_ERR_012_Rx, system-signal=DET_ELEVATION_ERR_012_Rx}, {application-record-element=DET_EXISTENCE_PROB_009_Rx, system-signal=DET_EXISTENCE_PROB_009_Rx}, {application-record-element=DET_EXISTENCE_PROB_010_Rx, system-signal=DET_EXISTENCE_PROB_010_Rx}, {application-record-element=DET_EXISTENCE_PROB_011_Rx, system-signal=DET_EXISTENCE_PROB_011_Rx}, {application-record-element=DET_EXISTENCE_PROB_012_Rx, system-signal=DET_EXISTENCE_PROB_012_Rx}, {application-record-element=DET_HVC_FLAG_009_Rx, system-signal=DET_HVC_FLAG_009_Rx}, {application-record-element=DET_HVC_FLAG_010_Rx, system-signal=DET_HVC_FLAG_010_Rx}, {application-record-element=DET_HVC_FLAG_011_Rx, system-signal=DET_HVC_FLAG_011_Rx}, {application-record-element=DET_HVC_FLAG_012_Rx, system-signal=DET_HVC_FLAG_012_Rx}, {application-record-element=DET_IDM_009_Rx, system-signal=DET_IDM_009_Rx}, {application-record-element=DET_IDM_010_Rx, system-signal=DET_IDM_010_Rx}, {application-record-element=DET_IDM_011_Rx, system-signal=DET_IDM_011_Rx}, {application-record-element=DET_IDM_012_Rx, system-signal=DET_IDM_012_Rx}, {application-record-element=DET_MH_CRC16_009_012_Rx, system-signal=DET_MH_CRC16_009_012_Rx}, {application-record-element=DET_MH_CYCLE_COUNTER_009_012_Rx, system-signal=DET_MH_CYCLE_COUNTER_009_012_Rx}, {application-record-element=DET_MH_SCAN_INDEX_4LSB_009_012_Rx, system-signal=DET_MH_SCAN_INDEX_4LSB_009_012_Rx}, {application-record-element=DET_MTD_009_Rx, system-signal=DET_MTD_009_Rx}, {application-record-element=DET_MTD_010_Rx, system-signal=DET_MTD_010_Rx}, {application-record-element=DET_MTD_011_Rx, system-signal=DET_MTD_011_Rx}, {application-record-element=DET_MTD_012_Rx, system-signal=DET_MTD_012_Rx}, {application-record-element=DET_PROB_1STAZHYPO_009_Rx, system-signal=DET_PROB_1STAZHYPO_009_Rx}, {application-record-element=DET_PROB_1STAZHYPO_010_Rx, system-signal=DET_PROB_1STAZHYPO_010_Rx}, {application-record-element=DET_PROB_1STAZHYPO_011_Rx, system-signal=DET_PROB_1STAZHYPO_011_Rx}, {application-record-element=DET_PROB_1STAZHYPO_012_Rx, system-signal=DET_PROB_1STAZHYPO_012_Rx}, {application-record-element=DET_RANGE_009_Rx, system-signal=DET_RANGE_009_Rx}, {application-record-element=DET_RANGE_010_Rx, system-signal=DET_RANGE_010_Rx}, {application-record-element=DET_RANGE_011_Rx, system-signal=DET_RANGE_011_Rx}, {application-record-element=DET_RANGE_012_Rx, system-signal=DET_RANGE_012_Rx}, {application-record-element=DET_RANGE_ERR_009_Rx, system-signal=DET_RANGE_ERR_009_Rx}, {application-record-element=DET_RANGE_ERR_010_Rx, system-signal=DET_RANGE_ERR_010_Rx}, {application-record-element=DET_RANGE_ERR_011_Rx, system-signal=DET_RANGE_ERR_011_Rx}, {application-record-element=DET_RANGE_ERR_012_Rx, system-signal=DET_RANGE_ERR_012_Rx}, {application-record-element=DET_RANGE_VELOCITY_009_Rx, system-signal=DET_RANGE_VELOCITY_009_Rx}, {application-record-element=DET_RANGE_VELOCITY_010_Rx, system-signal=DET_RANGE_VELOCITY_010_Rx}, {application-record-element=DET_RANGE_VELOCITY_011_Rx, system-signal=DET_RANGE_VELOCITY_011_Rx}, {application-record-element=DET_RANGE_VELOCITY_012_Rx, system-signal=DET_RANGE_VELOCITY_012_Rx}, {application-record-element=DET_RANGE_VELOCITY_ERR_009_Rx, system-signal=DET_RANGE_VELOCITY_ERR_009_Rx}, {application-record-element=DET_RANGE_VELOCITY_ERR_010_Rx, system-signal=DET_RANGE_VELOCITY_ERR_010_Rx}, {application-record-element=DET_RANGE_VELOCITY_ERR_011_Rx, system-signal=DET_RANGE_VELOCITY_ERR_011_Rx}, {application-record-element=DET_RANGE_VELOCITY_ERR_012_Rx, system-signal=DET_RANGE_VELOCITY_ERR_012_Rx}, {application-record-element=DET_RCS_009_Rx, system-signal=DET_RCS_009_Rx}, {application-record-element=DET_RCS_010_Rx, system-signal=DET_RCS_010_Rx}, {application-record-element=DET_RCS_011_Rx, system-signal=DET_RCS_011_Rx}, {application-record-element=DET_RCS_012_Rx, system-signal=DET_RCS_012_Rx}, {application-record-element=DET_SNR_009_Rx, system-signal=DET_SNR_009_Rx}, {application-record-element=DET_SNR_010_Rx, system-signal=DET_SNR_010_Rx}, {application-record-element=DET_SNR_011_Rx, system-signal=DET_SNR_011_Rx}, {application-record-element=DET_SNR_012_Rx, system-signal=DET_SNR_012_Rx}, {application-record-element=DET_SUPER_RES_TARGET_009_Rx, system-signal=DET_SUPER_RES_TARGET_009_Rx}, {application-record-element=DET_SUPER_RES_TARGET_010_Rx, system-signal=DET_SUPER_RES_TARGET_010_Rx}, {application-record-element=DET_SUPER_RES_TARGET_011_Rx, system-signal=DET_SUPER_RES_TARGET_011_Rx}, {application-record-element=DET_SUPER_RES_TARGET_012_Rx, system-signal=DET_SUPER_RES_TARGET_012_Rx}]}
        sender-receiver-to-signal-group-mapping={data-element=Rp_SG_Fusion_Detections_013_016_AL.Vdp_SG_Fusion_Detections_013_016_AL, signal-group=SG_Fusion_Detections_013_016, type-mapping=sender-rec-record-type-mapping=record-element-mappings=[{application-record-element=DET_AZIMUTH_013_Rx, system-signal=DET_AZIMUTH_013_Rx}, {application-record-element=DET_AZIMUTH_014_Rx, system-signal=DET_AZIMUTH_014_Rx}, {application-record-element=DET_AZIMUTH_015_Rx, system-signal=DET_AZIMUTH_015_Rx}, {application-record-element=DET_AZIMUTH_016_Rx, system-signal=DET_AZIMUTH_016_Rx}, {application-record-element=DET_AZIMUTH_ERR_013_Rx, system-signal=DET_AZIMUTH_ERR_013_Rx}, {application-record-element=DET_AZIMUTH_ERR_014_Rx, system-signal=DET_AZIMUTH_ERR_014_Rx}, {application-record-element=DET_AZIMUTH_ERR_015_Rx, system-signal=DET_AZIMUTH_ERR_015_Rx}, {application-record-element=DET_AZIMUTH_ERR_016_Rx, system-signal=DET_AZIMUTH_ERR_016_Rx}, {application-record-element=DET_BELOW_RAIN_THOLD_013_Rx, system-signal=DET_BELOW_RAIN_THOLD_013_Rx}, {application-record-element=DET_BELOW_RAIN_THOLD_014_Rx, system-signal=DET_BELOW_RAIN_THOLD_014_Rx}, {application-record-element=DET_BELOW_RAIN_THOLD_015_Rx, system-signal=DET_BELOW_RAIN_THOLD_015_Rx}, {application-record-element=DET_BELOW_RAIN_THOLD_016_Rx, system-signal=DET_BELOW_RAIN_THOLD_016_Rx}, {application-record-element=DET_BI_STATIC_FLAG_013_Rx, system-signal=DET_BI_STATIC_FLAG_013_Rx}, {application-record-element=DET_BI_STATIC_FLAG_014_Rx, system-signal=DET_BI_STATIC_FLAG_014_Rx}, {application-record-element=DET_BI_STATIC_FLAG_015_Rx, system-signal=DET_BI_STATIC_FLAG_015_Rx}, {application-record-element=DET_BI_STATIC_FLAG_016_Rx, system-signal=DET_BI_STATIC_FLAG_016_Rx}, {application-record-element=DET_CONFD_AZIMUTH_013_Rx, system-signal=DET_CONFD_AZIMUTH_013_Rx}, {application-record-element=DET_CONFD_AZIMUTH_014_Rx, system-signal=DET_CONFD_AZIMUTH_014_Rx}, {application-record-element=DET_CONFD_AZIMUTH_015_Rx, system-signal=DET_CONFD_AZIMUTH_015_Rx}, {application-record-element=DET_CONFD_AZIMUTH_016_Rx, system-signal=DET_CONFD_AZIMUTH_016_Rx}, {application-record-element=DET_CONFD_ELEVATION_013_Rx, system-signal=DET_CONFD_ELEVATION_013_Rx}, {application-record-element=DET_CONFD_ELEVATION_014_Rx, system-signal=DET_CONFD_ELEVATION_014_Rx}, {application-record-element=DET_CONFD_ELEVATION_015_Rx, system-signal=DET_CONFD_ELEVATION_015_Rx}, {application-record-element=DET_CONFD_ELEVATION_016_Rx, system-signal=DET_CONFD_ELEVATION_016_Rx}, {application-record-element=DET_ELEVATION_013_Rx, system-signal=DET_ELEVATION_013_Rx}, {application-record-element=DET_ELEVATION_014_Rx, system-signal=DET_ELEVATION_014_Rx}, {application-record-element=DET_ELEVATION_015_Rx, system-signal=DET_ELEVATION_015_Rx}, {application-record-element=DET_ELEVATION_016_Rx, system-signal=DET_ELEVATION_016_Rx}, {application-record-element=DET_ELEVATION_ERR_013_Rx, system-signal=DET_ELEVATION_ERR_013_Rx}, {application-record-element=DET_ELEVATION_ERR_014_Rx, system-signal=DET_ELEVATION_ERR_014_Rx}, {application-record-element=DET_ELEVATION_ERR_015_Rx, system-signal=DET_ELEVATION_ERR_015_Rx}, {application-record-element=DET_ELEVATION_ERR_016_Rx, system-signal=DET_ELEVATION_ERR_016_Rx}, {application-record-element=DET_EXISTENCE_PROB_013_Rx, system-signal=DET_EXISTENCE_PROB_013_Rx}, {application-record-element=DET_EXISTENCE_PROB_014_Rx, system-signal=DET_EXISTENCE_PROB_014_Rx}, {application-record-element=DET_EXISTENCE_PROB_015_Rx, system-signal=DET_EXISTENCE_PROB_015_Rx}, {application-record-element=DET_EXISTENCE_PROB_016_Rx, system-signal=DET_EXISTENCE_PROB_016_Rx}, {application-record-element=DET_HVC_FLAG_013_Rx, system-signal=DET_HVC_FLAG_013_Rx}, {application-record-element=DET_HVC_FLAG_014_Rx, system-signal=DET_HVC_FLAG_014_Rx}, {application-record-element=DET_HVC_FLAG_015_Rx, system-signal=DET_HVC_FLAG_015_Rx}, {application-record-element=DET_HVC_FLAG_016_Rx, system-signal=DET_HVC_FLAG_016_Rx}, {application-record-element=DET_IDM_013_Rx, system-signal=DET_IDM_013_Rx}, {application-record-element=DET_IDM_014_Rx, system-signal=DET_IDM_014_Rx}, {application-record-element=DET_IDM_015_Rx, system-signal=DET_IDM_015_Rx}, {application-record-element=DET_IDM_016_Rx, system-signal=DET_IDM_016_Rx}, {application-record-element=DET_MH_CRC16_013_016_Rx, system-signal=DET_MH_CRC16_013_016_Rx}, {application-record-element=DET_MH_CYCLE_COUNTER_013_016_Rx, system-signal=DET_MH_CYCLE_COUNTER_013_016_Rx}, {application-record-element=DET_MH_SCAN_INDEX_4LSB_013_016_Rx, system-signal=DET_MH_SCAN_INDEX_4LSB_013_016_Rx}, {application-record-element=DET_MTD_013_Rx, system-signal=DET_MTD_013_Rx}, {application-record-element=DET_MTD_014_Rx, system-signal=DET_MTD_014_Rx}, {application-record-element=DET_MTD_015_Rx, system-signal=DET_MTD_015_Rx}, {application-record-element=DET_MTD_016_Rx, system-signal=DET_MTD_016_Rx}, {application-record-element=DET_PROB_1STAZHYPO_013_Rx, system-signal=DET_PROB_1STAZHYPO_013_Rx}, {application-record-element=DET_PROB_1STAZHYPO_014_Rx, system-signal=DET_PROB_1STAZHYPO_014_Rx}, {application-record-element=DET_PROB_1STAZHYPO_015_Rx, system-signal=DET_PROB_1STAZHYPO_015_Rx}, {application-record-element=DET_PROB_1STAZHYPO_016_Rx, system-signal=DET_PROB_1STAZHYPO_016_Rx}, {application-record-element=DET_RANGE_013_Rx, system-signal=DET_RANGE_013_Rx}, {application-record-element=DET_RANGE_014_Rx, system-signal=DET_RANGE_014_Rx}, {application-record-element=DET_RANGE_015_Rx, system-signal=DET_RANGE_015_Rx}, {application-record-element=DET_RANGE_016_Rx, system-signal=DET_RANGE_016_Rx}, {application-record-element=DET_RANGE_ERR_013_Rx, system-signal=DET_RANGE_ERR_013_Rx}, {application-record-element=DET_RANGE_ERR_014_Rx, system-signal=DET_RANGE_ERR_014_Rx}, {application-record-element=DET_RANGE_ERR_015_Rx, system-signal=DET_RANGE_ERR_015_Rx}, {application-record-element=DET_RANGE_ERR_016_Rx, system-signal=DET_RANGE_ERR_016_Rx}, {application-record-element=DET_RANGE_VELOCITY_013_Rx, system-signal=DET_RANGE_VELOCITY_013_Rx}, {application-record-element=DET_RANGE_VELOCITY_014_Rx, system-signal=DET_RANGE_VELOCITY_014_Rx}, {application-record-element=DET_RANGE_VELOCITY_015_Rx, system-signal=DET_RANGE_VELOCITY_015_Rx}, {application-record-element=DET_RANGE_VELOCITY_016_Rx, system-signal=DET_RANGE_VELOCITY_016_Rx}, {application-record-element=DET_RANGE_VELOCITY_ERR_013_Rx, system-signal=DET_RANGE_VELOCITY_ERR_013_Rx}, {application-record-element=DET_RANGE_VELOCITY_ERR_014_Rx, system-signal=DET_RANGE_VELOCITY_ERR_014_Rx}, {application-record-element=DET_RANGE_VELOCITY_ERR_015_Rx, system-signal=DET_RANGE_VELOCITY_ERR_015_Rx}, {application-record-element=DET_RANGE_VELOCITY_ERR_016_Rx, system-signal=DET_RANGE_VELOCITY_ERR_016_Rx}, {application-record-element=DET_RCS_013_Rx, system-signal=DET_RCS_013_Rx}, {application-record-element=DET_RCS_014_Rx, system-signal=DET_RCS_014_Rx}, {application-record-element=DET_RCS_015_Rx, system-signal=DET_RCS_015_Rx}, {application-record-element=DET_RCS_016_Rx, system-signal=DET_RCS_016_Rx}, {application-record-element=DET_SNR_013_Rx, system-signal=DET_SNR_013_Rx}, {application-record-element=DET_SNR_014_Rx, system-signal=DET_SNR_014_Rx}, {application-record-element=DET_SNR_015_Rx, system-signal=DET_SNR_015_Rx}, {application-record-element=DET_SNR_016_Rx, system-signal=DET_SNR_016_Rx}, {application-record-element=DET_SUPER_RES_TARGET_013_Rx, system-signal=DET_SUPER_RES_TARGET_013_Rx}, {application-record-element=DET_SUPER_RES_TARGET_014_Rx, system-signal=DET_SUPER_RES_TARGET_014_Rx}, {application-record-element=DET_SUPER_RES_TARGET_015_Rx, system-signal=DET_SUPER_RES_TARGET_015_Rx}, {application-record-element=DET_SUPER_RES_TARGET_016_Rx, system-signal=DET_SUPER_RES_TARGET_016_Rx}]}
        sender-receiver-to-signal-group-mapping={data-element=Rp_SG_Fusion_Detections_017_020_AL.Vdp_SG_Fusion_Detections_017_020_AL, signal-group=SG_Fusion_Detections_017_020, type-mapping=sender-rec-record-type-mapping=record-element-mappings=[{application-record-element=DET_AZIMUTH_017_Rx, system-signal=DET_AZIMUTH_017_Rx}, {application-record-element=DET_AZIMUTH_018_Rx, system-signal=DET_AZIMUTH_018_Rx}, {application-record-element=DET_AZIMUTH_019_Rx, system-signal=DET_AZIMUTH_019_Rx}, {application-record-element=DET_AZIMUTH_020_Rx, system-signal=DET_AZIMUTH_020_Rx}, {application-record-element=DET_AZIMUTH_ERR_017_Rx, system-signal=DET_AZIMUTH_ERR_017_Rx}, {application-record-element=DET_AZIMUTH_ERR_018_Rx, system-signal=DET_AZIMUTH_ERR_018_Rx}, {application-record-element=DET_AZIMUTH_ERR_019_Rx, system-signal=DET_AZIMUTH_ERR_019_Rx}, {application-record-element=DET_AZIMUTH_ERR_020_Rx, system-signal=DET_AZIMUTH_ERR_020_Rx}, {application-record-element=DET_BELOW_RAIN_THOLD_017_Rx, system-signal=DET_BELOW_RAIN_THOLD_017_Rx}, {application-record-element=DET_BELOW_RAIN_THOLD_018_Rx, system-signal=DET_BELOW_RAIN_THOLD_018_Rx}, {application-record-element=DET_BELOW_RAIN_THOLD_019_Rx, system-signal=DET_BELOW_RAIN_THOLD_019_Rx}, {application-record-element=DET_BELOW_RAIN_THOLD_020_Rx, system-signal=DET_BELOW_RAIN_THOLD_020_Rx}, {application-record-element=DET_BI_STATIC_FLAG_017_Rx, system-signal=DET_BI_STATIC_FLAG_017_Rx}, {application-record-element=DET_BI_STATIC_FLAG_018_Rx, system-signal=DET_BI_STATIC_FLAG_018_Rx}, {application-record-element=DET_BI_STATIC_FLAG_019_Rx, system-signal=DET_BI_STATIC_FLAG_019_Rx}, {application-record-element=DET_BI_STATIC_FLAG_020_Rx, system-signal=DET_BI_STATIC_FLAG_020_Rx}, {application-record-element=DET_CONFD_AZIMUTH_017_Rx, system-signal=DET_CONFD_AZIMUTH_017_Rx}, {application-record-element=DET_CONFD_AZIMUTH_018_Rx, system-signal=DET_CONFD_AZIMUTH_018_Rx}, {application-record-element=DET_CONFD_AZIMUTH_019_Rx, system-signal=DET_CONFD_AZIMUTH_019_Rx}, {application-record-element=DET_CONFD_AZIMUTH_020_Rx, system-signal=DET_CONFD_AZIMUTH_020_Rx}, {application-record-element=DET_CONFD_ELEVATION_017_Rx, system-signal=DET_CONFD_ELEVATION_017_Rx}, {application-record-element=DET_CONFD_ELEVATION_018_Rx, system-signal=DET_CONFD_ELEVATION_018_Rx}, {application-record-element=DET_CONFD_ELEVATION_019_Rx, system-signal=DET_CONFD_ELEVATION_019_Rx}, {application-record-element=DET_CONFD_ELEVATION_020_Rx, system-signal=DET_CONFD_ELEVATION_020_Rx}, {application-record-element=DET_ELEVATION_017_Rx, system-signal=DET_ELEVATION_017_Rx}, {application-record-element=DET_ELEVATION_018_Rx, system-signal=DET_ELEVATION_018_Rx}, {application-record-element=DET_ELEVATION_019_Rx, system-signal=DET_ELEVATION_019_Rx}, {application-record-element=DET_ELEVATION_020_Rx, system-signal=DET_ELEVATION_020_Rx}, {application-record-element=DET_ELEVATION_ERR_017_Rx, system-signal=DET_ELEVATION_ERR_017_Rx}, {application-record-element=DET_ELEVATION_ERR_018_Rx, system-signal=DET_ELEVATION_ERR_018_Rx}, {application-record-element=DET_ELEVATION_ERR_019_Rx, system-signal=DET_ELEVATION_ERR_019_Rx}, {application-record-element=DET_ELEVATION_ERR_020_Rx, system-signal=DET_ELEVATION_ERR_020_Rx}, {application-record-element=DET_EXISTENCE_PROB_017_Rx, system-signal=DET_EXISTENCE_PROB_017_Rx}, {application-record-element=DET_EXISTENCE_PROB_018_Rx, system-signal=DET_EXISTENCE_PROB_018_Rx}, {application-record-element=DET_EXISTENCE_PROB_019_Rx, system-signal=DET_EXISTENCE_PROB_019_Rx}, {application-record-element=DET_EXISTENCE_PROB_020_Rx, system-signal=DET_EXISTENCE_PROB_020_Rx}, {application-record-element=DET_HVC_FLAG_017_Rx, system-signal=DET_HVC_FLAG_017_Rx}, {application-record-element=DET_HVC_FLAG_018_Rx, system-signal=DET_HVC_FLAG_018_Rx}, {application-record-element=DET_HVC_FLAG_019_Rx, system-signal=DET_HVC_FLAG_019_Rx}, {application-record-element=DET_HVC_FLAG_020_Rx, system-signal=DET_HVC_FLAG_020_Rx}, {application-record-element=DET_IDM_017_Rx, system-signal=DET_IDM_017_Rx}, {application-record-element=DET_IDM_018_Rx, system-signal=DET_IDM_018_Rx}, {application-record-element=DET_IDM_019_Rx, system-signal=DET_IDM_019_Rx}, {application-record-element=DET_IDM_020_Rx, system-signal=DET_IDM_020_Rx}, {application-record-element=DET_MH_CRC16_017_020_Rx, system-signal=DET_MH_CRC16_017_020_Rx}, {application-record-element=DET_MH_CYCLE_COUNTER_017_020_Rx, system-signal=DET_MH_CYCLE_COUNTER_017_020_Rx}, {application-record-element=DET_MH_SCAN_INDEX_4LSB_017_020_Rx, system-signal=DET_MH_SCAN_INDEX_4LSB_017_020_Rx}, {application-record-element=DET_MTD_017_Rx, system-signal=DET_MTD_017_Rx}, {application-record-element=DET_MTD_018_Rx, system-signal=DET_MTD_018_Rx}, {application-record-element=DET_MTD_019_Rx, system-signal=DET_MTD_019_Rx}, {application-record-element=DET_MTD_020_Rx, system-signal=DET_MTD_020_Rx}, {application-record-element=DET_PROB_1STAZHYPO_017_Rx, system-signal=DET_PROB_1STAZHYPO_017_Rx}, {application-record-element=DET_PROB_1STAZHYPO_018_Rx, system-signal=DET_PROB_1STAZHYPO_018_Rx}, {application-record-element=DET_PROB_1STAZHYPO_019_Rx, system-signal=DET_PROB_1STAZHYPO_019_Rx}, {application-record-element=DET_PROB_1STAZHYPO_020_Rx, system-signal=DET_PROB_1STAZHYPO_020_Rx}, {application-record-element=DET_RANGE_017_Rx, system-signal=DET_RANGE_017_Rx}, {application-record-element=DET_RANGE_018_Rx, system-signal=DET_RANGE_018_Rx}, {application-record-element=DET_RANGE_019_Rx, system-signal=DET_RANGE_019_Rx}, {application-record-element=DET_RANGE_020_Rx, system-signal=DET_RANGE_020_Rx}, {application-record-element=DET_RANGE_ERR_017_Rx, system-signal=DET_RANGE_ERR_017_Rx}, {application-record-element=DET_RANGE_ERR_018_Rx, system-signal=DET_RANGE_ERR_018_Rx}, {application-record-element=DET_RANGE_ERR_019_Rx, system-signal=DET_RANGE_ERR_019_Rx}, {application-record-element=DET_RANGE_ERR_020_Rx, system-signal=DET_RANGE_ERR_020_Rx}, {application-record-element=DET_RANGE_VELOCITY_017_Rx, system-signal=DET_RANGE_VELOCITY_017_Rx}, {application-record-element=DET_RANGE_VELOCITY_018_Rx, system-signal=DET_RANGE_VELOCITY_018_Rx}, {application-record-element=DET_RANGE_VELOCITY_019_Rx, system-signal=DET_RANGE_VELOCITY_019_Rx}, {application-record-element=DET_RANGE_VELOCITY_020_Rx, system-signal=DET_RANGE_VELOCITY_020_Rx}, {application-record-element=DET_RANGE_VELOCITY_ERR_017_Rx, system-signal=DET_RANGE_VELOCITY_ERR_017_Rx}, {application-record-element=DET_RANGE_VELOCITY_ERR_018_Rx, system-signal=DET_RANGE_VELOCITY_ERR_018_Rx}, {application-record-element=DET_RANGE_VELOCITY_ERR_019_Rx, system-signal=DET_RANGE_VELOCITY_ERR_019_Rx}, {application-record-element=DET_RANGE_VELOCITY_ERR_020_Rx, system-signal=DET_RANGE_VELOCITY_ERR_020_Rx}, {application-record-element=DET_RCS_017_Rx, system-signal=DET_RCS_017_Rx}, {application-record-element=DET_RCS_018_Rx, system-signal=DET_RCS_018_Rx}, {application-record-element=DET_RCS_019_Rx, system-signal=DET_RCS_019_Rx}, {application-record-element=DET_RCS_020_Rx, system-signal=DET_RCS_020_Rx}, {application-record-element=DET_SNR_017_Rx, system-signal=DET_SNR_017_Rx}, {application-record-element=DET_SNR_018_Rx, system-signal=DET_SNR_018_Rx}, {application-record-element=DET_SNR_019_Rx, system-signal=DET_SNR_019_Rx}, {application-record-element=DET_SNR_020_Rx, system-signal=DET_SNR_020_Rx}, {application-record-element=DET_SUPER_RES_TARGET_017_Rx, system-signal=DET_SUPER_RES_TARGET_017_Rx}, {application-record-element=DET_SUPER_RES_TARGET_018_Rx, system-signal=DET_SUPER_RES_TARGET_018_Rx}, {application-record-element=DET_SUPER_RES_TARGET_019_Rx, system-signal=DET_SUPER_RES_TARGET_019_Rx}, {application-record-element=DET_SUPER_RES_TARGET_020_Rx, system-signal=DET_SUPER_RES_TARGET_020_Rx}]}
        sender-receiver-to-signal-group-mapping={data-element=Rp_SG_Fusion_Detections_021_024_AL.Vdp_SG_Fusion_Detections_021_024_AL, signal-group=SG_Fusion_Detections_021_024, type-mapping=sender-rec-record-type-mapping=record-element-mappings=[{application-record-element=DET_AZIMUTH_021_Rx, system-signal=DET_AZIMUTH_021_Rx}, {application-record-element=DET_AZIMUTH_022_Rx, system-signal=DET_AZIMUTH_022_Rx}, {application-record-element=DET_AZIMUTH_023_Rx, system-signal=DET_AZIMUTH_023_Rx}, {application-record-element=DET_AZIMUTH_024_Rx, system-signal=DET_AZIMUTH_024_Rx}, {application-record-element=DET_AZIMUTH_ERR_021_Rx, system-signal=DET_AZIMUTH_ERR_021_Rx}, {application-record-element=DET_AZIMUTH_ERR_022_Rx, system-signal=DET_AZIMUTH_ERR_022_Rx}, {application-record-element=DET_AZIMUTH_ERR_023_Rx, system-signal=DET_AZIMUTH_ERR_023_Rx}, {application-record-element=DET_AZIMUTH_ERR_024_Rx, system-signal=DET_AZIMUTH_ERR_024_Rx}, {application-record-element=DET_BELOW_RAIN_THOLD_021_Rx, system-signal=DET_BELOW_RAIN_THOLD_021_Rx}, {application-record-element=DET_BELOW_RAIN_THOLD_022_Rx, system-signal=DET_BELOW_RAIN_THOLD_022_Rx}, {application-record-element=DET_BELOW_RAIN_THOLD_023_Rx, system-signal=DET_BELOW_RAIN_THOLD_023_Rx}, {application-record-element=DET_BELOW_RAIN_THOLD_024_Rx, system-signal=DET_BELOW_RAIN_THOLD_024_Rx}, {application-record-element=DET_BI_STATIC_FLAG_021_Rx, system-signal=DET_BI_STATIC_FLAG_021_Rx}, {application-record-element=DET_BI_STATIC_FLAG_022_Rx, system-signal=DET_BI_STATIC_FLAG_022_Rx}, {application-record-element=DET_BI_STATIC_FLAG_023_Rx, system-signal=DET_BI_STATIC_FLAG_023_Rx}, {application-record-element=DET_BI_STATIC_FLAG_024_Rx, system-signal=DET_BI_STATIC_FLAG_024_Rx}, {application-record-element=DET_CONFD_AZIMUTH_021_Rx, system-signal=DET_CONFD_AZIMUTH_021_Rx}, {application-record-element=DET_CONFD_AZIMUTH_022_Rx, system-signal=DET_CONFD_AZIMUTH_022_Rx}, {application-record-element=DET_CONFD_AZIMUTH_023_Rx, system-signal=DET_CONFD_AZIMUTH_023_Rx}, {application-record-element=DET_CONFD_AZIMUTH_024_Rx, system-signal=DET_CONFD_AZIMUTH_024_Rx}, {application-record-element=DET_CONFD_ELEVATION_021_Rx, system-signal=DET_CONFD_ELEVATION_021_Rx}, {application-record-element=DET_CONFD_ELEVATION_022_Rx, system-signal=DET_CONFD_ELEVATION_022_Rx}, {application-record-element=DET_CONFD_ELEVATION_023_Rx, system-signal=DET_CONFD_ELEVATION_023_Rx}, {application-record-element=DET_CONFD_ELEVATION_024_Rx, system-signal=DET_CONFD_ELEVATION_024_Rx}, {application-record-element=DET_ELEVATION_021_Rx, system-signal=DET_ELEVATION_021_Rx}, {application-record-element=DET_ELEVATION_022_Rx, system-signal=DET_ELEVATION_022_Rx}, {application-record-element=DET_ELEVATION_023_Rx, system-signal=DET_ELEVATION_023_Rx}, {application-record-element=DET_ELEVATION_024_Rx, system-signal=DET_ELEVATION_024_Rx}, {application-record-element=DET_ELEVATION_ERR_021_Rx, system-signal=DET_ELEVATION_ERR_021_Rx}, {application-record-element=DET_ELEVATION_ERR_022_Rx, system-signal=DET_ELEVATION_ERR_022_Rx}, {application-record-element=DET_ELEVATION_ERR_023_Rx, system-signal=DET_ELEVATION_ERR_023_Rx}, {application-record-element=DET_ELEVATION_ERR_024_Rx, system-signal=DET_ELEVATION_ERR_024_Rx}, {application-record-element=DET_EXISTENCE_PROB_021_Rx, system-signal=DET_EXISTENCE_PROB_021_Rx}, {application-record-element=DET_EXISTENCE_PROB_022_Rx, system-signal=DET_EXISTENCE_PROB_022_Rx}, {application-record-element=DET_EXISTENCE_PROB_023_Rx, system-signal=DET_EXISTENCE_PROB_023_Rx}, {application-record-element=DET_EXISTENCE_PROB_024_Rx, system-signal=DET_EXISTENCE_PROB_024_Rx}, {application-record-element=DET_HVC_FLAG_021_Rx, system-signal=DET_HVC_FLAG_021_Rx}, {application-record-element=DET_HVC_FLAG_022_Rx, system-signal=DET_HVC_FLAG_022_Rx}, {application-record-element=DET_HVC_FLAG_023_Rx, system-signal=DET_HVC_FLAG_023_Rx}, {application-record-element=DET_HVC_FLAG_024_Rx, system-signal=DET_HVC_FLAG_024_Rx}, {application-record-element=DET_IDM_021_Rx, system-signal=DET_IDM_021_Rx}, {application-record-element=DET_IDM_022_Rx, system-signal=DET_IDM_022_Rx}, {application-record-element=DET_IDM_023_Rx, system-signal=DET_IDM_023_Rx}, {application-record-element=DET_IDM_024_Rx, system-signal=DET_IDM_024_Rx}, {application-record-element=DET_MH_CRC16_021_024_Rx, system-signal=DET_MH_CRC16_021_024_Rx}, {application-record-element=DET_MH_CYCLE_COUNTER_021_024_Rx, system-signal=DET_MH_CYCLE_COUNTER_021_024_Rx}, {application-record-element=DET_MH_SCAN_INDEX_4LSB_021_024_Rx, system-signal=DET_MH_SCAN_INDEX_4LSB_021_024_Rx}, {application-record-element=DET_MTD_021_Rx, system-signal=DET_MTD_021_Rx}, {application-record-element=DET_MTD_022_Rx, system-signal=DET_MTD_022_Rx}, {application-record-element=DET_MTD_023_Rx, system-signal=DET_MTD_023_Rx}, {application-record-element=DET_MTD_024_Rx, system-signal=DET_MTD_024_Rx}, {application-record-element=DET_PROB_1STAZHYPO_021_Rx, system-signal=DET_PROB_1STAZHYPO_021_Rx}, {application-record-element=DET_PROB_1STAZHYPO_022_Rx, system-signal=DET_PROB_1STAZHYPO_022_Rx}, {application-record-element=DET_PROB_1STAZHYPO_023_Rx, system-signal=DET_PROB_1STAZHYPO_023_Rx}, {application-record-element=DET_PROB_1STAZHYPO_024_Rx, system-signal=DET_PROB_1STAZHYPO_024_Rx}, {application-record-element=DET_RANGE_021_Rx, system-signal=DET_RANGE_021_Rx}, {application-record-element=DET_RANGE_022_Rx, system-signal=DET_RANGE_022_Rx}, {application-record-element=DET_RANGE_023_Rx, system-signal=DET_RANGE_023_Rx}, {application-record-element=DET_RANGE_024_Rx, system-signal=DET_RANGE_024_Rx}, {application-record-element=DET_RANGE_ERR_021_Rx, system-signal=DET_RANGE_ERR_021_Rx}, {application-record-element=DET_RANGE_ERR_022_Rx, system-signal=DET_RANGE_ERR_022_Rx}, {application-record-element=DET_RANGE_ERR_023_Rx, system-signal=DET_RANGE_ERR_023_Rx}, {application-record-element=DET_RANGE_ERR_024_Rx, system-signal=DET_RANGE_ERR_024_Rx}, {application-record-element=DET_RANGE_VELOCITY_021_Rx, system-signal=DET_RANGE_VELOCITY_021_Rx}, {application-record-element=DET_RANGE_VELOCITY_022_Rx, system-signal=DET_RANGE_VELOCITY_022_Rx}, {application-record-element=DET_RANGE_VELOCITY_023_Rx, system-signal=DET_RANGE_VELOCITY_023_Rx}, {application-record-element=DET_RANGE_VELOCITY_024_Rx, system-signal=DET_RANGE_VELOCITY_024_Rx}, {application-record-element=DET_RANGE_VELOCITY_ERR_021_Rx, system-signal=DET_RANGE_VELOCITY_ERR_021_Rx}, {application-record-element=DET_RANGE_VELOCITY_ERR_022_Rx, system-signal=DET_RANGE_VELOCITY_ERR_022_Rx}, {application-record-element=DET_RANGE_VELOCITY_ERR_023_Rx, system-signal=DET_RANGE_VELOCITY_ERR_023_Rx}, {application-record-element=DET_RANGE_VELOCITY_ERR_024_Rx, system-signal=DET_RANGE_VELOCITY_ERR_024_Rx}, {application-record-element=DET_RCS_021_Rx, system-signal=DET_RCS_021_Rx}, {application-record-element=DET_RCS_022_Rx, system-signal=DET_RCS_022_Rx}, {application-record-element=DET_RCS_023_Rx, system-signal=DET_RCS_023_Rx}, {application-record-element=DET_RCS_024_Rx, system-signal=DET_RCS_024_Rx}, {application-record-element=DET_SNR_021_Rx, system-signal=DET_SNR_021_Rx}, {application-record-element=DET_SNR_022_Rx, system-signal=DET_SNR_022_Rx}, {application-record-element=DET_SNR_023_Rx, system-signal=DET_SNR_023_Rx}, {application-record-element=DET_SNR_024_Rx, system-signal=DET_SNR_024_Rx}, {application-record-element=DET_SUPER_RES_TARGET_021_Rx, system-signal=DET_SUPER_RES_TARGET_021_Rx}, {application-record-element=DET_SUPER_RES_TARGET_022_Rx, system-signal=DET_SUPER_RES_TARGET_022_Rx}, {application-record-element=DET_SUPER_RES_TARGET_023_Rx, system-signal=DET_SUPER_RES_TARGET_023_Rx}, {application-record-element=DET_SUPER_RES_TARGET_024_Rx, system-signal=DET_SUPER_RES_TARGET_024_Rx}]}
        sender-receiver-to-signal-group-mapping={data-element=Rp_SG_Fusion_Detections_025_028_AL.Vdp_SG_Fusion_Detections_025_028_AL, signal-group=SG_Fusion_Detections_025_028, type-mapping=sender-rec-record-type-mapping=record-element-mappings=[{application-record-element=DET_AZIMUTH_025_Rx, system-signal=DET_AZIMUTH_025_Rx}, {application-record-element=DET_AZIMUTH_026_Rx, system-signal=DET_AZIMUTH_026_Rx}, {application-record-element=DET_AZIMUTH_027_Rx, system-signal=DET_AZIMUTH_027_Rx}, {application-record-element=DET_AZIMUTH_028_Rx, system-signal=DET_AZIMUTH_028_Rx}, {application-record-element=DET_AZIMUTH_ERR_025_Rx, system-signal=DET_AZIMUTH_ERR_025_Rx}, {application-record-element=DET_AZIMUTH_ERR_026_Rx, system-signal=DET_AZIMUTH_ERR_026_Rx}, {application-record-element=DET_AZIMUTH_ERR_027_Rx, system-signal=DET_AZIMUTH_ERR_027_Rx}, {application-record-element=DET_AZIMUTH_ERR_028_Rx, system-signal=DET_AZIMUTH_ERR_028_Rx}, {application-record-element=DET_BELOW_RAIN_THOLD_025_Rx, system-signal=DET_BELOW_RAIN_THOLD_025_Rx}, {application-record-element=DET_BELOW_RAIN_THOLD_026_Rx, system-signal=DET_BELOW_RAIN_THOLD_026_Rx}, {application-record-element=DET_BELOW_RAIN_THOLD_027_Rx, system-signal=DET_BELOW_RAIN_THOLD_027_Rx}, {application-record-element=DET_BELOW_RAIN_THOLD_028_Rx, system-signal=DET_BELOW_RAIN_THOLD_028_Rx}, {application-record-element=DET_BI_STATIC_FLAG_025_Rx, system-signal=DET_BI_STATIC_FLAG_025_Rx}, {application-record-element=DET_BI_STATIC_FLAG_026_Rx, system-signal=DET_BI_STATIC_FLAG_026_Rx}, {application-record-element=DET_BI_STATIC_FLAG_027_Rx, system-signal=DET_BI_STATIC_FLAG_027_Rx}, {application-record-element=DET_BI_STATIC_FLAG_028_Rx, system-signal=DET_BI_STATIC_FLAG_028_Rx}, {application-record-element=DET_CONFD_AZIMUTH_025_Rx, system-signal=DET_CONFD_AZIMUTH_025_Rx}, {application-record-element=DET_CONFD_AZIMUTH_026_Rx, system-signal=DET_CONFD_AZIMUTH_026_Rx}, {application-record-element=DET_CONFD_AZIMUTH_027_Rx, system-signal=DET_CONFD_AZIMUTH_027_Rx}, {application-record-element=DET_CONFD_AZIMUTH_028_Rx, system-signal=DET_CONFD_AZIMUTH_028_Rx}, {application-record-element=DET_CONFD_ELEVATION_025_Rx, system-signal=DET_CONFD_ELEVATION_025_Rx}, {application-record-element=DET_CONFD_ELEVATION_026_Rx, system-signal=DET_CONFD_ELEVATION_026_Rx}, {application-record-element=DET_CONFD_ELEVATION_027_Rx, system-signal=DET_CONFD_ELEVATION_027_Rx}, {application-record-element=DET_CONFD_ELEVATION_028_Rx, system-signal=DET_CONFD_ELEVATION_028_Rx}, {application-record-element=DET_ELEVATION_025_Rx, system-signal=DET_ELEVATION_025_Rx}, {application-record-element=DET_ELEVATION_026_Rx, system-signal=DET_ELEVATION_026_Rx}, {application-record-element=DET_ELEVATION_027_Rx, system-signal=DET_ELEVATION_027_Rx}, {application-record-element=DET_ELEVATION_028_Rx, system-signal=DET_ELEVATION_028_Rx}, {application-record-element=DET_ELEVATION_ERR_025_Rx, system-signal=DET_ELEVATION_ERR_025_Rx}, {application-record-element=DET_ELEVATION_ERR_026_Rx, system-signal=DET_ELEVATION_ERR_026_Rx}, {application-record-element=DET_ELEVATION_ERR_027_Rx, system-signal=DET_ELEVATION_ERR_027_Rx}, {application-record-element=DET_ELEVATION_ERR_028_Rx, system-signal=DET_ELEVATION_ERR_028_Rx}, {application-record-element=DET_EXISTENCE_PROB_025_Rx, system-signal=DET_EXISTENCE_PROB_025_Rx}, {application-record-element=DET_EXISTENCE_PROB_026_Rx, system-signal=DET_EXISTENCE_PROB_026_Rx}, {application-record-element=DET_EXISTENCE_PROB_027_Rx, system-signal=DET_EXISTENCE_PROB_027_Rx}, {application-record-element=DET_EXISTENCE_PROB_028_Rx, system-signal=DET_EXISTENCE_PROB_028_Rx}, {application-record-element=DET_HVC_FLAG_025_Rx, system-signal=DET_HVC_FLAG_025_Rx}, {application-record-element=DET_HVC_FLAG_026_Rx, system-signal=DET_HVC_FLAG_026_Rx}, {application-record-element=DET_HVC_FLAG_027_Rx, system-signal=DET_HVC_FLAG_027_Rx}, {application-record-element=DET_HVC_FLAG_028_Rx, system-signal=DET_HVC_FLAG_028_Rx}, {application-record-element=DET_IDM_025_Rx, system-signal=DET_IDM_025_Rx}, {application-record-element=DET_IDM_026_Rx, system-signal=DET_IDM_026_Rx}, {application-record-element=DET_IDM_027_Rx, system-signal=DET_IDM_027_Rx}, {application-record-element=DET_IDM_028_Rx, system-signal=DET_IDM_028_Rx}, {application-record-element=DET_MH_CRC16_025_028_Rx, system-signal=DET_MH_CRC16_025_028_Rx}, {application-record-element=DET_MH_CYCLE_COUNTER_025_028_Rx, system-signal=DET_MH_CYCLE_COUNTER_025_028_Rx}, {application-record-element=DET_MH_SCAN_INDEX_4LSB_025_028_Rx, system-signal=DET_MH_SCAN_INDEX_4LSB_025_028_Rx}, {application-record-element=DET_MTD_025_Rx, system-signal=DET_MTD_025_Rx}, {application-record-element=DET_MTD_026_Rx, system-signal=DET_MTD_026_Rx}, {application-record-element=DET_MTD_027_Rx, system-signal=DET_MTD_027_Rx}, {application-record-element=DET_MTD_028_Rx, system-signal=DET_MTD_028_Rx}, {application-record-element=DET_PROB_1STAZHYPO_025_Rx, system-signal=DET_PROB_1STAZHYPO_025_Rx}, {application-record-element=DET_PROB_1STAZHYPO_026_Rx, system-signal=DET_PROB_1STAZHYPO_026_Rx}, {application-record-element=DET_PROB_1STAZHYPO_027_Rx, system-signal=DET_PROB_1STAZHYPO_027_Rx}, {application-record-element=DET_PROB_1STAZHYPO_028_Rx, system-signal=DET_PROB_1STAZHYPO_028_Rx}, {application-record-element=DET_RANGE_025_Rx, system-signal=DET_RANGE_025_Rx}, {application-record-element=DET_RANGE_026_Rx, system-signal=DET_RANGE_026_Rx}, {application-record-element=DET_RANGE_027_Rx, system-signal=DET_RANGE_027_Rx}, {application-record-element=DET_RANGE_028_Rx, system-signal=DET_RANGE_028_Rx}, {application-record-element=DET_RANGE_ERR_025_Rx, system-signal=DET_RANGE_ERR_025_Rx}, {application-record-element=DET_RANGE_ERR_026_Rx, system-signal=DET_RANGE_ERR_026_Rx}, {application-record-element=DET_RANGE_ERR_027_Rx, system-signal=DET_RANGE_ERR_027_Rx}, {application-record-element=DET_RANGE_ERR_028_Rx, system-signal=DET_RANGE_ERR_028_Rx}, {application-record-element=DET_RANGE_VELOCITY_025_Rx, system-signal=DET_RANGE_VELOCITY_025_Rx}, {application-record-element=DET_RANGE_VELOCITY_026_Rx, system-signal=DET_RANGE_VELOCITY_026_Rx}, {application-record-element=DET_RANGE_VELOCITY_027_Rx, system-signal=DET_RANGE_VELOCITY_027_Rx}, {application-record-element=DET_RANGE_VELOCITY_028_Rx, system-signal=DET_RANGE_VELOCITY_028_Rx}, {application-record-element=DET_RANGE_VELOCITY_ERR_025_Rx, system-signal=DET_RANGE_VELOCITY_ERR_025_Rx}, {application-record-element=DET_RANGE_VELOCITY_ERR_026_Rx, system-signal=DET_RANGE_VELOCITY_ERR_026_Rx}, {application-record-element=DET_RANGE_VELOCITY_ERR_027_Rx, system-signal=DET_RANGE_VELOCITY_ERR_027_Rx}, {application-record-element=DET_RANGE_VELOCITY_ERR_028_Rx, system-signal=DET_RANGE_VELOCITY_ERR_028_Rx}, {application-record-element=DET_RCS_025_Rx, system-signal=DET_RCS_025_Rx}, {application-record-element=DET_RCS_026_Rx, system-signal=DET_RCS_026_Rx}, {application-record-element=DET_RCS_027_Rx, system-signal=DET_RCS_027_Rx}, {application-record-element=DET_RCS_028_Rx, system-signal=DET_RCS_028_Rx}, {application-record-element=DET_SNR_025_Rx, system-signal=DET_SNR_025_Rx}, {application-record-element=DET_SNR_026_Rx, system-signal=DET_SNR_026_Rx}, {application-record-element=DET_SNR_027_Rx, system-signal=DET_SNR_027_Rx}, {application-record-element=DET_SNR_028_Rx, system-signal=DET_SNR_028_Rx}, {application-record-element=DET_SUPER_RES_TARGET_025_Rx, system-signal=DET_SUPER_RES_TARGET_025_Rx}, {application-record-element=DET_SUPER_RES_TARGET_026_Rx, system-signal=DET_SUPER_RES_TARGET_026_Rx}, {application-record-element=DET_SUPER_RES_TARGET_027_Rx, system-signal=DET_SUPER_RES_TARGET_027_Rx}, {application-record-element=DET_SUPER_RES_TARGET_028_Rx, system-signal=DET_SUPER_RES_TARGET_028_Rx}]}
        sender-receiver-to-signal-group-mapping={data-element=Rp_SG_Fusion_Detections_029_032_AL.Vdp_SG_Fusion_Detections_029_032_AL, signal-group=SG_Fusion_Detections_029_032, type-mapping=sender-rec-record-type-mapping=record-element-mappings=[{application-record-element=DET_AZIMUTH_029_Rx, system-signal=DET_AZIMUTH_029_Rx}, {application-record-element=DET_AZIMUTH_030_Rx, system-signal=DET_AZIMUTH_030_Rx}, {application-record-element=DET_AZIMUTH_031_Rx, system-signal=DET_AZIMUTH_031_Rx}, {application-record-element=DET_AZIMUTH_032_Rx, system-signal=DET_AZIMUTH_032_Rx}, {application-record-element=DET_AZIMUTH_ERR_029_Rx, system-signal=DET_AZIMUTH_ERR_029_Rx}, {application-record-element=DET_AZIMUTH_ERR_030_Rx, system-signal=DET_AZIMUTH_ERR_030_Rx}, {application-record-element=DET_AZIMUTH_ERR_031_Rx, system-signal=DET_AZIMUTH_ERR_031_Rx}, {application-record-element=DET_AZIMUTH_ERR_032_Rx, system-signal=DET_AZIMUTH_ERR_032_Rx}, {application-record-element=DET_BELOW_RAIN_THOLD_029_Rx, system-signal=DET_BELOW_RAIN_THOLD_029_Rx}, {application-record-element=DET_BELOW_RAIN_THOLD_030_Rx, system-signal=DET_BELOW_RAIN_THOLD_030_Rx}, {application-record-element=DET_BELOW_RAIN_THOLD_031_Rx, system-signal=DET_BELOW_RAIN_THOLD_031_Rx}, {application-record-element=DET_BELOW_RAIN_THOLD_032_Rx, system-signal=DET_BELOW_RAIN_THOLD_032_Rx}, {application-record-element=DET_BI_STATIC_FLAG_029_Rx, system-signal=DET_BI_STATIC_FLAG_029_Rx}, {application-record-element=DET_BI_STATIC_FLAG_030_Rx, system-signal=DET_BI_STATIC_FLAG_030_Rx}, {application-record-element=DET_BI_STATIC_FLAG_031_Rx, system-signal=DET_BI_STATIC_FLAG_031_Rx}, {application-record-element=DET_BI_STATIC_FLAG_032_Rx, system-signal=DET_BI_STATIC_FLAG_032_Rx}, {application-record-element=DET_CONFD_AZIMUTH_029_Rx, system-signal=DET_CONFD_AZIMUTH_029_Rx}, {application-record-element=DET_CONFD_AZIMUTH_030_Rx, system-signal=DET_CONFD_AZIMUTH_030_Rx}, {application-record-element=DET_CONFD_AZIMUTH_031_Rx, system-signal=DET_CONFD_AZIMUTH_031_Rx}, {application-record-element=DET_CONFD_AZIMUTH_032_Rx, system-signal=DET_CONFD_AZIMUTH_032_Rx}, {application-record-element=DET_CONFD_ELEVATION_029_Rx, system-signal=DET_CONFD_ELEVATION_029_Rx}, {application-record-element=DET_CONFD_ELEVATION_030_Rx, system-signal=DET_CONFD_ELEVATION_030_Rx}, {application-record-element=DET_CONFD_ELEVATION_031_Rx, system-signal=DET_CONFD_ELEVATION_031_Rx}, {application-record-element=DET_CONFD_ELEVATION_032_Rx, system-signal=DET_CONFD_ELEVATION_032_Rx}, {application-record-element=DET_ELEVATION_029_Rx, system-signal=DET_ELEVATION_029_Rx}, {application-record-element=DET_ELEVATION_030_Rx, system-signal=DET_ELEVATION_030_Rx}, {application-record-element=DET_ELEVATION_031_Rx, system-signal=DET_ELEVATION_031_Rx}, {application-record-element=DET_ELEVATION_032_Rx, system-signal=DET_ELEVATION_032_Rx}, {application-record-element=DET_ELEVATION_ERR_029_Rx, system-signal=DET_ELEVATION_ERR_029_Rx}, {application-record-element=DET_ELEVATION_ERR_030_Rx, system-signal=DET_ELEVATION_ERR_030_Rx}, {application-record-element=DET_ELEVATION_ERR_031_Rx, system-signal=DET_ELEVATION_ERR_031_Rx}, {application-record-element=DET_ELEVATION_ERR_032_Rx, system-signal=DET_ELEVATION_ERR_032_Rx}, {application-record-element=DET_EXISTENCE_PROB_029_Rx, system-signal=DET_EXISTENCE_PROB_029_Rx}, {application-record-element=DET_EXISTENCE_PROB_030_Rx, system-signal=DET_EXISTENCE_PROB_030_Rx}, {application-record-element=DET_EXISTENCE_PROB_031_Rx, system-signal=DET_EXISTENCE_PROB_031_Rx}, {application-record-element=DET_EXISTENCE_PROB_032_Rx, system-signal=DET_EXISTENCE_PROB_032_Rx}, {application-record-element=DET_HVC_FLAG_029_Rx, system-signal=DET_HVC_FLAG_029_Rx}, {application-record-element=DET_HVC_FLAG_030_Rx, system-signal=DET_HVC_FLAG_030_Rx}, {application-record-element=DET_HVC_FLAG_031_Rx, system-signal=DET_HVC_FLAG_031_Rx}, {application-record-element=DET_HVC_FLAG_032_Rx, system-signal=DET_HVC_FLAG_032_Rx}, {application-record-element=DET_IDM_029_Rx, system-signal=DET_IDM_029_Rx}, {application-record-element=DET_IDM_030_Rx, system-signal=DET_IDM_030_Rx}, {application-record-element=DET_IDM_031_Rx, system-signal=DET_IDM_031_Rx}, {application-record-element=DET_IDM_032_Rx, system-signal=DET_IDM_032_Rx}, {application-record-element=DET_MH_CRC16_029_032_Rx, system-signal=DET_MH_CRC16_029_032_Rx}, {application-record-element=DET_MH_CYCLE_COUNTER_029_032_Rx, system-signal=DET_MH_CYCLE_COUNTER_029_032_Rx}, {application-record-element=DET_MH_SCAN_INDEX_4LSB_029_032_Rx, system-signal=DET_MH_SCAN_INDEX_4LSB_029_032_Rx}, {application-record-element=DET_MTD_029_Rx, system-signal=DET_MTD_029_Rx}, {application-record-element=DET_MTD_030_Rx, system-signal=DET_MTD_030_Rx}, {application-record-element=DET_MTD_031_Rx, system-signal=DET_MTD_031_Rx}, {application-record-element=DET_MTD_032_Rx, system-signal=DET_MTD_032_Rx}, {application-record-element=DET_PROB_1STAZHYPO_029_Rx, system-signal=DET_PROB_1STAZHYPO_029_Rx}, {application-record-element=DET_PROB_1STAZHYPO_030_Rx, system-signal=DET_PROB_1STAZHYPO_030_Rx}, {application-record-element=DET_PROB_1STAZHYPO_031_Rx, system-signal=DET_PROB_1STAZHYPO_031_Rx}, {application-record-element=DET_PROB_1STAZHYPO_032_Rx, system-signal=DET_PROB_1STAZHYPO_032_Rx}, {application-record-element=DET_RANGE_029_Rx, system-signal=DET_RANGE_029_Rx}, {application-record-element=DET_RANGE_030_Rx, system-signal=DET_RANGE_030_Rx}, {application-record-element=DET_RANGE_031_Rx, system-signal=DET_RANGE_031_Rx}, {application-record-element=DET_RANGE_032_Rx, system-signal=DET_RANGE_032_Rx}, {application-record-element=DET_RANGE_ERR_029_Rx, system-signal=DET_RANGE_ERR_029_Rx}, {application-record-element=DET_RANGE_ERR_030_Rx, system-signal=DET_RANGE_ERR_030_Rx}, {application-record-element=DET_RANGE_ERR_031_Rx, system-signal=DET_RANGE_ERR_031_Rx}, {application-record-element=DET_RANGE_ERR_032_Rx, system-signal=DET_RANGE_ERR_032_Rx}, {application-record-element=DET_RANGE_VELOCITY_029_Rx, system-signal=DET_RANGE_VELOCITY_029_Rx}, {application-record-element=DET_RANGE_VELOCITY_030_Rx, system-signal=DET_RANGE_VELOCITY_030_Rx}, {application-record-element=DET_RANGE_VELOCITY_031_Rx, system-signal=DET_RANGE_VELOCITY_031_Rx}, {application-record-element=DET_RANGE_VELOCITY_032_Rx, system-signal=DET_RANGE_VELOCITY_032_Rx}, {application-record-element=DET_RANGE_VELOCITY_ERR_029_Rx, system-signal=DET_RANGE_VELOCITY_ERR_029_Rx}, {application-record-element=DET_RANGE_VELOCITY_ERR_030_Rx, system-signal=DET_RANGE_VELOCITY_ERR_030_Rx}, {application-record-element=DET_RANGE_VELOCITY_ERR_031_Rx, system-signal=DET_RANGE_VELOCITY_ERR_031_Rx}, {application-record-element=DET_RANGE_VELOCITY_ERR_032_Rx, system-signal=DET_RANGE_VELOCITY_ERR_032_Rx}, {application-record-element=DET_RCS_029_Rx, system-signal=DET_RCS_029_Rx}, {application-record-element=DET_RCS_030_Rx, system-signal=DET_RCS_030_Rx}, {application-record-element=DET_RCS_031_Rx, system-signal=DET_RCS_031_Rx}, {application-record-element=DET_RCS_032_Rx, system-signal=DET_RCS_032_Rx}, {application-record-element=DET_SNR_029_Rx, system-signal=DET_SNR_029_Rx}, {application-record-element=DET_SNR_030_Rx, system-signal=DET_SNR_030_Rx}, {application-record-element=DET_SNR_031_Rx, system-signal=DET_SNR_031_Rx}, {application-record-element=DET_SNR_032_Rx, system-signal=DET_SNR_032_Rx}, {application-record-element=DET_SUPER_RES_TARGET_029_Rx, system-signal=DET_SUPER_RES_TARGET_029_Rx}, {application-record-element=DET_SUPER_RES_TARGET_030_Rx, system-signal=DET_SUPER_RES_TARGET_030_Rx}, {application-record-element=DET_SUPER_RES_TARGET_031_Rx, system-signal=DET_SUPER_RES_TARGET_031_Rx}, {application-record-element=DET_SUPER_RES_TARGET_032_Rx, system-signal=DET_SUPER_RES_TARGET_032_Rx}]}
        sender-receiver-to-signal-group-mapping={data-element=Rp_SG_Fusion_Detections_033_036_AL.Vdp_SG_Fusion_Detections_033_036_AL, signal-group=SG_Fusion_Detections_033_036, type-mapping=sender-rec-record-type-mapping=record-element-mappings=[{application-record-element=DET_AZIMUTH_033_Rx, system-signal=DET_AZIMUTH_033_Rx}, {application-record-element=DET_AZIMUTH_034_Rx, system-signal=DET_AZIMUTH_034_Rx}, {application-record-element=DET_AZIMUTH_035_Rx, system-signal=DET_AZIMUTH_035_Rx}, {application-record-element=DET_AZIMUTH_036_Rx, system-signal=DET_AZIMUTH_036_Rx}, {application-record-element=DET_AZIMUTH_ERR_033_Rx, system-signal=DET_AZIMUTH_ERR_033_Rx}, {application-record-element=DET_AZIMUTH_ERR_034_Rx, system-signal=DET_AZIMUTH_ERR_034_Rx}, {application-record-element=DET_AZIMUTH_ERR_035_Rx, system-signal=DET_AZIMUTH_ERR_035_Rx}, {application-record-element=DET_AZIMUTH_ERR_036_Rx, system-signal=DET_AZIMUTH_ERR_036_Rx}, {application-record-element=DET_BELOW_RAIN_THOLD_033_Rx, system-signal=DET_BELOW_RAIN_THOLD_033_Rx}, {application-record-element=DET_BELOW_RAIN_THOLD_034_Rx, system-signal=DET_BELOW_RAIN_THOLD_034_Rx}, {application-record-element=DET_BELOW_RAIN_THOLD_035_Rx, system-signal=DET_BELOW_RAIN_THOLD_035_Rx}, {application-record-element=DET_BELOW_RAIN_THOLD_036_Rx, system-signal=DET_BELOW_RAIN_THOLD_036_Rx}, {application-record-element=DET_BI_STATIC_FLAG_033_Rx, system-signal=DET_BI_STATIC_FLAG_033_Rx}, {application-record-element=DET_BI_STATIC_FLAG_034_Rx, system-signal=DET_BI_STATIC_FLAG_034_Rx}, {application-record-element=DET_BI_STATIC_FLAG_035_Rx, system-signal=DET_BI_STATIC_FLAG_035_Rx}, {application-record-element=DET_BI_STATIC_FLAG_036_Rx, system-signal=DET_BI_STATIC_FLAG_036_Rx}, {application-record-element=DET_CONFD_AZIMUTH_033_Rx, system-signal=DET_CONFD_AZIMUTH_033_Rx}, {application-record-element=DET_CONFD_AZIMUTH_034_Rx, system-signal=DET_CONFD_AZIMUTH_034_Rx}, {application-record-element=DET_CONFD_AZIMUTH_035_Rx, system-signal=DET_CONFD_AZIMUTH_035_Rx}, {application-record-element=DET_CONFD_AZIMUTH_036_Rx, system-signal=DET_CONFD_AZIMUTH_036_Rx}, {application-record-element=DET_CONFD_ELEVATION_033_Rx, system-signal=DET_CONFD_ELEVATION_033_Rx}, {application-record-element=DET_CONFD_ELEVATION_034_Rx, system-signal=DET_CONFD_ELEVATION_034_Rx}, {application-record-element=DET_CONFD_ELEVATION_035_Rx, system-signal=DET_CONFD_ELEVATION_035_Rx}, {application-record-element=DET_CONFD_ELEVATION_036_Rx, system-signal=DET_CONFD_ELEVATION_036_Rx}, {application-record-element=DET_ELEVATION_033_Rx, system-signal=DET_ELEVATION_033_Rx}, {application-record-element=DET_ELEVATION_034_Rx, system-signal=DET_ELEVATION_034_Rx}, {application-record-element=DET_ELEVATION_035_Rx, system-signal=DET_ELEVATION_035_Rx}, {application-record-element=DET_ELEVATION_036_Rx, system-signal=DET_ELEVATION_036_Rx}, {application-record-element=DET_ELEVATION_ERR_033_Rx, system-signal=DET_ELEVATION_ERR_033_Rx}, {application-record-element=DET_ELEVATION_ERR_034_Rx, system-signal=DET_ELEVATION_ERR_034_Rx}, {application-record-element=DET_ELEVATION_ERR_035_Rx, system-signal=DET_ELEVATION_ERR_035_Rx}, {application-record-element=DET_ELEVATION_ERR_036_Rx, system-signal=DET_ELEVATION_ERR_036_Rx}, {application-record-element=DET_EXISTENCE_PROB_033_Rx, system-signal=DET_EXISTENCE_PROB_033_Rx}, {application-record-element=DET_EXISTENCE_PROB_034_Rx, system-signal=DET_EXISTENCE_PROB_034_Rx}, {application-record-element=DET_EXISTENCE_PROB_035_Rx, system-signal=DET_EXISTENCE_PROB_035_Rx}, {application-record-element=DET_EXISTENCE_PROB_036_Rx, system-signal=DET_EXISTENCE_PROB_036_Rx}, {application-record-element=DET_HVC_FLAG_033_Rx, system-signal=DET_HVC_FLAG_033_Rx}, {application-record-element=DET_HVC_FLAG_034_Rx, system-signal=DET_HVC_FLAG_034_Rx}, {application-record-element=DET_HVC_FLAG_035_Rx, system-signal=DET_HVC_FLAG_035_Rx}, {application-record-element=DET_HVC_FLAG_036_Rx, system-signal=DET_HVC_FLAG_036_Rx}, {application-record-element=DET_IDM_033_Rx, system-signal=DET_IDM_033_Rx}, {application-record-element=DET_IDM_034_Rx, system-signal=DET_IDM_034_Rx}, {application-record-element=DET_IDM_035_Rx, system-signal=DET_IDM_035_Rx}, {application-record-element=DET_IDM_036_Rx, system-signal=DET_IDM_036_Rx}, {application-record-element=DET_MH_CRC16_033_036_Rx, system-signal=DET_MH_CRC16_033_036_Rx}, {application-record-element=DET_MH_CYCLE_COUNTER_033_036_Rx, system-signal=DET_MH_CYCLE_COUNTER_033_036_Rx}, {application-record-element=DET_MH_SCAN_INDEX_4LSB_033_036_Rx, system-signal=DET_MH_SCAN_INDEX_4LSB_033_036_Rx}, {application-record-element=DET_MTD_033_Rx, system-signal=DET_MTD_033_Rx}, {application-record-element=DET_MTD_034_Rx, system-signal=DET_MTD_034_Rx}, {application-record-element=DET_MTD_035_Rx, system-signal=DET_MTD_035_Rx}, {application-record-element=DET_MTD_036_Rx, system-signal=DET_MTD_036_Rx}, {application-record-element=DET_PROB_1STAZHYPO_033_Rx, system-signal=DET_PROB_1STAZHYPO_033_Rx}, {application-record-element=DET_PROB_1STAZHYPO_034_Rx, system-signal=DET_PROB_1STAZHYPO_034_Rx}, {application-record-element=DET_PROB_1STAZHYPO_035_Rx, system-signal=DET_PROB_1STAZHYPO_035_Rx}, {application-record-element=DET_PROB_1STAZHYPO_036_Rx, system-signal=DET_PROB_1STAZHYPO_036_Rx}, {application-record-element=DET_RANGE_033_Rx, system-signal=DET_RANGE_033_Rx}, {application-record-element=DET_RANGE_034_Rx, system-signal=DET_RANGE_034_Rx}, {application-record-element=DET_RANGE_035_Rx, system-signal=DET_RANGE_035_Rx}, {application-record-element=DET_RANGE_036_Rx, system-signal=DET_RANGE_036_Rx}, {application-record-element=DET_RANGE_ERR_033_Rx, system-signal=DET_RANGE_ERR_033_Rx}, {application-record-element=DET_RANGE_ERR_034_Rx, system-signal=DET_RANGE_ERR_034_Rx}, {application-record-element=DET_RANGE_ERR_035_Rx, system-signal=DET_RANGE_ERR_035_Rx}, {application-record-element=DET_RANGE_ERR_036_Rx, system-signal=DET_RANGE_ERR_036_Rx}, {application-record-element=DET_RANGE_VELOCITY_033_Rx, system-signal=DET_RANGE_VELOCITY_033_Rx}, {application-record-element=DET_RANGE_VELOCITY_034_Rx, system-signal=DET_RANGE_VELOCITY_034_Rx}, {application-record-element=DET_RANGE_VELOCITY_035_Rx, system-signal=DET_RANGE_VELOCITY_035_Rx}, {application-record-element=DET_RANGE_VELOCITY_036_Rx, system-signal=DET_RANGE_VELOCITY_036_Rx}, {application-record-element=DET_RANGE_VELOCITY_ERR_033_Rx, system-signal=DET_RANGE_VELOCITY_ERR_033_Rx}, {application-record-element=DET_RANGE_VELOCITY_ERR_034_Rx, system-signal=DET_RANGE_VELOCITY_ERR_034_Rx}, {application-record-element=DET_RANGE_VELOCITY_ERR_035_Rx, system-signal=DET_RANGE_VELOCITY_ERR_035_Rx}, {application-record-element=DET_RANGE_VELOCITY_ERR_036_Rx, system-signal=DET_RANGE_VELOCITY_ERR_036_Rx}, {application-record-element=DET_RCS_033_Rx, system-signal=DET_RCS_033_Rx}, {application-record-element=DET_RCS_034_Rx, system-signal=DET_RCS_034_Rx}, {application-record-element=DET_RCS_035_Rx, system-signal=DET_RCS_035_Rx}, {application-record-element=DET_RCS_036_Rx, system-signal=DET_RCS_036_Rx}, {application-record-element=DET_SNR_033_Rx, system-signal=DET_SNR_033_Rx}, {application-record-element=DET_SNR_034_Rx, system-signal=DET_SNR_034_Rx}, {application-record-element=DET_SNR_035_Rx, system-signal=DET_SNR_035_Rx}, {application-record-element=DET_SNR_036_Rx, system-signal=DET_SNR_036_Rx}, {application-record-element=DET_SUPER_RES_TARGET_033_Rx, system-signal=DET_SUPER_RES_TARGET_033_Rx}, {application-record-element=DET_SUPER_RES_TARGET_034_Rx, system-signal=DET_SUPER_RES_TARGET_034_Rx}, {application-record-element=DET_SUPER_RES_TARGET_035_Rx, system-signal=DET_SUPER_RES_TARGET_035_Rx}, {application-record-element=DET_SUPER_RES_TARGET_036_Rx, system-signal=DET_SUPER_RES_TARGET_036_Rx}]}
        sender-receiver-to-signal-group-mapping={data-element=Rp_SG_Fusion_Detections_037_040_AL.Vdp_SG_Fusion_Detections_037_040_AL, signal-group=SG_Fusion_Detections_037_040, type-mapping=sender-rec-record-type-mapping=record-element-mappings=[{application-record-element=DET_AZIMUTH_037_Rx, system-signal=DET_AZIMUTH_037_Rx}, {application-record-element=DET_AZIMUTH_038_Rx, system-signal=DET_AZIMUTH_038_Rx}, {application-record-element=DET_AZIMUTH_039_Rx, system-signal=DET_AZIMUTH_039_Rx}, {application-record-element=DET_AZIMUTH_040_Rx, system-signal=DET_AZIMUTH_040_Rx}, {application-record-element=DET_AZIMUTH_ERR_037_Rx, system-signal=DET_AZIMUTH_ERR_037_Rx}, {application-record-element=DET_AZIMUTH_ERR_038_Rx, system-signal=DET_AZIMUTH_ERR_038_Rx}, {application-record-element=DET_AZIMUTH_ERR_039_Rx, system-signal=DET_AZIMUTH_ERR_039_Rx}, {application-record-element=DET_AZIMUTH_ERR_040_Rx, system-signal=DET_AZIMUTH_ERR_040_Rx}, {application-record-element=DET_BELOW_RAIN_THOLD_037_Rx, system-signal=DET_BELOW_RAIN_THOLD_037_Rx}, {application-record-element=DET_BELOW_RAIN_THOLD_038_Rx, system-signal=DET_BELOW_RAIN_THOLD_038_Rx}, {application-record-element=DET_BELOW_RAIN_THOLD_039_Rx, system-signal=DET_BELOW_RAIN_THOLD_039_Rx}, {application-record-element=DET_BELOW_RAIN_THOLD_040_Rx, system-signal=DET_BELOW_RAIN_THOLD_040_Rx}, {application-record-element=DET_BI_STATIC_FLAG_037_Rx, system-signal=DET_BI_STATIC_FLAG_037_Rx}, {application-record-element=DET_BI_STATIC_FLAG_038_Rx, system-signal=DET_BI_STATIC_FLAG_038_Rx}, {application-record-element=DET_BI_STATIC_FLAG_039_Rx, system-signal=DET_BI_STATIC_FLAG_039_Rx}, {application-record-element=DET_BI_STATIC_FLAG_040_Rx, system-signal=DET_BI_STATIC_FLAG_040_Rx}, {application-record-element=DET_CONFD_AZIMUTH_037_Rx, system-signal=DET_CONFD_AZIMUTH_037_Rx}, {application-record-element=DET_CONFD_AZIMUTH_038_Rx, system-signal=DET_CONFD_AZIMUTH_038_Rx}, {application-record-element=DET_CONFD_AZIMUTH_039_Rx, system-signal=DET_CONFD_AZIMUTH_039_Rx}, {application-record-element=DET_CONFD_AZIMUTH_040_Rx, system-signal=DET_CONFD_AZIMUTH_040_Rx}, {application-record-element=DET_CONFD_ELEVATION_037_Rx, system-signal=DET_CONFD_ELEVATION_037_Rx}, {application-record-element=DET_CONFD_ELEVATION_038_Rx, system-signal=DET_CONFD_ELEVATION_038_Rx}, {application-record-element=DET_CONFD_ELEVATION_039_Rx, system-signal=DET_CONFD_ELEVATION_039_Rx}, {application-record-element=DET_CONFD_ELEVATION_040_Rx, system-signal=DET_CONFD_ELEVATION_040_Rx}, {application-record-element=DET_ELEVATION_037_Rx, system-signal=DET_ELEVATION_037_Rx}, {application-record-element=DET_ELEVATION_038_Rx, system-signal=DET_ELEVATION_038_Rx}, {application-record-element=DET_ELEVATION_039_Rx, system-signal=DET_ELEVATION_039_Rx}, {application-record-element=DET_ELEVATION_040_Rx, system-signal=DET_ELEVATION_040_Rx}, {application-record-element=DET_ELEVATION_ERR_037_Rx, system-signal=DET_ELEVATION_ERR_037_Rx}, {application-record-element=DET_ELEVATION_ERR_038_Rx, system-signal=DET_ELEVATION_ERR_038_Rx}, {application-record-element=DET_ELEVATION_ERR_039_Rx, system-signal=DET_ELEVATION_ERR_039_Rx}, {application-record-element=DET_ELEVATION_ERR_040_Rx, system-signal=DET_ELEVATION_ERR_040_Rx}, {application-record-element=DET_EXISTENCE_PROB_037_Rx, system-signal=DET_EXISTENCE_PROB_037_Rx}, {application-record-element=DET_EXISTENCE_PROB_038_Rx, system-signal=DET_EXISTENCE_PROB_038_Rx}, {application-record-element=DET_EXISTENCE_PROB_039_Rx, system-signal=DET_EXISTENCE_PROB_039_Rx}, {application-record-element=DET_EXISTENCE_PROB_040_Rx, system-signal=DET_EXISTENCE_PROB_040_Rx}, {application-record-element=DET_HVC_FLAG_037_Rx, system-signal=DET_HVC_FLAG_037_Rx}, {application-record-element=DET_HVC_FLAG_038_Rx, system-signal=DET_HVC_FLAG_038_Rx}, {application-record-element=DET_HVC_FLAG_039_Rx, system-signal=DET_HVC_FLAG_039_Rx}, {application-record-element=DET_HVC_FLAG_040_Rx, system-signal=DET_HVC_FLAG_040_Rx}, {application-record-element=DET_IDM_037_Rx, system-signal=DET_IDM_037_Rx}, {application-record-element=DET_IDM_038_Rx, system-signal=DET_IDM_038_Rx}, {application-record-element=DET_IDM_039_Rx, system-signal=DET_IDM_039_Rx}, {application-record-element=DET_IDM_040_Rx, system-signal=DET_IDM_040_Rx}, {application-record-element=DET_MH_CRC16_037_040_Rx, system-signal=DET_MH_CRC16_037_040_Rx}, {application-record-element=DET_MH_CYCLE_COUNTER_037_040_Rx, system-signal=DET_MH_CYCLE_COUNTER_037_040_Rx}, {application-record-element=DET_MH_SCAN_INDEX_4LSB_037_040_Rx, system-signal=DET_MH_SCAN_INDEX_4LSB_037_040_Rx}, {application-record-element=DET_MTD_037_Rx, system-signal=DET_MTD_037_Rx}, {application-record-element=DET_MTD_038_Rx, system-signal=DET_MTD_038_Rx}, {application-record-element=DET_MTD_039_Rx, system-signal=DET_MTD_039_Rx}, {application-record-element=DET_MTD_040_Rx, system-signal=DET_MTD_040_Rx}, {application-record-element=DET_PROB_1STAZHYPO_037_Rx, system-signal=DET_PROB_1STAZHYPO_037_Rx}, {application-record-element=DET_PROB_1STAZHYPO_038_Rx, system-signal=DET_PROB_1STAZHYPO_038_Rx}, {application-record-element=DET_PROB_1STAZHYPO_039_Rx, system-signal=DET_PROB_1STAZHYPO_039_Rx}, {application-record-element=DET_PROB_1STAZHYPO_040_Rx, system-signal=DET_PROB_1STAZHYPO_040_Rx}, {application-record-element=DET_RANGE_037_Rx, system-signal=DET_RANGE_037_Rx}, {application-record-element=DET_RANGE_038_Rx, system-signal=DET_RANGE_038_Rx}, {application-record-element=DET_RANGE_039_Rx, system-signal=DET_RANGE_039_Rx}, {application-record-element=DET_RANGE_040_Rx, system-signal=DET_RANGE_040_Rx}, {application-record-element=DET_RANGE_ERR_037_Rx, system-signal=DET_RANGE_ERR_037_Rx}, {application-record-element=DET_RANGE_ERR_038_Rx, system-signal=DET_RANGE_ERR_038_Rx}, {application-record-element=DET_RANGE_ERR_039_Rx, system-signal=DET_RANGE_ERR_039_Rx}, {application-record-element=DET_RANGE_ERR_040_Rx, system-signal=DET_RANGE_ERR_040_Rx}, {application-record-element=DET_RANGE_VELOCITY_037_Rx, system-signal=DET_RANGE_VELOCITY_037_Rx}, {application-record-element=DET_RANGE_VELOCITY_038_Rx, system-signal=DET_RANGE_VELOCITY_038_Rx}, {application-record-element=DET_RANGE_VELOCITY_039_Rx, system-signal=DET_RANGE_VELOCITY_039_Rx}, {application-record-element=DET_RANGE_VELOCITY_040_Rx, system-signal=DET_RANGE_VELOCITY_040_Rx}, {application-record-element=DET_RANGE_VELOCITY_ERR_037_Rx, system-signal=DET_RANGE_VELOCITY_ERR_037_Rx}, {application-record-element=DET_RANGE_VELOCITY_ERR_038_Rx, system-signal=DET_RANGE_VELOCITY_ERR_038_Rx}, {application-record-element=DET_RANGE_VELOCITY_ERR_039_Rx, system-signal=DET_RANGE_VELOCITY_ERR_039_Rx}, {application-record-element=DET_RANGE_VELOCITY_ERR_040_Rx, system-signal=DET_RANGE_VELOCITY_ERR_040_Rx}, {application-record-element=DET_RCS_037_Rx, system-signal=DET_RCS_037_Rx}, {application-record-element=DET_RCS_038_Rx, system-signal=DET_RCS_038_Rx}, {application-record-element=DET_RCS_039_Rx, system-signal=DET_RCS_039_Rx}, {application-record-element=DET_RCS_040_Rx, system-signal=DET_RCS_040_Rx}, {application-record-element=DET_SNR_037_Rx, system-signal=DET_SNR_037_Rx}, {application-record-element=DET_SNR_038_Rx, system-signal=DET_SNR_038_Rx}, {application-record-element=DET_SNR_039_Rx, system-signal=DET_SNR_039_Rx}, {application-record-element=DET_SNR_040_Rx, system-signal=DET_SNR_040_Rx}, {application-record-element=DET_SUPER_RES_TARGET_037_Rx, system-signal=DET_SUPER_RES_TARGET_037_Rx}, {application-record-element=DET_SUPER_RES_TARGET_038_Rx, system-signal=DET_SUPER_RES_TARGET_038_Rx}, {application-record-element=DET_SUPER_RES_TARGET_039_Rx, system-signal=DET_SUPER_RES_TARGET_039_Rx}, {application-record-element=DET_SUPER_RES_TARGET_040_Rx, system-signal=DET_SUPER_RES_TARGET_040_Rx}]}
        sender-receiver-to-signal-group-mapping={data-element=Rp_SG_Fusion_Detections_041_044_AL.Vdp_SG_Fusion_Detections_041_044_AL, signal-group=SG_Fusion_Detections_041_044, type-mapping=sender-rec-record-type-mapping=record-element-mappings=[{application-record-element=DET_AZIMUTH_041_Rx, system-signal=DET_AZIMUTH_041_Rx}, {application-record-element=DET_AZIMUTH_042_Rx, system-signal=DET_AZIMUTH_042_Rx}, {application-record-element=DET_AZIMUTH_043_Rx, system-signal=DET_AZIMUTH_043_Rx}, {application-record-element=DET_AZIMUTH_044_Rx, system-signal=DET_AZIMUTH_044_Rx}, {application-record-element=DET_AZIMUTH_ERR_041_Rx, system-signal=DET_AZIMUTH_ERR_041_Rx}, {application-record-element=DET_AZIMUTH_ERR_042_Rx, system-signal=DET_AZIMUTH_ERR_042_Rx}, {application-record-element=DET_AZIMUTH_ERR_043_Rx, system-signal=DET_AZIMUTH_ERR_043_Rx}, {application-record-element=DET_AZIMUTH_ERR_044_Rx, system-signal=DET_AZIMUTH_ERR_044_Rx}, {application-record-element=DET_BELOW_RAIN_THOLD_041_Rx, system-signal=DET_BELOW_RAIN_THOLD_041_Rx}, {application-record-element=DET_BELOW_RAIN_THOLD_042_Rx, system-signal=DET_BELOW_RAIN_THOLD_042_Rx}, {application-record-element=DET_BELOW_RAIN_THOLD_043_Rx, system-signal=DET_BELOW_RAIN_THOLD_043_Rx}, {application-record-element=DET_BELOW_RAIN_THOLD_044_Rx, system-signal=DET_BELOW_RAIN_THOLD_044_Rx}, {application-record-element=DET_BI_STATIC_FLAG_041_Rx, system-signal=DET_BI_STATIC_FLAG_041_Rx}, {application-record-element=DET_BI_STATIC_FLAG_042_Rx, system-signal=DET_BI_STATIC_FLAG_042_Rx}, {application-record-element=DET_BI_STATIC_FLAG_043_Rx, system-signal=DET_BI_STATIC_FLAG_043_Rx}, {application-record-element=DET_BI_STATIC_FLAG_044_Rx, system-signal=DET_BI_STATIC_FLAG_044_Rx}, {application-record-element=DET_CONFD_AZIMUTH_041_Rx, system-signal=DET_CONFD_AZIMUTH_041_Rx}, {application-record-element=DET_CONFD_AZIMUTH_042_Rx, system-signal=DET_CONFD_AZIMUTH_042_Rx}, {application-record-element=DET_CONFD_AZIMUTH_043_Rx, system-signal=DET_CONFD_AZIMUTH_043_Rx}, {application-record-element=DET_CONFD_AZIMUTH_044_Rx, system-signal=DET_CONFD_AZIMUTH_044_Rx}, {application-record-element=DET_CONFD_ELEVATION_041_Rx, system-signal=DET_CONFD_ELEVATION_041_Rx}, {application-record-element=DET_CONFD_ELEVATION_042_Rx, system-signal=DET_CONFD_ELEVATION_042_Rx}, {application-record-element=DET_CONFD_ELEVATION_043_Rx, system-signal=DET_CONFD_ELEVATION_043_Rx}, {application-record-element=DET_CONFD_ELEVATION_044_Rx, system-signal=DET_CONFD_ELEVATION_044_Rx}, {application-record-element=DET_ELEVATION_041_Rx, system-signal=DET_ELEVATION_041_Rx}, {application-record-element=DET_ELEVATION_042_Rx, system-signal=DET_ELEVATION_042_Rx}, {application-record-element=DET_ELEVATION_043_Rx, system-signal=DET_ELEVATION_043_Rx}, {application-record-element=DET_ELEVATION_044_Rx, system-signal=DET_ELEVATION_044_Rx}, {application-record-element=DET_ELEVATION_ERR_041_Rx, system-signal=DET_ELEVATION_ERR_041_Rx}, {application-record-element=DET_ELEVATION_ERR_042_Rx, system-signal=DET_ELEVATION_ERR_042_Rx}, {application-record-element=DET_ELEVATION_ERR_043_Rx, system-signal=DET_ELEVATION_ERR_043_Rx}, {application-record-element=DET_ELEVATION_ERR_044_Rx, system-signal=DET_ELEVATION_ERR_044_Rx}, {application-record-element=DET_EXISTENCE_PROB_041_Rx, system-signal=DET_EXISTENCE_PROB_041_Rx}, {application-record-element=DET_EXISTENCE_PROB_042_Rx, system-signal=DET_EXISTENCE_PROB_042_Rx}, {application-record-element=DET_EXISTENCE_PROB_043_Rx, system-signal=DET_EXISTENCE_PROB_043_Rx}, {application-record-element=DET_EXISTENCE_PROB_044_Rx, system-signal=DET_EXISTENCE_PROB_044_Rx}, {application-record-element=DET_HVC_FLAG_041_Rx, system-signal=DET_HVC_FLAG_041_Rx}, {application-record-element=DET_HVC_FLAG_042_Rx, system-signal=DET_HVC_FLAG_042_Rx}, {application-record-element=DET_HVC_FLAG_043_Rx, system-signal=DET_HVC_FLAG_043_Rx}, {application-record-element=DET_HVC_FLAG_044_Rx, system-signal=DET_HVC_FLAG_044_Rx}, {application-record-element=DET_IDM_041_Rx, system-signal=DET_IDM_041_Rx}, {application-record-element=DET_IDM_042_Rx, system-signal=DET_IDM_042_Rx}, {application-record-element=DET_IDM_043_Rx, system-signal=DET_IDM_043_Rx}, {application-record-element=DET_IDM_044_Rx, system-signal=DET_IDM_044_Rx}, {application-record-element=DET_MH_CRC16_041_044_Rx, system-signal=DET_MH_CRC16_041_044_Rx}, {application-record-element=DET_MH_CYCLE_COUNTER_041_044_Rx, system-signal=DET_MH_CYCLE_COUNTER_041_044_Rx}, {application-record-element=DET_MH_SCAN_INDEX_4LSB_041_044_Rx, system-signal=DET_MH_SCAN_INDEX_4LSB_041_044_Rx}, {application-record-element=DET_MTD_041_Rx, system-signal=DET_MTD_041_Rx}, {application-record-element=DET_MTD_042_Rx, system-signal=DET_MTD_042_Rx}, {application-record-element=DET_MTD_043_Rx, system-signal=DET_MTD_043_Rx}, {application-record-element=DET_MTD_044_Rx, system-signal=DET_MTD_044_Rx}, {application-record-element=DET_PROB_1STAZHYPO_041_Rx, system-signal=DET_PROB_1STAZHYPO_041_Rx}, {application-record-element=DET_PROB_1STAZHYPO_042_Rx, system-signal=DET_PROB_1STAZHYPO_042_Rx}, {application-record-element=DET_PROB_1STAZHYPO_043_Rx, system-signal=DET_PROB_1STAZHYPO_043_Rx}, {application-record-element=DET_PROB_1STAZHYPO_044_Rx, system-signal=DET_PROB_1STAZHYPO_044_Rx}, {application-record-element=DET_RANGE_041_Rx, system-signal=DET_RANGE_041_Rx}, {application-record-element=DET_RANGE_042_Rx, system-signal=DET_RANGE_042_Rx}, {application-record-element=DET_RANGE_043_Rx, system-signal=DET_RANGE_043_Rx}, {application-record-element=DET_RANGE_044_Rx, system-signal=DET_RANGE_044_Rx}, {application-record-element=DET_RANGE_ERR_041_Rx, system-signal=DET_RANGE_ERR_041_Rx}, {application-record-element=DET_RANGE_ERR_042_Rx, system-signal=DET_RANGE_ERR_042_Rx}, {application-record-element=DET_RANGE_ERR_043_Rx, system-signal=DET_RANGE_ERR_043_Rx}, {application-record-element=DET_RANGE_ERR_044_Rx, system-signal=DET_RANGE_ERR_044_Rx}, {application-record-element=DET_RANGE_VELOCITY_041_Rx, system-signal=DET_RANGE_VELOCITY_041_Rx}, {application-record-element=DET_RANGE_VELOCITY_042_Rx, system-signal=DET_RANGE_VELOCITY_042_Rx}, {application-record-element=DET_RANGE_VELOCITY_043_Rx, system-signal=DET_RANGE_VELOCITY_043_Rx}, {application-record-element=DET_RANGE_VELOCITY_044_Rx, system-signal=DET_RANGE_VELOCITY_044_Rx}, {application-record-element=DET_RANGE_VELOCITY_ERR_041_Rx, system-signal=DET_RANGE_VELOCITY_ERR_041_Rx}, {application-record-element=DET_RANGE_VELOCITY_ERR_042_Rx, system-signal=DET_RANGE_VELOCITY_ERR_042_Rx}, {application-record-element=DET_RANGE_VELOCITY_ERR_043_Rx, system-signal=DET_RANGE_VELOCITY_ERR_043_Rx}, {application-record-element=DET_RANGE_VELOCITY_ERR_044_Rx, system-signal=DET_RANGE_VELOCITY_ERR_044_Rx}, {application-record-element=DET_RCS_041_Rx, system-signal=DET_RCS_041_Rx}, {application-record-element=DET_RCS_042_Rx, system-signal=DET_RCS_042_Rx}, {application-record-element=DET_RCS_043_Rx, system-signal=DET_RCS_043_Rx}, {application-record-element=DET_RCS_044_Rx, system-signal=DET_RCS_044_Rx}, {application-record-element=DET_SNR_041_Rx, system-signal=DET_SNR_041_Rx}, {application-record-element=DET_SNR_042_Rx, system-signal=DET_SNR_042_Rx}, {application-record-element=DET_SNR_043_Rx, system-signal=DET_SNR_043_Rx}, {application-record-element=DET_SNR_044_Rx, system-signal=DET_SNR_044_Rx}, {application-record-element=DET_SUPER_RES_TARGET_041_Rx, system-signal=DET_SUPER_RES_TARGET_041_Rx}, {application-record-element=DET_SUPER_RES_TARGET_042_Rx, system-signal=DET_SUPER_RES_TARGET_042_Rx}, {application-record-element=DET_SUPER_RES_TARGET_043_Rx, system-signal=DET_SUPER_RES_TARGET_043_Rx}, {application-record-element=DET_SUPER_RES_TARGET_044_Rx, system-signal=DET_SUPER_RES_TARGET_044_Rx}]}
        sender-receiver-to-signal-group-mapping={data-element=Rp_SG_Fusion_Detections_045_048_AL.Vdp_SG_Fusion_Detections_045_048_AL, signal-group=SG_Fusion_Detections_045_048, type-mapping=sender-rec-record-type-mapping=record-element-mappings=[{application-record-element=DET_AZIMUTH_045_Rx, system-signal=DET_AZIMUTH_045_Rx}, {application-record-element=DET_AZIMUTH_046_Rx, system-signal=DET_AZIMUTH_046_Rx}, {application-record-element=DET_AZIMUTH_047_Rx, system-signal=DET_AZIMUTH_047_Rx}, {application-record-element=DET_AZIMUTH_048_Rx, system-signal=DET_AZIMUTH_048_Rx}, {application-record-element=DET_AZIMUTH_ERR_045_Rx, system-signal=DET_AZIMUTH_ERR_045_Rx}, {application-record-element=DET_AZIMUTH_ERR_046_Rx, system-signal=DET_AZIMUTH_ERR_046_Rx}, {application-record-element=DET_AZIMUTH_ERR_047_Rx, system-signal=DET_AZIMUTH_ERR_047_Rx}, {application-record-element=DET_AZIMUTH_ERR_048_Rx, system-signal=DET_AZIMUTH_ERR_048_Rx}, {application-record-element=DET_BELOW_RAIN_THOLD_045_Rx, system-signal=DET_BELOW_RAIN_THOLD_045_Rx}, {application-record-element=DET_BELOW_RAIN_THOLD_046_Rx, system-signal=DET_BELOW_RAIN_THOLD_046_Rx}, {application-record-element=DET_BELOW_RAIN_THOLD_047_Rx, system-signal=DET_BELOW_RAIN_THOLD_047_Rx}, {application-record-element=DET_BELOW_RAIN_THOLD_048_Rx, system-signal=DET_BELOW_RAIN_THOLD_048_Rx}, {application-record-element=DET_BI_STATIC_FLAG_045_Rx, system-signal=DET_BI_STATIC_FLAG_045_Rx}, {application-record-element=DET_BI_STATIC_FLAG_046_Rx, system-signal=DET_BI_STATIC_FLAG_046_Rx}, {application-record-element=DET_BI_STATIC_FLAG_047_Rx, system-signal=DET_BI_STATIC_FLAG_047_Rx}, {application-record-element=DET_BI_STATIC_FLAG_048_Rx, system-signal=DET_BI_STATIC_FLAG_048_Rx}, {application-record-element=DET_CONFD_AZIMUTH_045_Rx, system-signal=DET_CONFD_AZIMUTH_045_Rx}, {application-record-element=DET_CONFD_AZIMUTH_046_Rx, system-signal=DET_CONFD_AZIMUTH_046_Rx}, {application-record-element=DET_CONFD_AZIMUTH_047_Rx, system-signal=DET_CONFD_AZIMUTH_047_Rx}, {application-record-element=DET_CONFD_AZIMUTH_048_Rx, system-signal=DET_CONFD_AZIMUTH_048_Rx}, {application-record-element=DET_CONFD_ELEVATION_045_Rx, system-signal=DET_CONFD_ELEVATION_045_Rx}, {application-record-element=DET_CONFD_ELEVATION_046_Rx, system-signal=DET_CONFD_ELEVATION_046_Rx}, {application-record-element=DET_CONFD_ELEVATION_047_Rx, system-signal=DET_CONFD_ELEVATION_047_Rx}, {application-record-element=DET_CONFD_ELEVATION_048_Rx, system-signal=DET_CONFD_ELEVATION_048_Rx}, {application-record-element=DET_ELEVATION_045_Rx, system-signal=DET_ELEVATION_045_Rx}, {application-record-element=DET_ELEVATION_046_Rx, system-signal=DET_ELEVATION_046_Rx}, {application-record-element=DET_ELEVATION_047_Rx, system-signal=DET_ELEVATION_047_Rx}, {application-record-element=DET_ELEVATION_048_Rx, system-signal=DET_ELEVATION_048_Rx}, {application-record-element=DET_ELEVATION_ERR_045_Rx, system-signal=DET_ELEVATION_ERR_045_Rx}, {application-record-element=DET_ELEVATION_ERR_046_Rx, system-signal=DET_ELEVATION_ERR_046_Rx}, {application-record-element=DET_ELEVATION_ERR_047_Rx, system-signal=DET_ELEVATION_ERR_047_Rx}, {application-record-element=DET_ELEVATION_ERR_048_Rx, system-signal=DET_ELEVATION_ERR_048_Rx}, {application-record-element=DET_EXISTENCE_PROB_045_Rx, system-signal=DET_EXISTENCE_PROB_045_Rx}, {application-record-element=DET_EXISTENCE_PROB_046_Rx, system-signal=DET_EXISTENCE_PROB_046_Rx}, {application-record-element=DET_EXISTENCE_PROB_047_Rx, system-signal=DET_EXISTENCE_PROB_047_Rx}, {application-record-element=DET_EXISTENCE_PROB_048_Rx, system-signal=DET_EXISTENCE_PROB_048_Rx}, {application-record-element=DET_HVC_FLAG_045_Rx, system-signal=DET_HVC_FLAG_045_Rx}, {application-record-element=DET_HVC_FLAG_046_Rx, system-signal=DET_HVC_FLAG_046_Rx}, {application-record-element=DET_HVC_FLAG_047_Rx, system-signal=DET_HVC_FLAG_047_Rx}, {application-record-element=DET_HVC_FLAG_048_Rx, system-signal=DET_HVC_FLAG_048_Rx}, {application-record-element=DET_IDM_045_Rx, system-signal=DET_IDM_045_Rx}, {application-record-element=DET_IDM_046_Rx, system-signal=DET_IDM_046_Rx}, {application-record-element=DET_IDM_047_Rx, system-signal=DET_IDM_047_Rx}, {application-record-element=DET_IDM_048_Rx, system-signal=DET_IDM_048_Rx}, {application-record-element=DET_MH_CRC16_045_048_Rx, system-signal=DET_MH_CRC16_045_048_Rx}, {application-record-element=DET_MH_CYCLE_COUNTER_045_048_Rx, system-signal=DET_MH_CYCLE_COUNTER_045_048_Rx}, {application-record-element=DET_MH_SCAN_INDEX_4LSB_045_048_Rx, system-signal=DET_MH_SCAN_INDEX_4LSB_045_048_Rx}, {application-record-element=DET_MTD_045_Rx, system-signal=DET_MTD_045_Rx}, {application-record-element=DET_MTD_046_Rx, system-signal=DET_MTD_046_Rx}, {application-record-element=DET_MTD_047_Rx, system-signal=DET_MTD_047_Rx}, {application-record-element=DET_MTD_048_Rx, system-signal=DET_MTD_048_Rx}, {application-record-element=DET_PROB_1STAZHYPO_045_Rx, system-signal=DET_PROB_1STAZHYPO_045_Rx}, {application-record-element=DET_PROB_1STAZHYPO_046_Rx, system-signal=DET_PROB_1STAZHYPO_046_Rx}, {application-record-element=DET_PROB_1STAZHYPO_047_Rx, system-signal=DET_PROB_1STAZHYPO_047_Rx}, {application-record-element=DET_PROB_1STAZHYPO_048_Rx, system-signal=DET_PROB_1STAZHYPO_048_Rx}, {application-record-element=DET_RANGE_045_Rx, system-signal=DET_RANGE_045_Rx}, {application-record-element=DET_RANGE_046_Rx, system-signal=DET_RANGE_046_Rx}, {application-record-element=DET_RANGE_047_Rx, system-signal=DET_RANGE_047_Rx}, {application-record-element=DET_RANGE_048_Rx, system-signal=DET_RANGE_048_Rx}, {application-record-element=DET_RANGE_ERR_045_Rx, system-signal=DET_RANGE_ERR_045_Rx}, {application-record-element=DET_RANGE_ERR_046_Rx, system-signal=DET_RANGE_ERR_046_Rx}, {application-record-element=DET_RANGE_ERR_047_Rx, system-signal=DET_RANGE_ERR_047_Rx}, {application-record-element=DET_RANGE_ERR_048_Rx, system-signal=DET_RANGE_ERR_048_Rx}, {application-record-element=DET_RANGE_VELOCITY_045_Rx, system-signal=DET_RANGE_VELOCITY_045_Rx}, {application-record-element=DET_RANGE_VELOCITY_046_Rx, system-signal=DET_RANGE_VELOCITY_046_Rx}, {application-record-element=DET_RANGE_VELOCITY_047_Rx, system-signal=DET_RANGE_VELOCITY_047_Rx}, {application-record-element=DET_RANGE_VELOCITY_048_Rx, system-signal=DET_RANGE_VELOCITY_048_Rx}, {application-record-element=DET_RANGE_VELOCITY_ERR_045_Rx, system-signal=DET_RANGE_VELOCITY_ERR_045_Rx}, {application-record-element=DET_RANGE_VELOCITY_ERR_046_Rx, system-signal=DET_RANGE_VELOCITY_ERR_046_Rx}, {application-record-element=DET_RANGE_VELOCITY_ERR_047_Rx, system-signal=DET_RANGE_VELOCITY_ERR_047_Rx}, {application-record-element=DET_RANGE_VELOCITY_ERR_048_Rx, system-signal=DET_RANGE_VELOCITY_ERR_048_Rx}, {application-record-element=DET_RCS_045_Rx, system-signal=DET_RCS_045_Rx}, {application-record-element=DET_RCS_046_Rx, system-signal=DET_RCS_046_Rx}, {application-record-element=DET_RCS_047_Rx, system-signal=DET_RCS_047_Rx}, {application-record-element=DET_RCS_048_Rx, system-signal=DET_RCS_048_Rx}, {application-record-element=DET_SNR_045_Rx, system-signal=DET_SNR_045_Rx}, {application-record-element=DET_SNR_046_Rx, system-signal=DET_SNR_046_Rx}, {application-record-element=DET_SNR_047_Rx, system-signal=DET_SNR_047_Rx}, {application-record-element=DET_SNR_048_Rx, system-signal=DET_SNR_048_Rx}, {application-record-element=DET_SUPER_RES_TARGET_045_Rx, system-signal=DET_SUPER_RES_TARGET_045_Rx}, {application-record-element=DET_SUPER_RES_TARGET_046_Rx, system-signal=DET_SUPER_RES_TARGET_046_Rx}, {application-record-element=DET_SUPER_RES_TARGET_047_Rx, system-signal=DET_SUPER_RES_TARGET_047_Rx}, {application-record-element=DET_SUPER_RES_TARGET_048_Rx, system-signal=DET_SUPER_RES_TARGET_048_Rx}]}
        sender-receiver-to-signal-group-mapping={data-element=Rp_SG_Fusion_Detections_049_052_AL.Vdp_SG_Fusion_Detections_049_052_AL, signal-group=SG_Fusion_Detections_049_052, type-mapping=sender-rec-record-type-mapping=record-element-mappings=[{application-record-element=DET_AZIMUTH_049_Rx, system-signal=DET_AZIMUTH_049_Rx}, {application-record-element=DET_AZIMUTH_050_Rx, system-signal=DET_AZIMUTH_050_Rx}, {application-record-element=DET_AZIMUTH_051_Rx, system-signal=DET_AZIMUTH_051_Rx}, {application-record-element=DET_AZIMUTH_052_Rx, system-signal=DET_AZIMUTH_052_Rx}, {application-record-element=DET_AZIMUTH_ERR_049_Rx, system-signal=DET_AZIMUTH_ERR_049_Rx}, {application-record-element=DET_AZIMUTH_ERR_050_Rx, system-signal=DET_AZIMUTH_ERR_050_Rx}, {application-record-element=DET_AZIMUTH_ERR_051_Rx, system-signal=DET_AZIMUTH_ERR_051_Rx}, {application-record-element=DET_AZIMUTH_ERR_052_Rx, system-signal=DET_AZIMUTH_ERR_052_Rx}, {application-record-element=DET_BELOW_RAIN_THOLD_049_Rx, system-signal=DET_BELOW_RAIN_THOLD_049_Rx}, {application-record-element=DET_BELOW_RAIN_THOLD_050_Rx, system-signal=DET_BELOW_RAIN_THOLD_050_Rx}, {application-record-element=DET_BELOW_RAIN_THOLD_051_Rx, system-signal=DET_BELOW_RAIN_THOLD_051_Rx}, {application-record-element=DET_BELOW_RAIN_THOLD_052_Rx, system-signal=DET_BELOW_RAIN_THOLD_052_Rx}, {application-record-element=DET_BI_STATIC_FLAG_049_Rx, system-signal=DET_BI_STATIC_FLAG_049_Rx}, {application-record-element=DET_BI_STATIC_FLAG_050_Rx, system-signal=DET_BI_STATIC_FLAG_050_Rx}, {application-record-element=DET_BI_STATIC_FLAG_051_Rx, system-signal=DET_BI_STATIC_FLAG_051_Rx}, {application-record-element=DET_BI_STATIC_FLAG_052_Rx, system-signal=DET_BI_STATIC_FLAG_052_Rx}, {application-record-element=DET_CONFD_AZIMUTH_049_Rx, system-signal=DET_CONFD_AZIMUTH_049_Rx}, {application-record-element=DET_CONFD_AZIMUTH_050_Rx, system-signal=DET_CONFD_AZIMUTH_050_Rx}, {application-record-element=DET_CONFD_AZIMUTH_051_Rx, system-signal=DET_CONFD_AZIMUTH_051_Rx}, {application-record-element=DET_CONFD_AZIMUTH_052_Rx, system-signal=DET_CONFD_AZIMUTH_052_Rx}, {application-record-element=DET_CONFD_ELEVATION_049_Rx, system-signal=DET_CONFD_ELEVATION_049_Rx}, {application-record-element=DET_CONFD_ELEVATION_050_Rx, system-signal=DET_CONFD_ELEVATION_050_Rx}, {application-record-element=DET_CONFD_ELEVATION_051_Rx, system-signal=DET_CONFD_ELEVATION_051_Rx}, {application-record-element=DET_CONFD_ELEVATION_052_Rx, system-signal=DET_CONFD_ELEVATION_052_Rx}, {application-record-element=DET_ELEVATION_049_Rx, system-signal=DET_ELEVATION_049_Rx}, {application-record-element=DET_ELEVATION_050_Rx, system-signal=DET_ELEVATION_050_Rx}, {application-record-element=DET_ELEVATION_051_Rx, system-signal=DET_ELEVATION_051_Rx}, {application-record-element=DET_ELEVATION_052_Rx, system-signal=DET_ELEVATION_052_Rx}, {application-record-element=DET_ELEVATION_ERR_049_Rx, system-signal=DET_ELEVATION_ERR_049_Rx}, {application-record-element=DET_ELEVATION_ERR_050_Rx, system-signal=DET_ELEVATION_ERR_050_Rx}, {application-record-element=DET_ELEVATION_ERR_051_Rx, system-signal=DET_ELEVATION_ERR_051_Rx}, {application-record-element=DET_ELEVATION_ERR_052_Rx, system-signal=DET_ELEVATION_ERR_052_Rx}, {application-record-element=DET_EXISTENCE_PROB_049_Rx, system-signal=DET_EXISTENCE_PROB_049_Rx}, {application-record-element=DET_EXISTENCE_PROB_050_Rx, system-signal=DET_EXISTENCE_PROB_050_Rx}, {application-record-element=DET_EXISTENCE_PROB_051_Rx, system-signal=DET_EXISTENCE_PROB_051_Rx}, {application-record-element=DET_EXISTENCE_PROB_052_Rx, system-signal=DET_EXISTENCE_PROB_052_Rx}, {application-record-element=DET_HVC_FLAG_049_Rx, system-signal=DET_HVC_FLAG_049_Rx}, {application-record-element=DET_HVC_FLAG_050_Rx, system-signal=DET_HVC_FLAG_050_Rx}, {application-record-element=DET_HVC_FLAG_051_Rx, system-signal=DET_HVC_FLAG_051_Rx}, {application-record-element=DET_HVC_FLAG_052_Rx, system-signal=DET_HVC_FLAG_052_Rx}, {application-record-element=DET_IDM_049_Rx, system-signal=DET_IDM_049_Rx}, {application-record-element=DET_IDM_050_Rx, system-signal=DET_IDM_050_Rx}, {application-record-element=DET_IDM_051_Rx, system-signal=DET_IDM_051_Rx}, {application-record-element=DET_IDM_052_Rx, system-signal=DET_IDM_052_Rx}, {application-record-element=DET_MH_CRC16_049_052_Rx, system-signal=DET_MH_CRC16_049_052_Rx}, {application-record-element=DET_MH_CYCLE_COUNTER_049_052_Rx, system-signal=DET_MH_CYCLE_COUNTER_049_052_Rx}, {application-record-element=DET_MH_SCAN_INDEX_4LSB_049_052_Rx, system-signal=DET_MH_SCAN_INDEX_4LSB_049_052_Rx}, {application-record-element=DET_MTD_049_Rx, system-signal=DET_MTD_049_Rx}, {application-record-element=DET_MTD_050_Rx, system-signal=DET_MTD_050_Rx}, {application-record-element=DET_MTD_051_Rx, system-signal=DET_MTD_051_Rx}, {application-record-element=DET_MTD_052_Rx, system-signal=DET_MTD_052_Rx}, {application-record-element=DET_PROB_1STAZHYPO_049_Rx, system-signal=DET_PROB_1STAZHYPO_049_Rx}, {application-record-element=DET_PROB_1STAZHYPO_050_Rx, system-signal=DET_PROB_1STAZHYPO_050_Rx}, {application-record-element=DET_PROB_1STAZHYPO_051_Rx, system-signal=DET_PROB_1STAZHYPO_051_Rx}, {application-record-element=DET_PROB_1STAZHYPO_052_Rx, system-signal=DET_PROB_1STAZHYPO_052_Rx}, {application-record-element=DET_RANGE_049_Rx, system-signal=DET_RANGE_049_Rx}, {application-record-element=DET_RANGE_050_Rx, system-signal=DET_RANGE_050_Rx}, {application-record-element=DET_RANGE_051_Rx, system-signal=DET_RANGE_051_Rx}, {application-record-element=DET_RANGE_052_Rx, system-signal=DET_RANGE_052_Rx}, {application-record-element=DET_RANGE_ERR_049_Rx, system-signal=DET_RANGE_ERR_049_Rx}, {application-record-element=DET_RANGE_ERR_050_Rx, system-signal=DET_RANGE_ERR_050_Rx}, {application-record-element=DET_RANGE_ERR_051_Rx, system-signal=DET_RANGE_ERR_051_Rx}, {application-record-element=DET_RANGE_ERR_052_Rx, system-signal=DET_RANGE_ERR_052_Rx}, {application-record-element=DET_RANGE_VELOCITY_049_Rx, system-signal=DET_RANGE_VELOCITY_049_Rx}, {application-record-element=DET_RANGE_VELOCITY_050_Rx, system-signal=DET_RANGE_VELOCITY_050_Rx}, {application-record-element=DET_RANGE_VELOCITY_051_Rx, system-signal=DET_RANGE_VELOCITY_051_Rx}, {application-record-element=DET_RANGE_VELOCITY_052_Rx, system-signal=DET_RANGE_VELOCITY_052_Rx}, {application-record-element=DET_RANGE_VELOCITY_ERR_049_Rx, system-signal=DET_RANGE_VELOCITY_ERR_049_Rx}, {application-record-element=DET_RANGE_VELOCITY_ERR_050_Rx, system-signal=DET_RANGE_VELOCITY_ERR_050_Rx}, {application-record-element=DET_RANGE_VELOCITY_ERR_051_Rx, system-signal=DET_RANGE_VELOCITY_ERR_051_Rx}, {application-record-element=DET_RANGE_VELOCITY_ERR_052_Rx, system-signal=DET_RANGE_VELOCITY_ERR_052_Rx}, {application-record-element=DET_RCS_049_Rx, system-signal=DET_RCS_049_Rx}, {application-record-element=DET_RCS_050_Rx, system-signal=DET_RCS_050_Rx}, {application-record-element=DET_RCS_051_Rx, system-signal=DET_RCS_051_Rx}, {application-record-element=DET_RCS_052_Rx, system-signal=DET_RCS_052_Rx}, {application-record-element=DET_SNR_049_Rx, system-signal=DET_SNR_049_Rx}, {application-record-element=DET_SNR_050_Rx, system-signal=DET_SNR_050_Rx}, {application-record-element=DET_SNR_051_Rx, system-signal=DET_SNR_051_Rx}, {application-record-element=DET_SNR_052_Rx, system-signal=DET_SNR_052_Rx}, {application-record-element=DET_SUPER_RES_TARGET_049_Rx, system-signal=DET_SUPER_RES_TARGET_049_Rx}, {application-record-element=DET_SUPER_RES_TARGET_050_Rx, system-signal=DET_SUPER_RES_TARGET_050_Rx}, {application-record-element=DET_SUPER_RES_TARGET_051_Rx, system-signal=DET_SUPER_RES_TARGET_051_Rx}, {application-record-element=DET_SUPER_RES_TARGET_052_Rx, system-signal=DET_SUPER_RES_TARGET_052_Rx}]}
        sender-receiver-to-signal-group-mapping={data-element=Rp_SG_Fusion_Detections_053_056_AL.Vdp_SG_Fusion_Detections_053_056_AL, signal-group=SG_Fusion_Detections_053_056, type-mapping=sender-rec-record-type-mapping=record-element-mappings=[{application-record-element=DET_AZIMUTH_053_Rx, system-signal=DET_AZIMUTH_053_Rx}, {application-record-element=DET_AZIMUTH_054_Rx, system-signal=DET_AZIMUTH_054_Rx}, {application-record-element=DET_AZIMUTH_055_Rx, system-signal=DET_AZIMUTH_055_Rx}, {application-record-element=DET_AZIMUTH_056_Rx, system-signal=DET_AZIMUTH_056_Rx}, {application-record-element=DET_AZIMUTH_ERR_053_Rx, system-signal=DET_AZIMUTH_ERR_053_Rx}, {application-record-element=DET_AZIMUTH_ERR_054_Rx, system-signal=DET_AZIMUTH_ERR_054_Rx}, {application-record-element=DET_AZIMUTH_ERR_055_Rx, system-signal=DET_AZIMUTH_ERR_055_Rx}, {application-record-element=DET_AZIMUTH_ERR_056_Rx, system-signal=DET_AZIMUTH_ERR_056_Rx}, {application-record-element=DET_BELOW_RAIN_THOLD_053_Rx, system-signal=DET_BELOW_RAIN_THOLD_053_Rx}, {application-record-element=DET_BELOW_RAIN_THOLD_054_Rx, system-signal=DET_BELOW_RAIN_THOLD_054_Rx}, {application-record-element=DET_BELOW_RAIN_THOLD_055_Rx, system-signal=DET_BELOW_RAIN_THOLD_055_Rx}, {application-record-element=DET_BELOW_RAIN_THOLD_056_Rx, system-signal=DET_BELOW_RAIN_THOLD_056_Rx}, {application-record-element=DET_BI_STATIC_FLAG_053_Rx, system-signal=DET_BI_STATIC_FLAG_053_Rx}, {application-record-element=DET_BI_STATIC_FLAG_054_Rx, system-signal=DET_BI_STATIC_FLAG_054_Rx}, {application-record-element=DET_BI_STATIC_FLAG_055_Rx, system-signal=DET_BI_STATIC_FLAG_055_Rx}, {application-record-element=DET_BI_STATIC_FLAG_056_Rx, system-signal=DET_BI_STATIC_FLAG_056_Rx}, {application-record-element=DET_CONFD_AZIMUTH_053_Rx, system-signal=DET_CONFD_AZIMUTH_053_Rx}, {application-record-element=DET_CONFD_AZIMUTH_054_Rx, system-signal=DET_CONFD_AZIMUTH_054_Rx}, {application-record-element=DET_CONFD_AZIMUTH_055_Rx, system-signal=DET_CONFD_AZIMUTH_055_Rx}, {application-record-element=DET_CONFD_AZIMUTH_056_Rx, system-signal=DET_CONFD_AZIMUTH_056_Rx}, {application-record-element=DET_CONFD_ELEVATION_053_Rx, system-signal=DET_CONFD_ELEVATION_053_Rx}, {application-record-element=DET_CONFD_ELEVATION_054_Rx, system-signal=DET_CONFD_ELEVATION_054_Rx}, {application-record-element=DET_CONFD_ELEVATION_055_Rx, system-signal=DET_CONFD_ELEVATION_055_Rx}, {application-record-element=DET_CONFD_ELEVATION_056_Rx, system-signal=DET_CONFD_ELEVATION_056_Rx}, {application-record-element=DET_ELEVATION_053_Rx, system-signal=DET_ELEVATION_053_Rx}, {application-record-element=DET_ELEVATION_054_Rx, system-signal=DET_ELEVATION_054_Rx}, {application-record-element=DET_ELEVATION_055_Rx, system-signal=DET_ELEVATION_055_Rx}, {application-record-element=DET_ELEVATION_056_Rx, system-signal=DET_ELEVATION_056_Rx}, {application-record-element=DET_ELEVATION_ERR_053_Rx, system-signal=DET_ELEVATION_ERR_053_Rx}, {application-record-element=DET_ELEVATION_ERR_054_Rx, system-signal=DET_ELEVATION_ERR_054_Rx}, {application-record-element=DET_ELEVATION_ERR_055_Rx, system-signal=DET_ELEVATION_ERR_055_Rx}, {application-record-element=DET_ELEVATION_ERR_056_Rx, system-signal=DET_ELEVATION_ERR_056_Rx}, {application-record-element=DET_EXISTENCE_PROB_053_Rx, system-signal=DET_EXISTENCE_PROB_053_Rx}, {application-record-element=DET_EXISTENCE_PROB_054_Rx, system-signal=DET_EXISTENCE_PROB_054_Rx}, {application-record-element=DET_EXISTENCE_PROB_055_Rx, system-signal=DET_EXISTENCE_PROB_055_Rx}, {application-record-element=DET_EXISTENCE_PROB_056_Rx, system-signal=DET_EXISTENCE_PROB_056_Rx}, {application-record-element=DET_HVC_FLAG_053_Rx, system-signal=DET_HVC_FLAG_053_Rx}, {application-record-element=DET_HVC_FLAG_054_Rx, system-signal=DET_HVC_FLAG_054_Rx}, {application-record-element=DET_HVC_FLAG_055_Rx, system-signal=DET_HVC_FLAG_055_Rx}, {application-record-element=DET_HVC_FLAG_056_Rx, system-signal=DET_HVC_FLAG_056_Rx}, {application-record-element=DET_IDM_053_Rx, system-signal=DET_IDM_053_Rx}, {application-record-element=DET_IDM_054_Rx, system-signal=DET_IDM_054_Rx}, {application-record-element=DET_IDM_055_Rx, system-signal=DET_IDM_055_Rx}, {application-record-element=DET_IDM_056_Rx, system-signal=DET_IDM_056_Rx}, {application-record-element=DET_MH_CRC16_053_056_Rx, system-signal=DET_MH_CRC16_053_056_Rx}, {application-record-element=DET_MH_CYCLE_COUNTER_053_056_Rx, system-signal=DET_MH_CYCLE_COUNTER_053_056_Rx}, {application-record-element=DET_MH_SCAN_INDEX_4LSB_053_056_Rx, system-signal=DET_MH_SCAN_INDEX_4LSB_053_056_Rx}, {application-record-element=DET_MTD_053_Rx, system-signal=DET_MTD_053_Rx}, {application-record-element=DET_MTD_054_Rx, system-signal=DET_MTD_054_Rx}, {application-record-element=DET_MTD_055_Rx, system-signal=DET_MTD_055_Rx}, {application-record-element=DET_MTD_056_Rx, system-signal=DET_MTD_056_Rx}, {application-record-element=DET_PROB_1STAZHYPO_053_Rx, system-signal=DET_PROB_1STAZHYPO_053_Rx}, {application-record-element=DET_PROB_1STAZHYPO_054_Rx, system-signal=DET_PROB_1STAZHYPO_054_Rx}, {application-record-element=DET_PROB_1STAZHYPO_055_Rx, system-signal=DET_PROB_1STAZHYPO_055_Rx}, {application-record-element=DET_PROB_1STAZHYPO_056_Rx, system-signal=DET_PROB_1STAZHYPO_056_Rx}, {application-record-element=DET_RANGE_053_Rx, system-signal=DET_RANGE_053_Rx}, {application-record-element=DET_RANGE_054_Rx, system-signal=DET_RANGE_054_Rx}, {application-record-element=DET_RANGE_055_Rx, system-signal=DET_RANGE_055_Rx}, {application-record-element=DET_RANGE_056_Rx, system-signal=DET_RANGE_056_Rx}, {application-record-element=DET_RANGE_ERR_053_Rx, system-signal=DET_RANGE_ERR_053_Rx}, {application-record-element=DET_RANGE_ERR_054_Rx, system-signal=DET_RANGE_ERR_054_Rx}, {application-record-element=DET_RANGE_ERR_055_Rx, system-signal=DET_RANGE_ERR_055_Rx}, {application-record-element=DET_RANGE_ERR_056_Rx, system-signal=DET_RANGE_ERR_056_Rx}, {application-record-element=DET_RANGE_VELOCITY_053_Rx, system-signal=DET_RANGE_VELOCITY_053_Rx}, {application-record-element=DET_RANGE_VELOCITY_054_Rx, system-signal=DET_RANGE_VELOCITY_054_Rx}, {application-record-element=DET_RANGE_VELOCITY_055_Rx, system-signal=DET_RANGE_VELOCITY_055_Rx}, {application-record-element=DET_RANGE_VELOCITY_056_Rx, system-signal=DET_RANGE_VELOCITY_056_Rx}, {application-record-element=DET_RANGE_VELOCITY_ERR_053_Rx, system-signal=DET_RANGE_VELOCITY_ERR_053_Rx}, {application-record-element=DET_RANGE_VELOCITY_ERR_054_Rx, system-signal=DET_RANGE_VELOCITY_ERR_054_Rx}, {application-record-element=DET_RANGE_VELOCITY_ERR_055_Rx, system-signal=DET_RANGE_VELOCITY_ERR_055_Rx}, {application-record-element=DET_RANGE_VELOCITY_ERR_056_Rx, system-signal=DET_RANGE_VELOCITY_ERR_056_Rx}, {application-record-element=DET_RCS_053_Rx, system-signal=DET_RCS_053_Rx}, {application-record-element=DET_RCS_054_Rx, system-signal=DET_RCS_054_Rx}, {application-record-element=DET_RCS_055_Rx, system-signal=DET_RCS_055_Rx}, {application-record-element=DET_RCS_056_Rx, system-signal=DET_RCS_056_Rx}, {application-record-element=DET_SNR_053_Rx, system-signal=DET_SNR_053_Rx}, {application-record-element=DET_SNR_054_Rx, system-signal=DET_SNR_054_Rx}, {application-record-element=DET_SNR_055_Rx, system-signal=DET_SNR_055_Rx}, {application-record-element=DET_SNR_056_Rx, system-signal=DET_SNR_056_Rx}, {application-record-element=DET_SUPER_RES_TARGET_053_Rx, system-signal=DET_SUPER_RES_TARGET_053_Rx}, {application-record-element=DET_SUPER_RES_TARGET_054_Rx, system-signal=DET_SUPER_RES_TARGET_054_Rx}, {application-record-element=DET_SUPER_RES_TARGET_055_Rx, system-signal=DET_SUPER_RES_TARGET_055_Rx}, {application-record-element=DET_SUPER_RES_TARGET_056_Rx, system-signal=DET_SUPER_RES_TARGET_056_Rx}]}
        sender-receiver-to-signal-group-mapping={data-element=Rp_SG_Fusion_Detections_057_060_AL.Vdp_SG_Fusion_Detections_057_060_AL, signal-group=SG_Fusion_Detections_057_060, type-mapping=sender-rec-record-type-mapping=record-element-mappings=[{application-record-element=DET_AZIMUTH_057_Rx, system-signal=DET_AZIMUTH_057_Rx}, {application-record-element=DET_AZIMUTH_058_Rx, system-signal=DET_AZIMUTH_058_Rx}, {application-record-element=DET_AZIMUTH_059_Rx, system-signal=DET_AZIMUTH_059_Rx}, {application-record-element=DET_AZIMUTH_060_Rx, system-signal=DET_AZIMUTH_060_Rx}, {application-record-element=DET_AZIMUTH_ERR_057_Rx, system-signal=DET_AZIMUTH_ERR_057_Rx}, {application-record-element=DET_AZIMUTH_ERR_058_Rx, system-signal=DET_AZIMUTH_ERR_058_Rx}, {application-record-element=DET_AZIMUTH_ERR_059_Rx, system-signal=DET_AZIMUTH_ERR_059_Rx}, {application-record-element=DET_AZIMUTH_ERR_060_Rx, system-signal=DET_AZIMUTH_ERR_060_Rx}, {application-record-element=DET_BELOW_RAIN_THOLD_057_Rx, system-signal=DET_BELOW_RAIN_THOLD_057_Rx}, {application-record-element=DET_BELOW_RAIN_THOLD_058_Rx, system-signal=DET_BELOW_RAIN_THOLD_058_Rx}, {application-record-element=DET_BELOW_RAIN_THOLD_059_Rx, system-signal=DET_BELOW_RAIN_THOLD_059_Rx}, {application-record-element=DET_BELOW_RAIN_THOLD_060_Rx, system-signal=DET_BELOW_RAIN_THOLD_060_Rx}, {application-record-element=DET_BI_STATIC_FLAG_057_Rx, system-signal=DET_BI_STATIC_FLAG_057_Rx}, {application-record-element=DET_BI_STATIC_FLAG_058_Rx, system-signal=DET_BI_STATIC_FLAG_058_Rx}, {application-record-element=DET_BI_STATIC_FLAG_059_Rx, system-signal=DET_BI_STATIC_FLAG_059_Rx}, {application-record-element=DET_BI_STATIC_FLAG_060_Rx, system-signal=DET_BI_STATIC_FLAG_060_Rx}, {application-record-element=DET_CONFD_AZIMUTH_057_Rx, system-signal=DET_CONFD_AZIMUTH_057_Rx}, {application-record-element=DET_CONFD_AZIMUTH_058_Rx, system-signal=DET_CONFD_AZIMUTH_058_Rx}, {application-record-element=DET_CONFD_AZIMUTH_059_Rx, system-signal=DET_CONFD_AZIMUTH_059_Rx}, {application-record-element=DET_CONFD_AZIMUTH_060_Rx, system-signal=DET_CONFD_AZIMUTH_060_Rx}, {application-record-element=DET_CONFD_ELEVATION_057_Rx, system-signal=DET_CONFD_ELEVATION_057_Rx}, {application-record-element=DET_CONFD_ELEVATION_058_Rx, system-signal=DET_CONFD_ELEVATION_058_Rx}, {application-record-element=DET_CONFD_ELEVATION_059_Rx, system-signal=DET_CONFD_ELEVATION_059_Rx}, {application-record-element=DET_CONFD_ELEVATION_060_Rx, system-signal=DET_CONFD_ELEVATION_060_Rx}, {application-record-element=DET_ELEVATION_057_Rx, system-signal=DET_ELEVATION_057_Rx}, {application-record-element=DET_ELEVATION_058_Rx, system-signal=DET_ELEVATION_058_Rx}, {application-record-element=DET_ELEVATION_059_Rx, system-signal=DET_ELEVATION_059_Rx}, {application-record-element=DET_ELEVATION_060_Rx, system-signal=DET_ELEVATION_060_Rx}, {application-record-element=DET_ELEVATION_ERR_057_Rx, system-signal=DET_ELEVATION_ERR_057_Rx}, {application-record-element=DET_ELEVATION_ERR_058_Rx, system-signal=DET_ELEVATION_ERR_058_Rx}, {application-record-element=DET_ELEVATION_ERR_059_Rx, system-signal=DET_ELEVATION_ERR_059_Rx}, {application-record-element=DET_ELEVATION_ERR_060_Rx, system-signal=DET_ELEVATION_ERR_060_Rx}, {application-record-element=DET_EXISTENCE_PROB_057_Rx, system-signal=DET_EXISTENCE_PROB_057_Rx}, {application-record-element=DET_EXISTENCE_PROB_058_Rx, system-signal=DET_EXISTENCE_PROB_058_Rx}, {application-record-element=DET_EXISTENCE_PROB_059_Rx, system-signal=DET_EXISTENCE_PROB_059_Rx}, {application-record-element=DET_EXISTENCE_PROB_060_Rx, system-signal=DET_EXISTENCE_PROB_060_Rx}, {application-record-element=DET_HVC_FLAG_057_Rx, system-signal=DET_HVC_FLAG_057_Rx}, {application-record-element=DET_HVC_FLAG_058_Rx, system-signal=DET_HVC_FLAG_058_Rx}, {application-record-element=DET_HVC_FLAG_059_Rx, system-signal=DET_HVC_FLAG_059_Rx}, {application-record-element=DET_HVC_FLAG_060_Rx, system-signal=DET_HVC_FLAG_060_Rx}, {application-record-element=DET_IDM_057_Rx, system-signal=DET_IDM_057_Rx}, {application-record-element=DET_IDM_058_Rx, system-signal=DET_IDM_058_Rx}, {application-record-element=DET_IDM_059_Rx, system-signal=DET_IDM_059_Rx}, {application-record-element=DET_IDM_060_Rx, system-signal=DET_IDM_060_Rx}, {application-record-element=DET_MH_CRC16_057_060_Rx, system-signal=DET_MH_CRC16_057_060_Rx}, {application-record-element=DET_MH_CYCLE_COUNTER_057_060_Rx, system-signal=DET_MH_CYCLE_COUNTER_057_060_Rx}, {application-record-element=DET_MH_SCAN_INDEX_4LSB_057_060_Rx, system-signal=DET_MH_SCAN_INDEX_4LSB_057_060_Rx}, {application-record-element=DET_MTD_057_Rx, system-signal=DET_MTD_057_Rx}, {application-record-element=DET_MTD_058_Rx, system-signal=DET_MTD_058_Rx}, {application-record-element=DET_MTD_059_Rx, system-signal=DET_MTD_059_Rx}, {application-record-element=DET_MTD_060_Rx, system-signal=DET_MTD_060_Rx}, {application-record-element=DET_PROB_1STAZHYPO_057_Rx, system-signal=DET_PROB_1STAZHYPO_057_Rx}, {application-record-element=DET_PROB_1STAZHYPO_058_Rx, system-signal=DET_PROB_1STAZHYPO_058_Rx}, {application-record-element=DET_PROB_1STAZHYPO_059_Rx, system-signal=DET_PROB_1STAZHYPO_059_Rx}, {application-record-element=DET_PROB_1STAZHYPO_060_Rx, system-signal=DET_PROB_1STAZHYPO_060_Rx}, {application-record-element=DET_RANGE_057_Rx, system-signal=DET_RANGE_057_Rx}, {application-record-element=DET_RANGE_058_Rx, system-signal=DET_RANGE_058_Rx}, {application-record-element=DET_RANGE_059_Rx, system-signal=DET_RANGE_059_Rx}, {application-record-element=DET_RANGE_060_Rx, system-signal=DET_RANGE_060_Rx}, {application-record-element=DET_RANGE_ERR_057_Rx, system-signal=DET_RANGE_ERR_057_Rx}, {application-record-element=DET_RANGE_ERR_058_Rx, system-signal=DET_RANGE_ERR_058_Rx}, {application-record-element=DET_RANGE_ERR_059_Rx, system-signal=DET_RANGE_ERR_059_Rx}, {application-record-element=DET_RANGE_ERR_060_Rx, system-signal=DET_RANGE_ERR_060_Rx}, {application-record-element=DET_RANGE_VELOCITY_057_Rx, system-signal=DET_RANGE_VELOCITY_057_Rx}, {application-record-element=DET_RANGE_VELOCITY_058_Rx, system-signal=DET_RANGE_VELOCITY_058_Rx}, {application-record-element=DET_RANGE_VELOCITY_059_Rx, system-signal=DET_RANGE_VELOCITY_059_Rx}, {application-record-element=DET_RANGE_VELOCITY_060_Rx, system-signal=DET_RANGE_VELOCITY_060_Rx}, {application-record-element=DET_RANGE_VELOCITY_ERR_057_Rx, system-signal=DET_RANGE_VELOCITY_ERR_057_Rx}, {application-record-element=DET_RANGE_VELOCITY_ERR_058_Rx, system-signal=DET_RANGE_VELOCITY_ERR_058_Rx}, {application-record-element=DET_RANGE_VELOCITY_ERR_059_Rx, system-signal=DET_RANGE_VELOCITY_ERR_059_Rx}, {application-record-element=DET_RANGE_VELOCITY_ERR_060_Rx, system-signal=DET_RANGE_VELOCITY_ERR_060_Rx}, {application-record-element=DET_RCS_057_Rx, system-signal=DET_RCS_057_Rx}, {application-record-element=DET_RCS_058_Rx, system-signal=DET_RCS_058_Rx}, {application-record-element=DET_RCS_059_Rx, system-signal=DET_RCS_059_Rx}, {application-record-element=DET_RCS_060_Rx, system-signal=DET_RCS_060_Rx}, {application-record-element=DET_SNR_057_Rx, system-signal=DET_SNR_057_Rx}, {application-record-element=DET_SNR_058_Rx, system-signal=DET_SNR_058_Rx}, {application-record-element=DET_SNR_059_Rx, system-signal=DET_SNR_059_Rx}, {application-record-element=DET_SNR_060_Rx, system-signal=DET_SNR_060_Rx}, {application-record-element=DET_SUPER_RES_TARGET_057_Rx, system-signal=DET_SUPER_RES_TARGET_057_Rx}, {application-record-element=DET_SUPER_RES_TARGET_058_Rx, system-signal=DET_SUPER_RES_TARGET_058_Rx}, {application-record-element=DET_SUPER_RES_TARGET_059_Rx, system-signal=DET_SUPER_RES_TARGET_059_Rx}, {application-record-element=DET_SUPER_RES_TARGET_060_Rx, system-signal=DET_SUPER_RES_TARGET_060_Rx}]}
        sender-receiver-to-signal-group-mapping={data-element=Rp_SG_Fusion_Detections_061_064_AL.Vdp_SG_Fusion_Detections_061_064_AL, signal-group=SG_Fusion_Detections_061_064, type-mapping=sender-rec-record-type-mapping=record-element-mappings=[{application-record-element=DET_AZIMUTH_061_Rx, system-signal=DET_AZIMUTH_061_Rx}, {application-record-element=DET_AZIMUTH_062_Rx, system-signal=DET_AZIMUTH_062_Rx}, {application-record-element=DET_AZIMUTH_063_Rx, system-signal=DET_AZIMUTH_063_Rx}, {application-record-element=DET_AZIMUTH_064_Rx, system-signal=DET_AZIMUTH_064_Rx}, {application-record-element=DET_AZIMUTH_ERR_061_Rx, system-signal=DET_AZIMUTH_ERR_061_Rx}, {application-record-element=DET_AZIMUTH_ERR_062_Rx, system-signal=DET_AZIMUTH_ERR_062_Rx}, {application-record-element=DET_AZIMUTH_ERR_063_Rx, system-signal=DET_AZIMUTH_ERR_063_Rx}, {application-record-element=DET_AZIMUTH_ERR_064_Rx, system-signal=DET_AZIMUTH_ERR_064_Rx}, {application-record-element=DET_BELOW_RAIN_THOLD_061_Rx, system-signal=DET_BELOW_RAIN_THOLD_061_Rx}, {application-record-element=DET_BELOW_RAIN_THOLD_062_Rx, system-signal=DET_BELOW_RAIN_THOLD_062_Rx}, {application-record-element=DET_BELOW_RAIN_THOLD_063_Rx, system-signal=DET_BELOW_RAIN_THOLD_063_Rx}, {application-record-element=DET_BELOW_RAIN_THOLD_064_Rx, system-signal=DET_BELOW_RAIN_THOLD_064_Rx}, {application-record-element=DET_BI_STATIC_FLAG_061_Rx, system-signal=DET_BI_STATIC_FLAG_061_Rx}, {application-record-element=DET_BI_STATIC_FLAG_062_Rx, system-signal=DET_BI_STATIC_FLAG_062_Rx}, {application-record-element=DET_BI_STATIC_FLAG_063_Rx, system-signal=DET_BI_STATIC_FLAG_063_Rx}, {application-record-element=DET_BI_STATIC_FLAG_064_Rx, system-signal=DET_BI_STATIC_FLAG_064_Rx}, {application-record-element=DET_CONFD_AZIMUTH_061_Rx, system-signal=DET_CONFD_AZIMUTH_061_Rx}, {application-record-element=DET_CONFD_AZIMUTH_062_Rx, system-signal=DET_CONFD_AZIMUTH_062_Rx}, {application-record-element=DET_CONFD_AZIMUTH_063_Rx, system-signal=DET_CONFD_AZIMUTH_063_Rx}, {application-record-element=DET_CONFD_AZIMUTH_064_Rx, system-signal=DET_CONFD_AZIMUTH_064_Rx}, {application-record-element=DET_CONFD_ELEVATION_061_Rx, system-signal=DET_CONFD_ELEVATION_061_Rx}, {application-record-element=DET_CONFD_ELEVATION_062_Rx, system-signal=DET_CONFD_ELEVATION_062_Rx}, {application-record-element=DET_CONFD_ELEVATION_063_Rx, system-signal=DET_CONFD_ELEVATION_063_Rx}, {application-record-element=DET_CONFD_ELEVATION_064_Rx, system-signal=DET_CONFD_ELEVATION_064_Rx}, {application-record-element=DET_ELEVATION_061_Rx, system-signal=DET_ELEVATION_061_Rx}, {application-record-element=DET_ELEVATION_062_Rx, system-signal=DET_ELEVATION_062_Rx}, {application-record-element=DET_ELEVATION_063_Rx, system-signal=DET_ELEVATION_063_Rx}, {application-record-element=DET_ELEVATION_064_Rx, system-signal=DET_ELEVATION_064_Rx}, {application-record-element=DET_ELEVATION_ERR_061_Rx, system-signal=DET_ELEVATION_ERR_061_Rx}, {application-record-element=DET_ELEVATION_ERR_062_Rx, system-signal=DET_ELEVATION_ERR_062_Rx}, {application-record-element=DET_ELEVATION_ERR_063_Rx, system-signal=DET_ELEVATION_ERR_063_Rx}, {application-record-element=DET_ELEVATION_ERR_064_Rx, system-signal=DET_ELEVATION_ERR_064_Rx}, {application-record-element=DET_EXISTENCE_PROB_061_Rx, system-signal=DET_EXISTENCE_PROB_061_Rx}, {application-record-element=DET_EXISTENCE_PROB_062_Rx, system-signal=DET_EXISTENCE_PROB_062_Rx}, {application-record-element=DET_EXISTENCE_PROB_063_Rx, system-signal=DET_EXISTENCE_PROB_063_Rx}, {application-record-element=DET_EXISTENCE_PROB_064_Rx, system-signal=DET_EXISTENCE_PROB_064_Rx}, {application-record-element=DET_HVC_FLAG_061_Rx, system-signal=DET_HVC_FLAG_061_Rx}, {application-record-element=DET_HVC_FLAG_062_Rx, system-signal=DET_HVC_FLAG_062_Rx}, {application-record-element=DET_HVC_FLAG_063_Rx, system-signal=DET_HVC_FLAG_063_Rx}, {application-record-element=DET_HVC_FLAG_064_Rx, system-signal=DET_HVC_FLAG_064_Rx}, {application-record-element=DET_IDM_061_Rx, system-signal=DET_IDM_061_Rx}, {application-record-element=DET_IDM_062_Rx, system-signal=DET_IDM_062_Rx}, {application-record-element=DET_IDM_063_Rx, system-signal=DET_IDM_063_Rx}, {application-record-element=DET_IDM_064_Rx, system-signal=DET_IDM_064_Rx}, {application-record-element=DET_MH_CRC16_061_064_Rx, system-signal=DET_MH_CRC16_061_064_Rx}, {application-record-element=DET_MH_CYCLE_COUNTER_061_064_Rx, system-signal=DET_MH_CYCLE_COUNTER_061_064_Rx}, {application-record-element=DET_MH_SCAN_INDEX_4LSB_061_064_Rx, system-signal=DET_MH_SCAN_INDEX_4LSB_061_064_Rx}, {application-record-element=DET_MTD_061_Rx, system-signal=DET_MTD_061_Rx}, {application-record-element=DET_MTD_062_Rx, system-signal=DET_MTD_062_Rx}, {application-record-element=DET_MTD_063_Rx, system-signal=DET_MTD_063_Rx}, {application-record-element=DET_MTD_064_Rx, system-signal=DET_MTD_064_Rx}, {application-record-element=DET_PROB_1STAZHYPO_061_Rx, system-signal=DET_PROB_1STAZHYPO_061_Rx}, {application-record-element=DET_PROB_1STAZHYPO_062_Rx, system-signal=DET_PROB_1STAZHYPO_062_Rx}, {application-record-element=DET_PROB_1STAZHYPO_063_Rx, system-signal=DET_PROB_1STAZHYPO_063_Rx}, {application-record-element=DET_PROB_1STAZHYPO_064_Rx, system-signal=DET_PROB_1STAZHYPO_064_Rx}, {application-record-element=DET_RANGE_061_Rx, system-signal=DET_RANGE_061_Rx}, {application-record-element=DET_RANGE_062_Rx, system-signal=DET_RANGE_062_Rx}, {application-record-element=DET_RANGE_063_Rx, system-signal=DET_RANGE_063_Rx}, {application-record-element=DET_RANGE_064_Rx, system-signal=DET_RANGE_064_Rx}, {application-record-element=DET_RANGE_ERR_061_Rx, system-signal=DET_RANGE_ERR_061_Rx}, {application-record-element=DET_RANGE_ERR_062_Rx, system-signal=DET_RANGE_ERR_062_Rx}, {application-record-element=DET_RANGE_ERR_063_Rx, system-signal=DET_RANGE_ERR_063_Rx}, {application-record-element=DET_RANGE_ERR_064_Rx, system-signal=DET_RANGE_ERR_064_Rx}, {application-record-element=DET_RANGE_VELOCITY_061_Rx, system-signal=DET_RANGE_VELOCITY_061_Rx}, {application-record-element=DET_RANGE_VELOCITY_062_Rx, system-signal=DET_RANGE_VELOCITY_062_Rx}, {application-record-element=DET_RANGE_VELOCITY_063_Rx, system-signal=DET_RANGE_VELOCITY_063_Rx}, {application-record-element=DET_RANGE_VELOCITY_064_Rx, system-signal=DET_RANGE_VELOCITY_064_Rx}, {application-record-element=DET_RANGE_VELOCITY_ERR_061_Rx, system-signal=DET_RANGE_VELOCITY_ERR_061_Rx}, {application-record-element=DET_RANGE_VELOCITY_ERR_062_Rx, system-signal=DET_RANGE_VELOCITY_ERR_062_Rx}, {application-record-element=DET_RANGE_VELOCITY_ERR_063_Rx, system-signal=DET_RANGE_VELOCITY_ERR_063_Rx}, {application-record-element=DET_RANGE_VELOCITY_ERR_064_Rx, system-signal=DET_RANGE_VELOCITY_ERR_064_Rx}, {application-record-element=DET_RCS_061_Rx, system-signal=DET_RCS_061_Rx}, {application-record-element=DET_RCS_062_Rx, system-signal=DET_RCS_062_Rx}, {application-record-element=DET_RCS_063_Rx, system-signal=DET_RCS_063_Rx}, {application-record-element=DET_RCS_064_Rx, system-signal=DET_RCS_064_Rx}, {application-record-element=DET_SNR_061_Rx, system-signal=DET_SNR_061_Rx}, {application-record-element=DET_SNR_062_Rx, system-signal=DET_SNR_062_Rx}, {application-record-element=DET_SNR_063_Rx, system-signal=DET_SNR_063_Rx}, {application-record-element=DET_SNR_064_Rx, system-signal=DET_SNR_064_Rx}, {application-record-element=DET_SUPER_RES_TARGET_061_Rx, system-signal=DET_SUPER_RES_TARGET_061_Rx}, {application-record-element=DET_SUPER_RES_TARGET_062_Rx, system-signal=DET_SUPER_RES_TARGET_062_Rx}, {application-record-element=DET_SUPER_RES_TARGET_063_Rx, system-signal=DET_SUPER_RES_TARGET_063_Rx}, {application-record-element=DET_SUPER_RES_TARGET_064_Rx, system-signal=DET_SUPER_RES_TARGET_064_Rx}]}
        sender-receiver-to-signal-group-mapping={data-element=Rp_SG_Fusion_Detections_065_068_AL.Vdp_SG_Fusion_Detections_065_068_AL, signal-group=SG_Fusion_Detections_065_068, type-mapping=sender-rec-record-type-mapping=record-element-mappings=[{application-record-element=DET_AZIMUTH_065_Rx, system-signal=DET_AZIMUTH_065_Rx}, {application-record-element=DET_AZIMUTH_066_Rx, system-signal=DET_AZIMUTH_066_Rx}, {application-record-element=DET_AZIMUTH_067_Rx, system-signal=DET_AZIMUTH_067_Rx}, {application-record-element=DET_AZIMUTH_068_Rx, system-signal=DET_AZIMUTH_068_Rx}, {application-record-element=DET_AZIMUTH_ERR_065_Rx, system-signal=DET_AZIMUTH_ERR_065_Rx}, {application-record-element=DET_AZIMUTH_ERR_066_Rx, system-signal=DET_AZIMUTH_ERR_066_Rx}, {application-record-element=DET_AZIMUTH_ERR_067_Rx, system-signal=DET_AZIMUTH_ERR_067_Rx}, {application-record-element=DET_AZIMUTH_ERR_068_Rx, system-signal=DET_AZIMUTH_ERR_068_Rx}, {application-record-element=DET_BELOW_RAIN_THOLD_065_Rx, system-signal=DET_BELOW_RAIN_THOLD_065_Rx}, {application-record-element=DET_BELOW_RAIN_THOLD_066_Rx, system-signal=DET_BELOW_RAIN_THOLD_066_Rx}, {application-record-element=DET_BELOW_RAIN_THOLD_067_Rx, system-signal=DET_BELOW_RAIN_THOLD_067_Rx}, {application-record-element=DET_BELOW_RAIN_THOLD_068_Rx, system-signal=DET_BELOW_RAIN_THOLD_068_Rx}, {application-record-element=DET_BI_STATIC_FLAG_065_Rx, system-signal=DET_BI_STATIC_FLAG_065_Rx}, {application-record-element=DET_BI_STATIC_FLAG_066_Rx, system-signal=DET_BI_STATIC_FLAG_066_Rx}, {application-record-element=DET_BI_STATIC_FLAG_067_Rx, system-signal=DET_BI_STATIC_FLAG_067_Rx}, {application-record-element=DET_BI_STATIC_FLAG_068_Rx, system-signal=DET_BI_STATIC_FLAG_068_Rx}, {application-record-element=DET_CONFD_AZIMUTH_065_Rx, system-signal=DET_CONFD_AZIMUTH_065_Rx}, {application-record-element=DET_CONFD_AZIMUTH_066_Rx, system-signal=DET_CONFD_AZIMUTH_066_Rx}, {application-record-element=DET_CONFD_AZIMUTH_067_Rx, system-signal=DET_CONFD_AZIMUTH_067_Rx}, {application-record-element=DET_CONFD_AZIMUTH_068_Rx, system-signal=DET_CONFD_AZIMUTH_068_Rx}, {application-record-element=DET_CONFD_ELEVATION_065_Rx, system-signal=DET_CONFD_ELEVATION_065_Rx}, {application-record-element=DET_CONFD_ELEVATION_066_Rx, system-signal=DET_CONFD_ELEVATION_066_Rx}, {application-record-element=DET_CONFD_ELEVATION_067_Rx, system-signal=DET_CONFD_ELEVATION_067_Rx}, {application-record-element=DET_CONFD_ELEVATION_068_Rx, system-signal=DET_CONFD_ELEVATION_068_Rx}, {application-record-element=DET_ELEVATION_065_Rx, system-signal=DET_ELEVATION_065_Rx}, {application-record-element=DET_ELEVATION_066_Rx, system-signal=DET_ELEVATION_066_Rx}, {application-record-element=DET_ELEVATION_067_Rx, system-signal=DET_ELEVATION_067_Rx}, {application-record-element=DET_ELEVATION_068_Rx, system-signal=DET_ELEVATION_068_Rx}, {application-record-element=DET_ELEVATION_ERR_065_Rx, system-signal=DET_ELEVATION_ERR_065_Rx}, {application-record-element=DET_ELEVATION_ERR_066_Rx, system-signal=DET_ELEVATION_ERR_066_Rx}, {application-record-element=DET_ELEVATION_ERR_067_Rx, system-signal=DET_ELEVATION_ERR_067_Rx}, {application-record-element=DET_ELEVATION_ERR_068_Rx, system-signal=DET_ELEVATION_ERR_068_Rx}, {application-record-element=DET_EXISTENCE_PROB_065_Rx, system-signal=DET_EXISTENCE_PROB_065_Rx}, {application-record-element=DET_EXISTENCE_PROB_066_Rx, system-signal=DET_EXISTENCE_PROB_066_Rx}, {application-record-element=DET_EXISTENCE_PROB_067_Rx, system-signal=DET_EXISTENCE_PROB_067_Rx}, {application-record-element=DET_EXISTENCE_PROB_068_Rx, system-signal=DET_EXISTENCE_PROB_068_Rx}, {application-record-element=DET_HVC_FLAG_065_Rx, system-signal=DET_HVC_FLAG_065_Rx}, {application-record-element=DET_HVC_FLAG_066_Rx, system-signal=DET_HVC_FLAG_066_Rx}, {application-record-element=DET_HVC_FLAG_067_Rx, system-signal=DET_HVC_FLAG_067_Rx}, {application-record-element=DET_HVC_FLAG_068_Rx, system-signal=DET_HVC_FLAG_068_Rx}, {application-record-element=DET_IDM_065_Rx, system-signal=DET_IDM_065_Rx}, {application-record-element=DET_IDM_066_Rx, system-signal=DET_IDM_066_Rx}, {application-record-element=DET_IDM_067_Rx, system-signal=DET_IDM_067_Rx}, {application-record-element=DET_IDM_068_Rx, system-signal=DET_IDM_068_Rx}, {application-record-element=DET_MH_CRC16_065_068_Rx, system-signal=DET_MH_CRC16_065_068_Rx}, {application-record-element=DET_MH_CYCLE_COUNTER_065_068_Rx, system-signal=DET_MH_CYCLE_COUNTER_065_068_Rx}, {application-record-element=DET_MH_SCAN_INDEX_4LSB_065_068_Rx, system-signal=DET_MH_SCAN_INDEX_4LSB_065_068_Rx}, {application-record-element=DET_MTD_065_Rx, system-signal=DET_MTD_065_Rx}, {application-record-element=DET_MTD_066_Rx, system-signal=DET_MTD_066_Rx}, {application-record-element=DET_MTD_067_Rx, system-signal=DET_MTD_067_Rx}, {application-record-element=DET_MTD_068_Rx, system-signal=DET_MTD_068_Rx}, {application-record-element=DET_PROB_1STAZHYPO_065_Rx, system-signal=DET_PROB_1STAZHYPO_065_Rx}, {application-record-element=DET_PROB_1STAZHYPO_066_Rx, system-signal=DET_PROB_1STAZHYPO_066_Rx}, {application-record-element=DET_PROB_1STAZHYPO_067_Rx, system-signal=DET_PROB_1STAZHYPO_067_Rx}, {application-record-element=DET_PROB_1STAZHYPO_068_Rx, system-signal=DET_PROB_1STAZHYPO_068_Rx}, {application-record-element=DET_RANGE_065_Rx, system-signal=DET_RANGE_065_Rx}, {application-record-element=DET_RANGE_066_Rx, system-signal=DET_RANGE_066_Rx}, {application-record-element=DET_RANGE_067_Rx, system-signal=DET_RANGE_067_Rx}, {application-record-element=DET_RANGE_068_Rx, system-signal=DET_RANGE_068_Rx}, {application-record-element=DET_RANGE_ERR_065_Rx, system-signal=DET_RANGE_ERR_065_Rx}, {application-record-element=DET_RANGE_ERR_066_Rx, system-signal=DET_RANGE_ERR_066_Rx}, {application-record-element=DET_RANGE_ERR_067_Rx, system-signal=DET_RANGE_ERR_067_Rx}, {application-record-element=DET_RANGE_ERR_068_Rx, system-signal=DET_RANGE_ERR_068_Rx}, {application-record-element=DET_RANGE_VELOCITY_065_Rx, system-signal=DET_RANGE_VELOCITY_065_Rx}, {application-record-element=DET_RANGE_VELOCITY_066_Rx, system-signal=DET_RANGE_VELOCITY_066_Rx}, {application-record-element=DET_RANGE_VELOCITY_067_Rx, system-signal=DET_RANGE_VELOCITY_067_Rx}, {application-record-element=DET_RANGE_VELOCITY_068_Rx, system-signal=DET_RANGE_VELOCITY_068_Rx}, {application-record-element=DET_RANGE_VELOCITY_ERR_065_Rx, system-signal=DET_RANGE_VELOCITY_ERR_065_Rx}, {application-record-element=DET_RANGE_VELOCITY_ERR_066_Rx, system-signal=DET_RANGE_VELOCITY_ERR_066_Rx}, {application-record-element=DET_RANGE_VELOCITY_ERR_067_Rx, system-signal=DET_RANGE_VELOCITY_ERR_067_Rx}, {application-record-element=DET_RANGE_VELOCITY_ERR_068_Rx, system-signal=DET_RANGE_VELOCITY_ERR_068_Rx}, {application-record-element=DET_RCS_065_Rx, system-signal=DET_RCS_065_Rx}, {application-record-element=DET_RCS_066_Rx, system-signal=DET_RCS_066_Rx}, {application-record-element=DET_RCS_067_Rx, system-signal=DET_RCS_067_Rx}, {application-record-element=DET_RCS_068_Rx, system-signal=DET_RCS_068_Rx}, {application-record-element=DET_SNR_065_Rx, system-signal=DET_SNR_065_Rx}, {application-record-element=DET_SNR_066_Rx, system-signal=DET_SNR_066_Rx}, {application-record-element=DET_SNR_067_Rx, system-signal=DET_SNR_067_Rx}, {application-record-element=DET_SNR_068_Rx, system-signal=DET_SNR_068_Rx}, {application-record-element=DET_SUPER_RES_TARGET_065_Rx, system-signal=DET_SUPER_RES_TARGET_065_Rx}, {application-record-element=DET_SUPER_RES_TARGET_066_Rx, system-signal=DET_SUPER_RES_TARGET_066_Rx}, {application-record-element=DET_SUPER_RES_TARGET_067_Rx, system-signal=DET_SUPER_RES_TARGET_067_Rx}, {application-record-element=DET_SUPER_RES_TARGET_068_Rx, system-signal=DET_SUPER_RES_TARGET_068_Rx}]}
