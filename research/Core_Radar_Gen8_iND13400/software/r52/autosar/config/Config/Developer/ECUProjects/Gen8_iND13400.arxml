[part 7 of 10: package /System]
AUTOSAR XML (schema 00053)
package /System  (continued)
  system System  (continued)
    system mapping System_MPPNG  (continued)
      data-mappings:  (continued)
        sender-receiver-to-signal-group-mapping={data-element=Rp_SG_Fusion_Detections_069_072_AL.Vdp_SG_Fusion_Detections_069_072_AL, signal-group=SG_Fusion_Detections_069_072, type-mapping=sender-rec-record-type-mapping=record-element-mappings=[{application-record-element=DET_AZIMUTH_069_Rx, system-signal=DET_AZIMUTH_069_Rx}, {application-record-element=DET_AZIMUTH_070_Rx, system-signal=DET_AZIMUTH_070_Rx}, {application-record-element=DET_AZIMUTH_071_Rx, system-signal=DET_AZIMUTH_071_Rx}, {application-record-element=DET_AZIMUTH_072_Rx, system-signal=DET_AZIMUTH_072_Rx}, {application-record-element=DET_AZIMUTH_ERR_069_Rx, system-signal=DET_AZIMUTH_ERR_069_Rx}, {application-record-element=DET_AZIMUTH_ERR_070_Rx, system-signal=DET_AZIMUTH_ERR_070_Rx}, {application-record-element=DET_AZIMUTH_ERR_071_Rx, system-signal=DET_AZIMUTH_ERR_071_Rx}, {application-record-element=DET_AZIMUTH_ERR_072_Rx, system-signal=DET_AZIMUTH_ERR_072_Rx}, {application-record-element=DET_BELOW_RAIN_THOLD_069_Rx, system-signal=DET_BELOW_RAIN_THOLD_069_Rx}, {application-record-element=DET_BELOW_RAIN_THOLD_070_Rx, system-signal=DET_BELOW_RAIN_THOLD_070_Rx}, {application-record-element=DET_BELOW_RAIN_THOLD_071_Rx, system-signal=DET_BELOW_RAIN_THOLD_071_Rx}, {application-record-element=DET_BELOW_RAIN_THOLD_072_Rx, system-signal=DET_BELOW_RAIN_THOLD_072_Rx}, {application-record-element=DET_BI_STATIC_FLAG_069_Rx, system-signal=DET_BI_STATIC_FLAG_069_Rx}, {application-record-element=DET_BI_STATIC_FLAG_070_Rx, system-signal=DET_BI_STATIC_FLAG_070_Rx}, {application-record-element=DET_BI_STATIC_FLAG_071_Rx, system-signal=DET_BI_STATIC_FLAG_071_Rx}, {application-record-element=DET_BI_STATIC_FLAG_072_Rx, system-signal=DET_BI_STATIC_FLAG_072_Rx}, {application-record-element=DET_CONFD_AZIMUTH_069_Rx, system-signal=DET_CONFD_AZIMUTH_069_Rx}, {application-record-element=DET_CONFD_AZIMUTH_070_Rx, system-signal=DET_CONFD_AZIMUTH_070_Rx}, {application-record-element=DET_CONFD_AZIMUTH_071_Rx, system-signal=DET_CONFD_AZIMUTH_071_Rx}, {application-record-element=DET_CONFD_AZIMUTH_072_Rx, system-signal=DET_CONFD_AZIMUTH_072_Rx}, {application-record-element=DET_CONFD_ELEVATION_069_Rx, system-signal=DET_CONFD_ELEVATION_069_Rx}, {application-record-element=DET_CONFD_ELEVATION_070_Rx, system-signal=DET_CONFD_ELEVATION_070_Rx}, {application-record-element=DET_CONFD_ELEVATION_071_Rx, system-signal=DET_CONFD_ELEVATION_071_Rx}, {application-record-element=DET_CONFD_ELEVATION_072_Rx, system-signal=DET_CONFD_ELEVATION_072_Rx}, {application-record-element=DET_ELEVATION_069_Rx, system-signal=DET_ELEVATION_069_Rx}, {application-record-element=DET_ELEVATION_070_Rx, system-signal=DET_ELEVATION_070_Rx}, {application-record-element=DET_ELEVATION_071_Rx, system-signal=DET_ELEVATION_071_Rx}, {application-record-element=DET_ELEVATION_072_Rx, system-signal=DET_ELEVATION_072_Rx}, {application-record-element=DET_ELEVATION_ERR_069_Rx, system-signal=DET_ELEVATION_ERR_069_Rx}, {application-record-element=DET_ELEVATION_ERR_070_Rx, system-signal=DET_ELEVATION_ERR_070_Rx}, {application-record-element=DET_ELEVATION_ERR_071_Rx, system-signal=DET_ELEVATION_ERR_071_Rx}, {application-record-element=DET_ELEVATION_ERR_072_Rx, system-signal=DET_ELEVATION_ERR_072_Rx}, {application-record-element=DET_EXISTENCE_PROB_069_Rx, system-signal=DET_EXISTENCE_PROB_069_Rx}, {application-record-element=DET_EXISTENCE_PROB_070_Rx, system-signal=DET_EXISTENCE_PROB_070_Rx}, {application-record-element=DET_EXISTENCE_PROB_071_Rx, system-signal=DET_EXISTENCE_PROB_071_Rx}, {application-record-element=DET_EXISTENCE_PROB_072_Rx, system-signal=DET_EXISTENCE_PROB_072_Rx}, {application-record-element=DET_HVC_FLAG_069_Rx, system-signal=DET_HVC_FLAG_069_Rx}, {application-record-element=DET_HVC_FLAG_070_Rx, system-signal=DET_HVC_FLAG_070_Rx}, {application-record-element=DET_HVC_FLAG_071_Rx, system-signal=DET_HVC_FLAG_071_Rx}, {application-record-element=DET_HVC_FLAG_072_Rx, system-signal=DET_HVC_FLAG_072_Rx}, {application-record-element=DET_IDM_069_Rx, system-signal=DET_IDM_069_Rx}, {application-record-element=DET_IDM_070_Rx, system-signal=DET_IDM_070_Rx}, {application-record-element=DET_IDM_071_Rx, system-signal=DET_IDM_071_Rx}, {application-record-element=DET_IDM_072_Rx, system-signal=DET_IDM_072_Rx}, {application-record-element=DET_MH_CRC16_069_072_Rx, system-signal=DET_MH_CRC16_069_072_Rx}, {application-record-element=DET_MH_CYCLE_COUNTER_069_072_Rx, system-signal=DET_MH_CYCLE_COUNTER_069_072_Rx}, {application-record-element=DET_MH_SCAN_INDEX_4LSB_069_072_Rx, system-signal=DET_MH_SCAN_INDEX_4LSB_069_072_Rx}, {application-record-element=DET_MTD_069_Rx, system-signal=DET_MTD_069_Rx}, {application-record-element=DET_MTD_070_Rx, system-signal=DET_MTD_070_Rx}, {application-record-element=DET_MTD_071_Rx, system-signal=DET_MTD_071_Rx}, {application-record-element=DET_MTD_072_Rx, system-signal=DET_MTD_072_Rx}, {application-record-element=DET_PROB_1STAZHYPO_069_Rx, system-signal=DET_PROB_1STAZHYPO_069_Rx}, {application-record-element=DET_PROB_1STAZHYPO_070_Rx, system-signal=DET_PROB_1STAZHYPO_070_Rx}, {application-record-element=DET_PROB_1STAZHYPO_071_Rx, system-signal=DET_PROB_1STAZHYPO_071_Rx}, {application-record-element=DET_PROB_1STAZHYPO_072_Rx, system-signal=DET_PROB_1STAZHYPO_072_Rx}, {application-record-element=DET_RANGE_069_Rx, system-signal=DET_RANGE_069_Rx}, {application-record-element=DET_RANGE_070_Rx, system-signal=DET_RANGE_070_Rx}, {application-record-element=DET_RANGE_071_Rx, system-signal=DET_RANGE_071_Rx}, {application-record-element=DET_RANGE_072_Rx, system-signal=DET_RANGE_072_Rx}, {application-record-element=DET_RANGE_ERR_069_Rx, system-signal=DET_RANGE_ERR_069_Rx}, {application-record-element=DET_RANGE_ERR_070_Rx, system-signal=DET_RANGE_ERR_070_Rx}, {application-record-element=DET_RANGE_ERR_071_Rx, system-signal=DET_RANGE_ERR_071_Rx}, {application-record-element=DET_RANGE_ERR_072_Rx, system-signal=DET_RANGE_ERR_072_Rx}, {application-record-element=DET_RANGE_VELOCITY_069_Rx, system-signal=DET_RANGE_VELOCITY_069_Rx}, {application-record-element=DET_RANGE_VELOCITY_070_Rx, system-signal=DET_RANGE_VELOCITY_070_Rx}, {application-record-element=DET_RANGE_VELOCITY_071_Rx, system-signal=DET_RANGE_VELOCITY_071_Rx}, {application-record-element=DET_RANGE_VELOCITY_072_Rx, system-signal=DET_RANGE_VELOCITY_072_Rx}, {application-record-element=DET_RANGE_VELOCITY_ERR_069_Rx, system-signal=DET_RANGE_VELOCITY_ERR_069_Rx}, {application-record-element=DET_RANGE_VELOCITY_ERR_070_Rx, system-signal=DET_RANGE_VELOCITY_ERR_070_Rx}, {application-record-element=DET_RANGE_VELOCITY_ERR_071_Rx, system-signal=DET_RANGE_VELOCITY_ERR_071_Rx}, {application-record-element=DET_RANGE_VELOCITY_ERR_072_Rx, system-signal=DET_RANGE_VELOCITY_ERR_072_Rx}, {application-record-element=DET_RCS_069_Rx, system-signal=DET_RCS_069_Rx}, {application-record-element=DET_RCS_070_Rx, system-signal=DET_RCS_070_Rx}, {application-record-element=DET_RCS_071_Rx, system-signal=DET_RCS_071_Rx}, {application-record-element=DET_RCS_072_Rx, system-signal=DET_RCS_072_Rx}, {application-record-element=DET_SNR_069_Rx, system-signal=DET_SNR_069_Rx}, {application-record-element=DET_SNR_070_Rx, system-signal=DET_SNR_070_Rx}, {application-record-element=DET_SNR_071_Rx, system-signal=DET_SNR_071_Rx}, {application-record-element=DET_SNR_072_Rx, system-signal=DET_SNR_072_Rx}, {application-record-element=DET_SUPER_RES_TARGET_069_Rx, system-signal=DET_SUPER_RES_TARGET_069_Rx}, {application-record-element=DET_SUPER_RES_TARGET_070_Rx, system-signal=DET_SUPER_RES_TARGET_070_Rx}, {application-record-element=DET_SUPER_RES_TARGET_071_Rx, system-signal=DET_SUPER_RES_TARGET_071_Rx}, {application-record-element=DET_SUPER_RES_TARGET_072_Rx, system-signal=DET_SUPER_RES_TARGET_072_Rx}]}
        sender-receiver-to-signal-group-mapping={data-element=Rp_SG_Fusion_Detections_073_076_AL.Vdp_SG_Fusion_Detections_073_076_AL, signal-group=SG_Fusion_Detections_073_076, type-mapping=sender-rec-record-type-mapping=record-element-mappings=[{application-record-element=DET_AZIMUTH_073_Rx, system-signal=DET_AZIMUTH_073_Rx}, {application-record-element=DET_AZIMUTH_074_Rx, system-signal=DET_AZIMUTH_074_Rx}, {application-record-element=DET_AZIMUTH_075_Rx, system-signal=DET_AZIMUTH_075_Rx}, {application-record-element=DET_AZIMUTH_076_Rx, system-signal=DET_AZIMUTH_076_Rx}, {application-record-element=DET_AZIMUTH_ERR_073_Rx, system-signal=DET_AZIMUTH_ERR_073_Rx}, {application-record-element=DET_AZIMUTH_ERR_074_Rx, system-signal=DET_AZIMUTH_ERR_074_Rx}, {application-record-element=DET_AZIMUTH_ERR_075_Rx, system-signal=DET_AZIMUTH_ERR_075_Rx}, {application-record-element=DET_AZIMUTH_ERR_076_Rx, system-signal=DET_AZIMUTH_ERR_076_Rx}, {application-record-element=DET_BELOW_RAIN_THOLD_073_Rx, system-signal=DET_BELOW_RAIN_THOLD_073_Rx}, {application-record-element=DET_BELOW_RAIN_THOLD_074_Rx, system-signal=DET_BELOW_RAIN_THOLD_074_Rx}, {application-record-element=DET_BELOW_RAIN_THOLD_075_Rx, system-signal=DET_BELOW_RAIN_THOLD_075_Rx}, {application-record-element=DET_BELOW_RAIN_THOLD_076_Rx, system-signal=DET_BELOW_RAIN_THOLD_076_Rx}, {application-record-element=DET_BI_STATIC_FLAG_073_Rx, system-signal=DET_BI_STATIC_FLAG_073_Rx}, {application-record-element=DET_BI_STATIC_FLAG_074_Rx, system-signal=DET_BI_STATIC_FLAG_074_Rx}, {application-record-element=DET_BI_STATIC_FLAG_075_Rx, system-signal=DET_BI_STATIC_FLAG_075_Rx}, {application-record-element=DET_BI_STATIC_FLAG_076_Rx, system-signal=DET_BI_STATIC_FLAG_076_Rx}, {application-record-element=DET_CONFD_AZIMUTH_073_Rx, system-signal=DET_CONFD_AZIMUTH_073_Rx}, {application-record-element=DET_CONFD_AZIMUTH_074_Rx, system-signal=DET_CONFD_AZIMUTH_074_Rx}, {application-record-element=DET_CONFD_AZIMUTH_075_Rx, system-signal=DET_CONFD_AZIMUTH_075_Rx}, {application-record-element=DET_CONFD_AZIMUTH_076_Rx, system-signal=DET_CONFD_AZIMUTH_076_Rx}, {application-record-element=DET_CONFD_ELEVATION_073_Rx, system-signal=DET_CONFD_ELEVATION_073_Rx}, {application-record-element=DET_CONFD_ELEVATION_074_Rx, system-signal=DET_CONFD_ELEVATION_074_Rx}, {application-record-element=DET_CONFD_ELEVATION_075_Rx, system-signal=DET_CONFD_ELEVATION_075_Rx}, {application-record-element=DET_CONFD_ELEVATION_076_Rx, system-signal=DET_CONFD_ELEVATION_076_Rx}, {application-record-element=DET_ELEVATION_073_Rx, system-signal=DET_ELEVATION_073_Rx}, {application-record-element=DET_ELEVATION_074_Rx, system-signal=DET_ELEVATION_074_Rx}, {application-record-element=DET_ELEVATION_075_Rx, system-signal=DET_ELEVATION_075_Rx}, {application-record-element=DET_ELEVATION_076_Rx, system-signal=DET_ELEVATION_076_Rx}, {application-record-element=DET_ELEVATION_ERR_073_Rx, system-signal=DET_ELEVATION_ERR_073_Rx}, {application-record-element=DET_ELEVATION_ERR_074_Rx, system-signal=DET_ELEVATION_ERR_074_Rx}, {application-record-element=DET_ELEVATION_ERR_075_Rx, system-signal=DET_ELEVATION_ERR_075_Rx}, {application-record-element=DET_ELEVATION_ERR_076_Rx, system-signal=DET_ELEVATION_ERR_076_Rx}, {application-record-element=DET_EXISTENCE_PROB_073_Rx, system-signal=DET_EXISTENCE_PROB_073_Rx}, {application-record-element=DET_EXISTENCE_PROB_074_Rx, system-signal=DET_EXISTENCE_PROB_074_Rx}, {application-record-element=DET_EXISTENCE_PROB_075_Rx, system-signal=DET_EXISTENCE_PROB_075_Rx}, {application-record-element=DET_EXISTENCE_PROB_076_Rx, system-signal=DET_EXISTENCE_PROB_076_Rx}, {application-record-element=DET_HVC_FLAG_073_Rx, system-signal=DET_HVC_FLAG_073_Rx}, {application-record-element=DET_HVC_FLAG_074_Rx, system-signal=DET_HVC_FLAG_074_Rx}, {application-record-element=DET_HVC_FLAG_075_Rx, system-signal=DET_HVC_FLAG_075_Rx}, {application-record-element=DET_HVC_FLAG_076_Rx, system-signal=DET_HVC_FLAG_076_Rx}, {application-record-element=DET_IDM_073_Rx, system-signal=DET_IDM_073_Rx}, {application-record-element=DET_IDM_074_Rx, system-signal=DET_IDM_074_Rx}, {application-record-element=DET_IDM_075_Rx, system-signal=DET_IDM_075_Rx}, {application-record-element=DET_IDM_076_Rx, system-signal=DET_IDM_076_Rx}, {application-record-element=DET_MH_CRC16_073_076_Rx, system-signal=DET_MH_CRC16_073_076_Rx}, {application-record-element=DET_MH_CYCLE_COUNTER_073_076_Rx, system-signal=DET_MH_CYCLE_COUNTER_073_076_Rx}, {application-record-element=DET_MH_SCAN_INDEX_4LSB_073_076_Rx, system-signal=DET_MH_SCAN_INDEX_4LSB_073_076_Rx}, {application-record-element=DET_MTD_073_Rx, system-signal=DET_MTD_073_Rx}, {application-record-element=DET_MTD_074_Rx, system-signal=DET_MTD_074_Rx}, {application-record-element=DET_MTD_075_Rx, system-signal=DET_MTD_075_Rx}, {application-record-element=DET_MTD_076_Rx, system-signal=DET_MTD_076_Rx}, {application-record-element=DET_PROB_1STAZHYPO_073_Rx, system-signal=DET_PROB_1STAZHYPO_073_Rx}, {application-record-element=DET_PROB_1STAZHYPO_074_Rx, system-signal=DET_PROB_1STAZHYPO_074_Rx}, {application-record-element=DET_PROB_1STAZHYPO_075_Rx, system-signal=DET_PROB_1STAZHYPO_075_Rx}, {application-record-element=DET_PROB_1STAZHYPO_076_Rx, system-signal=DET_PROB_1STAZHYPO_076_Rx}, {application-record-element=DET_RANGE_073_Rx, system-signal=DET_RANGE_073_Rx}, {application-record-element=DET_RANGE_074_Rx, system-signal=DET_RANGE_074_Rx}, {application-record-element=DET_RANGE_075_Rx, system-signal=DET_RANGE_075_Rx}, {application-record-element=DET_RANGE_076_Rx, system-signal=DET_RANGE_076_Rx}, {application-record-element=DET_RANGE_ERR_073_Rx, system-signal=DET_RANGE_ERR_073_Rx}, {application-record-element=DET_RANGE_ERR_074_Rx, system-signal=DET_RANGE_ERR_074_Rx}, {application-record-element=DET_RANGE_ERR_075_Rx, system-signal=DET_RANGE_ERR_075_Rx}, {application-record-element=DET_RANGE_ERR_076_Rx, system-signal=DET_RANGE_ERR_076_Rx}, {application-record-element=DET_RANGE_VELOCITY_073_Rx, system-signal=DET_RANGE_VELOCITY_073_Rx}, {application-record-element=DET_RANGE_VELOCITY_074_Rx, system-signal=DET_RANGE_VELOCITY_074_Rx}, {application-record-element=DET_RANGE_VELOCITY_075_Rx, system-signal=DET_RANGE_VELOCITY_075_Rx}, {application-record-element=DET_RANGE_VELOCITY_076_Rx, system-signal=DET_RANGE_VELOCITY_076_Rx}, {application-record-element=DET_RANGE_VELOCITY_ERR_073_Rx, system-signal=DET_RANGE_VELOCITY_ERR_073_Rx}, {application-record-element=DET_RANGE_VELOCITY_ERR_074_Rx, system-signal=DET_RANGE_VELOCITY_ERR_074_Rx}, {application-record-element=DET_RANGE_VELOCITY_ERR_075_Rx, system-signal=DET_RANGE_VELOCITY_ERR_075_Rx}, {application-record-element=DET_RANGE_VELOCITY_ERR_076_Rx, system-signal=DET_RANGE_VELOCITY_ERR_076_Rx}, {application-record-element=DET_RCS_073_Rx, system-signal=DET_RCS_073_Rx}, {application-record-element=DET_RCS_074_Rx, system-signal=DET_RCS_074_Rx}, {application-record-element=DET_RCS_075_Rx, system-signal=DET_RCS_075_Rx}, {application-record-element=DET_RCS_076_Rx, system-signal=DET_RCS_076_Rx}, {application-record-element=DET_SNR_073_Rx, system-signal=DET_SNR_073_Rx}, {application-record-element=DET_SNR_074_Rx, system-signal=DET_SNR_074_Rx}, {application-record-element=DET_SNR_075_Rx, system-signal=DET_SNR_075_Rx}, {application-record-element=DET_SNR_076_Rx, system-signal=DET_SNR_076_Rx}, {application-record-element=DET_SUPER_RES_TARGET_073_Rx, system-signal=DET_SUPER_RES_TARGET_073_Rx}, {application-record-element=DET_SUPER_RES_TARGET_074_Rx, system-signal=DET_SUPER_RES_TARGET_074_Rx}, {application-record-element=DET_SUPER_RES_TARGET_075_Rx, system-signal=DET_SUPER_RES_TARGET_075_Rx}, {application-record-element=DET_SUPER_RES_TARGET_076_Rx, system-signal=DET_SUPER_RES_TARGET_076_Rx}]}
        sender-receiver-to-signal-group-mapping={data-element=Rp_SG_Fusion_Detections_077_080_AL.Vdp_SG_Fusion_Detections_077_080_AL, signal-group=SG_Fusion_Detections_077_080, type-mapping=sender-rec-record-type-mapping=record-element-mappings=[{application-record-element=DET_AZIMUTH_077_Rx, system-signal=DET_AZIMUTH_077_Rx}, {application-record-element=DET_AZIMUTH_078_Rx, system-signal=DET_AZIMUTH_078_Rx}, {application-record-element=DET_AZIMUTH_079_Rx, system-signal=DET_AZIMUTH_079_Rx}, {application-record-element=DET_AZIMUTH_080_Rx, system-signal=DET_AZIMUTH_080_Rx}, {application-record-element=DET_AZIMUTH_ERR_077_Rx, system-signal=DET_AZIMUTH_ERR_077_Rx}, {application-record-element=DET_AZIMUTH_ERR_078_Rx, system-signal=DET_AZIMUTH_ERR_078_Rx}, {application-record-element=DET_AZIMUTH_ERR_079_Rx, system-signal=DET_AZIMUTH_ERR_079_Rx}, {application-record-element=DET_AZIMUTH_ERR_080_Rx, system-signal=DET_AZIMUTH_ERR_080_Rx}, {application-record-element=DET_BELOW_RAIN_THOLD_077_Rx, system-signal=DET_BELOW_RAIN_THOLD_077_Rx}, {application-record-element=DET_BELOW_RAIN_THOLD_078_Rx, system-signal=DET_BELOW_RAIN_THOLD_078_Rx}, {application-record-element=DET_BELOW_RAIN_THOLD_079_Rx, system-signal=DET_BELOW_RAIN_THOLD_079_Rx}, {application-record-element=DET_BELOW_RAIN_THOLD_080_Rx, system-signal=DET_BELOW_RAIN_THOLD_080_Rx}, {application-record-element=DET_BI_STATIC_FLAG_077_Rx, system-signal=DET_BI_STATIC_FLAG_077_Rx}, {application-record-element=DET_BI_STATIC_FLAG_078_Rx, system-signal=DET_BI_STATIC_FLAG_078_Rx}, {application-record-element=DET_BI_STATIC_FLAG_079_Rx, system-signal=DET_BI_STATIC_FLAG_079_Rx}, {application-record-element=DET_BI_STATIC_FLAG_080_Rx, system-signal=DET_BI_STATIC_FLAG_080_Rx}, {application-record-element=DET_CONFD_AZIMUTH_077_Rx, system-signal=DET_CONFD_AZIMUTH_077_Rx}, {application-record-element=DET_CONFD_AZIMUTH_078_Rx, system-signal=DET_CONFD_AZIMUTH_078_Rx}, {application-record-element=DET_CONFD_AZIMUTH_079_Rx, system-signal=DET_CONFD_AZIMUTH_079_Rx}, {application-record-element=DET_CONFD_AZIMUTH_080_Rx, system-signal=DET_CONFD_AZIMUTH_080_Rx}, {application-record-element=DET_CONFD_ELEVATION_077_Rx, system-signal=DET_CONFD_ELEVATION_077_Rx}, {application-record-element=DET_CONFD_ELEVATION_078_Rx, system-signal=DET_CONFD_ELEVATION_078_Rx}, {application-record-element=DET_CONFD_ELEVATION_079_Rx, system-signal=DET_CONFD_ELEVATION_079_Rx}, {application-record-element=DET_CONFD_ELEVATION_080_Rx, system-signal=DET_CONFD_ELEVATION_080_Rx}, {application-record-element=DET_ELEVATION_077_Rx, system-signal=DET_ELEVATION_077_Rx}, {application-record-element=DET_ELEVATION_078_Rx, system-signal=DET_ELEVATION_078_Rx}, {application-record-element=DET_ELEVATION_079_Rx, system-signal=DET_ELEVATION_079_Rx}, {application-record-element=DET_ELEVATION_080_Rx, system-signal=DET_ELEVATION_080_Rx}, {application-record-element=DET_ELEVATION_ERR_077_Rx, system-signal=DET_ELEVATION_ERR_077_Rx}, {application-record-element=DET_ELEVATION_ERR_078_Rx, system-signal=DET_ELEVATION_ERR_078_Rx}, {application-record-element=DET_ELEVATION_ERR_079_Rx, system-signal=DET_ELEVATION_ERR_079_Rx}, {application-record-element=DET_ELEVATION_ERR_080_Rx, system-signal=DET_ELEVATION_ERR_080_Rx}, {application-record-element=DET_EXISTENCE_PROB_077_Rx, system-signal=DET_EXISTENCE_PROB_077_Rx}, {application-record-element=DET_EXISTENCE_PROB_078_Rx, system-signal=DET_EXISTENCE_PROB_078_Rx}, {application-record-element=DET_EXISTENCE_PROB_079_Rx, system-signal=DET_EXISTENCE_PROB_079_Rx}, {application-record-element=DET_EXISTENCE_PROB_080_Rx, system-signal=DET_EXISTENCE_PROB_080_Rx}, {application-record-element=DET_HVC_FLAG_077_Rx, system-signal=DET_HVC_FLAG_077_Rx}, {application-record-element=DET_HVC_FLAG_078_Rx, system-signal=DET_HVC_FLAG_078_Rx}, {application-record-element=DET_HVC_FLAG_079_Rx, system-signal=DET_HVC_FLAG_079_Rx}, {application-record-element=DET_HVC_FLAG_080_Rx, system-signal=DET_HVC_FLAG_080_Rx}, {application-record-element=DET_IDM_077_Rx, system-signal=DET_IDM_077_Rx}, {application-record-element=DET_IDM_078_Rx, system-signal=DET_IDM_078_Rx}, {application-record-element=DET_IDM_079_Rx, system-signal=DET_IDM_079_Rx}, {application-record-element=DET_IDM_080_Rx, system-signal=DET_IDM_080_Rx}, {application-record-element=DET_MH_CRC16_077_080_Rx, system-signal=DET_MH_CRC16_077_080_Rx}, {application-record-element=DET_MH_CYCLE_COUNTER_077_080_Rx, system-signal=DET_MH_CYCLE_COUNTER_077_080_Rx}, {application-record-element=DET_MH_SCAN_INDEX_4LSB_077_080_Rx, system-signal=DET_MH_SCAN_INDEX_4LSB_077_080_Rx}, {application-record-element=DET_MTD_077_Rx, system-signal=DET_MTD_077_Rx}, {application-record-element=DET_MTD_078_Rx, system-signal=DET_MTD_078_Rx}, {application-record-element=DET_MTD_079_Rx, system-signal=DET_MTD_079_Rx}, {application-record-element=DET_MTD_080_Rx, system-signal=DET_MTD_080_Rx}, {application-record-element=DET_PROB_1STAZHYPO_077_Rx, system-signal=DET_PROB_1STAZHYPO_077_Rx}, {application-record-element=DET_PROB_1STAZHYPO_078_Rx, system-signal=DET_PROB_1STAZHYPO_078_Rx}, {application-record-element=DET_PROB_1STAZHYPO_079_Rx, system-signal=DET_PROB_1STAZHYPO_079_Rx}, {application-record-element=DET_PROB_1STAZHYPO_080_Rx, system-signal=DET_PROB_1STAZHYPO_080_Rx}, {application-record-element=DET_RANGE_077_Rx, system-signal=DET_RANGE_077_Rx}, {application-record-element=DET_RANGE_078_Rx, system-signal=DET_RANGE_078_Rx}, {application-record-element=DET_RANGE_079_Rx, system-signal=DET_RANGE_079_Rx}, {application-record-element=DET_RANGE_080_Rx, system-signal=DET_RANGE_080_Rx}, {application-record-element=DET_RANGE_ERR_077_Rx, system-signal=DET_RANGE_ERR_077_Rx}, {application-record-element=DET_RANGE_ERR_078_Rx, system-signal=DET_RANGE_ERR_078_Rx}, {application-record-element=DET_RANGE_ERR_079_Rx, system-signal=DET_RANGE_ERR_079_Rx}, {application-record-element=DET_RANGE_ERR_080_Rx, system-signal=DET_RANGE_ERR_080_Rx}, {application-record-element=DET_RANGE_VELOCITY_077_Rx, system-signal=DET_RANGE_VELOCITY_077_Rx}, {application-record-element=DET_RANGE_VELOCITY_078_Rx, system-signal=DET_RANGE_VELOCITY_078_Rx}, {application-record-element=DET_RANGE_VELOCITY_079_Rx, system-signal=DET_RANGE_VELOCITY_079_Rx}, {application-record-element=DET_RANGE_VELOCITY_080_Rx, system-signal=DET_RANGE_VELOCITY_080_Rx}, {application-record-element=DET_RANGE_VELOCITY_ERR_077_Rx, system-signal=DET_RANGE_VELOCITY_ERR_077_Rx}, {application-record-element=DET_RANGE_VELOCITY_ERR_078_Rx, system-signal=DET_RANGE_VELOCITY_ERR_078_Rx}, {application-record-element=DET_RANGE_VELOCITY_ERR_079_Rx, system-signal=DET_RANGE_VELOCITY_ERR_079_Rx}, {application-record-element=DET_RANGE_VELOCITY_ERR_080_Rx, system-signal=DET_RANGE_VELOCITY_ERR_080_Rx}, {application-record-element=DET_RCS_077_Rx, system-signal=DET_RCS_077_Rx}, {application-record-element=DET_RCS_078_Rx, system-signal=DET_RCS_078_Rx}, {application-record-element=DET_RCS_079_Rx, system-signal=DET_RCS_079_Rx}, {application-record-element=DET_RCS_080_Rx, system-signal=DET_RCS_080_Rx}, {application-record-element=DET_SNR_077_Rx, system-signal=DET_SNR_077_Rx}, {application-record-element=DET_SNR_078_Rx, system-signal=DET_SNR_078_Rx}, {application-record-element=DET_SNR_079_Rx, system-signal=DET_SNR_079_Rx}, {application-record-element=DET_SNR_080_Rx, system-signal=DET_SNR_080_Rx}, {application-record-element=DET_SUPER_RES_TARGET_077_Rx, system-signal=DET_SUPER_RES_TARGET_077_Rx}, {application-record-element=DET_SUPER_RES_TARGET_078_Rx, system-signal=DET_SUPER_RES_TARGET_078_Rx}, {application-record-element=DET_SUPER_RES_TARGET_079_Rx, system-signal=DET_SUPER_RES_TARGET_079_Rx}, {application-record-element=DET_SUPER_RES_TARGET_080_Rx, system-signal=DET_SUPER_RES_TARGET_080_Rx}]}
        sender-receiver-to-signal-group-mapping={data-element=Rp_SG_Fusion_Detections_081_084_AL.Vdp_SG_Fusion_Detections_081_084_AL, signal-group=SG_Fusion_Detections_081_084, type-mapping=sender-rec-record-type-mapping=record-element-mappings=[{application-record-element=DET_AZIMUTH_081_Rx, system-signal=DET_AZIMUTH_081_Rx}, {application-record-element=DET_AZIMUTH_082_Rx, system-signal=DET_AZIMUTH_082_Rx}, {application-record-element=DET_AZIMUTH_083_Rx, system-signal=DET_AZIMUTH_083_Rx}, {application-record-element=DET_AZIMUTH_084_Rx, system-signal=DET_AZIMUTH_084_Rx}, {application-record-element=DET_AZIMUTH_ERR_081_Rx, system-signal=DET_AZIMUTH_ERR_081_Rx}, {application-record-element=DET_AZIMUTH_ERR_082_Rx, system-signal=DET_AZIMUTH_ERR_082_Rx}, {application-record-element=DET_AZIMUTH_ERR_083_Rx, system-signal=DET_AZIMUTH_ERR_083_Rx}, {application-record-element=DET_AZIMUTH_ERR_084_Rx, system-signal=DET_AZIMUTH_ERR_084_Rx}, {application-record-element=DET_BELOW_RAIN_THOLD_081_Rx, system-signal=DET_BELOW_RAIN_THOLD_081_Rx}, {application-record-element=DET_BELOW_RAIN_THOLD_082_Rx, system-signal=DET_BELOW_RAIN_THOLD_082_Rx}, {application-record-element=DET_BELOW_RAIN_THOLD_083_Rx, system-signal=DET_BELOW_RAIN_THOLD_083_Rx}, {application-record-element=DET_BELOW_RAIN_THOLD_084_Rx, system-signal=DET_BELOW_RAIN_THOLD_084_Rx}, {application-record-element=DET_BI_STATIC_FLAG_081_Rx, system-signal=DET_BI_STATIC_FLAG_081_Rx}, {application-record-element=DET_BI_STATIC_FLAG_082_Rx, system-signal=DET_BI_STATIC_FLAG_082_Rx}, {application-record-element=DET_BI_STATIC_FLAG_083_Rx, system-signal=DET_BI_STATIC_FLAG_083_Rx}, {application-record-element=DET_BI_STATIC_FLAG_084_Rx, system-signal=DET_BI_STATIC_FLAG_084_Rx}, {application-record-element=DET_CONFD_AZIMUTH_081_Rx, system-signal=DET_CONFD_AZIMUTH_081_Rx}, {application-record-element=DET_CONFD_AZIMUTH_082_Rx, system-signal=DET_CONFD_AZIMUTH_082_Rx}, {application-record-element=DET_CONFD_AZIMUTH_083_Rx, system-signal=DET_CONFD_AZIMUTH_083_Rx}, {application-record-element=DET_CONFD_AZIMUTH_084_Rx, system-signal=DET_CONFD_AZIMUTH_084_Rx}, {application-record-element=DET_CONFD_ELEVATION_081_Rx, system-signal=DET_CONFD_ELEVATION_081_Rx}, {application-record-element=DET_CONFD_ELEVATION_082_Rx, system-signal=DET_CONFD_ELEVATION_082_Rx}, {application-record-element=DET_CONFD_ELEVATION_083_Rx, system-signal=DET_CONFD_ELEVATION_083_Rx}, {application-record-element=DET_CONFD_ELEVATION_084_Rx, system-signal=DET_CONFD_ELEVATION_084_Rx}, {application-record-element=DET_ELEVATION_081_Rx, system-signal=DET_ELEVATION_081_Rx}, {application-record-element=DET_ELEVATION_082_Rx, system-signal=DET_ELEVATION_082_Rx}, {application-record-element=DET_ELEVATION_083_Rx, system-signal=DET_ELEVATION_083_Rx}, {application-record-element=DET_ELEVATION_084_Rx, system-signal=DET_ELEVATION_084_Rx}, {application-record-element=DET_ELEVATION_ERR_081_Rx, system-signal=DET_ELEVATION_ERR_081_Rx}, {application-record-element=DET_ELEVATION_ERR_082_Rx, system-signal=DET_ELEVATION_ERR_082_Rx}, {application-record-element=DET_ELEVATION_ERR_083_Rx, system-signal=DET_ELEVATION_ERR_083_Rx}, {application-record-element=DET_ELEVATION_ERR_084_Rx, system-signal=DET_ELEVATION_ERR_084_Rx}, {application-record-element=DET_EXISTENCE_PROB_081_Rx, system-signal=DET_EXISTENCE_PROB_081_Rx}, {application-record-element=DET_EXISTENCE_PROB_082_Rx, system-signal=DET_EXISTENCE_PROB_082_Rx}, {application-record-element=DET_EXISTENCE_PROB_083_Rx, system-signal=DET_EXISTENCE_PROB_083_Rx}, {application-record-element=DET_EXISTENCE_PROB_084_Rx, system-signal=DET_EXISTENCE_PROB_084_Rx}, {application-record-element=DET_HVC_FLAG_081_Rx, system-signal=DET_HVC_FLAG_081_Rx}, {application-record-element=DET_HVC_FLAG_082_Rx, system-signal=DET_HVC_FLAG_082_Rx}, {application-record-element=DET_HVC_FLAG_083_Rx, system-signal=DET_HVC_FLAG_083_Rx}, {application-record-element=DET_HVC_FLAG_084_Rx, system-signal=DET_HVC_FLAG_084_Rx}, {application-record-element=DET_IDM_081_Rx, system-signal=DET_IDM_081_Rx}, {application-record-element=DET_IDM_082_Rx, system-signal=DET_IDM_082_Rx}, {application-record-element=DET_IDM_083_Rx, system-signal=DET_IDM_083_Rx}, {application-record-element=DET_IDM_084_Rx, system-signal=DET_IDM_084_Rx}, {application-record-element=DET_MH_CRC16_081_084_Rx, system-signal=DET_MH_CRC16_081_084_Rx}, {application-record-element=DET_MH_CYCLE_COUNTER_081_084_Rx, system-signal=DET_MH_CYCLE_COUNTER_081_084_Rx}, {application-record-element=DET_MH_SCAN_INDEX_4LSB_081_084_Rx, system-signal=DET_MH_SCAN_INDEX_4LSB_081_084_Rx}, {application-record-element=DET_MTD_081_Rx, system-signal=DET_MTD_081_Rx}, {application-record-element=DET_MTD_082_Rx, system-signal=DET_MTD_082_Rx}, {application-record-element=DET_MTD_083_Rx, system-signal=DET_MTD_083_Rx}, {application-record-element=DET_MTD_084_Rx, system-signal=DET_MTD_084_Rx}, {application-record-element=DET_PROB_1STAZHYPO_081_Rx, system-signal=DET_PROB_1STAZHYPO_081_Rx}, {application-record-element=DET_PROB_1STAZHYPO_082_Rx, system-signal=DET_PROB_1STAZHYPO_082_Rx}, {application-record-element=DET_PROB_1STAZHYPO_083_Rx, system-signal=DET_PROB_1STAZHYPO_083_Rx}, {application-record-element=DET_PROB_1STAZHYPO_084_Rx, system-signal=DET_PROB_1STAZHYPO_084_Rx}, {application-record-element=DET_RANGE_081_Rx, system-signal=DET_RANGE_081_Rx}, {application-record-element=DET_RANGE_082_Rx, system-signal=DET_RANGE_082_Rx}, {application-record-element=DET_RANGE_083_Rx, system-signal=DET_RANGE_083_Rx}, {application-record-element=DET_RANGE_084_Rx, system-signal=DET_RANGE_084_Rx}, {application-record-element=DET_RANGE_ERR_081_Rx, system-signal=DET_RANGE_ERR_081_Rx}, {application-record-element=DET_RANGE_ERR_082_Rx, system-signal=DET_RANGE_ERR_082_Rx}, {application-record-element=DET_RANGE_ERR_083_Rx, system-signal=DET_RANGE_ERR_083_Rx}, {application-record-element=DET_RANGE_ERR_084_Rx, system-signal=DET_RANGE_ERR_084_Rx}, {application-record-element=DET_RANGE_VELOCITY_081_Rx, system-signal=DET_RANGE_VELOCITY_081_Rx}, {application-record-element=DET_RANGE_VELOCITY_082_Rx, system-signal=DET_RANGE_VELOCITY_082_Rx}, {application-record-element=DET_RANGE_VELOCITY_083_Rx, system-signal=DET_RANGE_VELOCITY_083_Rx}, {application-record-element=DET_RANGE_VELOCITY_084_Rx, system-signal=DET_RANGE_VELOCITY_084_Rx}, {application-record-element=DET_RANGE_VELOCITY_ERR_081_Rx, system-signal=DET_RANGE_VELOCITY_ERR_081_Rx}, {application-record-element=DET_RANGE_VELOCITY_ERR_082_Rx, system-signal=DET_RANGE_VELOCITY_ERR_082_Rx}, {application-record-element=DET_RANGE_VELOCITY_ERR_083_Rx, system-signal=DET_RANGE_VELOCITY_ERR_083_Rx}, {application-record-element=DET_RANGE_VELOCITY_ERR_084_Rx, system-signal=DET_RANGE_VELOCITY_ERR_084_Rx}, {application-record-element=DET_RCS_081_Rx, system-signal=DET_RCS_081_Rx}, {application-record-element=DET_RCS_082_Rx, system-signal=DET_RCS_082_Rx}, {application-record-element=DET_RCS_083_Rx, system-signal=DET_RCS_083_Rx}, {application-record-element=DET_RCS_084_Rx, system-signal=DET_RCS_084_Rx}, {application-record-element=DET_SNR_081_Rx, system-signal=DET_SNR_081_Rx}, {application-record-element=DET_SNR_082_Rx, system-signal=DET_SNR_082_Rx}, {application-record-element=DET_SNR_083_Rx, system-signal=DET_SNR_083_Rx}, {application-record-element=DET_SNR_084_Rx, system-signal=DET_SNR_084_Rx}, {application-record-element=DET_SUPER_RES_TARGET_081_Rx, system-signal=DET_SUPER_RES_TARGET_081_Rx}, {application-record-element=DET_SUPER_RES_TARGET_082_Rx, system-signal=DET_SUPER_RES_TARGET_082_Rx}, {application-record-element=DET_SUPER_RES_TARGET_083_Rx, system-signal=DET_SUPER_RES_TARGET_083_Rx}, {application-record-element=DET_SUPER_RES_TARGET_084_Rx, system-signal=DET_SUPER_RES_TARGET_084_Rx}]}
        sender-receiver-to-signal-group-mapping={data-element=Rp_SG_Fusion_Detections_085_088_AL.Vdp_SG_Fusion_Detections_085_088_AL, signal-group=SG_Fusion_Detections_085_088, type-mapping=sender-rec-record-type-mapping=record-element-mappings=[{application-record-element=DET_AZIMUTH_085_Rx, system-signal=DET_AZIMUTH_085_Rx}, {application-record-element=DET_AZIMUTH_086_Rx, system-signal=DET_AZIMUTH_086_Rx}, {application-record-element=DET_AZIMUTH_087_Rx, system-signal=DET_AZIMUTH_087_Rx}, {application-record-element=DET_AZIMUTH_088_Rx, system-signal=DET_AZIMUTH_088_Rx}, {application-record-element=DET_AZIMUTH_ERR_085_Rx, system-signal=DET_AZIMUTH_ERR_085_Rx}, {application-record-element=DET_AZIMUTH_ERR_086_Rx, system-signal=DET_AZIMUTH_ERR_086_Rx}, {application-record-element=DET_AZIMUTH_ERR_087_Rx, system-signal=DET_AZIMUTH_ERR_087_Rx}, {application-record-element=DET_AZIMUTH_ERR_088_Rx, system-signal=DET_AZIMUTH_ERR_088_Rx}, {application-record-element=DET_BELOW_RAIN_THOLD_085_Rx, system-signal=DET_BELOW_RAIN_THOLD_085_Rx}, {application-record-element=DET_BELOW_RAIN_THOLD_086_Rx, system-signal=DET_BELOW_RAIN_THOLD_086_Rx}, {application-record-element=DET_BELOW_RAIN_THOLD_087_Rx, system-signal=DET_BELOW_RAIN_THOLD_087_Rx}, {application-record-element=DET_BELOW_RAIN_THOLD_088_Rx, system-signal=DET_BELOW_RAIN_THOLD_088_Rx}, {application-record-element=DET_BI_STATIC_FLAG_085_Rx, system-signal=DET_BI_STATIC_FLAG_085_Rx}, {application-record-element=DET_BI_STATIC_FLAG_086_Rx, system-signal=DET_BI_STATIC_FLAG_086_Rx}, {application-record-element=DET_BI_STATIC_FLAG_087_Rx, system-signal=DET_BI_STATIC_FLAG_087_Rx}, {application-record-element=DET_BI_STATIC_FLAG_088_Rx, system-signal=DET_BI_STATIC_FLAG_088_Rx}, {application-record-element=DET_CONFD_AZIMUTH_085_Rx, system-signal=DET_CONFD_AZIMUTH_085_Rx}, {application-record-element=DET_CONFD_AZIMUTH_086_Rx, system-signal=DET_CONFD_AZIMUTH_086_Rx}, {application-record-element=DET_CONFD_AZIMUTH_087_Rx, system-signal=DET_CONFD_AZIMUTH_087_Rx}, {application-record-element=DET_CONFD_AZIMUTH_088_Rx, system-signal=DET_CONFD_AZIMUTH_088_Rx}, {application-record-element=DET_CONFD_ELEVATION_085_Rx, system-signal=DET_CONFD_ELEVATION_085_Rx}, {application-record-element=DET_CONFD_ELEVATION_086_Rx, system-signal=DET_CONFD_ELEVATION_086_Rx}, {application-record-element=DET_CONFD_ELEVATION_087_Rx, system-signal=DET_CONFD_ELEVATION_087_Rx}, {application-record-element=DET_CONFD_ELEVATION_088_Rx, system-signal=DET_CONFD_ELEVATION_088_Rx}, {application-record-element=DET_ELEVATION_085_Rx, system-signal=DET_ELEVATION_085_Rx}, {application-record-element=DET_ELEVATION_086_Rx, system-signal=DET_ELEVATION_086_Rx}, {application-record-element=DET_ELEVATION_087_Rx, system-signal=DET_ELEVATION_087_Rx}, {application-record-element=DET_ELEVATION_088_Rx, system-signal=DET_ELEVATION_088_Rx}, {application-record-element=DET_ELEVATION_ERR_085_Rx, system-signal=DET_ELEVATION_ERR_085_Rx}, {application-record-element=DET_ELEVATION_ERR_086_Rx, system-signal=DET_ELEVATION_ERR_086_Rx}, {application-record-element=DET_ELEVATION_ERR_087_Rx, system-signal=DET_ELEVATION_ERR_087_Rx}, {application-record-element=DET_ELEVATION_ERR_088_Rx, system-signal=DET_ELEVATION_ERR_088_Rx}, {application-record-element=DET_EXISTENCE_PROB_085_Rx, system-signal=DET_EXISTENCE_PROB_085_Rx}, {application-record-element=DET_EXISTENCE_PROB_086_Rx, system-signal=DET_EXISTENCE_PROB_086_Rx}, {application-record-element=DET_EXISTENCE_PROB_087_Rx, system-signal=DET_EXISTENCE_PROB_087_Rx}, {application-record-element=DET_EXISTENCE_PROB_088_Rx, system-signal=DET_EXISTENCE_PROB_088_Rx}, {application-record-element=DET_HVC_FLAG_085_Rx, system-signal=DET_HVC_FLAG_085_Rx}, {application-record-element=DET_HVC_FLAG_086_Rx, system-signal=DET_HVC_FLAG_086_Rx}, {application-record-element=DET_HVC_FLAG_087_Rx, system-signal=DET_HVC_FLAG_087_Rx}, {application-record-element=DET_HVC_FLAG_088_Rx, system-signal=DET_HVC_FLAG_088_Rx}, {application-record-element=DET_IDM_085_Rx, system-signal=DET_IDM_085_Rx}, {application-record-element=DET_IDM_086_Rx, system-signal=DET_IDM_086_Rx}, {application-record-element=DET_IDM_087_Rx, system-signal=DET_IDM_087_Rx}, {application-record-element=DET_IDM_088_Rx, system-signal=DET_IDM_088_Rx}, {application-record-element=DET_MH_CRC16_085_088_Rx, system-signal=DET_MH_CRC16_085_088_Rx}, {application-record-element=DET_MH_CYCLE_COUNTER_085_088_Rx, system-signal=DET_MH_CYCLE_COUNTER_085_088_Rx}, {application-record-element=DET_MH_SCAN_INDEX_4LSB_085_088_Rx, system-signal=DET_MH_SCAN_INDEX_4LSB_085_088_Rx}, {application-record-element=DET_MTD_085_Rx, system-signal=DET_MTD_085_Rx}, {application-record-element=DET_MTD_086_Rx, system-signal=DET_MTD_086_Rx}, {application-record-element=DET_MTD_087_Rx, system-signal=DET_MTD_087_Rx}, {application-record-element=DET_MTD_088_Rx, system-signal=DET_MTD_088_Rx}, {application-record-element=DET_PROB_1STAZHYPO_085_Rx, system-signal=DET_PROB_1STAZHYPO_085_Rx}, {application-record-element=DET_PROB_1STAZHYPO_086_Rx, system-signal=DET_PROB_1STAZHYPO_086_Rx}, {application-record-element=DET_PROB_1STAZHYPO_087_Rx, system-signal=DET_PROB_1STAZHYPO_087_Rx}, {application-record-element=DET_PROB_1STAZHYPO_088_Rx, system-signal=DET_PROB_1STAZHYPO_088_Rx}, {application-record-element=DET_RANGE_085_Rx, system-signal=DET_RANGE_085_Rx}, {application-record-element=DET_RANGE_086_Rx, system-signal=DET_RANGE_086_Rx}, {application-record-element=DET_RANGE_087_Rx, system-signal=DET_RANGE_087_Rx}, {application-record-element=DET_RANGE_088_Rx, system-signal=DET_RANGE_088_Rx}, {application-record-element=DET_RANGE_ERR_085_Rx, system-signal=DET_RANGE_ERR_085_Rx}, {application-record-element=DET_RANGE_ERR_086_Rx, system-signal=DET_RANGE_ERR_086_Rx}, {application-record-element=DET_RANGE_ERR_087_Rx, system-signal=DET_RANGE_ERR_087_Rx}, {application-record-element=DET_RANGE_ERR_088_Rx, system-signal=DET_RANGE_ERR_088_Rx}, {application-record-element=DET_RANGE_VELOCITY_085_Rx, system-signal=DET_RANGE_VELOCITY_085_Rx}, {application-record-element=DET_RANGE_VELOCITY_086_Rx, system-signal=DET_RANGE_VELOCITY_086_Rx}, {application-record-element=DET_RANGE_VELOCITY_087_Rx, system-signal=DET_RANGE_VELOCITY_087_Rx}, {application-record-element=DET_RANGE_VELOCITY_088_Rx, system-signal=DET_RANGE_VELOCITY_088_Rx}, {application-record-element=DET_RANGE_VELOCITY_ERR_085_Rx, system-signal=DET_RANGE_VELOCITY_ERR_085_Rx}, {application-record-element=DET_RANGE_VELOCITY_ERR_086_Rx, system-signal=DET_RANGE_VELOCITY_ERR_086_Rx}, {application-record-element=DET_RANGE_VELOCITY_ERR_087_Rx, system-signal=DET_RANGE_VELOCITY_ERR_087_Rx}, {application-record-element=DET_RANGE_VELOCITY_ERR_088_Rx, system-signal=DET_RANGE_VELOCITY_ERR_088_Rx}, {application-record-element=DET_RCS_085_Rx, system-signal=DET_RCS_085_Rx}, {application-record-element=DET_RCS_086_Rx, system-signal=DET_RCS_086_Rx}, {application-record-element=DET_RCS_087_Rx, system-signal=DET_RCS_087_Rx}, {application-record-element=DET_RCS_088_Rx, system-signal=DET_RCS_088_Rx}, {application-record-element=DET_SNR_085_Rx, system-signal=DET_SNR_085_Rx}, {application-record-element=DET_SNR_086_Rx, system-signal=DET_SNR_086_Rx}, {application-record-element=DET_SNR_087_Rx, system-signal=DET_SNR_087_Rx}, {application-record-element=DET_SNR_088_Rx, system-signal=DET_SNR_088_Rx}, {application-record-element=DET_SUPER_RES_TARGET_085_Rx, system-signal=DET_SUPER_RES_TARGET_085_Rx}, {application-record-element=DET_SUPER_RES_TARGET_086_Rx, system-signal=DET_SUPER_RES_TARGET_086_Rx}, {application-record-element=DET_SUPER_RES_TARGET_087_Rx, system-signal=DET_SUPER_RES_TARGET_087_Rx}, {application-record-element=DET_SUPER_RES_TARGET_088_Rx, system-signal=DET_SUPER_RES_TARGET_088_Rx}]}
        sender-receiver-to-signal-group-mapping={data-element=Rp_SG_Fusion_Detections_089_092_AL.Vdp_SG_Fusion_Detections_089_092_AL, signal-group=SG_Fusion_Detections_089_092, type-mapping=sender-rec-record-type-mapping=record-element-mappings=[{application-record-element=DET_AZIMUTH_089_Rx, system-signal=DET_AZIMUTH_089_Rx}, {application-record-element=DET_AZIMUTH_090_Rx, system-signal=DET_AZIMUTH_090_Rx}, {application-record-element=DET_AZIMUTH_091_Rx, system-signal=DET_AZIMUTH_091_Rx}, {application-record-element=DET_AZIMUTH_092_Rx, system-signal=DET_AZIMUTH_092_Rx}, {application-record-element=DET_AZIMUTH_ERR_089_Rx, system-signal=DET_AZIMUTH_ERR_089_Rx}, {application-record-element=DET_AZIMUTH_ERR_090_Rx, system-signal=DET_AZIMUTH_ERR_090_Rx}, {application-record-element=DET_AZIMUTH_ERR_091_Rx, system-signal=DET_AZIMUTH_ERR_091_Rx}, {application-record-element=DET_AZIMUTH_ERR_092_Rx, system-signal=DET_AZIMUTH_ERR_092_Rx}, {application-record-element=DET_BELOW_RAIN_THOLD_089_Rx, system-signal=DET_BELOW_RAIN_THOLD_089_Rx}, {application-record-element=DET_BELOW_RAIN_THOLD_090_Rx, system-signal=DET_BELOW_RAIN_THOLD_090_Rx}, {application-record-element=DET_BELOW_RAIN_THOLD_091_Rx, system-signal=DET_BELOW_RAIN_THOLD_091_Rx}, {application-record-element=DET_BELOW_RAIN_THOLD_092_Rx, system-signal=DET_BELOW_RAIN_THOLD_092_Rx}, {application-record-element=DET_BI_STATIC_FLAG_089_Rx, system-signal=DET_BI_STATIC_FLAG_089_Rx}, {application-record-element=DET_BI_STATIC_FLAG_090_Rx, system-signal=DET_BI_STATIC_FLAG_090_Rx}, {application-record-element=DET_BI_STATIC_FLAG_091_Rx, system-signal=DET_BI_STATIC_FLAG_091_Rx}, {application-record-element=DET_BI_STATIC_FLAG_092_Rx, system-signal=DET_BI_STATIC_FLAG_092_Rx}, {application-record-element=DET_CONFD_AZIMUTH_089_Rx, system-signal=DET_CONFD_AZIMUTH_089_Rx}, {application-record-element=DET_CONFD_AZIMUTH_090_Rx, system-signal=DET_CONFD_AZIMUTH_090_Rx}, {application-record-element=DET_CONFD_AZIMUTH_091_Rx, system-signal=DET_CONFD_AZIMUTH_091_Rx}, {application-record-element=DET_CONFD_AZIMUTH_092_Rx, system-signal=DET_CONFD_AZIMUTH_092_Rx}, {application-record-element=DET_CONFD_ELEVATION_089_Rx, system-signal=DET_CONFD_ELEVATION_089_Rx}, {application-record-element=DET_CONFD_ELEVATION_090_Rx, system-signal=DET_CONFD_ELEVATION_090_Rx}, {application-record-element=DET_CONFD_ELEVATION_091_Rx, system-signal=DET_CONFD_ELEVATION_091_Rx}, {application-record-element=DET_CONFD_ELEVATION_092_Rx, system-signal=DET_CONFD_ELEVATION_092_Rx}, {application-record-element=DET_ELEVATION_089_Rx, system-signal=DET_ELEVATION_089_Rx}, {application-record-element=DET_ELEVATION_090_Rx, system-signal=DET_ELEVATION_090_Rx}, {application-record-element=DET_ELEVATION_091_Rx, system-signal=DET_ELEVATION_091_Rx}, {application-record-element=DET_ELEVATION_092_Rx, system-signal=DET_ELEVATION_092_Rx}, {application-record-element=DET_ELEVATION_ERR_089_Rx, system-signal=DET_ELEVATION_ERR_089_Rx}, {application-record-element=DET_ELEVATION_ERR_090_Rx, system-signal=DET_ELEVATION_ERR_090_Rx}, {application-record-element=DET_ELEVATION_ERR_091_Rx, system-signal=DET_ELEVATION_ERR_091_Rx}, {application-record-element=DET_ELEVATION_ERR_092_Rx, system-signal=DET_ELEVATION_ERR_092_Rx}, {application-record-element=DET_EXISTENCE_PROB_089_Rx, system-signal=DET_EXISTENCE_PROB_089_Rx}, {application-record-element=DET_EXISTENCE_PROB_090_Rx, system-signal=DET_EXISTENCE_PROB_090_Rx}, {application-record-element=DET_EXISTENCE_PROB_091_Rx, system-signal=DET_EXISTENCE_PROB_091_Rx}, {application-record-element=DET_EXISTENCE_PROB_092_Rx, system-signal=DET_EXISTENCE_PROB_092_Rx}, {application-record-element=DET_HVC_FLAG_089_Rx, system-signal=DET_HVC_FLAG_089_Rx}, {application-record-element=DET_HVC_FLAG_090_Rx, system-signal=DET_HVC_FLAG_090_Rx}, {application-record-element=DET_HVC_FLAG_091_Rx, system-signal=DET_HVC_FLAG_091_Rx}, {application-record-element=DET_HVC_FLAG_092_Rx, system-signal=DET_HVC_FLAG_092_Rx}, {application-record-element=DET_IDM_089_Rx, system-signal=DET_IDM_089_Rx}, {application-record-element=DET_IDM_090_Rx, system-signal=DET_IDM_090_Rx}, {application-record-element=DET_IDM_091_Rx, system-signal=DET_IDM_091_Rx}, {application-record-element=DET_IDM_092_Rx, system-signal=DET_IDM_092_Rx}, {application-record-element=DET_MH_CRC16_089_092_Rx, system-signal=DET_MH_CRC16_089_092_Rx}, {application-record-element=DET_MH_CYCLE_COUNTER_089_092_Rx, system-signal=DET_MH_CYCLE_COUNTER_089_092_Rx}, {application-record-element=DET_MH_SCAN_INDEX_4LSB_089_092_Rx, system-signal=DET_MH_SCAN_INDEX_4LSB_089_092_Rx}, {application-record-element=DET_MTD_089_Rx, system-signal=DET_MTD_089_Rx}, {application-record-element=DET_MTD_090_Rx, system-signal=DET_MTD_090_Rx}, {application-record-element=DET_MTD_091_Rx, system-signal=DET_MTD_091_Rx}, {application-record-element=DET_MTD_092_Rx, system-signal=DET_MTD_092_Rx}, {application-record-element=DET_PROB_1STAZHYPO_089_Rx, system-signal=DET_PROB_1STAZHYPO_089_Rx}, {application-record-element=DET_PROB_1STAZHYPO_090_Rx, system-signal=DET_PROB_1STAZHYPO_090_Rx}, {application-record-element=DET_PROB_1STAZHYPO_091_Rx, system-signal=DET_PROB_1STAZHYPO_091_Rx}, {application-record-element=DET_PROB_1STAZHYPO_092_Rx, system-signal=DET_PROB_1STAZHYPO_092_Rx}, {application-record-element=DET_RANGE_089_Rx, system-signal=DET_RANGE_089_Rx}, {application-record-element=DET_RANGE_090_Rx, system-signal=DET_RANGE_090_Rx}, {application-record-element=DET_RANGE_091_Rx, system-signal=DET_RANGE_091_Rx}, {application-record-element=DET_RANGE_092_Rx, system-signal=DET_RANGE_092_Rx}, {application-record-element=DET_RANGE_ERR_089_Rx, system-signal=DET_RANGE_ERR_089_Rx}, {application-record-element=DET_RANGE_ERR_090_Rx, system-signal=DET_RANGE_ERR_090_Rx}, {application-record-element=DET_RANGE_ERR_091_Rx, system-signal=DET_RANGE_ERR_091_Rx}, {application-record-element=DET_RANGE_ERR_092_Rx, system-signal=DET_RANGE_ERR_092_Rx}, {application-record-element=DET_RANGE_VELOCITY_089_Rx, system-signal=DET_RANGE_VELOCITY_089_Rx}, {application-record-element=DET_RANGE_VELOCITY_090_Rx, system-signal=DET_RANGE_VELOCITY_090_Rx}, {application-record-element=DET_RANGE_VELOCITY_091_Rx, system-signal=DET_RANGE_VELOCITY_091_Rx}, {application-record-element=DET_RANGE_VELOCITY_092_Rx, system-signal=DET_RANGE_VELOCITY_092_Rx}, {application-record-element=DET_RANGE_VELOCITY_ERR_089_Rx, system-signal=DET_RANGE_VELOCITY_ERR_089_Rx}, {application-record-element=DET_RANGE_VELOCITY_ERR_090_Rx, system-signal=DET_RANGE_VELOCITY_ERR_090_Rx}, {application-record-element=DET_RANGE_VELOCITY_ERR_091_Rx, system-signal=DET_RANGE_VELOCITY_ERR_091_Rx}, {application-record-element=DET_RANGE_VELOCITY_ERR_092_Rx, system-signal=DET_RANGE_VELOCITY_ERR_092_Rx}, {application-record-element=DET_RCS_089_Rx, system-signal=DET_RCS_089_Rx}, {application-record-element=DET_RCS_090_Rx, system-signal=DET_RCS_090_Rx}, {application-record-element=DET_RCS_091_Rx, system-signal=DET_RCS_091_Rx}, {application-record-element=DET_RCS_092_Rx, system-signal=DET_RCS_092_Rx}, {application-record-element=DET_SNR_089_Rx, system-signal=DET_SNR_089_Rx}, {application-record-element=DET_SNR_090_Rx, system-signal=DET_SNR_090_Rx}, {application-record-element=DET_SNR_091_Rx, system-signal=DET_SNR_091_Rx}, {application-record-element=DET_SNR_092_Rx, system-signal=DET_SNR_092_Rx}, {application-record-element=DET_SUPER_RES_TARGET_089_Rx, system-signal=DET_SUPER_RES_TARGET_089_Rx}, {application-record-element=DET_SUPER_RES_TARGET_090_Rx, system-signal=DET_SUPER_RES_TARGET_090_Rx}, {application-record-element=DET_SUPER_RES_TARGET_091_Rx, system-signal=DET_SUPER_RES_TARGET_091_Rx}, {application-record-element=DET_SUPER_RES_TARGET_092_Rx, system-signal=DET_SUPER_RES_TARGET_092_Rx}]}
        sender-receiver-to-signal-group-mapping={data-element=Rp_SG_Fusion_Detections_093_096_AL.Vdp_SG_Fusion_Detections_093_096_AL, signal-group=SG_Fusion_Detections_093_096, type-mapping=sender-rec-record-type-mapping=record-element-mappings=[{application-record-element=DET_AZIMUTH_093_Rx, system-signal=DET_AZIMUTH_093_Rx}, {application-record-element=DET_AZIMUTH_094_Rx, system-signal=DET_AZIMUTH_094_Rx}, {application-record-element=DET_AZIMUTH_095_Rx, system-signal=DET_AZIMUTH_095_Rx}, {application-record-element=DET_AZIMUTH_096_Rx, system-signal=DET_AZIMUTH_096_Rx}, {application-record-element=DET_AZIMUTH_ERR_093_Rx, system-signal=DET_AZIMUTH_ERR_093_Rx}, {application-record-element=DET_AZIMUTH_ERR_094_Rx, system-signal=DET_AZIMUTH_ERR_094_Rx}, {application-record-element=DET_AZIMUTH_ERR_095_Rx, system-signal=DET_AZIMUTH_ERR_095_Rx}, {application-record-element=DET_AZIMUTH_ERR_096_Rx, system-signal=DET_AZIMUTH_ERR_096_Rx}, {application-record-element=DET_BELOW_RAIN_THOLD_093_Rx, system-signal=DET_BELOW_RAIN_THOLD_093_Rx}, {application-record-element=DET_BELOW_RAIN_THOLD_094_Rx, system-signal=DET_BELOW_RAIN_THOLD_094_Rx}, {application-record-element=DET_BELOW_RAIN_THOLD_095_Rx, system-signal=DET_BELOW_RAIN_THOLD_095_Rx}, {application-record-element=DET_BELOW_RAIN_THOLD_096_Rx, system-signal=DET_BELOW_RAIN_THOLD_096_Rx}, {application-record-element=DET_BI_STATIC_FLAG_093_Rx, system-signal=DET_BI_STATIC_FLAG_093_Rx}, {application-record-element=DET_BI_STATIC_FLAG_094_Rx, system-signal=DET_BI_STATIC_FLAG_094_Rx}, {application-record-element=DET_BI_STATIC_FLAG_095_Rx, system-signal=DET_BI_STATIC_FLAG_095_Rx}, {application-record-element=DET_BI_STATIC_FLAG_096_Rx, system-signal=DET_BI_STATIC_FLAG_096_Rx}, {application-record-element=DET_CONFD_AZIMUTH_093_Rx, system-signal=DET_CONFD_AZIMUTH_093_Rx}, {application-record-element=DET_CONFD_AZIMUTH_094_Rx, system-signal=DET_CONFD_AZIMUTH_094_Rx}, {application-record-element=DET_CONFD_AZIMUTH_095_Rx, system-signal=DET_CONFD_AZIMUTH_095_Rx}, {application-record-element=DET_CONFD_AZIMUTH_096_Rx, system-signal=DET_CONFD_AZIMUTH_096_Rx}, {application-record-element=DET_CONFD_ELEVATION_093_Rx, system-signal=DET_CONFD_ELEVATION_093_Rx}, {application-record-element=DET_CONFD_ELEVATION_094_Rx, system-signal=DET_CONFD_ELEVATION_094_Rx}, {application-record-element=DET_CONFD_ELEVATION_095_Rx, system-signal=DET_CONFD_ELEVATION_095_Rx}, {application-record-element=DET_CONFD_ELEVATION_096_Rx, system-signal=DET_CONFD_ELEVATION_096_Rx}, {application-record-element=DET_ELEVATION_093_Rx, system-signal=DET_ELEVATION_093_Rx}, {application-record-element=DET_ELEVATION_094_Rx, system-signal=DET_ELEVATION_094_Rx}, {application-record-element=DET_ELEVATION_095_Rx, system-signal=DET_ELEVATION_095_Rx}, {application-record-element=DET_ELEVATION_096_Rx, system-signal=DET_ELEVATION_096_Rx}, {application-record-element=DET_ELEVATION_ERR_093_Rx, system-signal=DET_ELEVATION_ERR_093_Rx}, {application-record-element=DET_ELEVATION_ERR_094_Rx, system-signal=DET_ELEVATION_ERR_094_Rx}, {application-record-element=DET_ELEVATION_ERR_095_Rx, system-signal=DET_ELEVATION_ERR_095_Rx}, {application-record-element=DET_ELEVATION_ERR_096_Rx, system-signal=DET_ELEVATION_ERR_096_Rx}, {application-record-element=DET_EXISTENCE_PROB_093_Rx, system-signal=DET_EXISTENCE_PROB_093_Rx}, {application-record-element=DET_EXISTENCE_PROB_094_Rx, system-signal=DET_EXISTENCE_PROB_094_Rx}, {application-record-element=DET_EXISTENCE_PROB_095_Rx, system-signal=DET_EXISTENCE_PROB_095_Rx}, {application-record-element=DET_EXISTENCE_PROB_096_Rx, system-signal=DET_EXISTENCE_PROB_096_Rx}, {application-record-element=DET_HVC_FLAG_093_Rx, system-signal=DET_HVC_FLAG_093_Rx}, {application-record-element=DET_HVC_FLAG_094_Rx, system-signal=DET_HVC_FLAG_094_Rx}, {application-record-element=DET_HVC_FLAG_095_Rx, system-signal=DET_HVC_FLAG_095_Rx}, {application-record-element=DET_HVC_FLAG_096_Rx, system-signal=DET_HVC_FLAG_096_Rx}, {application-record-element=DET_IDM_093_Rx, system-signal=DET_IDM_093_Rx}, {application-record-element=DET_IDM_094_Rx, system-signal=DET_IDM_094_Rx}, {application-record-element=DET_IDM_095_Rx, system-signal=DET_IDM_095_Rx}, {application-record-element=DET_IDM_096_Rx, system-signal=DET_IDM_096_Rx}, {application-record-element=DET_MH_CRC16_093_096_Rx, system-signal=DET_MH_CRC16_093_096_Rx}, {application-record-element=DET_MH_CYCLE_COUNTER_093_096_Rx, system-signal=DET_MH_CYCLE_COUNTER_093_096_Rx}, {application-record-element=DET_MH_SCAN_INDEX_4LSB_093_096_Rx, system-signal=DET_MH_SCAN_INDEX_4LSB_093_096_Rx}, {application-record-element=DET_MTD_093_Rx, system-signal=DET_MTD_093_Rx}, {application-record-element=DET_MTD_094_Rx, system-signal=DET_MTD_094_Rx}, {application-record-element=DET_MTD_095_Rx, system-signal=DET_MTD_095_Rx}, {application-record-element=DET_MTD_096_Rx, system-signal=DET_MTD_096_Rx}, {application-record-element=DET_PROB_1STAZHYPO_093_Rx, system-signal=DET_PROB_1STAZHYPO_093_Rx}, {application-record-element=DET_PROB_1STAZHYPO_094_Rx, system-signal=DET_PROB_1STAZHYPO_094_Rx}, {application-record-element=DET_PROB_1STAZHYPO_095_Rx, system-signal=DET_PROB_1STAZHYPO_095_Rx}, {application-record-element=DET_PROB_1STAZHYPO_096_Rx, system-signal=DET_PROB_1STAZHYPO_096_Rx}, {application-record-element=DET_RANGE_093_Rx, system-signal=DET_RANGE_093_Rx}, {application-record-element=DET_RANGE_094_Rx, system-signal=DET_RANGE_094_Rx}, {application-record-element=DET_RANGE_095_Rx, system-signal=DET_RANGE_095_Rx}, {application-record-element=DET_RANGE_096_Rx, system-signal=DET_RANGE_096_Rx}, {application-record-element=DET_RANGE_ERR_093_Rx, system-signal=DET_RANGE_ERR_093_Rx}, {application-record-element=DET_RANGE_ERR_094_Rx, system-signal=DET_RANGE_ERR_094_Rx}, {application-record-element=DET_RANGE_ERR_095_Rx, system-signal=DET_RANGE_ERR_095_Rx}, {application-record-element=DET_RANGE_ERR_096_Rx, system-signal=DET_RANGE_ERR_096_Rx}, {application-record-element=DET_RANGE_VELOCITY_093_Rx, system-signal=DET_RANGE_VELOCITY_093_Rx}, {application-record-element=DET_RANGE_VELOCITY_094_Rx, system-signal=DET_RANGE_VELOCITY_094_Rx}, {application-record-element=DET_RANGE_VELOCITY_095_Rx, system-signal=DET_RANGE_VELOCITY_095_Rx}, {application-record-element=DET_RANGE_VELOCITY_096_Rx, system-signal=DET_RANGE_VELOCITY_096_Rx}, {application-record-element=DET_RANGE_VELOCITY_ERR_093_Rx, system-signal=DET_RANGE_VELOCITY_ERR_093_Rx}, {application-record-element=DET_RANGE_VELOCITY_ERR_094_Rx, system-signal=DET_RANGE_VELOCITY_ERR_094_Rx}, {application-record-element=DET_RANGE_VELOCITY_ERR_095_Rx, system-signal=DET_RANGE_VELOCITY_ERR_095_Rx}, {application-record-element=DET_RANGE_VELOCITY_ERR_096_Rx, system-signal=DET_RANGE_VELOCITY_ERR_096_Rx}, {application-record-element=DET_RCS_093_Rx, system-signal=DET_RCS_093_Rx}, {application-record-element=DET_RCS_094_Rx, system-signal=DET_RCS_094_Rx}, {application-record-element=DET_RCS_095_Rx, system-signal=DET_RCS_095_Rx}, {application-record-element=DET_RCS_096_Rx, system-signal=DET_RCS_096_Rx}, {application-record-element=DET_SNR_093_Rx, system-signal=DET_SNR_093_Rx}, {application-record-element=DET_SNR_094_Rx, system-signal=DET_SNR_094_Rx}, {application-record-element=DET_SNR_095_Rx, system-signal=DET_SNR_095_Rx}, {application-record-element=DET_SNR_096_Rx, system-signal=DET_SNR_096_Rx}, {application-record-element=DET_SUPER_RES_TARGET_093_Rx, system-signal=DET_SUPER_RES_TARGET_093_Rx}, {application-record-element=DET_SUPER_RES_TARGET_094_Rx, system-signal=DET_SUPER_RES_TARGET_094_Rx}, {application-record-element=DET_SUPER_RES_TARGET_095_Rx, system-signal=DET_SUPER_RES_TARGET_095_Rx}, {application-record-element=DET_SUPER_RES_TARGET_096_Rx, system-signal=DET_SUPER_RES_TARGET_096_Rx}]}
        sender-receiver-to-signal-group-mapping={data-element=Rp_SG_Fusion_Detections_097_100_AL.Vdp_SG_Fusion_Detections_097_100_AL, signal-group=SG_Fusion_Detections_097_100, type-mapping=sender-rec-record-type-mapping=record-element-mappings=[{application-record-element=DET_AZIMUTH_097_Rx, system-signal=DET_AZIMUTH_097_Rx}, {application-record-element=DET_AZIMUTH_098_Rx, system-signal=DET_AZIMUTH_098_Rx}, {application-record-element=DET_AZIMUTH_099_Rx, system-signal=DET_AZIMUTH_099_Rx}, {application-record-element=DET_AZIMUTH_100_Rx, system-signal=DET_AZIMUTH_100_Rx}, {application-record-element=DET_AZIMUTH_ERR_097_Rx, system-signal=DET_AZIMUTH_ERR_097_Rx}, {application-record-element=DET_AZIMUTH_ERR_098_Rx, system-signal=DET_AZIMUTH_ERR_098_Rx}, {application-record-element=DET_AZIMUTH_ERR_099_Rx, system-signal=DET_AZIMUTH_ERR_099_Rx}, {application-record-element=DET_AZIMUTH_ERR_100_Rx, system-signal=DET_AZIMUTH_ERR_100_Rx}, {application-record-element=DET_BELOW_RAIN_THOLD_097_Rx, system-signal=DET_BELOW_RAIN_THOLD_097_Rx}, {application-record-element=DET_BELOW_RAIN_THOLD_098_Rx, system-signal=DET_BELOW_RAIN_THOLD_098_Rx}, {application-record-element=DET_BELOW_RAIN_THOLD_099_Rx, system-signal=DET_BELOW_RAIN_THOLD_099_Rx}, {application-record-element=DET_BELOW_RAIN_THOLD_100_Rx, system-signal=DET_BELOW_RAIN_THOLD_100_Rx}, {application-record-element=DET_BI_STATIC_FLAG_097_Rx, system-signal=DET_BI_STATIC_FLAG_097_Rx}, {application-record-element=DET_BI_STATIC_FLAG_098_Rx, system-signal=DET_BI_STATIC_FLAG_098_Rx}, {application-record-element=DET_BI_STATIC_FLAG_099_Rx, system-signal=DET_BI_STATIC_FLAG_099_Rx}, {application-record-element=DET_BI_STATIC_FLAG_100_Rx, system-signal=DET_BI_STATIC_FLAG_100_Rx}, {application-record-element=DET_CONFD_AZIMUTH_097_Rx, system-signal=DET_CONFD_AZIMUTH_097_Rx}, {application-record-element=DET_CONFD_AZIMUTH_098_Rx, system-signal=DET_CONFD_AZIMUTH_098_Rx}, {application-record-element=DET_CONFD_AZIMUTH_099_Rx, system-signal=DET_CONFD_AZIMUTH_099_Rx}, {application-record-element=DET_CONFD_AZIMUTH_100_Rx, system-signal=DET_CONFD_AZIMUTH_100_Rx}, {application-record-element=DET_CONFD_ELEVATION_097_Rx, system-signal=DET_CONFD_ELEVATION_097_Rx}, {application-record-element=DET_CONFD_ELEVATION_098_Rx, system-signal=DET_CONFD_ELEVATION_098_Rx}, {application-record-element=DET_CONFD_ELEVATION_099_Rx, system-signal=DET_CONFD_ELEVATION_099_Rx}, {application-record-element=DET_CONFD_ELEVATION_100_Rx, system-signal=DET_CONFD_ELEVATION_100_Rx}, {application-record-element=DET_ELEVATION_097_Rx, system-signal=DET_ELEVATION_097_Rx}, {application-record-element=DET_ELEVATION_098_Rx, system-signal=DET_ELEVATION_098_Rx}, {application-record-element=DET_ELEVATION_099_Rx, system-signal=DET_ELEVATION_099_Rx}, {application-record-element=DET_ELEVATION_100_Rx, system-signal=DET_ELEVATION_100_Rx}, {application-record-element=DET_ELEVATION_ERR_097_Rx, system-signal=DET_ELEVATION_ERR_097_Rx}, {application-record-element=DET_ELEVATION_ERR_098_Rx, system-signal=DET_ELEVATION_ERR_098_Rx}, {application-record-element=DET_ELEVATION_ERR_099_Rx, system-signal=DET_ELEVATION_ERR_099_Rx}, {application-record-element=DET_ELEVATION_ERR_100_Rx, system-signal=DET_ELEVATION_ERR_100_Rx}, {application-record-element=DET_EXISTENCE_PROB_097_Rx, system-signal=DET_EXISTENCE_PROB_097_Rx}, {application-record-element=DET_EXISTENCE_PROB_098_Rx, system-signal=DET_EXISTENCE_PROB_098_Rx}, {application-record-element=DET_EXISTENCE_PROB_099_Rx, system-signal=DET_EXISTENCE_PROB_099_Rx}, {application-record-element=DET_EXISTENCE_PROB_100_Rx, system-signal=DET_EXISTENCE_PROB_100_Rx}, {application-record-element=DET_HVC_FLAG_097_Rx, system-signal=DET_HVC_FLAG_097_Rx}, {application-record-element=DET_HVC_FLAG_098_Rx, system-signal=DET_HVC_FLAG_098_Rx}, {application-record-element=DET_HVC_FLAG_099_Rx, system-signal=DET_HVC_FLAG_099_Rx}, {application-record-element=DET_HVC_FLAG_100_Rx, system-signal=DET_HVC_FLAG_100_Rx}, {application-record-element=DET_IDM_097_Rx, system-signal=DET_IDM_097_Rx}, {application-record-element=DET_IDM_098_Rx, system-signal=DET_IDM_098_Rx}, {application-record-element=DET_IDM_099_Rx, system-signal=DET_IDM_099_Rx}, {application-record-element=DET_IDM_100_Rx, system-signal=DET_IDM_100_Rx}, {application-record-element=DET_MH_CRC16_097_100_Rx, system-signal=DET_MH_CRC16_097_100_Rx}, {application-record-element=DET_MH_CYCLE_COUNTER_097_100_Rx, system-signal=DET_MH_CYCLE_COUNTER_097_100_Rx}, {application-record-element=DET_MH_SCAN_INDEX_4LSB_097_100_Rx, system-signal=DET_MH_SCAN_INDEX_4LSB_097_100_Rx}, {application-record-element=DET_MTD_097_Rx, system-signal=DET_MTD_097_Rx}, {application-record-element=DET_MTD_098_Rx, system-signal=DET_MTD_098_Rx}, {application-record-element=DET_MTD_099_Rx, system-signal=DET_MTD_099_Rx}, {application-record-element=DET_MTD_100_Rx, system-signal=DET_MTD_100_Rx}, {application-record-element=DET_PROB_1STAZHYPO_097_Rx, system-signal=DET_PROB_1STAZHYPO_097_Rx}, {application-record-element=DET_PROB_1STAZHYPO_098_Rx, system-signal=DET_PROB_1STAZHYPO_098_Rx}, {application-record-element=DET_PROB_1STAZHYPO_099_Rx, system-signal=DET_PROB_1STAZHYPO_099_Rx}, {application-record-element=DET_PROB_1STAZHYPO_100_Rx, system-signal=DET_PROB_1STAZHYPO_100_Rx}, {application-record-element=DET_RANGE_097_Rx, system-signal=DET_RANGE_097_Rx}, {application-record-element=DET_RANGE_098_Rx, system-signal=DET_RANGE_098_Rx}, {application-record-element=DET_RANGE_099_Rx, system-signal=DET_RANGE_099_Rx}, {application-record-element=DET_RANGE_100_Rx, system-signal=DET_RANGE_100_Rx}, {application-record-element=DET_RANGE_ERR_097_Rx, system-signal=DET_RANGE_ERR_097_Rx}, {application-record-element=DET_RANGE_ERR_098_Rx, system-signal=DET_RANGE_ERR_098_Rx}, {application-record-element=DET_RANGE_ERR_099_Rx, system-signal=DET_RANGE_ERR_099_Rx}, {application-record-element=DET_RANGE_ERR_100_Rx, system-signal=DET_RANGE_ERR_100_Rx}, {application-record-element=DET_RANGE_VELOCITY_097_Rx, system-signal=DET_RANGE_VELOCITY_097_Rx}, {application-record-element=DET_RANGE_VELOCITY_098_Rx, system-signal=DET_RANGE_VELOCITY_098_Rx}, {application-record-element=DET_RANGE_VELOCITY_099_Rx, system-signal=DET_RANGE_VELOCITY_099_Rx}, {application-record-element=DET_RANGE_VELOCITY_100_Rx, system-signal=DET_RANGE_VELOCITY_100_Rx}, {application-record-element=DET_RANGE_VELOCITY_ERR_097_Rx, system-signal=DET_RANGE_VELOCITY_ERR_097_Rx}, {application-record-element=DET_RANGE_VELOCITY_ERR_098_Rx, system-signal=DET_RANGE_VELOCITY_ERR_098_Rx}, {application-record-element=DET_RANGE_VELOCITY_ERR_099_Rx, system-signal=DET_RANGE_VELOCITY_ERR_099_Rx}, {application-record-element=DET_RANGE_VELOCITY_ERR_100_Rx, system-signal=DET_RANGE_VELOCITY_ERR_100_Rx}, {application-record-element=DET_RCS_097_Rx, system-signal=DET_RCS_097_Rx}, {application-record-element=DET_RCS_098_Rx, system-signal=DET_RCS_098_Rx}, {application-record-element=DET_RCS_099_Rx, system-signal=DET_RCS_099_Rx}, {application-record-element=DET_RCS_100_Rx, system-signal=DET_RCS_100_Rx}, {application-record-element=DET_SNR_097_Rx, system-signal=DET_SNR_097_Rx}, {application-record-element=DET_SNR_098_Rx, system-signal=DET_SNR_098_Rx}, {application-record-element=DET_SNR_099_Rx, system-signal=DET_SNR_099_Rx}, {application-record-element=DET_SNR_100_Rx, system-signal=DET_SNR_100_Rx}, {application-record-element=DET_SUPER_RES_TARGET_097_Rx, system-signal=DET_SUPER_RES_TARGET_097_Rx}, {application-record-element=DET_SUPER_RES_TARGET_098_Rx, system-signal=DET_SUPER_RES_TARGET_098_Rx}, {application-record-element=DET_SUPER_RES_TARGET_099_Rx, system-signal=DET_SUPER_RES_TARGET_099_Rx}, {application-record-element=DET_SUPER_RES_TARGET_100_Rx, system-signal=DET_SUPER_RES_TARGET_100_Rx}]}
        sender-receiver-to-signal-group-mapping={data-element=Rp_SG_Fusion_Detections_101_104_AL.Vdp_SG_Fusion_Detections_101_104_AL, signal-group=SG_Fusion_Detections_101_104, type-mapping=sender-rec-record-type-mapping=record-element-mappings=[{application-record-element=DET_AZIMUTH_101_Rx, system-signal=DET_AZIMUTH_101_Rx}, {application-record-element=DET_AZIMUTH_102_Rx, system-signal=DET_AZIMUTH_102_Rx}, {application-record-element=DET_AZIMUTH_103_Rx, system-signal=DET_AZIMUTH_103_Rx}, {application-record-element=DET_AZIMUTH_104_Rx, system-signal=DET_AZIMUTH_104_Rx}, {application-record-element=DET_AZIMUTH_ERR_101_Rx, system-signal=DET_AZIMUTH_ERR_101_Rx}, {application-record-element=DET_AZIMUTH_ERR_102_Rx, system-signal=DET_AZIMUTH_ERR_102_Rx}, {application-record-element=DET_AZIMUTH_ERR_103_Rx, system-signal=DET_AZIMUTH_ERR_103_Rx}, {application-record-element=DET_AZIMUTH_ERR_104_Rx, system-signal=DET_AZIMUTH_ERR_104_Rx}, {application-record-element=DET_BELOW_RAIN_THOLD_101_Rx, system-signal=DET_BELOW_RAIN_THOLD_101_Rx}, {application-record-element=DET_BELOW_RAIN_THOLD_102_Rx, system-signal=DET_BELOW_RAIN_THOLD_102_Rx}, {application-record-element=DET_BELOW_RAIN_THOLD_103_Rx, system-signal=DET_BELOW_RAIN_THOLD_103_Rx}, {application-record-element=DET_BELOW_RAIN_THOLD_104_Rx, system-signal=DET_BELOW_RAIN_THOLD_104_Rx}, {application-record-element=DET_BI_STATIC_FLAG_101_Rx, system-signal=DET_BI_STATIC_FLAG_101_Rx}, {application-record-element=DET_BI_STATIC_FLAG_102_Rx, system-signal=DET_BI_STATIC_FLAG_102_Rx}, {application-record-element=DET_BI_STATIC_FLAG_103_Rx, system-signal=DET_BI_STATIC_FLAG_103_Rx}, {application-record-element=DET_BI_STATIC_FLAG_104_Rx, system-signal=DET_BI_STATIC_FLAG_104_Rx}, {application-record-element=DET_CONFD_AZIMUTH_101_Rx, system-signal=DET_CONFD_AZIMUTH_101_Rx}, {application-record-element=DET_CONFD_AZIMUTH_102_Rx, system-signal=DET_CONFD_AZIMUTH_102_Rx}, {application-record-element=DET_CONFD_AZIMUTH_103_Rx, system-signal=DET_CONFD_AZIMUTH_103_Rx}, {application-record-element=DET_CONFD_AZIMUTH_104_Rx, system-signal=DET_CONFD_AZIMUTH_104_Rx}, {application-record-element=DET_CONFD_ELEVATION_101_Rx, system-signal=DET_CONFD_ELEVATION_101_Rx}, {application-record-element=DET_CONFD_ELEVATION_102_Rx, system-signal=DET_CONFD_ELEVATION_102_Rx}, {application-record-element=DET_CONFD_ELEVATION_103_Rx, system-signal=DET_CONFD_ELEVATION_103_Rx}, {application-record-element=DET_CONFD_ELEVATION_104_Rx, system-signal=DET_CONFD_ELEVATION_104_Rx}, {application-record-element=DET_ELEVATION_101_Rx, system-signal=DET_ELEVATION_101_Rx}, {application-record-element=DET_ELEVATION_102_Rx, system-signal=DET_ELEVATION_102_Rx}, {application-record-element=DET_ELEVATION_103_Rx, system-signal=DET_ELEVATION_103_Rx}, {application-record-element=DET_ELEVATION_104_Rx, system-signal=DET_ELEVATION_104_Rx}, {application-record-element=DET_ELEVATION_ERR_101_Rx, system-signal=DET_ELEVATION_ERR_101_Rx}, {application-record-element=DET_ELEVATION_ERR_102_Rx, system-signal=DET_ELEVATION_ERR_102_Rx}, {application-record-element=DET_ELEVATION_ERR_103_Rx, system-signal=DET_ELEVATION_ERR_103_Rx}, {application-record-element=DET_ELEVATION_ERR_104_Rx, system-signal=DET_ELEVATION_ERR_104_Rx}, {application-record-element=DET_EXISTENCE_PROB_101_Rx, system-signal=DET_EXISTENCE_PROB_101_Rx}, {application-record-element=DET_EXISTENCE_PROB_102_Rx, system-signal=DET_EXISTENCE_PROB_102_Rx}, {application-record-element=DET_EXISTENCE_PROB_103_Rx, system-signal=DET_EXISTENCE_PROB_103_Rx}, {application-record-element=DET_EXISTENCE_PROB_104_Rx, system-signal=DET_EXISTENCE_PROB_104_Rx}, {application-record-element=DET_HVC_FLAG_101_Rx, system-signal=DET_HVC_FLAG_101_Rx}, {application-record-element=DET_HVC_FLAG_102_Rx, system-signal=DET_HVC_FLAG_102_Rx}, {application-record-element=DET_HVC_FLAG_103_Rx, system-signal=DET_HVC_FLAG_103_Rx}, {application-record-element=DET_HVC_FLAG_104_Rx, system-signal=DET_HVC_FLAG_104_Rx}, {application-record-element=DET_IDM_101_Rx, system-signal=DET_IDM_101_Rx}, {application-record-element=DET_IDM_102_Rx, system-signal=DET_IDM_102_Rx}, {application-record-element=DET_IDM_103_Rx, system-signal=DET_IDM_103_Rx}, {application-record-element=DET_IDM_104_Rx, system-signal=DET_IDM_104_Rx}, {application-record-element=DET_MH_CRC16_101_104_Rx, system-signal=DET_MH_CRC16_101_104_Rx}, {application-record-element=DET_MH_CYCLE_COUNTER_101_104_Rx, system-signal=DET_MH_CYCLE_COUNTER_101_104_Rx}, {application-record-element=DET_MH_SCAN_INDEX_4LSB_101_104_Rx, system-signal=DET_MH_SCAN_INDEX_4LSB_101_104_Rx}, {application-record-element=DET_MTD_101_Rx, system-signal=DET_MTD_101_Rx}, {application-record-element=DET_MTD_102_Rx, system-signal=DET_MTD_102_Rx}, {application-record-element=DET_MTD_103_Rx, system-signal=DET_MTD_103_Rx}, {application-record-element=DET_MTD_104_Rx, system-signal=DET_MTD_104_Rx}, {application-record-element=DET_PROB_1STAZHYPO_101_Rx, system-signal=DET_PROB_1STAZHYPO_101_Rx}, {application-record-element=DET_PROB_1STAZHYPO_102_Rx, system-signal=DET_PROB_1STAZHYPO_102_Rx}, {application-record-element=DET_PROB_1STAZHYPO_103_Rx, system-signal=DET_PROB_1STAZHYPO_103_Rx}, {application-record-element=DET_PROB_1STAZHYPO_104_Rx, system-signal=DET_PROB_1STAZHYPO_104_Rx}, {application-record-element=DET_RANGE_101_Rx, system-signal=DET_RANGE_101_Rx}, {application-record-element=DET_RANGE_102_Rx, system-signal=DET_RANGE_102_Rx}, {application-record-element=DET_RANGE_103_Rx, system-signal=DET_RANGE_103_Rx}, {application-record-element=DET_RANGE_104_Rx, system-signal=DET_RANGE_104_Rx}, {application-record-element=DET_RANGE_ERR_101_Rx, system-signal=DET_RANGE_ERR_101_Rx}, {application-record-element=DET_RANGE_ERR_102_Rx, system-signal=DET_RANGE_ERR_102_Rx}, {application-record-element=DET_RANGE_ERR_103_Rx, system-signal=DET_RANGE_ERR_103_Rx}, {application-record-element=DET_RANGE_ERR_104_Rx, system-signal=DET_RANGE_ERR_104_Rx}, {application-record-element=DET_RANGE_VELOCITY_101_Rx, system-signal=DET_RANGE_VELOCITY_101_Rx}, {application-record-element=DET_RANGE_VELOCITY_102_Rx, system-signal=DET_RANGE_VELOCITY_102_Rx}, {application-record-element=DET_RANGE_VELOCITY_103_Rx, system-signal=DET_RANGE_VELOCITY_103_Rx}, {application-record-element=DET_RANGE_VELOCITY_104_Rx, system-signal=DET_RANGE_VELOCITY_104_Rx}, {application-record-element=DET_RANGE_VELOCITY_ERR_101_Rx, system-signal=DET_RANGE_VELOCITY_ERR_101_Rx}, {application-record-element=DET_RANGE_VELOCITY_ERR_102_Rx, system-signal=DET_RANGE_VELOCITY_ERR_102_Rx}, {application-record-element=DET_RANGE_VELOCITY_ERR_103_Rx, system-signal=DET_RANGE_VELOCITY_ERR_103_Rx}, {application-record-element=DET_RANGE_VELOCITY_ERR_104_Rx, system-signal=DET_RANGE_VELOCITY_ERR_104_Rx}, {application-record-element=DET_RCS_101_Rx, system-signal=DET_RCS_101_Rx}, {application-record-element=DET_RCS_102_Rx, system-signal=DET_RCS_102_Rx}, {application-record-element=DET_RCS_103_Rx, system-signal=DET_RCS_103_Rx}, {application-record-element=DET_RCS_104_Rx, system-signal=DET_RCS_104_Rx}, {application-record-element=DET_SNR_101_Rx, system-signal=DET_SNR_101_Rx}, {application-record-element=DET_SNR_102_Rx, system-signal=DET_SNR_102_Rx}, {application-record-element=DET_SNR_103_Rx, system-signal=DET_SNR_103_Rx}, {application-record-element=DET_SNR_104_Rx, system-signal=DET_SNR_104_Rx}, {application-record-element=DET_SUPER_RES_TARGET_101_Rx, system-signal=DET_SUPER_RES_TARGET_101_Rx}, {application-record-element=DET_SUPER_RES_TARGET_102_Rx, system-signal=DET_SUPER_RES_TARGET_102_Rx}, {application-record-element=DET_SUPER_RES_TARGET_103_Rx, system-signal=DET_SUPER_RES_TARGET_103_Rx}, {application-record-element=DET_SUPER_RES_TARGET_104_Rx, system-signal=DET_SUPER_RES_TARGET_104_Rx}]}
        sender-receiver-to-signal-group-mapping={data-element=Rp_SG_Fusion_Detections_105_108_AL.Vdp_SG_Fusion_Detections_105_108_AL, signal-group=SG_Fusion_Detections_105_108, type-mapping=sender-rec-record-type-mapping=record-element-mappings=[{application-record-element=DET_AZIMUTH_105_Rx, system-signal=DET_AZIMUTH_105_Rx}, {application-record-element=DET_AZIMUTH_106_Rx, system-signal=DET_AZIMUTH_106_Rx}, {application-record-element=DET_AZIMUTH_107_Rx, system-signal=DET_AZIMUTH_107_Rx}, {application-record-element=DET_AZIMUTH_108_Rx, system-signal=DET_AZIMUTH_108_Rx}, {application-record-element=DET_AZIMUTH_ERR_105_Rx, system-signal=DET_AZIMUTH_ERR_105_Rx}, {application-record-element=DET_AZIMUTH_ERR_106_Rx, system-signal=DET_AZIMUTH_ERR_106_Rx}, {application-record-element=DET_AZIMUTH_ERR_107_Rx, system-signal=DET_AZIMUTH_ERR_107_Rx}, {application-record-element=DET_AZIMUTH_ERR_108_Rx, system-signal=DET_AZIMUTH_ERR_108_Rx}, {application-record-element=DET_BELOW_RAIN_THOLD_105_Rx, system-signal=DET_BELOW_RAIN_THOLD_105_Rx}, {application-record-element=DET_BELOW_RAIN_THOLD_106_Rx, system-signal=DET_BELOW_RAIN_THOLD_106_Rx}, {application-record-element=DET_BELOW_RAIN_THOLD_107_Rx, system-signal=DET_BELOW_RAIN_THOLD_107_Rx}, {application-record-element=DET_BELOW_RAIN_THOLD_108_Rx, system-signal=DET_BELOW_RAIN_THOLD_108_Rx}, {application-record-element=DET_BI_STATIC_FLAG_105_Rx, system-signal=DET_BI_STATIC_FLAG_105_Rx}, {application-record-element=DET_BI_STATIC_FLAG_106_Rx, system-signal=DET_BI_STATIC_FLAG_106_Rx}, {application-record-element=DET_BI_STATIC_FLAG_107_Rx, system-signal=DET_BI_STATIC_FLAG_107_Rx}, {application-record-element=DET_BI_STATIC_FLAG_108_Rx, system-signal=DET_BI_STATIC_FLAG_108_Rx}, {application-record-element=DET_CONFD_AZIMUTH_105_Rx, system-signal=DET_CONFD_AZIMUTH_105_Rx}, {application-record-element=DET_CONFD_AZIMUTH_106_Rx, system-signal=DET_CONFD_AZIMUTH_106_Rx}, {application-record-element=DET_CONFD_AZIMUTH_107_Rx, system-signal=DET_CONFD_AZIMUTH_107_Rx}, {application-record-element=DET_CONFD_AZIMUTH_108_Rx, system-signal=DET_CONFD_AZIMUTH_108_Rx}, {application-record-element=DET_CONFD_ELEVATION_105_Rx, system-signal=DET_CONFD_ELEVATION_105_Rx}, {application-record-element=DET_CONFD_ELEVATION_106_Rx, system-signal=DET_CONFD_ELEVATION_106_Rx}, {application-record-element=DET_CONFD_ELEVATION_107_Rx, system-signal=DET_CONFD_ELEVATION_107_Rx}, {application-record-element=DET_CONFD_ELEVATION_108_Rx, system-signal=DET_CONFD_ELEVATION_108_Rx}, {application-record-element=DET_ELEVATION_105_Rx, system-signal=DET_ELEVATION_105_Rx}, {application-record-element=DET_ELEVATION_106_Rx, system-signal=DET_ELEVATION_106_Rx}, {application-record-element=DET_ELEVATION_107_Rx, system-signal=DET_ELEVATION_107_Rx}, {application-record-element=DET_ELEVATION_108_Rx, system-signal=DET_ELEVATION_108_Rx}, {application-record-element=DET_ELEVATION_ERR_105_Rx, system-signal=DET_ELEVATION_ERR_105_Rx}, {application-record-element=DET_ELEVATION_ERR_106_Rx, system-signal=DET_ELEVATION_ERR_106_Rx}, {application-record-element=DET_ELEVATION_ERR_107_Rx, system-signal=DET_ELEVATION_ERR_107_Rx}, {application-record-element=DET_ELEVATION_ERR_108_Rx, system-signal=DET_ELEVATION_ERR_108_Rx}, {application-record-element=DET_EXISTENCE_PROB_105_Rx, system-signal=DET_EXISTENCE_PROB_105_Rx}, {application-record-element=DET_EXISTENCE_PROB_106_Rx, system-signal=DET_EXISTENCE_PROB_106_Rx}, {application-record-element=DET_EXISTENCE_PROB_107_Rx, system-signal=DET_EXISTENCE_PROB_107_Rx}, {application-record-element=DET_EXISTENCE_PROB_108_Rx, system-signal=DET_EXISTENCE_PROB_108_Rx}, {application-record-element=DET_HVC_FLAG_105_Rx, system-signal=DET_HVC_FLAG_105_Rx}, {application-record-element=DET_HVC_FLAG_106_Rx, system-signal=DET_HVC_FLAG_106_Rx}, {application-record-element=DET_HVC_FLAG_107_Rx, system-signal=DET_HVC_FLAG_107_Rx}, {application-record-element=DET_HVC_FLAG_108_Rx, system-signal=DET_HVC_FLAG_108_Rx}, {application-record-element=DET_IDM_105_Rx, system-signal=DET_IDM_105_Rx}, {application-record-element=DET_IDM_106_Rx, system-signal=DET_IDM_106_Rx}, {application-record-element=DET_IDM_107_Rx, system-signal=DET_IDM_107_Rx}, {application-record-element=DET_IDM_108_Rx, system-signal=DET_IDM_108_Rx}, {application-record-element=DET_MH_CRC16_105_108_Rx, system-signal=DET_MH_CRC16_105_108_Rx}, {application-record-element=DET_MH_CYCLE_COUNTER_105_108_Rx, system-signal=DET_MH_CYCLE_COUNTER_105_108_Rx}, {application-record-element=DET_MH_SCAN_INDEX_4LSB_105_108_Rx, system-signal=DET_MH_SCAN_INDEX_4LSB_105_108_Rx}, {application-record-element=DET_MTD_105_Rx, system-signal=DET_MTD_105_Rx}, {application-record-element=DET_MTD_106_Rx, system-signal=DET_MTD_106_Rx}, {application-record-element=DET_MTD_107_Rx, system-signal=DET_MTD_107_Rx}, {application-record-element=DET_MTD_108_Rx, system-signal=DET_MTD_108_Rx}, {application-record-element=DET_PROB_1STAZHYPO_105_Rx, system-signal=DET_PROB_1STAZHYPO_105_Rx}, {application-record-element=DET_PROB_1STAZHYPO_106_Rx, system-signal=DET_PROB_1STAZHYPO_106_Rx}, {application-record-element=DET_PROB_1STAZHYPO_107_Rx, system-signal=DET_PROB_1STAZHYPO_107_Rx}, {application-record-element=DET_PROB_1STAZHYPO_108_Rx, system-signal=DET_PROB_1STAZHYPO_108_Rx}, {application-record-element=DET_RANGE_105_Rx, system-signal=DET_RANGE_105_Rx}, {application-record-element=DET_RANGE_106_Rx, system-signal=DET_RANGE_106_Rx}, {application-record-element=DET_RANGE_107_Rx, system-signal=DET_RANGE_107_Rx}, {application-record-element=DET_RANGE_108_Rx, system-signal=DET_RANGE_108_Rx}, {application-record-element=DET_RANGE_ERR_105_Rx, system-signal=DET_RANGE_ERR_105_Rx}, {application-record-element=DET_RANGE_ERR_106_Rx, system-signal=DET_RANGE_ERR_106_Rx}, {application-record-element=DET_RANGE_ERR_107_Rx, system-signal=DET_RANGE_ERR_107_Rx}, {application-record-element=DET_RANGE_ERR_108_Rx, system-signal=DET_RANGE_ERR_108_Rx}, {application-record-element=DET_RANGE_VELOCITY_105_Rx, system-signal=DET_RANGE_VELOCITY_105_Rx}, {application-record-element=DET_RANGE_VELOCITY_106_Rx, system-signal=DET_RANGE_VELOCITY_106_Rx}, {application-record-element=DET_RANGE_VELOCITY_107_Rx, system-signal=DET_RANGE_VELOCITY_107_Rx}, {application-record-element=DET_RANGE_VELOCITY_108_Rx, system-signal=DET_RANGE_VELOCITY_108_Rx}, {application-record-element=DET_RANGE_VELOCITY_ERR_105_Rx, system-signal=DET_RANGE_VELOCITY_ERR_105_Rx}, {application-record-element=DET_RANGE_VELOCITY_ERR_106_Rx, system-signal=DET_RANGE_VELOCITY_ERR_106_Rx}, {application-record-element=DET_RANGE_VELOCITY_ERR_107_Rx, system-signal=DET_RANGE_VELOCITY_ERR_107_Rx}, {application-record-element=DET_RANGE_VELOCITY_ERR_108_Rx, system-signal=DET_RANGE_VELOCITY_ERR_108_Rx}, {application-record-element=DET_RCS_105_Rx, system-signal=DET_RCS_105_Rx}, {application-record-element=DET_RCS_106_Rx, system-signal=DET_RCS_106_Rx}, {application-record-element=DET_RCS_107_Rx, system-signal=DET_RCS_107_Rx}, {application-record-element=DET_RCS_108_Rx, system-signal=DET_RCS_108_Rx}, {application-record-element=DET_SNR_105_Rx, system-signal=DET_SNR_105_Rx}, {application-record-element=DET_SNR_106_Rx, system-signal=DET_SNR_106_Rx}, {application-record-element=DET_SNR_107_Rx, system-signal=DET_SNR_107_Rx}, {application-record-element=DET_SNR_108_Rx, system-signal=DET_SNR_108_Rx}, {application-record-element=DET_SUPER_RES_TARGET_105_Rx, system-signal=DET_SUPER_RES_TARGET_105_Rx}, {application-record-element=DET_SUPER_RES_TARGET_106_Rx, system-signal=DET_SUPER_RES_TARGET_106_Rx}, {application-record-element=DET_SUPER_RES_TARGET_107_Rx, system-signal=DET_SUPER_RES_TARGET_107_Rx}, {application-record-element=DET_SUPER_RES_TARGET_108_Rx, system-signal=DET_SUPER_RES_TARGET_108_Rx}]}
        sender-receiver-to-signal-group-mapping={data-element=Rp_SG_Fusion_Detections_109_112_AL.Vdp_SG_Fusion_Detections_109_112_AL, signal-group=SG_Fusion_Detections_109_112, type-mapping=sender-rec-record-type-mapping=record-element-mappings=[{application-record-element=DET_AZIMUTH_109_Rx, system-signal=DET_AZIMUTH_109_Rx}, {application-record-element=DET_AZIMUTH_110_Rx, system-signal=DET_AZIMUTH_110_Rx}, {application-record-element=DET_AZIMUTH_111_Rx, system-signal=DET_AZIMUTH_111_Rx}, {application-record-element=DET_AZIMUTH_112_Rx, system-signal=DET_AZIMUTH_112_Rx}, {application-record-element=DET_AZIMUTH_ERR_109_Rx, system-signal=DET_AZIMUTH_ERR_109_Rx}, {application-record-element=DET_AZIMUTH_ERR_110_Rx, system-signal=DET_AZIMUTH_ERR_110_Rx}, {application-record-element=DET_AZIMUTH_ERR_111_Rx, system-signal=DET_AZIMUTH_ERR_111_Rx}, {application-record-element=DET_AZIMUTH_ERR_112_Rx, system-signal=DET_AZIMUTH_ERR_112_Rx}, {application-record-element=DET_BELOW_RAIN_THOLD_109_Rx, system-signal=DET_BELOW_RAIN_THOLD_109_Rx}, {application-record-element=DET_BELOW_RAIN_THOLD_110_Rx, system-signal=DET_BELOW_RAIN_THOLD_110_Rx}, {application-record-element=DET_BELOW_RAIN_THOLD_111_Rx, system-signal=DET_BELOW_RAIN_THOLD_111_Rx}, {application-record-element=DET_BELOW_RAIN_THOLD_112_Rx, system-signal=DET_BELOW_RAIN_THOLD_112_Rx}, {application-record-element=DET_BI_STATIC_FLAG_109_Rx, system-signal=DET_BI_STATIC_FLAG_109_Rx}, {application-record-element=DET_BI_STATIC_FLAG_110_Rx, system-signal=DET_BI_STATIC_FLAG_110_Rx}, {application-record-element=DET_BI_STATIC_FLAG_111_Rx, system-signal=DET_BI_STATIC_FLAG_111_Rx}, {application-record-element=DET_BI_STATIC_FLAG_112_Rx, system-signal=DET_BI_STATIC_FLAG_112_Rx}, {application-record-element=DET_CONFD_AZIMUTH_109_Rx, system-signal=DET_CONFD_AZIMUTH_109_Rx}, {application-record-element=DET_CONFD_AZIMUTH_110_Rx, system-signal=DET_CONFD_AZIMUTH_110_Rx}, {application-record-element=DET_CONFD_AZIMUTH_111_Rx, system-signal=DET_CONFD_AZIMUTH_111_Rx}, {application-record-element=DET_CONFD_AZIMUTH_112_Rx, system-signal=DET_CONFD_AZIMUTH_112_Rx}, {application-record-element=DET_CONFD_ELEVATION_109_Rx, system-signal=DET_CONFD_ELEVATION_109_Rx}, {application-record-element=DET_CONFD_ELEVATION_110_Rx, system-signal=DET_CONFD_ELEVATION_110_Rx}, {application-record-element=DET_CONFD_ELEVATION_111_Rx, system-signal=DET_CONFD_ELEVATION_111_Rx}, {application-record-element=DET_CONFD_ELEVATION_112_Rx, system-signal=DET_CONFD_ELEVATION_112_Rx}, {application-record-element=DET_ELEVATION_109_Rx, system-signal=DET_ELEVATION_109_Rx}, {application-record-element=DET_ELEVATION_110_Rx, system-signal=DET_ELEVATION_110_Rx}, {application-record-element=DET_ELEVATION_111_Rx, system-signal=DET_ELEVATION_111_Rx}, {application-record-element=DET_ELEVATION_112_Rx, system-signal=DET_ELEVATION_112_Rx}, {application-record-element=DET_ELEVATION_ERR_109_Rx, system-signal=DET_ELEVATION_ERR_109_Rx}, {application-record-element=DET_ELEVATION_ERR_110_Rx, system-signal=DET_ELEVATION_ERR_110_Rx}, {application-record-element=DET_ELEVATION_ERR_111_Rx, system-signal=DET_ELEVATION_ERR_111_Rx}, {application-record-element=DET_ELEVATION_ERR_112_Rx, system-signal=DET_ELEVATION_ERR_112_Rx}, {application-record-element=DET_EXISTENCE_PROB_109_Rx, system-signal=DET_EXISTENCE_PROB_109_Rx}, {application-record-element=DET_EXISTENCE_PROB_110_Rx, system-signal=DET_EXISTENCE_PROB_110_Rx}, {application-record-element=DET_EXISTENCE_PROB_111_Rx, system-signal=DET_EXISTENCE_PROB_111_Rx}, {application-record-element=DET_EXISTENCE_PROB_112_Rx, system-signal=DET_EXISTENCE_PROB_112_Rx}, {application-record-element=DET_HVC_FLAG_109_Rx, system-signal=DET_HVC_FLAG_109_Rx}, {application-record-element=DET_HVC_FLAG_110_Rx, system-signal=DET_HVC_FLAG_110_Rx}, {application-record-element=DET_HVC_FLAG_111_Rx, system-signal=DET_HVC_FLAG_111_Rx}, {application-record-element=DET_HVC_FLAG_112_Rx, system-signal=DET_HVC_FLAG_112_Rx}, {application-record-element=DET_IDM_109_Rx, system-signal=DET_IDM_109_Rx}, {application-record-element=DET_IDM_110_Rx, system-signal=DET_IDM_110_Rx}, {application-record-element=DET_IDM_111_Rx, system-signal=DET_IDM_111_Rx}, {application-record-element=DET_IDM_112_Rx, system-signal=DET_IDM_112_Rx}, {application-record-element=DET_MH_CRC16_109_112_Rx, system-signal=DET_MH_CRC16_109_112_Rx}, {application-record-element=DET_MH_CYCLE_COUNTER_109_112_Rx, system-signal=DET_MH_CYCLE_COUNTER_109_112_Rx}, {application-record-element=DET_MH_SCAN_INDEX_4LSB_109_112_Rx, system-signal=DET_MH_SCAN_INDEX_4LSB_109_112_Rx}, {application-record-element=DET_MTD_109_Rx, system-signal=DET_MTD_109_Rx}, {application-record-element=DET_MTD_110_Rx, system-signal=DET_MTD_110_Rx}, {application-record-element=DET_MTD_111_Rx, system-signal=DET_MTD_111_Rx}, {application-record-element=DET_MTD_112_Rx, system-signal=DET_MTD_112_Rx}, {application-record-element=DET_PROB_1STAZHYPO_109_Rx, system-signal=DET_PROB_1STAZHYPO_109_Rx}, {application-record-element=DET_PROB_1STAZHYPO_110_Rx, system-signal=DET_PROB_1STAZHYPO_110_Rx}, {application-record-element=DET_PROB_1STAZHYPO_111_Rx, system-signal=DET_PROB_1STAZHYPO_111_Rx}, {application-record-element=DET_PROB_1STAZHYPO_112_Rx, system-signal=DET_PROB_1STAZHYPO_112_Rx}, {application-record-element=DET_RANGE_109_Rx, system-signal=DET_RANGE_109_Rx}, {application-record-element=DET_RANGE_110_Rx, system-signal=DET_RANGE_110_Rx}, {application-record-element=DET_RANGE_111_Rx, system-signal=DET_RANGE_111_Rx}, {application-record-element=DET_RANGE_112_Rx, system-signal=DET_RANGE_112_Rx}, {application-record-element=DET_RANGE_ERR_109_Rx, system-signal=DET_RANGE_ERR_109_Rx}, {application-record-element=DET_RANGE_ERR_110_Rx, system-signal=DET_RANGE_ERR_110_Rx}, {application-record-element=DET_RANGE_ERR_111_Rx, system-signal=DET_RANGE_ERR_111_Rx}, {application-record-element=DET_RANGE_ERR_112_Rx, system-signal=DET_RANGE_ERR_112_Rx}, {application-record-element=DET_RANGE_VELOCITY_109_Rx, system-signal=DET_RANGE_VELOCITY_109_Rx}, {application-record-element=DET_RANGE_VELOCITY_110_Rx, system-signal=DET_RANGE_VELOCITY_110_Rx}, {application-record-element=DET_RANGE_VELOCITY_111_Rx, system-signal=DET_RANGE_VELOCITY_111_Rx}, {application-record-element=DET_RANGE_VELOCITY_112_Rx, system-signal=DET_RANGE_VELOCITY_112_Rx}, {application-record-element=DET_RANGE_VELOCITY_ERR_109_Rx, system-signal=DET_RANGE_VELOCITY_ERR_109_Rx}, {application-record-element=DET_RANGE_VELOCITY_ERR_110_Rx, system-signal=DET_RANGE_VELOCITY_ERR_110_Rx}, {application-record-element=DET_RANGE_VELOCITY_ERR_111_Rx, system-signal=DET_RANGE_VELOCITY_ERR_111_Rx}, {application-record-element=DET_RANGE_VELOCITY_ERR_112_Rx, system-signal=DET_RANGE_VELOCITY_ERR_112_Rx}, {application-record-element=DET_RCS_109_Rx, system-signal=DET_RCS_109_Rx}, {application-record-element=DET_RCS_110_Rx, system-signal=DET_RCS_110_Rx}, {application-record-element=DET_RCS_111_Rx, system-signal=DET_RCS_111_Rx}, {application-record-element=DET_RCS_112_Rx, system-signal=DET_RCS_112_Rx}, {application-record-element=DET_SNR_109_Rx, system-signal=DET_SNR_109_Rx}, {application-record-element=DET_SNR_110_Rx, system-signal=DET_SNR_110_Rx}, {application-record-element=DET_SNR_111_Rx, system-signal=DET_SNR_111_Rx}, {application-record-element=DET_SNR_112_Rx, system-signal=DET_SNR_112_Rx}, {application-record-element=DET_SUPER_RES_TARGET_109_Rx, system-signal=DET_SUPER_RES_TARGET_109_Rx}, {application-record-element=DET_SUPER_RES_TARGET_110_Rx, system-signal=DET_SUPER_RES_TARGET_110_Rx}, {application-record-element=DET_SUPER_RES_TARGET_111_Rx, system-signal=DET_SUPER_RES_TARGET_111_Rx}, {application-record-element=DET_SUPER_RES_TARGET_112_Rx, system-signal=DET_SUPER_RES_TARGET_112_Rx}]}
        sender-receiver-to-signal-group-mapping={data-element=Rp_SG_Fusion_Detections_113_116_AL.Vdp_SG_Fusion_Detections_113_116_AL, signal-group=SG_Fusion_Detections_113_116, type-mapping=sender-rec-record-type-mapping=record-element-mappings=[{application-record-element=DET_AZIMUTH_113_Rx, system-signal=DET_AZIMUTH_113_Rx}, {application-record-element=DET_AZIMUTH_114_Rx, system-signal=DET_AZIMUTH_114_Rx}, {application-record-element=DET_AZIMUTH_115_Rx, system-signal=DET_AZIMUTH_115_Rx}, {application-record-element=DET_AZIMUTH_116_Rx, system-signal=DET_AZIMUTH_116_Rx}, {application-record-element=DET_AZIMUTH_ERR_113_Rx, system-signal=DET_AZIMUTH_ERR_113_Rx}, {application-record-element=DET_AZIMUTH_ERR_114_Rx, system-signal=DET_AZIMUTH_ERR_114_Rx}, {application-record-element=DET_AZIMUTH_ERR_115_Rx, system-signal=DET_AZIMUTH_ERR_115_Rx}, {application-record-element=DET_AZIMUTH_ERR_116_Rx, system-signal=DET_AZIMUTH_ERR_116_Rx}, {application-record-element=DET_BELOW_RAIN_THOLD_113_Rx, system-signal=DET_BELOW_RAIN_THOLD_113_Rx}, {application-record-element=DET_BELOW_RAIN_THOLD_114_Rx, system-signal=DET_BELOW_RAIN_THOLD_114_Rx}, {application-record-element=DET_BELOW_RAIN_THOLD_115_Rx, system-signal=DET_BELOW_RAIN_THOLD_115_Rx}, {application-record-element=DET_BELOW_RAIN_THOLD_116_Rx, system-signal=DET_BELOW_RAIN_THOLD_116_Rx}, {application-record-element=DET_BI_STATIC_FLAG_113_Rx, system-signal=DET_BI_STATIC_FLAG_113_Rx}, {application-record-element=DET_BI_STATIC_FLAG_114_Rx, system-signal=DET_BI_STATIC_FLAG_114_Rx}, {application-record-element=DET_BI_STATIC_FLAG_115_Rx, system-signal=DET_BI_STATIC_FLAG_115_Rx}, {application-record-element=DET_BI_STATIC_FLAG_116_Rx, system-signal=DET_BI_STATIC_FLAG_116_Rx}, {application-record-element=DET_CONFD_AZIMUTH_113_Rx, system-signal=DET_CONFD_AZIMUTH_113_Rx}, {application-record-element=DET_CONFD_AZIMUTH_114_Rx, system-signal=DET_CONFD_AZIMUTH_114_Rx}, {application-record-element=DET_CONFD_AZIMUTH_115_Rx, system-signal=DET_CONFD_AZIMUTH_115_Rx}, {application-record-element=DET_CONFD_AZIMUTH_116_Rx, system-signal=DET_CONFD_AZIMUTH_116_Rx}, {application-record-element=DET_CONFD_ELEVATION_113_Rx, system-signal=DET_CONFD_ELEVATION_113_Rx}, {application-record-element=DET_CONFD_ELEVATION_114_Rx, system-signal=DET_CONFD_ELEVATION_114_Rx}, {application-record-element=DET_CONFD_ELEVATION_115_Rx, system-signal=DET_CONFD_ELEVATION_115_Rx}, {application-record-element=DET_CONFD_ELEVATION_116_Rx, system-signal=DET_CONFD_ELEVATION_116_Rx}, {application-record-element=DET_ELEVATION_113_Rx, system-signal=DET_ELEVATION_113_Rx}, {application-record-element=DET_ELEVATION_114_Rx, system-signal=DET_ELEVATION_114_Rx}, {application-record-element=DET_ELEVATION_115_Rx, system-signal=DET_ELEVATION_115_Rx}, {application-record-element=DET_ELEVATION_116_Rx, system-signal=DET_ELEVATION_116_Rx}, {application-record-element=DET_ELEVATION_ERR_113_Rx, system-signal=DET_ELEVATION_ERR_113_Rx}, {application-record-element=DET_ELEVATION_ERR_114_Rx, system-signal=DET_ELEVATION_ERR_114_Rx}, {application-record-element=DET_ELEVATION_ERR_115_Rx, system-signal=DET_ELEVATION_ERR_115_Rx}, {application-record-element=DET_ELEVATION_ERR_116_Rx, system-signal=DET_ELEVATION_ERR_116_Rx}, {application-record-element=DET_EXISTENCE_PROB_113_Rx, system-signal=DET_EXISTENCE_PROB_113_Rx}, {application-record-element=DET_EXISTENCE_PROB_114_Rx, system-signal=DET_EXISTENCE_PROB_114_Rx}, {application-record-element=DET_EXISTENCE_PROB_115_Rx, system-signal=DET_EXISTENCE_PROB_115_Rx}, {application-record-element=DET_EXISTENCE_PROB_116_Rx, system-signal=DET_EXISTENCE_PROB_116_Rx}, {application-record-element=DET_HVC_FLAG_113_Rx, system-signal=DET_HVC_FLAG_113_Rx}, {application-record-element=DET_HVC_FLAG_114_Rx, system-signal=DET_HVC_FLAG_114_Rx}, {application-record-element=DET_HVC_FLAG_115_Rx, system-signal=DET_HVC_FLAG_115_Rx}, {application-record-element=DET_HVC_FLAG_116_Rx, system-signal=DET_HVC_FLAG_116_Rx}, {application-record-element=DET_IDM_113_Rx, system-signal=DET_IDM_113_Rx}, {application-record-element=DET_IDM_114_Rx, system-signal=DET_IDM_114_Rx}, {application-record-element=DET_IDM_115_Rx, system-signal=DET_IDM_115_Rx}, {application-record-element=DET_IDM_116_Rx, system-signal=DET_IDM_116_Rx}, {application-record-element=DET_MH_CRC16_113_116_Rx, system-signal=DET_MH_CRC16_113_116_Rx}, {application-record-element=DET_MH_CYCLE_COUNTER_113_116_Rx, system-signal=DET_MH_CYCLE_COUNTER_113_116_Rx}, {application-record-element=DET_MH_SCAN_INDEX_4LSB_113_116_Rx, system-signal=DET_MH_SCAN_INDEX_4LSB_113_116_Rx}, {application-record-element=DET_MTD_113_Rx, system-signal=DET_MTD_113_Rx}, {application-record-element=DET_MTD_114_Rx, system-signal=DET_MTD_114_Rx}, {application-record-element=DET_MTD_115_Rx, system-signal=DET_MTD_115_Rx}, {application-record-element=DET_MTD_116_Rx, system-signal=DET_MTD_116_Rx}, {application-record-element=DET_PROB_1STAZHYPO_113_Rx, system-signal=DET_PROB_1STAZHYPO_113_Rx}, {application-record-element=DET_PROB_1STAZHYPO_114_Rx, system-signal=DET_PROB_1STAZHYPO_114_Rx}, {application-record-element=DET_PROB_1STAZHYPO_115_Rx, system-signal=DET_PROB_1STAZHYPO_115_Rx}, {application-record-element=DET_PROB_1STAZHYPO_116_Rx, system-signal=DET_PROB_1STAZHYPO_116_Rx}, {application-record-element=DET_RANGE_113_Rx, system-signal=DET_RANGE_113_Rx}, {application-record-element=DET_RANGE_114_Rx, system-signal=DET_RANGE_114_Rx}, {application-record-element=DET_RANGE_115_Rx, system-signal=DET_RANGE_115_Rx}, {application-record-element=DET_RANGE_116_Rx, system-signal=DET_RANGE_116_Rx}, {application-record-element=DET_RANGE_ERR_113_Rx, system-signal=DET_RANGE_ERR_113_Rx}, {application-record-element=DET_RANGE_ERR_114_Rx, system-signal=DET_RANGE_ERR_114_Rx}, {application-record-element=DET_RANGE_ERR_115_Rx, system-signal=DET_RANGE_ERR_115_Rx}, {application-record-element=DET_RANGE_ERR_116_Rx, system-signal=DET_RANGE_ERR_116_Rx}, {application-record-element=DET_RANGE_VELOCITY_113_Rx, system-signal=DET_RANGE_VELOCITY_113_Rx}, {application-record-element=DET_RANGE_VELOCITY_114_Rx, system-signal=DET_RANGE_VELOCITY_114_Rx}, {application-record-element=DET_RANGE_VELOCITY_115_Rx, system-signal=DET_RANGE_VELOCITY_115_Rx}, {application-record-element=DET_RANGE_VELOCITY_116_Rx, system-signal=DET_RANGE_VELOCITY_116_Rx}, {application-record-element=DET_RANGE_VELOCITY_ERR_113_Rx, system-signal=DET_RANGE_VELOCITY_ERR_113_Rx}, {application-record-element=DET_RANGE_VELOCITY_ERR_114_Rx, system-signal=DET_RANGE_VELOCITY_ERR_114_Rx}, {application-record-element=DET_RANGE_VELOCITY_ERR_115_Rx, system-signal=DET_RANGE_VELOCITY_ERR_115_Rx}, {application-record-element=DET_RANGE_VELOCITY_ERR_116_Rx, system-signal=DET_RANGE_VELOCITY_ERR_116_Rx}, {application-record-element=DET_RCS_113_Rx, system-signal=DET_RCS_113_Rx}, {application-record-element=DET_RCS_114_Rx, system-signal=DET_RCS_114_Rx}, {application-record-element=DET_RCS_115_Rx, system-signal=DET_RCS_115_Rx}, {application-record-element=DET_RCS_116_Rx, system-signal=DET_RCS_116_Rx}, {application-record-element=DET_SNR_113_Rx, system-signal=DET_SNR_113_Rx}, {application-record-element=DET_SNR_114_Rx, system-signal=DET_SNR_114_Rx}, {application-record-element=DET_SNR_115_Rx, system-signal=DET_SNR_115_Rx}, {application-record-element=DET_SNR_116_Rx, system-signal=DET_SNR_116_Rx}, {application-record-element=DET_SUPER_RES_TARGET_113_Rx, system-signal=DET_SUPER_RES_TARGET_113_Rx}, {application-record-element=DET_SUPER_RES_TARGET_114_Rx, system-signal=DET_SUPER_RES_TARGET_114_Rx}, {application-record-element=DET_SUPER_RES_TARGET_115_Rx, system-signal=DET_SUPER_RES_TARGET_115_Rx}, {application-record-element=DET_SUPER_RES_TARGET_116_Rx, system-signal=DET_SUPER_RES_TARGET_116_Rx}]}
        sender-receiver-to-signal-group-mapping={data-element=Rp_SG_Fusion_Detections_117_120_AL.Vdp_SG_Fusion_Detections_117_120_AL, signal-group=SG_Fusion_Detections_117_120, type-mapping=sender-rec-record-type-mapping=record-element-mappings=[{application-record-element=DET_AZIMUTH_117_Rx, system-signal=DET_AZIMUTH_117_Rx}, {application-record-element=DET_AZIMUTH_118_Rx, system-signal=DET_AZIMUTH_118_Rx}, {application-record-element=DET_AZIMUTH_119_Rx, system-signal=DET_AZIMUTH_119_Rx}, {application-record-element=DET_AZIMUTH_120_Rx, system-signal=DET_AZIMUTH_120_Rx}, {application-record-element=DET_AZIMUTH_ERR_117_Rx, system-signal=DET_AZIMUTH_ERR_117_Rx}, {application-record-element=DET_AZIMUTH_ERR_118_Rx, system-signal=DET_AZIMUTH_ERR_118_Rx}, {application-record-element=DET_AZIMUTH_ERR_119_Rx, system-signal=DET_AZIMUTH_ERR_119_Rx}, {application-record-element=DET_AZIMUTH_ERR_120_Rx, system-signal=DET_AZIMUTH_ERR_120_Rx}, {application-record-element=DET_BELOW_RAIN_THOLD_117_Rx, system-signal=DET_BELOW_RAIN_THOLD_117_Rx}, {application-record-element=DET_BELOW_RAIN_THOLD_118_Rx, system-signal=DET_BELOW_RAIN_THOLD_118_Rx}, {application-record-element=DET_BELOW_RAIN_THOLD_119_Rx, system-signal=DET_BELOW_RAIN_THOLD_119_Rx}, {application-record-element=DET_BELOW_RAIN_THOLD_120_Rx, system-signal=DET_BELOW_RAIN_THOLD_120_Rx}, {application-record-element=DET_BI_STATIC_FLAG_117_Rx, system-signal=DET_BI_STATIC_FLAG_117_Rx}, {application-record-element=DET_BI_STATIC_FLAG_118_Rx, system-signal=DET_BI_STATIC_FLAG_118_Rx}, {application-record-element=DET_BI_STATIC_FLAG_119_Rx, system-signal=DET_BI_STATIC_FLAG_119_Rx}, {application-record-element=DET_BI_STATIC_FLAG_120_Rx, system-signal=DET_BI_STATIC_FLAG_120_Rx}, {application-record-element=DET_CONFD_AZIMUTH_117_Rx, system-signal=DET_CONFD_AZIMUTH_117_Rx}, {application-record-element=DET_CONFD_AZIMUTH_118_Rx, system-signal=DET_CONFD_AZIMUTH_118_Rx}, {application-record-element=DET_CONFD_AZIMUTH_119_Rx, system-signal=DET_CONFD_AZIMUTH_119_Rx}, {application-record-element=DET_CONFD_AZIMUTH_120_Rx, system-signal=DET_CONFD_AZIMUTH_120_Rx}, {application-record-element=DET_CONFD_ELEVATION_117_Rx, system-signal=DET_CONFD_ELEVATION_117_Rx}, {application-record-element=DET_CONFD_ELEVATION_118_Rx, system-signal=DET_CONFD_ELEVATION_118_Rx}, {application-record-element=DET_CONFD_ELEVATION_119_Rx, system-signal=DET_CONFD_ELEVATION_119_Rx}, {application-record-element=DET_CONFD_ELEVATION_120_Rx, system-signal=DET_CONFD_ELEVATION_120_Rx}, {application-record-element=DET_ELEVATION_117_Rx, system-signal=DET_ELEVATION_117_Rx}, {application-record-element=DET_ELEVATION_118_Rx, system-signal=DET_ELEVATION_118_Rx}, {application-record-element=DET_ELEVATION_119_Rx, system-signal=DET_ELEVATION_119_Rx}, {application-record-element=DET_ELEVATION_120_Rx, system-signal=DET_ELEVATION_120_Rx}, {application-record-element=DET_ELEVATION_ERR_117_Rx, system-signal=DET_ELEVATION_ERR_117_Rx}, {application-record-element=DET_ELEVATION_ERR_118_Rx, system-signal=DET_ELEVATION_ERR_118_Rx}, {application-record-element=DET_ELEVATION_ERR_119_Rx, system-signal=DET_ELEVATION_ERR_119_Rx}, {application-record-element=DET_ELEVATION_ERR_120_Rx, system-signal=DET_ELEVATION_ERR_120_Rx}, {application-record-element=DET_EXISTENCE_PROB_117_Rx, system-signal=DET_EXISTENCE_PROB_117_Rx}, {application-record-element=DET_EXISTENCE_PROB_118_Rx, system-signal=DET_EXISTENCE_PROB_118_Rx}, {application-record-element=DET_EXISTENCE_PROB_119_Rx, system-signal=DET_EXISTENCE_PROB_119_Rx}, {application-record-element=DET_EXISTENCE_PROB_120_Rx, system-signal=DET_EXISTENCE_PROB_120_Rx}, {application-record-element=DET_HVC_FLAG_117_Rx, system-signal=DET_HVC_FLAG_117_Rx}, {application-record-element=DET_HVC_FLAG_118_Rx, system-signal=DET_HVC_FLAG_118_Rx}, {application-record-element=DET_HVC_FLAG_119_Rx, system-signal=DET_HVC_FLAG_119_Rx}, {application-record-element=DET_HVC_FLAG_120_Rx, system-signal=DET_HVC_FLAG_120_Rx}, {application-record-element=DET_IDM_117_Rx, system-signal=DET_IDM_117_Rx}, {application-record-element=DET_IDM_118_Rx, system-signal=DET_IDM_118_Rx}, {application-record-element=DET_IDM_119_Rx, system-signal=DET_IDM_119_Rx}, {application-record-element=DET_IDM_120_Rx, system-signal=DET_IDM_120_Rx}, {application-record-element=DET_MH_CRC16_117_120_Rx, system-signal=DET_MH_CRC16_117_120_Rx}, {application-record-element=DET_MH_CYCLE_COUNTER_117_120_Rx, system-signal=DET_MH_CYCLE_COUNTER_117_120_Rx}, {application-record-element=DET_MH_SCAN_INDEX_4LSB_117_120_Rx, system-signal=DET_MH_SCAN_INDEX_4LSB_117_120_Rx}, {application-record-element=DET_MTD_117_Rx, system-signal=DET_MTD_117_Rx}, {application-record-element=DET_MTD_118_Rx, system-signal=DET_MTD_118_Rx}, {application-record-element=DET_MTD_119_Rx, system-signal=DET_MTD_119_Rx}, {application-record-element=DET_MTD_120_Rx, system-signal=DET_MTD_120_Rx}, {application-record-element=DET_PROB_1STAZHYPO_117_Rx, system-signal=DET_PROB_1STAZHYPO_117_Rx}, {application-record-element=DET_PROB_1STAZHYPO_118_Rx, system-signal=DET_PROB_1STAZHYPO_118_Rx}, {application-record-element=DET_PROB_1STAZHYPO_119_Rx, system-signal=DET_PROB_1STAZHYPO_119_Rx}, {application-record-element=DET_PROB_1STAZHYPO_120_Rx, system-signal=DET_PROB_1STAZHYPO_120_Rx}, {application-record-element=DET_RANGE_117_Rx, system-signal=DET_RANGE_117_Rx}, {application-record-element=DET_RANGE_118_Rx, system-signal=DET_RANGE_118_Rx}, {application-record-element=DET_RANGE_119_Rx, system-signal=DET_RANGE_119_Rx}, {application-record-element=DET_RANGE_120_Rx, system-signal=DET_RANGE_120_Rx}, {application-record-element=DET_RANGE_ERR_117_Rx, system-signal=DET_RANGE_ERR_117_Rx}, {application-record-element=DET_RANGE_ERR_118_Rx, system-signal=DET_RANGE_ERR_118_Rx}, {application-record-element=DET_RANGE_ERR_119_Rx, system-signal=DET_RANGE_ERR_119_Rx}, {application-record-element=DET_RANGE_ERR_120_Rx, system-signal=DET_RANGE_ERR_120_Rx}, {application-record-element=DET_RANGE_VELOCITY_117_Rx, system-signal=DET_RANGE_VELOCITY_117_Rx}, {application-record-element=DET_RANGE_VELOCITY_118_Rx, system-signal=DET_RANGE_VELOCITY_118_Rx}, {application-record-element=DET_RANGE_VELOCITY_119_Rx, system-signal=DET_RANGE_VELOCITY_119_Rx}, {application-record-element=DET_RANGE_VELOCITY_120_Rx, system-signal=DET_RANGE_VELOCITY_120_Rx}, {application-record-element=DET_RANGE_VELOCITY_ERR_117_Rx, system-signal=DET_RANGE_VELOCITY_ERR_117_Rx}, {application-record-element=DET_RANGE_VELOCITY_ERR_118_Rx, system-signal=DET_RANGE_VELOCITY_ERR_118_Rx}, {application-record-element=DET_RANGE_VELOCITY_ERR_119_Rx, system-signal=DET_RANGE_VELOCITY_ERR_119_Rx}, {application-record-element=DET_RANGE_VELOCITY_ERR_120_Rx, system-signal=DET_RANGE_VELOCITY_ERR_120_Rx}, {application-record-element=DET_RCS_117_Rx, system-signal=DET_RCS_117_Rx}, {application-record-element=DET_RCS_118_Rx, system-signal=DET_RCS_118_Rx}, {application-record-element=DET_RCS_119_Rx, system-signal=DET_RCS_119_Rx}, {application-record-element=DET_RCS_120_Rx, system-signal=DET_RCS_120_Rx}, {application-record-element=DET_SNR_117_Rx, system-signal=DET_SNR_117_Rx}, {application-record-element=DET_SNR_118_Rx, system-signal=DET_SNR_118_Rx}, {application-record-element=DET_SNR_119_Rx, system-signal=DET_SNR_119_Rx}, {application-record-element=DET_SNR_120_Rx, system-signal=DET_SNR_120_Rx}, {application-record-element=DET_SUPER_RES_TARGET_117_Rx, system-signal=DET_SUPER_RES_TARGET_117_Rx}, {application-record-element=DET_SUPER_RES_TARGET_118_Rx, system-signal=DET_SUPER_RES_TARGET_118_Rx}, {application-record-element=DET_SUPER_RES_TARGET_119_Rx, system-signal=DET_SUPER_RES_TARGET_119_Rx}, {application-record-element=DET_SUPER_RES_TARGET_120_Rx, system-signal=DET_SUPER_RES_TARGET_120_Rx}]}
        sender-receiver-to-signal-group-mapping={data-element=Rp_SG_Fusion_Detections_121_124_AL.Vdp_SG_Fusion_Detections_121_124_AL, signal-group=SG_Fusion_Detections_121_124, type-mapping=sender-rec-record-type-mapping=record-element-mappings=[{application-record-element=DET_AZIMUTH_121_Rx, system-signal=DET_AZIMUTH_121_Rx}, {application-record-element=DET_AZIMUTH_122_Rx, system-signal=DET_AZIMUTH_122_Rx}, {application-record-element=DET_AZIMUTH_123_Rx, system-signal=DET_AZIMUTH_123_Rx}, {application-record-element=DET_AZIMUTH_124_Rx, system-signal=DET_AZIMUTH_124_Rx}, {application-record-element=DET_AZIMUTH_ERR_121_Rx, system-signal=DET_AZIMUTH_ERR_121_Rx}, {application-record-element=DET_AZIMUTH_ERR_122_Rx, system-signal=DET_AZIMUTH_ERR_122_Rx}, {application-record-element=DET_AZIMUTH_ERR_123_Rx, system-signal=DET_AZIMUTH_ERR_123_Rx}, {application-record-element=DET_AZIMUTH_ERR_124_Rx, system-signal=DET_AZIMUTH_ERR_124_Rx}, {application-record-element=DET_BELOW_RAIN_THOLD_121_Rx, system-signal=DET_BELOW_RAIN_THOLD_121_Rx}, {application-record-element=DET_BELOW_RAIN_THOLD_122_Rx, system-signal=DET_BELOW_RAIN_THOLD_122_Rx}, {application-record-element=DET_BELOW_RAIN_THOLD_123_Rx, system-signal=DET_BELOW_RAIN_THOLD_123_Rx}, {application-record-element=DET_BELOW_RAIN_THOLD_124_Rx, system-signal=DET_BELOW_RAIN_THOLD_124_Rx}, {application-record-element=DET_BI_STATIC_FLAG_121_Rx, system-signal=DET_BI_STATIC_FLAG_121_Rx}, {application-record-element=DET_BI_STATIC_FLAG_122_Rx, system-signal=DET_BI_STATIC_FLAG_122_Rx}, {application-record-element=DET_BI_STATIC_FLAG_123_Rx, system-signal=DET_BI_STATIC_FLAG_123_Rx}, {application-record-element=DET_BI_STATIC_FLAG_124_Rx, system-signal=DET_BI_STATIC_FLAG_124_Rx}, {application-record-element=DET_CONFD_AZIMUTH_121_Rx, system-signal=DET_CONFD_AZIMUTH_121_Rx}, {application-record-element=DET_CONFD_AZIMUTH_122_Rx, system-signal=DET_CONFD_AZIMUTH_122_Rx}, {application-record-element=DET_CONFD_AZIMUTH_123_Rx, system-signal=DET_CONFD_AZIMUTH_123_Rx}, {application-record-element=DET_CONFD_AZIMUTH_124_Rx, system-signal=DET_CONFD_AZIMUTH_124_Rx}, {application-record-element=DET_CONFD_ELEVATION_121_Rx, system-signal=DET_CONFD_ELEVATION_121_Rx}, {application-record-element=DET_CONFD_ELEVATION_122_Rx, system-signal=DET_CONFD_ELEVATION_122_Rx}, {application-record-element=DET_CONFD_ELEVATION_123_Rx, system-signal=DET_CONFD_ELEVATION_123_Rx}, {application-record-element=DET_CONFD_ELEVATION_124_Rx, system-signal=DET_CONFD_ELEVATION_124_Rx}, {application-record-element=DET_ELEVATION_121_Rx, system-signal=DET_ELEVATION_121_Rx}, {application-record-element=DET_ELEVATION_122_Rx, system-signal=DET_ELEVATION_122_Rx}, {application-record-element=DET_ELEVATION_123_Rx, system-signal=DET_ELEVATION_123_Rx}, {application-record-element=DET_ELEVATION_124_Rx, system-signal=DET_ELEVATION_124_Rx}, {application-record-element=DET_ELEVATION_ERR_121_Rx, system-signal=DET_ELEVATION_ERR_121_Rx}, {application-record-element=DET_ELEVATION_ERR_122_Rx, system-signal=DET_ELEVATION_ERR_122_Rx}, {application-record-element=DET_ELEVATION_ERR_123_Rx, system-signal=DET_ELEVATION_ERR_123_Rx}, {application-record-element=DET_ELEVATION_ERR_124_Rx, system-signal=DET_ELEVATION_ERR_124_Rx}, {application-record-element=DET_EXISTENCE_PROB_121_Rx, system-signal=DET_EXISTENCE_PROB_121_Rx}, {application-record-element=DET_EXISTENCE_PROB_122_Rx, system-signal=DET_EXISTENCE_PROB_122_Rx}, {application-record-element=DET_EXISTENCE_PROB_123_Rx, system-signal=DET_EXISTENCE_PROB_123_Rx}, {application-record-element=DET_EXISTENCE_PROB_124_Rx, system-signal=DET_EXISTENCE_PROB_124_Rx}, {application-record-element=DET_HVC_FLAG_121_Rx, system-signal=DET_HVC_FLAG_121_Rx}, {application-record-element=DET_HVC_FLAG_122_Rx, system-signal=DET_HVC_FLAG_122_Rx}, {application-record-element=DET_HVC_FLAG_123_Rx, system-signal=DET_HVC_FLAG_123_Rx}, {application-record-element=DET_HVC_FLAG_124_Rx, system-signal=DET_HVC_FLAG_124_Rx}, {application-record-element=DET_IDM_121_Rx, system-signal=DET_IDM_121_Rx}, {application-record-element=DET_IDM_122_Rx, system-signal=DET_IDM_122_Rx}, {application-record-element=DET_IDM_123_Rx, system-signal=DET_IDM_123_Rx}, {application-record-element=DET_IDM_124_Rx, system-signal=DET_IDM_124_Rx}, {application-record-element=DET_MH_CRC16_121_124_Rx, system-signal=DET_MH_CRC16_121_124_Rx}, {application-record-element=DET_MH_CYCLE_COUNTER_121_124_Rx, system-signal=DET_MH_CYCLE_COUNTER_121_124_Rx}, {application-record-element=DET_MH_SCAN_INDEX_4LSB_121_124_Rx, system-signal=DET_MH_SCAN_INDEX_4LSB_121_124_Rx}, {application-record-element=DET_MTD_121_Rx, system-signal=DET_MTD_121_Rx}, {application-record-element=DET_MTD_122_Rx, system-signal=DET_MTD_122_Rx}, {application-record-element=DET_MTD_123_Rx, system-signal=DET_MTD_123_Rx}, {application-record-element=DET_MTD_124_Rx, system-signal=DET_MTD_124_Rx}, {application-record-element=DET_PROB_1STAZHYPO_121_Rx, system-signal=DET_PROB_1STAZHYPO_121_Rx}, {application-record-element=DET_PROB_1STAZHYPO_122_Rx, system-signal=DET_PROB_1STAZHYPO_122_Rx}, {application-record-element=DET_PROB_1STAZHYPO_123_Rx, system-signal=DET_PROB_1STAZHYPO_123_Rx}, {application-record-element=DET_PROB_1STAZHYPO_124_Rx, system-signal=DET_PROB_1STAZHYPO_124_Rx}, {application-record-element=DET_RANGE_121_Rx, system-signal=DET_RANGE_121_Rx}, {application-record-element=DET_RANGE_122_Rx, system-signal=DET_RANGE_122_Rx}, {application-record-element=DET_RANGE_123_Rx, system-signal=DET_RANGE_123_Rx}, {application-record-element=DET_RANGE_124_Rx, system-signal=DET_RANGE_124_Rx}, {application-record-element=DET_RANGE_ERR_121_Rx, system-signal=DET_RANGE_ERR_121_Rx}, {application-record-element=DET_RANGE_ERR_122_Rx, system-signal=DET_RANGE_ERR_122_Rx}, {application-record-element=DET_RANGE_ERR_123_Rx, system-signal=DET_RANGE_ERR_123_Rx}, {application-record-element=DET_RANGE_ERR_124_Rx, system-signal=DET_RANGE_ERR_124_Rx}, {application-record-element=DET_RANGE_VELOCITY_121_Rx, system-signal=DET_RANGE_VELOCITY_121_Rx}, {application-record-element=DET_RANGE_VELOCITY_122_Rx, system-signal=DET_RANGE_VELOCITY_122_Rx}, {application-record-element=DET_RANGE_VELOCITY_123_Rx, system-signal=DET_RANGE_VELOCITY_123_Rx}, {application-record-element=DET_RANGE_VELOCITY_124_Rx, system-signal=DET_RANGE_VELOCITY_124_Rx}, {application-record-element=DET_RANGE_VELOCITY_ERR_121_Rx, system-signal=DET_RANGE_VELOCITY_ERR_121_Rx}, {application-record-element=DET_RANGE_VELOCITY_ERR_122_Rx, system-signal=DET_RANGE_VELOCITY_ERR_122_Rx}, {application-record-element=DET_RANGE_VELOCITY_ERR_123_Rx, system-signal=DET_RANGE_VELOCITY_ERR_123_Rx}, {application-record-element=DET_RANGE_VELOCITY_ERR_124_Rx, system-signal=DET_RANGE_VELOCITY_ERR_124_Rx}, {application-record-element=DET_RCS_121_Rx, system-signal=DET_RCS_121_Rx}, {application-record-element=DET_RCS_122_Rx, system-signal=DET_RCS_122_Rx}, {application-record-element=DET_RCS_123_Rx, system-signal=DET_RCS_123_Rx}, {application-record-element=DET_RCS_124_Rx, system-signal=DET_RCS_124_Rx}, {application-record-element=DET_SNR_121_Rx, system-signal=DET_SNR_121_Rx}, {application-record-element=DET_SNR_122_Rx, system-signal=DET_SNR_122_Rx}, {application-record-element=DET_SNR_123_Rx, system-signal=DET_SNR_123_Rx}, {application-record-element=DET_SNR_124_Rx, system-signal=DET_SNR_124_Rx}, {application-record-element=DET_SUPER_RES_TARGET_121_Rx, system-signal=DET_SUPER_RES_TARGET_121_Rx}, {application-record-element=DET_SUPER_RES_TARGET_122_Rx, system-signal=DET_SUPER_RES_TARGET_122_Rx}, {application-record-element=DET_SUPER_RES_TARGET_123_Rx, system-signal=DET_SUPER_RES_TARGET_123_Rx}, {application-record-element=DET_SUPER_RES_TARGET_124_Rx, system-signal=DET_SUPER_RES_TARGET_124_Rx}]}
        sender-receiver-to-signal-group-mapping={data-element=Rp_SG_Fusion_Detections_125_128_AL.Vdp_SG_Fusion_Detections_125_128_AL, signal-group=SG_Fusion_Detections_125_128, type-mapping=sender-rec-record-type-mapping=record-element-mappings=[{application-record-element=DET_AZIMUTH_125_Rx, system-signal=DET_AZIMUTH_125_Rx}, {application-record-element=DET_AZIMUTH_126_Rx, system-signal=DET_AZIMUTH_126_Rx}, {application-record-element=DET_AZIMUTH_127_Rx, system-signal=DET_AZIMUTH_127_Rx}, {application-record-element=DET_AZIMUTH_128_Rx, system-signal=DET_AZIMUTH_128_Rx}, {application-record-element=DET_AZIMUTH_ERR_125_Rx, system-signal=DET_AZIMUTH_ERR_125_Rx}, {application-record-element=DET_AZIMUTH_ERR_126_Rx, system-signal=DET_AZIMUTH_ERR_126_Rx}, {application-record-element=DET_AZIMUTH_ERR_127_Rx, system-signal=DET_AZIMUTH_ERR_127_Rx}, {application-record-element=DET_AZIMUTH_ERR_128_Rx, system-signal=DET_AZIMUTH_ERR_128_Rx}, {application-record-element=DET_BELOW_RAIN_THOLD_125_Rx, system-signal=DET_BELOW_RAIN_THOLD_125_Rx}, {application-record-element=DET_BELOW_RAIN_THOLD_126_Rx, system-signal=DET_BELOW_RAIN_THOLD_126_Rx}, {application-record-element=DET_BELOW_RAIN_THOLD_127_Rx, system-signal=DET_BELOW_RAIN_THOLD_127_Rx}, {application-record-element=DET_BELOW_RAIN_THOLD_128_Rx, system-signal=DET_BELOW_RAIN_THOLD_128_Rx}, {application-record-element=DET_BI_STATIC_FLAG_125_Rx, system-signal=DET_BI_STATIC_FLAG_125_Rx}, {application-record-element=DET_BI_STATIC_FLAG_126_Rx, system-signal=DET_BI_STATIC_FLAG_126_Rx}, {application-record-element=DET_BI_STATIC_FLAG_127_Rx, system-signal=DET_BI_STATIC_FLAG_127_Rx}, {application-record-element=DET_BI_STATIC_FLAG_128_Rx, system-signal=DET_BI_STATIC_FLAG_128_Rx}, {application-record-element=DET_CONFD_AZIMUTH_125_Rx, system-signal=DET_CONFD_AZIMUTH_125_Rx}, {application-record-element=DET_CONFD_AZIMUTH_126_Rx, system-signal=DET_CONFD_AZIMUTH_126_Rx}, {application-record-element=DET_CONFD_AZIMUTH_127_Rx, system-signal=DET_CONFD_AZIMUTH_127_Rx}, {application-record-element=DET_CONFD_AZIMUTH_128_Rx, system-signal=DET_CONFD_AZIMUTH_128_Rx}, {application-record-element=DET_CONFD_ELEVATION_125_Rx, system-signal=DET_CONFD_ELEVATION_125_Rx}, {application-record-element=DET_CONFD_ELEVATION_126_Rx, system-signal=DET_CONFD_ELEVATION_126_Rx}, {application-record-element=DET_CONFD_ELEVATION_127_Rx, system-signal=DET_CONFD_ELEVATION_127_Rx}, {application-record-element=DET_CONFD_ELEVATION_128_Rx, system-signal=DET_CONFD_ELEVATION_128_Rx}, {application-record-element=DET_ELEVATION_125_Rx, system-signal=DET_ELEVATION_125_Rx}, {application-record-element=DET_ELEVATION_126_Rx, system-signal=DET_ELEVATION_126_Rx}, {application-record-element=DET_ELEVATION_127_Rx, system-signal=DET_ELEVATION_127_Rx}, {application-record-element=DET_ELEVATION_128_Rx, system-signal=DET_ELEVATION_128_Rx}, {application-record-element=DET_ELEVATION_ERR_125_Rx, system-signal=DET_ELEVATION_ERR_125_Rx}, {application-record-element=DET_ELEVATION_ERR_126_Rx, system-signal=DET_ELEVATION_ERR_126_Rx}, {application-record-element=DET_ELEVATION_ERR_127_Rx, system-signal=DET_ELEVATION_ERR_127_Rx}, {application-record-element=DET_ELEVATION_ERR_128_Rx, system-signal=DET_ELEVATION_ERR_128_Rx}, {application-record-element=DET_EXISTENCE_PROB_125_Rx, system-signal=DET_EXISTENCE_PROB_125_Rx}, {application-record-element=DET_EXISTENCE_PROB_126_Rx, system-signal=DET_EXISTENCE_PROB_126_Rx}, {application-record-element=DET_EXISTENCE_PROB_127_Rx, system-signal=DET_EXISTENCE_PROB_127_Rx}, {application-record-element=DET_EXISTENCE_PROB_128_Rx, system-signal=DET_EXISTENCE_PROB_128_Rx}, {application-record-element=DET_HVC_FLAG_125_Rx, system-signal=DET_HVC_FLAG_125_Rx}, {application-record-element=DET_HVC_FLAG_126_Rx, system-signal=DET_HVC_FLAG_126_Rx}, {application-record-element=DET_HVC_FLAG_127_Rx, system-signal=DET_HVC_FLAG_127_Rx}, {application-record-element=DET_HVC_FLAG_128_Rx, system-signal=DET_HVC_FLAG_128_Rx}, {application-record-element=DET_IDM_125_Rx, system-signal=DET_IDM_125_Rx}, {application-record-element=DET_IDM_126_Rx, system-signal=DET_IDM_126_Rx}, {application-record-element=DET_IDM_127_Rx, system-signal=DET_IDM_127_Rx}, {application-record-element=DET_IDM_128_Rx, system-signal=DET_IDM_128_Rx}, {application-record-element=DET_MH_CRC16_125_128_Rx, system-signal=DET_MH_CRC16_125_128_Rx}, {application-record-element=DET_MH_CYCLE_COUNTER_125_128_Rx, system-signal=DET_MH_CYCLE_COUNTER_125_128_Rx}, {application-record-element=DET_MH_SCAN_INDEX_4LSB_125_128_Rx, system-signal=DET_MH_SCAN_INDEX_4LSB_125_128_Rx}, {application-record-element=DET_MTD_125_Rx, system-signal=DET_MTD_125_Rx}, {application-record-element=DET_MTD_126_Rx, system-signal=DET_MTD_126_Rx}, {application-record-element=DET_MTD_127_Rx, system-signal=DET_MTD_127_Rx}, {application-record-element=DET_MTD_128_Rx, system-signal=DET_MTD_128_Rx}, {application-record-element=DET_PROB_1STAZHYPO_125_Rx, system-signal=DET_PROB_1STAZHYPO_125_Rx}, {application-record-element=DET_PROB_1STAZHYPO_126_Rx, system-signal=DET_PROB_1STAZHYPO_126_Rx}, {application-record-element=DET_PROB_1STAZHYPO_127_Rx, system-signal=DET_PROB_1STAZHYPO_127_Rx}, {application-record-element=DET_PROB_1STAZHYPO_128_Rx, system-signal=DET_PROB_1STAZHYPO_128_Rx}, {application-record-element=DET_RANGE_125_Rx, system-signal=DET_RANGE_125_Rx}, {application-record-element=DET_RANGE_126_Rx, system-signal=DET_RANGE_126_Rx}, {application-record-element=DET_RANGE_127_Rx, system-signal=DET_RANGE_127_Rx}, {application-record-element=DET_RANGE_128_Rx, system-signal=DET_RANGE_128_Rx}, {application-record-element=DET_RANGE_ERR_125_Rx, system-signal=DET_RANGE_ERR_125_Rx}, {application-record-element=DET_RANGE_ERR_126_Rx, system-signal=DET_RANGE_ERR_126_Rx}, {application-record-element=DET_RANGE_ERR_127_Rx, system-signal=DET_RANGE_ERR_127_Rx}, {application-record-element=DET_RANGE_ERR_128_Rx, system-signal=DET_RANGE_ERR_128_Rx}, {application-record-element=DET_RANGE_VELOCITY_125_Rx, system-signal=DET_RANGE_VELOCITY_125_Rx}, {application-record-element=DET_RANGE_VELOCITY_126_Rx, system-signal=DET_RANGE_VELOCITY_126_Rx}, {application-record-element=DET_RANGE_VELOCITY_127_Rx, system-signal=DET_RANGE_VELOCITY_127_Rx}, {application-record-element=DET_RANGE_VELOCITY_128_Rx, system-signal=DET_RANGE_VELOCITY_128_Rx}, {application-record-element=DET_RANGE_VELOCITY_ERR_125_Rx, system-signal=DET_RANGE_VELOCITY_ERR_125_Rx}, {application-record-element=DET_RANGE_VELOCITY_ERR_126_Rx, system-signal=DET_RANGE_VELOCITY_ERR_126_Rx}, {application-record-element=DET_RANGE_VELOCITY_ERR_127_Rx, system-signal=DET_RANGE_VELOCITY_ERR_127_Rx}, {application-record-element=DET_RANGE_VELOCITY_ERR_128_Rx, system-signal=DET_RANGE_VELOCITY_ERR_128_Rx}, {application-record-element=DET_RCS_125_Rx, system-signal=DET_RCS_125_Rx}, {application-record-element=DET_RCS_126_Rx, system-signal=DET_RCS_126_Rx}, {application-record-element=DET_RCS_127_Rx, system-signal=DET_RCS_127_Rx}, {application-record-element=DET_RCS_128_Rx, system-signal=DET_RCS_128_Rx}, {application-record-element=DET_SNR_125_Rx, system-signal=DET_SNR_125_Rx}, {application-record-element=DET_SNR_126_Rx, system-signal=DET_SNR_126_Rx}, {application-record-element=DET_SNR_127_Rx, system-signal=DET_SNR_127_Rx}, {application-record-element=DET_SNR_128_Rx, system-signal=DET_SNR_128_Rx}, {application-record-element=DET_SUPER_RES_TARGET_125_Rx, system-signal=DET_SUPER_RES_TARGET_125_Rx}, {application-record-element=DET_SUPER_RES_TARGET_126_Rx, system-signal=DET_SUPER_RES_TARGET_126_Rx}, {application-record-element=DET_SUPER_RES_TARGET_127_Rx, system-signal=DET_SUPER_RES_TARGET_127_Rx}, {application-record-element=DET_SUPER_RES_TARGET_128_Rx, system-signal=DET_SUPER_RES_TARGET_128_Rx}]}
        sender-receiver-to-signal-group-mapping={data-element=Vdp_SG_Fusion_RadarHeader_AL, signal-group=SG_Fusion_RadarHeader, type-mapping=sender-rec-record-type-mapping=record-element-mappings=[{application-record-element=HED_ALIGN_HOR_REF_Rx, system-signal=HED_ALIGN_HOR_REF_Rx}, {application-record-element=HED_ALIGN_VER_REF_Rx, system-signal=HED_ALIGN_VER_REF_Rx}, {application-record-element=HED_Auth_CRC32_Rx, system-signal=HED_Auth_CRC32_Rx}, {application-record-element=HED_DATA_QUALIFIER_Rx, system-signal=HED_DATA_QUALIFIER_Rx}, {application-record-element=HED_DET_BI_STATIC_COUNT_Rx, system-signal=HED_DET_BI_STATIC_COUNT_Rx}, {application-record-element=HED_DET_NUM_OF_1PASS_Rx, system-signal=HED_DET_NUM_OF_1PASS_Rx}, {application-record-element=HED_DET_NUM_OF_2PASS_Rx, system-signal=HED_DET_NUM_OF_2PASS_Rx}, {application-record-element=HED_DET_RANGE_MAX_Rx, system-signal=HED_DET_RANGE_MAX_Rx}, {application-record-element=HED_DET_RANGE_MIN_Rx, system-signal=HED_DET_RANGE_MIN_Rx}, {application-record-element=HED_DET_SPEED_RANGE_MAX_Rx, system-signal=HED_DET_SPEED_RANGE_MAX_Rx}, {application-record-element=HED_DET_SPEED_RANGE_MIN_Rx, system-signal=HED_DET_SPEED_RANGE_MIN_Rx}, {application-record-element=HED_FOV_HOR_MAX_Rx, system-signal=HED_FOV_HOR_MAX_Rx}, {application-record-element=HED_FOV_HOR_MIN_Rx, system-signal=HED_FOV_HOR_MIN_Rx}, {application-record-element=HED_FOV_VER_MAX_Rx, system-signal=HED_FOV_VER_MAX_Rx}, {application-record-element=HED_FOV_VER_MIN_Rx, system-signal=HED_FOV_VER_MIN_Rx}, {application-record-element=HED_LOOK_ID_Rx, system-signal=HED_LOOK_ID_Rx}, {application-record-element=HED_LOOK_INDEX_Rx, system-signal=HED_LOOK_INDEX_Rx}, {application-record-element=HED_MAX_NUM_OF_DETECTIONS_Rx, system-signal=HED_MAX_NUM_OF_DETECTIONS_Rx}, {application-record-element=HED_MH_CRC16_Rx, system-signal=HED_MH_CRC16_Rx}, {application-record-element=HED_MH_CYCLE_COUNTER_Rx, system-signal=HED_MH_CYCLE_COUNTER_Rx}, {application-record-element=HED_NUM_OF_RESTBINS_USED_Rx, system-signal=HED_NUM_OF_RESTBINS_USED_Rx}, {application-record-element=HED_NUM_OF_VALID_DETECTIONS_Rx, system-signal=HED_NUM_OF_VALID_DETECTIONS_Rx}, {application-record-element=HED_OPERATION_MODE_Rx, system-signal=HED_OPERATION_MODE_Rx}, {application-record-element=HED_PROCESSED_RANGE_Rx, system-signal=HED_PROCESSED_RANGE_Rx}, {application-record-element=HED_RDR_HEADER_CMAC_Rx, system-signal=HED_RDR_HEADER_CMAC_Rx}, {application-record-element=HED_RDR_HEADER_FV_Rx, system-signal=HED_RDR_HEADER_FV_Rx}, {application-record-element=HED_R_WRAPPING_Rx, system-signal=HED_R_WRAPPING_Rx}, {application-record-element=HED_Rain_Level_Rx, system-signal=HED_Rain_Level_Rx}, {application-record-element=HED_SCAN_INDEX_Rx, system-signal=HED_SCAN_INDEX_Rx}, {application-record-element=HED_SENSOR_TIME_STAMP_NS_Rx, system-signal=HED_SENSOR_TIME_STAMP_NS_Rx}, {application-record-element=HED_SENSOR_TIME_STAMP_SEC_Rx, system-signal=HED_SENSOR_TIME_STAMP_SEC_Rx}, {application-record-element=HED_SLOPE_CORR_EXECUTIONFLAG_Rx, system-signal=HED_SLOPE_CORR_EXECUTIONFLAG_Rx}, {application-record-element=HED_TIME_SYNC_SRC_MASTER_Rx, system-signal=HED_TIME_SYNC_SRC_MASTER_Rx}, {application-record-element=HED_TIME_SYNC_VALIDITY_FLAG_Rx, system-signal=HED_TIME_SYNC_VALIDITY_FLAG_Rx}, {application-record-element=HED_TRIGGER_TIME_Rx, system-signal=HED_TRIGGER_TIME_Rx}, {application-record-element=HED_V_WRAPPING_Rx, system-signal=HED_V_WRAPPING_Rx}]}
        sender-receiver-to-signal-group-mapping={data-element=Vdp_SG_Fusion_RadarStatus_AL, signal-group=SG_Fusion_RadarStatus, type-mapping=sender-rec-record-type-mapping=record-element-mappings=[{application-record-element=STS_AF_TIME_INST_Rx, system-signal=STS_AF_TIME_INST_Rx}, {application-record-element=STS_AF_TIME_PEAK_Rx, system-signal=STS_AF_TIME_PEAK_Rx}, {application-record-element=STS_DET_DBC_BASE_VER_MAJOR_Rx, system-signal=STS_DET_DBC_BASE_VER_MAJOR_Rx}, {application-record-element=STS_DET_DBC_BASE_VER_MINOR_Rx, system-signal=STS_DET_DBC_BASE_VER_MINOR_Rx}, {application-record-element=STS_DIST_FRNT_BMPR_TO_RR_AXL_Rx, system-signal=STS_DIST_FRNT_BMPR_TO_RR_AXL_Rx}, {application-record-element=STS_HARDWARE_VERSION_Rx, system-signal=STS_HARDWARE_VERSION_Rx}, {application-record-element=STS_MAIN_CORE_TIME_INST_Rx, system-signal=STS_MAIN_CORE_TIME_INST_Rx}, {application-record-element=STS_MAIN_CORE_TIME_PEAK_Rx, system-signal=STS_MAIN_CORE_TIME_PEAK_Rx}, {application-record-element=STS_MH_001_CRC16_Rx, system-signal=STS_MH_001_CRC16_Rx}, {application-record-element=STS_MH_001_CYCLE_COUNTER_Rx, system-signal=STS_MH_001_CYCLE_COUNTER_Rx}, {application-record-element=STS_PBL_VERSION_FIELD1_Rx, system-signal=STS_PBL_VERSION_FIELD1_Rx}, {application-record-element=STS_PBL_VERSION_FIELD2_Rx, system-signal=STS_PBL_VERSION_FIELD2_Rx}, {application-record-element=STS_PBL_VERSION_FIELD3_Rx, system-signal=STS_PBL_VERSION_FIELD3_Rx}, {application-record-element=STS_PBL_VERSION_FIELD4_Rx, system-signal=STS_PBL_VERSION_FIELD4_Rx}, {application-record-element=STS_PCAN_PROTOCOL_VER_MAJOR_Rx, system-signal=STS_PCAN_PROTOCOL_VER_MAJOR_Rx}, {application-record-element=STS_PCAN_PROTOCOL_VER_MINOR_Rx, system-signal=STS_PCAN_PROTOCOL_VER_MINOR_Rx}, {application-record-element=STS_PLATFORM_VARIANT_Rx, system-signal=STS_PLATFORM_VARIANT_Rx}, {application-record-element=STS_RDD_CORE_TIME_INST_Rx, system-signal=STS_RDD_CORE_TIME_INST_Rx}, {application-record-element=STS_RDD_CORE_TIME_PEAK_Rx, system-signal=STS_RDD_CORE_TIME_PEAK_Rx}, {application-record-element=STS_SENSOR_HEIGHT_Rx, system-signal=STS_SENSOR_HEIGHT_Rx}, {application-record-element=STS_SENSOR_MOUNT_ORNT_PITCH_Rx, system-signal=STS_SENSOR_MOUNT_ORNT_PITCH_Rx}, {application-record-element=STS_SENSOR_MOUNT_ORNT_ROLL_Rx, system-signal=STS_SENSOR_MOUNT_ORNT_ROLL_Rx}, {application-record-element=STS_SENSOR_MOUNT_ORNT_YAW_Rx, system-signal=STS_SENSOR_MOUNT_ORNT_YAW_Rx}, {application-record-element=STS_SENSOR_MOUNT_POS_X_Rx, system-signal=STS_SENSOR_MOUNT_POS_X_Rx}, {application-record-element=STS_SENSOR_MOUNT_POS_Y_Rx, system-signal=STS_SENSOR_MOUNT_POS_Y_Rx}, {application-record-element=STS_SENSOR_MOUNT_POS_Z_Rx, system-signal=STS_SENSOR_MOUNT_POS_Z_Rx}, {application-record-element=STS_SENSOR_POLARITY_Rx, system-signal=STS_SENSOR_POLARITY_Rx}, {application-record-element=STS_SENSOR_POSITION_Rx, system-signal=STS_SENSOR_POSITION_Rx}, {application-record-element=STS_SERIAL_NUMBER_SEQUENCE_Rx, system-signal=STS_SERIAL_NUMBER_SEQUENCE_Rx}, {application-record-element=STS_SERIAL_NUM_JULIAN_DAY_Rx, system-signal=STS_SERIAL_NUM_JULIAN_DAY_Rx}, {application-record-element=STS_SERIAL_NUM_JULIAN_YEAR_Rx, system-signal=STS_SERIAL_NUM_JULIAN_YEAR_Rx}, {application-record-element=STS_SMC_CAL_VER_MAJOR_Rx, system-signal=STS_SMC_CAL_VER_MAJOR_Rx}, {application-record-element=STS_SMC_CAL_VER_MINOR_Rx, system-signal=STS_SMC_CAL_VER_MINOR_Rx}, {application-record-element=STS_SMC_PLATFROM_VERSION_Rx, system-signal=STS_SMC_PLATFROM_VERSION_Rx}, {application-record-element=STS_SMC_SECTION_COMPTBLITY_Rx, system-signal=STS_SMC_SECTION_COMPTBLITY_Rx}, {application-record-element=STS_SP_CORE_TIME_INST_Rx, system-signal=STS_SP_CORE_TIME_INST_Rx}, {application-record-element=STS_SP_CORE_TIME_PEAK_Rx, system-signal=STS_SP_CORE_TIME_PEAK_Rx}, {application-record-element=STS_SW_VERSION_FIELD1_Rx, system-signal=STS_SW_VERSION_FIELD1_Rx}, {application-record-element=STS_SW_VERSION_FIELD2_Rx, system-signal=STS_SW_VERSION_FIELD2_Rx}, {application-record-element=STS_SW_VERSION_FIELD3_Rx, system-signal=STS_SW_VERSION_FIELD3_Rx}, {application-record-element=STS_SW_VERSION_FIELD4_Rx, system-signal=STS_SW_VERSION_FIELD4_Rx}, {application-record-element=STS_TIME_SINCE_POWER_ON_Rx, system-signal=STS_TIME_SINCE_POWER_ON_Rx}, {application-record-element=STS_USC_CAL_VER_MAJOR_Rx, system-signal=STS_USC_CAL_VER_MAJOR_Rx}, {application-record-element=STS_USC_CAL_VER_MINOR_Rx, system-signal=STS_USC_CAL_VER_MINOR_Rx}, {application-record-element=STS_USC_SECTION_COMPTBLITY_Rx, system-signal=STS_USC_SECTION_COMPTBLITY_Rx}, {application-record-element=STS_VIN_Status_Rx, system-signal=STS_VIN_Status_Rx}]}
        sender-receiver-to-signal-group-mapping={data-element=Pp_SG_RadarCapability_AL.Vdp_SG_RadarCapability_AL, signal-group=SG_RadarCapability, type-mapping=sender-rec-record-type-mapping=record-element-mappings=[{application-record-element=CAP_AngleAzimuthRangeEnd, system-signal=CAP_AngleAzimuthRangeEnd}, {application-record-element=CAP_AngleAzimuthRangeStart, system-signal=CAP_AngleAzimuthRangeStart}, {application-record-element=CAP_BlockageActive, system-signal=CAP_BlockageActive}, {application-record-element=CAP_BlockageProbability, system-signal=CAP_BlockageProbability}, {application-record-element=CAP_BlockageSensitivity, system-signal=CAP_BlockageSensitivity}, {application-record-element=CAP_BlockageStatus, system-signal=CAP_BlockageStatus}, {application-record-element=CAP_BlockageValue, system-signal=CAP_BlockageValue}, {application-record-element=CAP_CYCLE_COUNTER, system-signal=CAP_CYCLE_COUNTER}, {application-record-element=CAP_DampingActive, system-signal=CAP_DampingActive}, {application-record-element=CAP_DampingCurrent, system-signal=CAP_DampingCurrent}, {application-record-element=CAP_DampingStandardDeviation, system-signal=CAP_DampingStandardDeviation}, {application-record-element=CAP_DampingStatus, system-signal=CAP_DampingStatus}, {application-record-element=CAP_FreeSightCheckActive, system-signal=CAP_FreeSightCheckActive}, {application-record-element=CAP_FreeSightCheckStatus, system-signal=CAP_FreeSightCheckStatus}, {application-record-element=CAP_MH_CRC16, system-signal=CAP_MH_CRC16}, {application-record-element=CAP_MaxDetRangeMotorbike_0, system-signal=CAP_MaxDetRangeMotorbike_0}, {application-record-element=CAP_MaxDetRangeMotorbike_1, system-signal=CAP_MaxDetRangeMotorbike_1}, {application-record-element=CAP_MaxDetRangeMotorbike_2, system-signal=CAP_MaxDetRangeMotorbike_2}, {application-record-element=CAP_MaxDetRangePedestrian_0, system-signal=CAP_MaxDetRangePedestrian_0}, {application-record-element=CAP_MaxDetRangePedestrian_1, system-signal=CAP_MaxDetRangePedestrian_1}, {application-record-element=CAP_MaxDetRangePedestrian_2, system-signal=CAP_MaxDetRangePedestrian_2}, {application-record-element=CAP_MaxDetectionRangeCar_0, system-signal=CAP_MaxDetectionRangeCar_0}, {application-record-element=CAP_MaxDetectionRangeCar_1, system-signal=CAP_MaxDetectionRangeCar_1}, {application-record-element=CAP_MaxDetectionRangeCar_2, system-signal=CAP_MaxDetectionRangeCar_2}, {application-record-element=CAP_RangeEstimationActive, system-signal=CAP_RangeEstimationActive}, {application-record-element=CAP_RangeEstimationStatus, system-signal=CAP_RangeEstimationStatus}, {application-record-element=CAP_SLBlockageFilterValue, system-signal=CAP_SLBlockageFilterValue}, {application-record-element=CAP_SLBlockageFlag, system-signal=CAP_SLBlockageFlag}, {application-record-element=CAP_SLLMonitoringActive, system-signal=CAP_SLLMonitoringActive}, {application-record-element=CAP_SLLMonitoringStatus, system-signal=CAP_SLLMonitoringStatus}, {application-record-element=CAP_SideLobeLevelBeamformer, system-signal=CAP_SideLobeLevelBeamformer}]}
        sender-receiver-to-signal-group-mapping={data-element=Vdp_SG_RadarHeader_AL, signal-group=SG_RadarHeader, type-mapping=sender-rec-record-type-mapping=record-element-mappings=[{application-record-element=HED_ALIGN_HOR_REF, system-signal=HED_ALIGN_HOR_REF}, {application-record-element=HED_ALIGN_VER_REF, system-signal=HED_ALIGN_VER_REF}, {application-record-element=HED_Auth_CRC32, system-signal=HED_Auth_CRC32}, {application-record-element=HED_DATA_QUALIFIER, system-signal=HED_DATA_QUALIFIER}, {application-record-element=HED_DET_BI_STATIC_COUNT, system-signal=HED_DET_BI_STATIC_COUNT}, {application-record-element=HED_DET_NUM_OF_1PASS, system-signal=HED_DET_NUM_OF_1PASS}, {application-record-element=HED_DET_NUM_OF_2PASS, system-signal=HED_DET_NUM_OF_2PASS}, {application-record-element=HED_DET_RANGE_MAX, system-signal=HED_DET_RANGE_MAX}, {application-record-element=HED_DET_RANGE_MIN, system-signal=HED_DET_RANGE_MIN}, {application-record-element=HED_DET_SPEED_RANGE_MAX, system-signal=HED_DET_SPEED_RANGE_MAX}, {application-record-element=HED_DET_SPEED_RANGE_MIN, system-signal=HED_DET_SPEED_RANGE_MIN}, {application-record-element=HED_FOV_HOR_MAX, system-signal=HED_FOV_HOR_MAX}, {application-record-element=HED_FOV_HOR_MIN, system-signal=HED_FOV_HOR_MIN}, {application-record-element=HED_FOV_VER_MAX, system-signal=HED_FOV_VER_MAX}, {application-record-element=HED_FOV_VER_MIN, system-signal=HED_FOV_VER_MIN}, {application-record-element=HED_LOOK_ID, system-signal=HED_LOOK_ID}, {application-record-element=HED_LOOK_INDEX, system-signal=HED_LOOK_INDEX}, {application-record-element=HED_MAX_NUM_OF_DETECTIONS, system-signal=HED_MAX_NUM_OF_DETECTIONS}, {application-record-element=HED_MH_CRC16, system-signal=HED_MH_CRC16}, {application-record-element=HED_MH_CYCLE_COUNTER, system-signal=HED_MH_CYCLE_COUNTER}, {application-record-element=HED_NUM_OF_RESTBINS_USED, system-signal=HED_NUM_OF_RESTBINS_USED}, {application-record-element=HED_NUM_OF_VALID_DETECTIONS, system-signal=HED_NUM_OF_VALID_DETECTIONS}, {application-record-element=HED_OPERATION_MODE, system-signal=HED_OPERATION_MODE}, {application-record-element=HED_PROCESSED_RANGE, system-signal=HED_PROCESSED_RANGE}, {application-record-element=HED_RDR_HEADER_CMAC, system-signal=HED_RDR_HEADER_CMAC}, {application-record-element=HED_RDR_HEADER_FV, system-signal=HED_RDR_HEADER_FV}, {application-record-element=HED_R_WRAPPING, system-signal=HED_R_WRAPPING}, {application-record-element=HED_Rain_Level, system-signal=HED_Rain_Level}, {application-record-element=HED_SCAN_INDEX, system-signal=HED_SCAN_INDEX}, {application-record-element=HED_SENSOR_TIME_STAMP_NS, system-signal=HED_SENSOR_TIME_STAMP_NS}, {application-record-element=HED_SENSOR_TIME_STAMP_SEC, system-signal=HED_SENSOR_TIME_STAMP_SEC}, {application-record-element=HED_SLOPE_CORR_EXECUTIONFLAG, system-signal=HED_SLOPE_CORR_EXECUTIONFLAG}, {application-record-element=HED_TIME_SYNC_SRC_MASTER, system-signal=HED_TIME_SYNC_SRC_MASTER}, {application-record-element=HED_TIME_SYNC_VALIDITY_FLAG, system-signal=HED_TIME_SYNC_VALIDITY_FLAG}, {application-record-element=HED_TRIGGER_TIME, system-signal=HED_TRIGGER_TIME}, {application-record-element=HED_V_WRAPPING, system-signal=HED_V_WRAPPING}]}
        sender-receiver-to-signal-group-mapping={data-element=Vdp_SG_RadarStatus1_AL, signal-group=SG_RadarStatus1, type-mapping=sender-rec-record-type-mapping=record-element-mappings=[{application-record-element=STS_AF_TIME_INST, system-signal=STS_AF_TIME_INST}, {application-record-element=STS_AF_TIME_PEAK, system-signal=STS_AF_TIME_PEAK}, {application-record-element=STS_DET_DBC_BASE_VER_MAJOR, system-signal=STS_DET_DBC_BASE_VER_MAJOR}, {application-record-element=STS_DET_DBC_BASE_VER_MINOR, system-signal=STS_DET_DBC_BASE_VER_MINOR}, {application-record-element=STS_DIST_FRNT_BMPR_TO_RR_AXL, system-signal=STS_DIST_FRNT_BMPR_TO_RR_AXL}, {application-record-element=STS_HARDWARE_VERSION, system-signal=STS_HARDWARE_VERSION}, {application-record-element=STS_MAIN_CORE_TIME_INST, system-signal=STS_MAIN_CORE_TIME_INST}, {application-record-element=STS_MAIN_CORE_TIME_PEAK, system-signal=STS_MAIN_CORE_TIME_PEAK}, {application-record-element=STS_MH_001_CRC16, system-signal=STS_MH_001_CRC16}, {application-record-element=STS_MH_001_CYCLE_COUNTER, system-signal=STS_MH_001_CYCLE_COUNTER}, {application-record-element=STS_PBL_VERSION_FIELD1, system-signal=STS_PBL_VERSION_FIELD1}, {application-record-element=STS_PBL_VERSION_FIELD2, system-signal=STS_PBL_VERSION_FIELD2}, {application-record-element=STS_PBL_VERSION_FIELD3, system-signal=STS_PBL_VERSION_FIELD3}, {application-record-element=STS_PBL_VERSION_FIELD4, system-signal=STS_PBL_VERSION_FIELD4}, {application-record-element=STS_PCAN_PROTOCOL_VER_MAJOR, system-signal=STS_PCAN_PROTOCOL_VER_MAJOR}, {application-record-element=STS_PCAN_PROTOCOL_VER_MINOR, system-signal=STS_PCAN_PROTOCOL_VER_MINOR}, {application-record-element=STS_PLATFORM_VARIANT, system-signal=STS_PLATFORM_VARIANT}, {application-record-element=STS_RDD_CORE_TIME_INST, system-signal=STS_RDD_CORE_TIME_INST}, {application-record-element=STS_RDD_CORE_TIME_PEAK, system-signal=STS_RDD_CORE_TIME_PEAK}, {application-record-element=STS_SENSOR_HEIGHT, system-signal=STS_SENSOR_HEIGHT}, {application-record-element=STS_SENSOR_MOUNT_ORNT_PITCH, system-signal=STS_SENSOR_MOUNT_ORNT_PITCH}, {application-record-element=STS_SENSOR_MOUNT_ORNT_ROLL, system-signal=STS_SENSOR_MOUNT_ORNT_ROLL}, {application-record-element=STS_SENSOR_MOUNT_ORNT_YAW, system-signal=STS_SENSOR_MOUNT_ORNT_YAW}, {application-record-element=STS_SENSOR_MOUNT_POS_X, system-signal=STS_SENSOR_MOUNT_POS_X}, {application-record-element=STS_SENSOR_MOUNT_POS_Y, system-signal=STS_SENSOR_MOUNT_POS_Y}, {application-record-element=STS_SENSOR_MOUNT_POS_Z, system-signal=STS_SENSOR_MOUNT_POS_Z}, {application-record-element=STS_SENSOR_POLARITY, system-signal=STS_SENSOR_POLARITY}, {application-record-element=STS_SENSOR_POSITION, system-signal=STS_SENSOR_POSITION}, {application-record-element=STS_SERIAL_NUMBER_SEQUENCE, system-signal=STS_SERIAL_NUMBER_SEQUENCE}, {application-record-element=STS_SERIAL_NUM_JULIAN_DAY, system-signal=STS_SERIAL_NUM_JULIAN_DAY}, {application-record-element=STS_SERIAL_NUM_JULIAN_YEAR, system-signal=STS_SERIAL_NUM_JULIAN_YEAR}, {application-record-element=STS_SMC_CAL_VER_MAJOR, system-signal=STS_SMC_CAL_VER_MAJOR}, {application-record-element=STS_SMC_CAL_VER_MINOR, system-signal=STS_SMC_CAL_VER_MINOR}, {application-record-element=STS_SMC_PLATFROM_VERSION, system-signal=STS_SMC_PLATFROM_VERSION}, {application-record-element=STS_SMC_SECTION_COMPTBLITY, system-signal=STS_SMC_SECTION_COMPTBLITY}, {application-record-element=STS_SP_CORE_TIME_INST, system-signal=STS_SP_CORE_TIME_INST}, {application-record-element=STS_SP_CORE_TIME_PEAK, system-signal=STS_SP_CORE_TIME_PEAK}, {application-record-element=STS_SW_VERSION_FIELD1, system-signal=STS_SW_VERSION_FIELD1}, {application-record-element=STS_SW_VERSION_FIELD2, system-signal=STS_SW_VERSION_FIELD2}, {application-record-element=STS_SW_VERSION_FIELD3, system-signal=STS_SW_VERSION_FIELD3}, {application-record-element=STS_SW_VERSION_FIELD4, system-signal=STS_SW_VERSION_FIELD4}, {application-record-element=STS_TIME_SINCE_POWER_ON, system-signal=STS_TIME_SINCE_POWER_ON}, {application-record-element=STS_USC_CAL_VER_MAJOR, system-signal=STS_USC_CAL_VER_MAJOR}, {application-record-element=STS_USC_CAL_VER_MINOR, system-signal=STS_USC_CAL_VER_MINOR}, {application-record-element=STS_USC_SECTION_COMPTBLITY, system-signal=STS_USC_SECTION_COMPTBLITY}, {application-record-element=STS_VIN_Status, system-signal=STS_VIN_Status}]}
        sender-receiver-to-signal-group-mapping={data-element=Pp_SG_RadarStatus2_AL.Vdp_SG_RadarStatus2_AL, signal-group=SG_RadarStatus2, type-mapping=sender-rec-record-type-mapping=record-element-mappings=[{application-record-element=STS_AF_CORE_THROUGHPUT, system-signal=STS_AF_CORE_THROUGHPUT}, {application-record-element=STS_BRR_STATUS, system-signal=STS_BRR_STATUS}, {application-record-element=STS_CAN_NM_State, system-signal=STS_CAN_NM_State}, {application-record-element=STS_CORE_ACTV_FLT_BYTE_0_to_3, system-signal=STS_CORE_ACTV_FLT_BYTE_0_to_3}, {application-record-element=STS_CORE_ACTV_FLT_BYTE_11_to_15, system-signal=STS_CORE_ACTV_FLT_BYTE_11_to_15}, {application-record-element=STS_CORE_ACTV_FLT_BYTE_4_to_7, system-signal=STS_CORE_ACTV_FLT_BYTE_4_to_7}, {application-record-element=STS_CORE_ACTV_FLT_BYTE_8_to_11, system-signal=STS_CORE_ACTV_FLT_BYTE_8_to_11}, {application-record-element=STS_First_CAN_Det_Inst_Latency, system-signal=STS_First_CAN_Det_Inst_Latency}, {application-record-element=STS_Gear_Position, system-signal=STS_Gear_Position}, {application-record-element=STS_INTRFC_VERSION_ID_MAJOR, system-signal=STS_INTRFC_VERSION_ID_MAJOR}, {application-record-element=STS_INTRFC_VERSION_ID_MINOR, system-signal=STS_INTRFC_VERSION_ID_MINOR}, {application-record-element=STS_INTRFC_VERSION_ID_PATCH, system-signal=STS_INTRFC_VERSION_ID_PATCH}, {application-record-element=STS_Last_CAN_Det_Inst_Latency, system-signal=STS_Last_CAN_Det_Inst_Latency}, {application-record-element=STS_MCU_TEMP, system-signal=STS_MCU_TEMP}, {application-record-element=STS_MH_002_CRC16, system-signal=STS_MH_002_CRC16}, {application-record-element=STS_MH_002_CYCLE_COUNTER, system-signal=STS_MH_002_CYCLE_COUNTER}, {application-record-element=STS_MMIC_RE_INIT_COUNT, system-signal=STS_MMIC_RE_INIT_COUNT}, {application-record-element=STS_MMIC_TEMP_RX, system-signal=STS_MMIC_TEMP_RX}, {application-record-element=STS_MMIC_TEMP_TX0, system-signal=STS_MMIC_TEMP_TX0}, {application-record-element=STS_MMIC_TEMP_TX1_2, system-signal=STS_MMIC_TEMP_TX1_2}, {application-record-element=STS_MMIC_TEMP_TX3_4, system-signal=STS_MMIC_TEMP_TX3_4}, {application-record-element=STS_NO_TSYN_ERROR, system-signal=STS_NO_TSYN_ERROR}, {application-record-element=STS_POINT_OF_TRIGGER, system-signal=STS_POINT_OF_TRIGGER}, {application-record-element=STS_RAIN_COUNT, system-signal=STS_RAIN_COUNT}, {application-record-element=STS_RDD_CORE_THROUGHPUT, system-signal=STS_RDD_CORE_THROUGHPUT}, {application-record-element=STS_SCAN_TYPE, system-signal=STS_SCAN_TYPE}, {application-record-element=STS_STEERING_ANGLE, system-signal=STS_STEERING_ANGLE}, {application-record-element=STS_STEERING_ANGLE_SIGN, system-signal=STS_STEERING_ANGLE_SIGN}, {application-record-element=STS_TIME_SYNC_OFFSET, system-signal=STS_TIME_SYNC_OFFSET}, {application-record-element=STS_TKEY_ACTV_FLT_BYTE_0_to_3, system-signal=STS_TKEY_ACTV_FLT_BYTE_0_to_3}, {application-record-element=STS_TKEY_ACTV_FLT_BYTE_4_to_5, system-signal=STS_TKEY_ACTV_FLT_BYTE_4_to_5}, {application-record-element=STS_VEHICLE_SPEED_CALC, system-signal=STS_VEHICLE_SPEED_CALC}, {application-record-element=STS_VEHICLE_SUPPLY_VOLTAGE, system-signal=STS_VEHICLE_SUPPLY_VOLTAGE}, {application-record-element=STS_VEH_SPEED_DIRECTION, system-signal=STS_VEH_SPEED_DIRECTION}, {application-record-element=STS_Vehicle_Speed_Calc_QF, system-signal=STS_Vehicle_Speed_Calc_QF}, {application-record-element=STS_XCVR_OPERATIONAL, system-signal=STS_XCVR_OPERATIONAL}, {application-record-element=STS_YAW_RATE_BIAS, system-signal=STS_YAW_RATE_BIAS}, {application-record-element=STS_Yaw_Rate_Calc_QF, system-signal=STS_Yaw_Rate_Calc_QF}]}
        sender-receiver-to-signal-group-mapping={data-element=Rp_SG_VehicleStatus_AL.Vdp_SG_VehicleStatus_AL, signal-group=SG_VehicleStatus, type-mapping=sender-rec-record-type-mapping=record-element-mappings=[{application-record-element=SSTS_CAN_PCAN_MAJOR_ADAS, system-signal=SSTS_CAN_PCAN_MAJOR_ADAS}, {application-record-element=SSTS_CAN_PCAN_MINOR_ADAS, system-signal=SSTS_CAN_PCAN_MINOR_ADAS}, {application-record-element=SSTS_DRIVE_DIR, system-signal=SSTS_DRIVE_DIR}, {application-record-element=SSTS_DRIVE_REVERSE, system-signal=SSTS_DRIVE_REVERSE}, {application-record-element=SSTS_GEAR_POSITION, system-signal=SSTS_GEAR_POSITION}, {application-record-element=SSTS_IGN_STATUS, system-signal=SSTS_IGN_STATUS}, {application-record-element=SSTS_MH_VS_CRC16, system-signal=SSTS_MH_VS_CRC16}, {application-record-element=SSTS_MH_VS_CYCLE_COUNTER, system-signal=SSTS_MH_VS_CYCLE_COUNTER}, {application-record-element=SSTS_STEERING_ANGLE, system-signal=SSTS_STEERING_ANGLE}, {application-record-element=SSTS_STEERING_ANGLE_SIGN, system-signal=SSTS_STEERING_ANGLE_SIGN}, {application-record-element=SSTS_SW_VERSION_ADAS, system-signal=SSTS_SW_VERSION_ADAS}, {application-record-element=SSTS_VEHICLE_SPEED_CALC, system-signal=SSTS_VEHICLE_SPEED_CALC}, {application-record-element=SSTS_VEHICLE_SPEED_CALC_QF, system-signal=SSTS_VEHICLE_SPEED_CALC_QF}, {application-record-element=SSTS_VEHICLE_STATE, system-signal=SSTS_VEHICLE_STATE}, {application-record-element=SSTS_VEH_AbsoluteTime_Day, system-signal=SSTS_VEH_AbsoluteTime_Day}, {application-record-element=SSTS_VEH_AbsoluteTime_Hour, system-signal=SSTS_VEH_AbsoluteTime_Hour}, {application-record-element=SSTS_VEH_AbsoluteTime_Minute, system-signal=SSTS_VEH_AbsoluteTime_Minute}, {application-record-element=SSTS_VEH_AbsoluteTime_Month, system-signal=SSTS_VEH_AbsoluteTime_Month}, {application-record-element=SSTS_VEH_AbsoluteTime_Second, system-signal=SSTS_VEH_AbsoluteTime_Second}, {application-record-element=SSTS_VEH_AbsoluteTime_Year, system-signal=SSTS_VEH_AbsoluteTime_Year}, {application-record-element=SSTS_VEH_ODOMETER, system-signal=SSTS_VEH_ODOMETER}, {application-record-element=SSTS_VEH_POWER_MODE_STATUS, system-signal=SSTS_VEH_POWER_MODE_STATUS}, {application-record-element=SSTS_VEH_SPD_COMP_FACTOR, system-signal=SSTS_VEH_SPD_COMP_FACTOR}, {application-record-element=SSTS_VEH_SYSTEM_VOLTAGE, system-signal=SSTS_VEH_SYSTEM_VOLTAGE}, {application-record-element=SSTS_VEH_Status_CMAC, system-signal=SSTS_VEH_Status_CMAC}, {application-record-element=SSTS_VEH_Status_FV, system-signal=SSTS_VEH_Status_FV}, {application-record-element=SSTS_VEH_TRAILER_CONNECTED, system-signal=SSTS_VEH_TRAILER_CONNECTED}, {application-record-element=SSTS_VEH_VARIANT, system-signal=SSTS_VEH_VARIANT}, {application-record-element=SSTS_VIN_Data_Byte0, system-signal=SSTS_VIN_Data_Byte0}, {application-record-element=SSTS_VIN_Data_Byte1, system-signal=SSTS_VIN_Data_Byte1}, {application-record-element=SSTS_VIN_Data_Byte2, system-signal=SSTS_VIN_Data_Byte2}, {application-record-element=SSTS_VIN_Data_Byte3, system-signal=SSTS_VIN_Data_Byte3}, {application-record-element=SSTS_VIN_Data_Byte4, system-signal=SSTS_VIN_Data_Byte4}, {application-record-element=SSTS_VIN_Data_Byte5, system-signal=SSTS_VIN_Data_Byte5}, {application-record-element=SSTS_VIN_Data_Byte6, system-signal=SSTS_VIN_Data_Byte6}, {application-record-element=SSTS_VIN_FrameIdx, system-signal=SSTS_VIN_FrameIdx}, {application-record-element=SSTS_YAW_RATE_BIAS, system-signal=SSTS_YAW_RATE_BIAS}, {application-record-element=SSTS_YAW_RATE_CALC, system-signal=SSTS_YAW_RATE_CALC}, {application-record-element=SSTS_YAW_RATE_CALC_QF, system-signal=SSTS_YAW_RATE_CALC_QF}]}
        sender-receiver-to-signal-group-mapping={data-element=Rp_SG_XcpCTOReq_AL.Vdp_SG_XcpCTOReq_AL, signal-group=SG_XcpCTOReq, type-mapping=sender-rec-record-type-mapping=record-element-mappings=[{implementation-record-element=STS_PID, system-signal=STS_PID}, {implementation-record-element=STS_XCP_REQ_CTO_Byte1, system-signal=STS_XCP_REQ_CTO_Byte1}, {implementation-record-element=STS_XCP_REQ_CTO_Byte10, system-signal=STS_XCP_REQ_CTO_Byte10}, {implementation-record-element=STS_XCP_REQ_CTO_Byte11, system-signal=STS_XCP_REQ_CTO_Byte11}, {implementation-record-element=STS_XCP_REQ_CTO_Byte12, system-signal=STS_XCP_REQ_CTO_Byte12}, {implementation-record-element=STS_XCP_REQ_CTO_Byte13, system-signal=STS_XCP_REQ_CTO_Byte13}, {implementation-record-element=STS_XCP_REQ_CTO_Byte14, system-signal=STS_XCP_REQ_CTO_Byte14}, {implementation-record-element=STS_XCP_REQ_CTO_Byte15, system-signal=STS_XCP_REQ_CTO_Byte15}, {implementation-record-element=STS_XCP_REQ_CTO_Byte16, system-signal=STS_XCP_REQ_CTO_Byte16}, {implementation-record-element=STS_XCP_REQ_CTO_Byte17, system-signal=STS_XCP_REQ_CTO_Byte17}, {implementation-record-element=STS_XCP_REQ_CTO_Byte18, system-signal=STS_XCP_REQ_CTO_Byte18}, {implementation-record-element=STS_XCP_REQ_CTO_Byte19, system-signal=STS_XCP_REQ_CTO_Byte19}, {implementation-record-element=STS_XCP_REQ_CTO_Byte2, system-signal=STS_XCP_REQ_CTO_Byte2}, {implementation-record-element=STS_XCP_REQ_CTO_Byte20, system-signal=STS_XCP_REQ_CTO_Byte20}, {implementation-record-element=STS_XCP_REQ_CTO_Byte21, system-signal=STS_XCP_REQ_CTO_Byte21}, {implementation-record-element=STS_XCP_REQ_CTO_Byte22, system-signal=STS_XCP_REQ_CTO_Byte22}, {implementation-record-element=STS_XCP_REQ_CTO_Byte23, system-signal=STS_XCP_REQ_CTO_Byte23}, {implementation-record-element=STS_XCP_REQ_CTO_Byte24, system-signal=STS_XCP_REQ_CTO_Byte24}, {implementation-record-element=STS_XCP_REQ_CTO_Byte25, system-signal=STS_XCP_REQ_CTO_Byte25}, {implementation-record-element=STS_XCP_REQ_CTO_Byte26, system-signal=STS_XCP_REQ_CTO_Byte26}, {implementation-record-element=STS_XCP_REQ_CTO_Byte27, system-signal=STS_XCP_REQ_CTO_Byte27}, {implementation-record-element=STS_XCP_REQ_CTO_Byte28, system-signal=STS_XCP_REQ_CTO_Byte28}, {implementation-record-element=STS_XCP_REQ_CTO_Byte29, system-signal=STS_XCP_REQ_CTO_Byte29}, {implementation-record-element=STS_XCP_REQ_CTO_Byte3, system-signal=STS_XCP_REQ_CTO_Byte3}, {implementation-record-element=STS_XCP_REQ_CTO_Byte30, system-signal=STS_XCP_REQ_CTO_Byte30}, {implementation-record-element=STS_XCP_REQ_CTO_Byte31, system-signal=STS_XCP_REQ_CTO_Byte31}, {implementation-record-element=STS_XCP_REQ_CTO_Byte32, system-signal=STS_XCP_REQ_CTO_Byte32}, {implementation-record-element=STS_XCP_REQ_CTO_Byte33, system-signal=STS_XCP_REQ_CTO_Byte33}, {implementation-record-element=STS_XCP_REQ_CTO_Byte34, system-signal=STS_XCP_REQ_CTO_Byte34}, {implementation-record-element=STS_XCP_REQ_CTO_Byte35, system-signal=STS_XCP_REQ_CTO_Byte35}, {implementation-record-element=STS_XCP_REQ_CTO_Byte36, system-signal=STS_XCP_REQ_CTO_Byte36}, {implementation-record-element=STS_XCP_REQ_CTO_Byte37, system-signal=STS_XCP_REQ_CTO_Byte37}, {implementation-record-element=STS_XCP_REQ_CTO_Byte38, system-signal=STS_XCP_REQ_CTO_Byte38}, {implementation-record-element=STS_XCP_REQ_CTO_Byte39, system-signal=STS_XCP_REQ_CTO_Byte39}, {implementation-record-element=STS_XCP_REQ_CTO_Byte4, system-signal=STS_XCP_REQ_CTO_Byte4}, {implementation-record-element=STS_XCP_REQ_CTO_Byte40, system-signal=STS_XCP_REQ_CTO_Byte40}, {implementation-record-element=STS_XCP_REQ_CTO_Byte41, system-signal=STS_XCP_REQ_CTO_Byte41}, {implementation-record-element=STS_XCP_REQ_CTO_Byte42, system-signal=STS_XCP_REQ_CTO_Byte42}, {implementation-record-element=STS_XCP_REQ_CTO_Byte43, system-signal=STS_XCP_REQ_CTO_Byte43}, {implementation-record-element=STS_XCP_REQ_CTO_Byte44, system-signal=STS_XCP_REQ_CTO_Byte44}, {implementation-record-element=STS_XCP_REQ_CTO_Byte45, system-signal=STS_XCP_REQ_CTO_Byte45}, {implementation-record-element=STS_XCP_REQ_CTO_Byte46, system-signal=STS_XCP_REQ_CTO_Byte46}, {implementation-record-element=STS_XCP_REQ_CTO_Byte47, system-signal=STS_XCP_REQ_CTO_Byte47}, {implementation-record-element=STS_XCP_REQ_CTO_Byte48, system-signal=STS_XCP_REQ_CTO_Byte48}, {implementation-record-element=STS_XCP_REQ_CTO_Byte49, system-signal=STS_XCP_REQ_CTO_Byte49}, {implementation-record-element=STS_XCP_REQ_CTO_Byte5, system-signal=STS_XCP_REQ_CTO_Byte5}, {implementation-record-element=STS_XCP_REQ_CTO_Byte50, system-signal=STS_XCP_REQ_CTO_Byte50}, {implementation-record-element=STS_XCP_REQ_CTO_Byte51, system-signal=STS_XCP_REQ_CTO_Byte51}, {implementation-record-element=STS_XCP_REQ_CTO_Byte52, system-signal=STS_XCP_REQ_CTO_Byte52}, {implementation-record-element=STS_XCP_REQ_CTO_Byte53, system-signal=STS_XCP_REQ_CTO_Byte53}, {implementation-record-element=STS_XCP_REQ_CTO_Byte54, system-signal=STS_XCP_REQ_CTO_Byte54}, {implementation-record-element=STS_XCP_REQ_CTO_Byte55, system-signal=STS_XCP_REQ_CTO_Byte55}, {implementation-record-element=STS_XCP_REQ_CTO_Byte56, system-signal=STS_XCP_REQ_CTO_Byte56}, {implementation-record-element=STS_XCP_REQ_CTO_Byte57, system-signal=STS_XCP_REQ_CTO_Byte57}, {implementation-record-element=STS_XCP_REQ_CTO_Byte58, system-signal=STS_XCP_REQ_CTO_Byte58}, {implementation-record-element=STS_XCP_REQ_CTO_Byte59, system-signal=STS_XCP_REQ_CTO_Byte59}, {implementation-record-element=STS_XCP_REQ_CTO_Byte6, system-signal=STS_XCP_REQ_CTO_Byte6}, {implementation-record-element=STS_XCP_REQ_CTO_Byte60, system-signal=STS_XCP_REQ_CTO_Byte60}, {implementation-record-element=STS_XCP_REQ_CTO_Byte61, system-signal=STS_XCP_REQ_CTO_Byte61}, {implementation-record-element=STS_XCP_REQ_CTO_Byte62, system-signal=STS_XCP_REQ_CTO_Byte62}, {implementation-record-element=STS_XCP_REQ_CTO_Byte63, system-signal=STS_XCP_REQ_CTO_Byte63}, {implementation-record-element=STS_XCP_REQ_CTO_Byte7, system-signal=STS_XCP_REQ_CTO_Byte7}, {implementation-record-element=STS_XCP_REQ_CTO_Byte8, system-signal=STS_XCP_REQ_CTO_Byte8}, {implementation-record-element=STS_XCP_REQ_CTO_Byte9, system-signal=STS_XCP_REQ_CTO_Byte9}]}
        sender-receiver-to-signal-group-mapping={data-element=Pp_SG_XcpCTOResp_AL.Vdp_SG_XcpCTOResp_AL, signal-group=SG_XcpCTOResp, type-mapping=sender-rec-record-type-mapping=record-element-mappings=[{implementation-record-element=STS_XCP_RES_CTO_Byte0, system-signal=STS_XCP_RES_CTO_Byte0}, {implementation-record-element=STS_XCP_RES_CTO_Byte1, system-signal=STS_XCP_RES_CTO_Byte1}, {implementation-record-element=STS_XCP_RES_CTO_Byte10, system-signal=STS_XCP_RES_CTO_Byte10}, {implementation-record-element=STS_XCP_RES_CTO_Byte11, system-signal=STS_XCP_RES_CTO_Byte11}, {implementation-record-element=STS_XCP_RES_CTO_Byte12, system-signal=STS_XCP_RES_CTO_Byte12}, {implementation-record-element=STS_XCP_RES_CTO_Byte13, system-signal=STS_XCP_RES_CTO_Byte13}, {implementation-record-element=STS_XCP_RES_CTO_Byte14, system-signal=STS_XCP_RES_CTO_Byte14}, {implementation-record-element=STS_XCP_RES_CTO_Byte15, system-signal=STS_XCP_RES_CTO_Byte15}, {implementation-record-element=STS_XCP_RES_CTO_Byte16, system-signal=STS_XCP_RES_CTO_Byte16}, {implementation-record-element=STS_XCP_RES_CTO_Byte17, system-signal=STS_XCP_RES_CTO_Byte17}, {implementation-record-element=STS_XCP_RES_CTO_Byte18, system-signal=STS_XCP_RES_CTO_Byte18}, {implementation-record-element=STS_XCP_RES_CTO_Byte19, system-signal=STS_XCP_RES_CTO_Byte19}, {implementation-record-element=STS_XCP_RES_CTO_Byte2, system-signal=STS_XCP_RES_CTO_Byte2}, {implementation-record-element=STS_XCP_RES_CTO_Byte20, system-signal=STS_XCP_RES_CTO_Byte20}, {implementation-record-element=STS_XCP_RES_CTO_Byte21, system-signal=STS_XCP_RES_CTO_Byte21}, {implementation-record-element=STS_XCP_RES_CTO_Byte22, system-signal=STS_XCP_RES_CTO_Byte22}, {implementation-record-element=STS_XCP_RES_CTO_Byte23, system-signal=STS_XCP_RES_CTO_Byte23}, {implementation-record-element=STS_XCP_RES_CTO_Byte24, system-signal=STS_XCP_RES_CTO_Byte24}, {implementation-record-element=STS_XCP_RES_CTO_Byte25, system-signal=STS_XCP_RES_CTO_Byte25}, {implementation-record-element=STS_XCP_RES_CTO_Byte26, system-signal=STS_XCP_RES_CTO_Byte26}, {implementation-record-element=STS_XCP_RES_CTO_Byte27, system-signal=STS_XCP_RES_CTO_Byte27}, {implementation-record-element=STS_XCP_RES_CTO_Byte28, system-signal=STS_XCP_RES_CTO_Byte28}, {implementation-record-element=STS_XCP_RES_CTO_Byte29, system-signal=STS_XCP_RES_CTO_Byte29}, {implementation-record-element=STS_XCP_RES_CTO_Byte3, system-signal=STS_XCP_RES_CTO_Byte3}, {implementation-record-element=STS_XCP_RES_CTO_Byte30, system-signal=STS_XCP_RES_CTO_Byte30}, {implementation-record-element=STS_XCP_RES_CTO_Byte31, system-signal=STS_XCP_RES_CTO_Byte31}, {implementation-record-element=STS_XCP_RES_CTO_Byte32, system-signal=STS_XCP_RES_CTO_Byte32}, {implementation-record-element=STS_XCP_RES_CTO_Byte33, system-signal=STS_XCP_RES_CTO_Byte33}, {implementation-record-element=STS_XCP_RES_CTO_Byte34, system-signal=STS_XCP_RES_CTO_Byte34}, {implementation-record-element=STS_XCP_RES_CTO_Byte35, system-signal=STS_XCP_RES_CTO_Byte35}, {implementation-record-element=STS_XCP_RES_CTO_Byte36, system-signal=STS_XCP_RES_CTO_Byte36}, {implementation-record-element=STS_XCP_RES_CTO_Byte37, system-signal=STS_XCP_RES_CTO_Byte37}, {implementation-record-element=STS_XCP_RES_CTO_Byte38, system-signal=STS_XCP_RES_CTO_Byte38}, {implementation-record-element=STS_XCP_RES_CTO_Byte39, system-signal=STS_XCP_RES_CTO_Byte39}, {implementation-record-element=STS_XCP_RES_CTO_Byte4, system-signal=STS_XCP_RES_CTO_Byte4}, {implementation-record-element=STS_XCP_RES_CTO_Byte40, system-signal=STS_XCP_RES_CTO_Byte40}, {implementation-record-element=STS_XCP_RES_CTO_Byte41, system-signal=STS_XCP_RES_CTO_Byte41}, {implementation-record-element=STS_XCP_RES_CTO_Byte42, system-signal=STS_XCP_RES_CTO_Byte42}, {implementation-record-element=STS_XCP_RES_CTO_Byte43, system-signal=STS_XCP_RES_CTO_Byte43}, {implementation-record-element=STS_XCP_RES_CTO_Byte44, system-signal=STS_XCP_RES_CTO_Byte44}, {implementation-record-element=STS_XCP_RES_CTO_Byte45, system-signal=STS_XCP_RES_CTO_Byte45}, {implementation-record-element=STS_XCP_RES_CTO_Byte46, system-signal=STS_XCP_RES_CTO_Byte46}, {implementation-record-element=STS_XCP_RES_CTO_Byte47, system-signal=STS_XCP_RES_CTO_Byte47}, {implementation-record-element=STS_XCP_RES_CTO_Byte48, system-signal=STS_XCP_RES_CTO_Byte48}, {implementation-record-element=STS_XCP_RES_CTO_Byte49, system-signal=STS_XCP_RES_CTO_Byte49}, {implementation-record-element=STS_XCP_RES_CTO_Byte5, system-signal=STS_XCP_RES_CTO_Byte5}, {implementation-record-element=STS_XCP_RES_CTO_Byte50, system-signal=STS_XCP_RES_CTO_Byte50}, {implementation-record-element=STS_XCP_RES_CTO_Byte51, system-signal=STS_XCP_RES_CTO_Byte51}, {implementation-record-element=STS_XCP_RES_CTO_Byte52, system-signal=STS_XCP_RES_CTO_Byte52}, {implementation-record-element=STS_XCP_RES_CTO_Byte53, system-signal=STS_XCP_RES_CTO_Byte53}, {implementation-record-element=STS_XCP_RES_CTO_Byte54, system-signal=STS_XCP_RES_CTO_Byte54}, {implementation-record-element=STS_XCP_RES_CTO_Byte55, system-signal=STS_XCP_RES_CTO_Byte55}, {implementation-record-element=STS_XCP_RES_CTO_Byte56, system-signal=STS_XCP_RES_CTO_Byte56}, {implementation-record-element=STS_XCP_RES_CTO_Byte57, system-signal=STS_XCP_RES_CTO_Byte57}, {implementation-record-element=STS_XCP_RES_CTO_Byte58, system-signal=STS_XCP_RES_CTO_Byte58}, {implementation-record-element=STS_XCP_RES_CTO_Byte59, system-signal=STS_XCP_RES_CTO_Byte59}, {implementation-record-element=STS_XCP_RES_CTO_Byte6, system-signal=STS_XCP_RES_CTO_Byte6}, {implementation-record-element=STS_XCP_RES_CTO_Byte60, system-signal=STS_XCP_RES_CTO_Byte60}, {implementation-record-element=STS_XCP_RES_CTO_Byte61, system-signal=STS_XCP_RES_CTO_Byte61}, {implementation-record-element=STS_XCP_RES_CTO_Byte62, system-signal=STS_XCP_RES_CTO_Byte62}, {implementation-record-element=STS_XCP_RES_CTO_Byte63, system-signal=STS_XCP_RES_CTO_Byte63}, {implementation-record-element=STS_XCP_RES_CTO_Byte7, system-signal=STS_XCP_RES_CTO_Byte7}, {implementation-record-element=STS_XCP_RES_CTO_Byte8, system-signal=STS_XCP_RES_CTO_Byte8}, {implementation-record-element=STS_XCP_RES_CTO_Byte9, system-signal=STS_XCP_RES_CTO_Byte9}]}
        sender-receiver-to-signal-group-mapping={data-element=Pp_SG_XcpDAQResp_AL.Vdp_SG_XcpDAQResp_AL, signal-group=SG_XcpDAQResp, type-mapping=sender-rec-record-type-mapping=record-element-mappings=[{implementation-record-element=STS_XCP_RES_DAQ_Byte0, system-signal=STS_XCP_RES_DAQ_Byte0}, {implementation-record-element=STS_XCP_RES_DAQ_Byte1, system-signal=STS_XCP_RES_DAQ_Byte1}, {implementation-record-element=STS_XCP_RES_DAQ_Byte10, system-signal=STS_XCP_RES_DAQ_Byte10}, {implementation-record-element=STS_XCP_RES_DAQ_Byte11, system-signal=STS_XCP_RES_DAQ_Byte11}, {implementation-record-element=STS_XCP_RES_DAQ_Byte12, system-signal=STS_XCP_RES_DAQ_Byte12}, {implementation-record-element=STS_XCP_RES_DAQ_Byte13, system-signal=STS_XCP_RES_DAQ_Byte13}, {implementation-record-element=STS_XCP_RES_DAQ_Byte14, system-signal=STS_XCP_RES_DAQ_Byte14}, {implementation-record-element=STS_XCP_RES_DAQ_Byte15, system-signal=STS_XCP_RES_DAQ_Byte15}, {implementation-record-element=STS_XCP_RES_DAQ_Byte16, system-signal=STS_XCP_RES_DAQ_Byte16}, {implementation-record-element=STS_XCP_RES_DAQ_Byte17, system-signal=STS_XCP_RES_DAQ_Byte17}, {implementation-record-element=STS_XCP_RES_DAQ_Byte18, system-signal=STS_XCP_RES_DAQ_Byte18}, {implementation-record-element=STS_XCP_RES_DAQ_Byte19, system-signal=STS_XCP_RES_DAQ_Byte19}, {implementation-record-element=STS_XCP_RES_DAQ_Byte2, system-signal=STS_XCP_RES_DAQ_Byte2}, {implementation-record-element=STS_XCP_RES_DAQ_Byte20, system-signal=STS_XCP_RES_DAQ_Byte20}, {implementation-record-element=STS_XCP_RES_DAQ_Byte21, system-signal=STS_XCP_RES_DAQ_Byte21}, {implementation-record-element=STS_XCP_RES_DAQ_Byte22, system-signal=STS_XCP_RES_DAQ_Byte22}, {implementation-record-element=STS_XCP_RES_DAQ_Byte23, system-signal=STS_XCP_RES_DAQ_Byte23}, {implementation-record-element=STS_XCP_RES_DAQ_Byte24, system-signal=STS_XCP_RES_DAQ_Byte24}, {implementation-record-element=STS_XCP_RES_DAQ_Byte25, system-signal=STS_XCP_RES_DAQ_Byte25}, {implementation-record-element=STS_XCP_RES_DAQ_Byte26, system-signal=STS_XCP_RES_DAQ_Byte26}, {implementation-record-element=STS_XCP_RES_DAQ_Byte27, system-signal=STS_XCP_RES_DAQ_Byte27}, {implementation-record-element=STS_XCP_RES_DAQ_Byte28, system-signal=STS_XCP_RES_DAQ_Byte28}, {implementation-record-element=STS_XCP_RES_DAQ_Byte29, system-signal=STS_XCP_RES_DAQ_Byte29}, {implementation-record-element=STS_XCP_RES_DAQ_Byte3, system-signal=STS_XCP_RES_DAQ_Byte3}, {implementation-record-element=STS_XCP_RES_DAQ_Byte30, system-signal=STS_XCP_RES_DAQ_Byte30}, {implementation-record-element=STS_XCP_RES_DAQ_Byte31, system-signal=STS_XCP_RES_DAQ_Byte31}, {implementation-record-element=STS_XCP_RES_DAQ_Byte32, system-signal=STS_XCP_RES_DAQ_Byte32}, {implementation-record-element=STS_XCP_RES_DAQ_Byte33, system-signal=STS_XCP_RES_DAQ_Byte33}, {implementation-record-element=STS_XCP_RES_DAQ_Byte34, system-signal=STS_XCP_RES_DAQ_Byte34}, {implementation-record-element=STS_XCP_RES_DAQ_Byte35, system-signal=STS_XCP_RES_DAQ_Byte35}, {implementation-record-element=STS_XCP_RES_DAQ_Byte36, system-signal=STS_XCP_RES_DAQ_Byte36}, {implementation-record-element=STS_XCP_RES_DAQ_Byte37, system-signal=STS_XCP_RES_DAQ_Byte37}, {implementation-record-element=STS_XCP_RES_DAQ_Byte38, system-signal=STS_XCP_RES_DAQ_Byte38}, {implementation-record-element=STS_XCP_RES_DAQ_Byte39, system-signal=STS_XCP_RES_DAQ_Byte39}, {implementation-record-element=STS_XCP_RES_DAQ_Byte4, system-signal=STS_XCP_RES_DAQ_Byte4}, {implementation-record-element=STS_XCP_RES_DAQ_Byte40, system-signal=STS_XCP_RES_DAQ_Byte40}, {implementation-record-element=STS_XCP_RES_DAQ_Byte41, system-signal=STS_XCP_RES_DAQ_Byte41}, {implementation-record-element=STS_XCP_RES_DAQ_Byte42, system-signal=STS_XCP_RES_DAQ_Byte42}, {implementation-record-element=STS_XCP_RES_DAQ_Byte43, system-signal=STS_XCP_RES_DAQ_Byte43}, {implementation-record-element=STS_XCP_RES_DAQ_Byte44, system-signal=STS_XCP_RES_DAQ_Byte44}, {implementation-record-element=STS_XCP_RES_DAQ_Byte45, system-signal=STS_XCP_RES_DAQ_Byte45}, {implementation-record-element=STS_XCP_RES_DAQ_Byte46, system-signal=STS_XCP_RES_DAQ_Byte46}, {implementation-record-element=STS_XCP_RES_DAQ_Byte47, system-signal=STS_XCP_RES_DAQ_Byte47}, {implementation-record-element=STS_XCP_RES_DAQ_Byte48, system-signal=STS_XCP_RES_DAQ_Byte48}, {implementation-record-element=STS_XCP_RES_DAQ_Byte49, system-signal=STS_XCP_RES_DAQ_Byte49}, {implementation-record-element=STS_XCP_RES_DAQ_Byte5, system-signal=STS_XCP_RES_DAQ_Byte5}, {implementation-record-element=STS_XCP_RES_DAQ_Byte50, system-signal=STS_XCP_RES_DAQ_Byte50}, {implementation-record-element=STS_XCP_RES_DAQ_Byte51, system-signal=STS_XCP_RES_DAQ_Byte51}, {implementation-record-element=STS_XCP_RES_DAQ_Byte52, system-signal=STS_XCP_RES_DAQ_Byte52}, {implementation-record-element=STS_XCP_RES_DAQ_Byte53, system-signal=STS_XCP_RES_DAQ_Byte53}, {implementation-record-element=STS_XCP_RES_DAQ_Byte54, system-signal=STS_XCP_RES_DAQ_Byte54}, {implementation-record-element=STS_XCP_RES_DAQ_Byte55, system-signal=STS_XCP_RES_DAQ_Byte55}, {implementation-record-element=STS_XCP_RES_DAQ_Byte56, system-signal=STS_XCP_RES_DAQ_Byte56}, {implementation-record-element=STS_XCP_RES_DAQ_Byte57, system-signal=STS_XCP_RES_DAQ_Byte57}, {implementation-record-element=STS_XCP_RES_DAQ_Byte58, system-signal=STS_XCP_RES_DAQ_Byte58}, {implementation-record-element=STS_XCP_RES_DAQ_Byte59, system-signal=STS_XCP_RES_DAQ_Byte59}, {implementation-record-element=STS_XCP_RES_DAQ_Byte6, system-signal=STS_XCP_RES_DAQ_Byte6}, {implementation-record-element=STS_XCP_RES_DAQ_Byte60, system-signal=STS_XCP_RES_DAQ_Byte60}, {implementation-record-element=STS_XCP_RES_DAQ_Byte61, system-signal=STS_XCP_RES_DAQ_Byte61}, {implementation-record-element=STS_XCP_RES_DAQ_Byte62, system-signal=STS_XCP_RES_DAQ_Byte62}, {implementation-record-element=STS_XCP_RES_DAQ_Byte63, system-signal=STS_XCP_RES_DAQ_Byte63}, {implementation-record-element=STS_XCP_RES_DAQ_Byte7, system-signal=STS_XCP_RES_DAQ_Byte7}, {implementation-record-element=STS_XCP_RES_DAQ_Byte8, system-signal=STS_XCP_RES_DAQ_Byte8}, {implementation-record-element=STS_XCP_RES_DAQ_Byte9, system-signal=STS_XCP_RES_DAQ_Byte9}]}
        sender-receiver-to-signal-mapping={data-element=RootComposition.PP_DetectionList_Event.DetectionList_Event, system-signal=sysSignal_RDR_1_Detections}
        sender-receiver-to-signal-mapping={data-element=RootComposition.PP_RDR_Radar_SW_Info.RDR_SW_Info, system-signal=sysSignal_RDR_1_SW_Info}
        sender-receiver-to-signal-mapping={data-element=RootComposition.PP_RDR_Radar_Status.RDR_Status, system-signal=sysSignal_RDR_1_Status}
        sender-receiver-to-signal-mapping={data-element=RootComposition.RP_Vehicle_Status.Vehicle_Status, system-signal=sysSignal_ADAS_Vehicle_Status}
        sender-receiver-to-signal-group-mapping={data-element=Rp_SG_ADAS_FN_Enable_disable_sts_ALVCAN.Vdp_SG_ADAS_FN_Enable_disable_sts_ALVCAN, signal-group=SG_ADAS_FN_Enable_disable_sts, type-mapping=sender-rec-record-type-mapping=record-element-mappings=[{implementation-record-element=BSIS_Fn_Switch_Sts, system-signal=BSIS_Fn_Switch_Sts}, {implementation-record-element=MOIS_Fn_Switch_sts, system-signal=MOIS_Fn_Switch_sts}, {implementation-record-element=MessageAliveCounter, system-signal=MessageAliveCounter}, {implementation-record-element=MessageCRC, system-signal=MessageCRC}]}
        sender-receiver-to-signal-group-mapping={data-element=Rp_SG_CCVS1_ALVCAN.Vdp_SG_CCVS1_ALVCAN, signal-group=SG_CCVS1, type-mapping=sender-rec-record-type-mapping=record-element-mappings=[{application-record-element=BrakeSwitch, system-signal=BrakeSwitch}, {application-record-element=ParkingBrakeSwitch, system-signal=ParkingBrakeSwitch}, {application-record-element=WheelBasedVehicleSpeed, system-signal=WheelBasedVehicleSpeed}]}
        sender-receiver-to-signal-group-mapping={data-element=Rp_SG_CLS_Tx_16_ALVCAN.Vdp_SG_CLS_Tx_16_ALVCAN, signal-group=SG_CLS_Tx_16, type-mapping=sender-rec-record-type-mapping=record-element-mappings=[{implementation-record-element=Crawler_confi_status_info, system-signal=Crawler_confi_status_info}, {implementation-record-element=Transmission_type_info, system-signal=Transmission_type_info}]}
        sender-receiver-to-signal-group-mapping={data-element=Rp_SG_CLS_Tx_4_ALVCAN.Vdp_SG_CLS_Tx_4_ALVCAN, signal-group=SG_CLS_Tx_4, type-mapping=sender-rec-record-type-mapping=record-element-mappings=[{implementation-record-element=Ignition, system-signal=Ignition}, {implementation-record-element=ReverseSwitchInfo, system-signal=ReverseSwitchInfo}]}
        sender-receiver-to-signal-group-mapping={data-element=Rp_SG_ETC2_00_ALVCAN.Vdp_SG_ETC2_00_ALVCAN, signal-group=SG_ETC2_00, type-mapping=sender-rec-record-type-mapping=sender-rec-record-element-mapping{application-record-element=TransCurrentGear_00, system-signal=TransCurrentGear_00}}
        sender-receiver-to-signal-group-mapping={data-element=Rp_SG_ETC2_03_ALVCAN.Vdp_SG_ETC2_03_ALVCAN, signal-group=SG_ETC2_03, type-mapping=sender-rec-record-type-mapping=sender-rec-record-element-mapping{application-record-element=TransCurrentGear_03, system-signal=TransCurrentGear_03}}
        sender-receiver-to-signal-group-mapping={data-element=Rp_SG_OEL_ALVCAN.Vdp_SG_OEL_ALVCAN, signal-group=SG_OEL, type-mapping=sender-rec-record-type-mapping=record-element-mappings=[{implementation-record-element=HazardLightSwitch, system-signal=HazardLightSwitch}, {implementation-record-element=HighLowBeamSwitch, system-signal=HighLowBeamSwitch}, {implementation-record-element=TurnSignalSwitch, system-signal=TurnSignalSwitch}]}
        sender-receiver-to-signal-group-mapping={data-element=Rp_SG_SAS_ALVCAN.Vdp_SG_SAS_ALVCAN, signal-group=SG_SAS, type-mapping=sender-rec-record-type-mapping=record-element-mappings=[{application-record-element=ActiveMode, system-signal=ActiveMode}, {application-record-element=Calibrated, system-signal=Calibrated}, {application-record-element=MessageChecksum, system-signal=MessageChecksum}, {application-record-element=MessageCounter, system-signal=MessageCounter}, {application-record-element=SteeringWheelAngle, system-signal=SteeringWheelAngle}, {application-record-element=SteeringWheelAngleRange, system-signal=SteeringWheelAngleRange}, {application-record-element=SteeringWheelAngleRangeCounter, system-signal=SteeringWheelAngleRangeCounter}, {application-record-element=SteeringWheelAngleRangeCounterType, system-signal=SteeringWheelAngleRangeCounterType}]}
        sender-receiver-to-signal-group-mapping={data-element=Rp_SG_TD_ALVCAN.Vdp_SG_TD_ALVCAN, signal-group=SG_TD, type-mapping=sender-rec-record-type-mapping=record-element-mappings=[{application-record-element=Day, system-signal=Day}, {application-record-element=Hours, system-signal=Hours}, {application-record-element=LocalHourOffset, system-signal=LocalHourOffset}, {application-record-element=LocalMinuteOffset, system-signal=LocalMinuteOffset}, {application-record-element=Minutes, system-signal=Minutes}, {application-record-element=Month, system-signal=Month}, {application-record-element=Seconds, system-signal=Seconds}, {application-record-element=Year, system-signal=Year}]}
        sender-receiver-to-signal-group-mapping={data-element=Rp_SG_VD_ALVCAN.Vdp_SG_VD_ALVCAN, signal-group=SG_VD, type-mapping=sender-rec-record-type-mapping=sender-rec-record-element-mapping{application-record-element=Total_vehicle_distance, system-signal=Total_vehicle_distance}}
        sender-receiver-to-signal-group-mapping={data-element=Rp_SG_VDC2_ALVCAN.Vdp_SG_VDC2_ALVCAN, signal-group=SG_VDC2, type-mapping=sender-rec-record-type-mapping=record-element-mappings=[{application-record-element=LateralAcceleration, system-signal=LateralAcceleration}, {application-record-element=LongitudinalAcceleration, system-signal=LongitudinalAcceleration}, {application-record-element=SteerWheelAngle, system-signal=SteerWheelAngle}, {application-record-element=YawRate, system-signal=YawRate}]}
        sender-receiver-to-signal-group-mapping={data-element=Rp_SG_VI_ALVCAN.Vdp_SG_VI_ALVCAN, signal-group=SG_VI, type-mapping=sender-rec-record-type-mapping=sender-rec-record-element-mapping{implementation-record-element=VehicleIdentification, system-signal=VehicleIdentification}}
        sender-receiver-to-signal-group-mapping={data-element=Rp_SG_Fusion_AlignmentStatus1_ALPCAN.Vdp_SG_Fusion_AlignmentStatus1_ALPCAN, signal-group=SG_Fusion_AlignmentStatus1, type-mapping=sender-rec-record-type-mapping=record-element-mappings=[{application-record-element=AL_STS_001_CYCLE_COUNTER_Rx, system-signal=AL_STS_001_CYCLE_COUNTER_Rx}, {application-record-element=AL_STS_001_MH_CRC16_Rx, system-signal=AL_STS_001_MH_CRC16_Rx}, {application-record-element=STS_AAAzimuthStd_Rx, system-signal=STS_AAAzimuthStd_Rx}, {application-record-element=STS_AACurrentAzimuth_Rx, system-signal=STS_AACurrentAzimuth_Rx}, {application-record-element=STS_AACurrentElevation_Rx, system-signal=STS_AACurrentElevation_Rx}, {application-record-element=STS_AACurrentRoll_Rx, system-signal=STS_AACurrentRoll_Rx}, {application-record-element=STS_AAElevationStd_Rx, system-signal=STS_AAElevationStd_Rx}, {application-record-element=STS_AARoll_Std_Rx, system-signal=STS_AARoll_Std_Rx}, {application-record-element=STS_AlignmentAutoStatus_Rx, system-signal=STS_AlignmentAutoStatus_Rx}, {application-record-element=STS_AlignmentAzimuth_Rx, system-signal=STS_AlignmentAzimuth_Rx}, {application-record-element=STS_AlignmentElevation_Rx, system-signal=STS_AlignmentElevation_Rx}, {application-record-element=STS_AlignmentError_Rx, system-signal=STS_AlignmentError_Rx}, {application-record-element=STS_AlignmentModeIn_Rx, system-signal=STS_AlignmentModeIn_Rx}, {application-record-element=STS_AlignmentModeOut_Rx, system-signal=STS_AlignmentModeOut_Rx}, {application-record-element=STS_AutoAlignmentFailRootCause_Rx, system-signal=STS_AutoAlignmentFailRootCause_Rx}, {application-record-element=STS_AzimuthErrorNegative_Rx, system-signal=STS_AzimuthErrorNegative_Rx}, {application-record-element=STS_AzimuthErrorPositive_Rx, system-signal=STS_AzimuthErrorPositive_Rx}, {application-record-element=STS_AzimuthStd_Rx, system-signal=STS_AzimuthStd_Rx}, {application-record-element=STS_AzimuthUpdates_Rx, system-signal=STS_AzimuthUpdates_Rx}, {application-record-element=STS_CalDisplay_Rx, system-signal=STS_CalDisplay_Rx}, {application-record-element=STS_CalTime_Rx, system-signal=STS_CalTime_Rx}, {application-record-element=STS_CoordinateSystemInput_Rx, system-signal=STS_CoordinateSystemInput_Rx}, {application-record-element=STS_ElevationErrorNegative_Rx, system-signal=STS_ElevationErrorNegative_Rx}, {application-record-element=STS_ElevationErrorPositive_Rx, system-signal=STS_ElevationErrorPositive_Rx}, {application-record-element=STS_ElevationStd_Rx, system-signal=STS_ElevationStd_Rx}, {application-record-element=STS_ElevationUpdates_Rx, system-signal=STS_ElevationUpdates_Rx}, {application-record-element=STS_HostSpdCompensationFactorQF_Rx, system-signal=STS_HostSpdCompensationFactorQF_Rx}, {application-record-element=STS_HostSpeedCompensationFactor_Rx, system-signal=STS_HostSpeedCompensationFactor_Rx}, {application-record-element=STS_InitAlignResultAzimuthUpdate_Rx, system-signal=STS_InitAlignResultAzimuthUpdate_Rx}, {application-record-element=STS_InitAlignRsltElevationUpdate_Rx, system-signal=STS_InitAlignRsltElevationUpdate_Rx}, {application-record-element=STS_InitAlignRsltHostSpdCompFac_Rx, system-signal=STS_InitAlignRsltHostSpdCompFac_Rx}, {application-record-element=STS_InitAlignmentResultAzimuth_Rx, system-signal=STS_InitAlignmentResultAzimuth_Rx}, {application-record-element=STS_InitAlignmentResultElevation_Rx, system-signal=STS_InitAlignmentResultElevation_Rx}, {application-record-element=STS_InitLastSuccessfulAlignMode_Rx, system-signal=STS_InitLastSuccessfulAlignMode_Rx}, {application-record-element=STS_ProgressPercent_Rx, system-signal=STS_ProgressPercent_Rx}, {application-record-element=STS_RadarTypeInput_Rx, system-signal=STS_RadarTypeInput_Rx}, {application-record-element=STS_RollErrorNegative_Rx, system-signal=STS_RollErrorNegative_Rx}, {application-record-element=STS_RollErrorPositive_Rx, system-signal=STS_RollErrorPositive_Rx}, {application-record-element=STS_Roll_Updates_Rx, system-signal=STS_Roll_Updates_Rx}, {application-record-element=STS_StartAzimuth_Rx, system-signal=STS_StartAzimuth_Rx}, {application-record-element=STS_StartElevation_Rx, system-signal=STS_StartElevation_Rx}, {application-record-element=STS_StartRoll_Rx, system-signal=STS_StartRoll_Rx}]}
        sender-receiver-to-signal-group-mapping={data-element=Rp_SG_Fusion_AlignmentStatus2_ALPCAN.Vdp_SG_Fusion_AlignmentStatus2_ALPCAN, signal-group=SG_Fusion_AlignmentStatus2, type-mapping=sender-rec-record-type-mapping=record-element-mappings=[{application-record-element=AL_STS_002_CYCLE_COUNTER_Rx, system-signal=AL_STS_002_CYCLE_COUNTER_Rx}, {application-record-element=AL_STS_002_MH_CRC16_Rx, system-signal=AL_STS_002_MH_CRC16_Rx}, {application-record-element=STS_AlignmentServiceStatus_Rx, system-signal=STS_AlignmentServiceStatus_Rx}, {application-record-element=STS_AlignmentShortTrackStatus_Rx, system-signal=STS_AlignmentShortTrackStatus_Rx}, {application-record-element=STS_AlignmentStaticStatus_Rx, system-signal=STS_AlignmentStaticStatus_Rx}, {application-record-element=STS_AverageNumberOfDetections_Rx, system-signal=STS_AverageNumberOfDetections_Rx}, {application-record-element=STS_AverageSpeed_Rx, system-signal=STS_AverageSpeed_Rx}, {application-record-element=STS_DistanceAbsolute_Rx, system-signal=STS_DistanceAbsolute_Rx}, {application-record-element=STS_DistanceEffective_Rx, system-signal=STS_DistanceEffective_Rx}, {application-record-element=STS_DurationAbsolute_Rx, system-signal=STS_DurationAbsolute_Rx}, {application-record-element=STS_DurationEffective_Rx, system-signal=STS_DurationEffective_Rx}, {application-record-element=STS_ImpactByInterference_Rx, system-signal=STS_ImpactByInterference_Rx}, {application-record-element=STS_MeasuredAmpSTD_Rx, system-signal=STS_MeasuredAmpSTD_Rx}, {application-record-element=STS_MeasuredRangeRateStd_Rx, system-signal=STS_MeasuredRangeRateStd_Rx}, {application-record-element=STS_MeasuredRangeRate_Rx, system-signal=STS_MeasuredRangeRate_Rx}, {application-record-element=STS_MeasuredRangeStd_Rx, system-signal=STS_MeasuredRangeStd_Rx}, {application-record-element=STS_MeasuredRawAmplitude_Rx, system-signal=STS_MeasuredRawAmplitude_Rx}, {application-record-element=STS_Measured_Range_Rx, system-signal=STS_Measured_Range_Rx}, {application-record-element=STS_VehicleCondition_Rx, system-signal=STS_VehicleCondition_Rx}]}
        sender-receiver-to-signal-group-mapping={data-element=Rp_SG_Fusion_RadarCapability_ALPCAN.Vdp_SG_Fusion_RadarCapability_ALPCAN, signal-group=SG_Fusion_RadarCapability, type-mapping=sender-rec-record-type-mapping=record-element-mappings=[{application-record-element=CAP_AngleAzimuthRangeEnd_Rx, system-signal=CAP_AngleAzimuthRangeEnd_Rx}, {application-record-element=CAP_AngleAzimuthRangeStart_Rx, system-signal=CAP_AngleAzimuthRangeStart_Rx}, {application-record-element=CAP_BlockageActive_Rx, system-signal=CAP_BlockageActive_Rx}, {application-record-element=CAP_BlockageProbability_Rx, system-signal=CAP_BlockageProbability_Rx}, {application-record-element=CAP_BlockageSensitivity_Rx, system-signal=CAP_BlockageSensitivity_Rx}, {application-record-element=CAP_BlockageStatus_Rx, system-signal=CAP_BlockageStatus_Rx}, {application-record-element=CAP_BlockageValue_Rx, system-signal=CAP_BlockageValue_Rx}, {application-record-element=CAP_CYCLE_COUNTER_Rx, system-signal=CAP_CYCLE_COUNTER_Rx}, {application-record-element=CAP_DampingActive_Rx, system-signal=CAP_DampingActive_Rx}, {application-record-element=CAP_DampingCurrent_Rx, system-signal=CAP_DampingCurrent_Rx}, {application-record-element=CAP_DampingStandardDeviation_Rx, system-signal=CAP_DampingStandardDeviation_Rx}, {application-record-element=CAP_DampingStatus_Rx, system-signal=CAP_DampingStatus_Rx}, {application-record-element=CAP_FreeSightCheckActive_Rx, system-signal=CAP_FreeSightCheckActive_Rx}, {application-record-element=CAP_FreeSightCheckStatus_Rx, system-signal=CAP_FreeSightCheckStatus_Rx}, {application-record-element=CAP_MH_CRC16_Rx, system-signal=CAP_MH_CRC16_Rx}, {application-record-element=CAP_MaxDetRangeMotorbike_0_Rx, system-signal=CAP_MaxDetRangeMotorbike_0_Rx}, {application-record-element=CAP_MaxDetRangeMotorbike_1_Rx, system-signal=CAP_MaxDetRangeMotorbike_1_Rx}, {application-record-element=CAP_MaxDetRangeMotorbike_2_Rx, system-signal=CAP_MaxDetRangeMotorbike_2_Rx}, {application-record-element=CAP_MaxDetRangePedestrian_0_Rx, system-signal=CAP_MaxDetRangePedestrian_0_Rx}, {application-record-element=CAP_MaxDetRangePedestrian_1_Rx, system-signal=CAP_MaxDetRangePedestrian_1_Rx}, {application-record-element=CAP_MaxDetRangePedestrian_2_Rx, system-signal=CAP_MaxDetRangePedestrian_2_Rx}, {application-record-element=CAP_MaxDetectionRangeCar_0_Rx, system-signal=CAP_MaxDetectionRangeCar_0_Rx}, {application-record-element=CAP_MaxDetectionRangeCar_1_Rx, system-signal=CAP_MaxDetectionRangeCar_1_Rx}, {application-record-element=CAP_MaxDetectionRangeCar_2_Rx, system-signal=CAP_MaxDetectionRangeCar_2_Rx}, {application-record-element=CAP_RangeEstimationActive_Rx, system-signal=CAP_RangeEstimationActive_Rx}, {application-record-element=CAP_RangeEstimationStatus_Rx, system-signal=CAP_RangeEstimationStatus_Rx}, {application-record-element=CAP_SLBlockageFilterValue_Rx, system-signal=CAP_SLBlockageFilterValue_Rx}, {application-record-element=CAP_SLBlockageFlag_Rx, system-signal=CAP_SLBlockageFlag_Rx}, {application-record-element=CAP_SLLMonitoringActive_Rx, system-signal=CAP_SLLMonitoringActive_Rx}, {application-record-element=CAP_SLLMonitoringStatus_Rx, system-signal=CAP_SLLMonitoringStatus_Rx}, {application-record-element=CAP_SideLobeLevelBeamformer_Rx, system-signal=CAP_SideLobeLevelBeamformer_Rx}]}
        sender-receiver-to-signal-group-mapping={data-element=Rp_SG_Fusion_RadarStatus2_ALPCAN.Vdp_SG_Fusion_RadarStatus2_ALPCAN, signal-group=SG_Fusion_RadarStatus2, type-mapping=sender-rec-record-type-mapping=record-element-mappings=[{application-record-element=STS_AF_CORE_THROUGHPUT_Rx, system-signal=STS_AF_CORE_THROUGHPUT_Rx}, {application-record-element=STS_BRR_STATUS_Rx, system-signal=STS_BRR_STATUS_Rx}, {application-record-element=STS_CAN_NM_State_Rx, system-signal=STS_CAN_NM_State_Rx}, {application-record-element=STS_CORE_ACTV_FLT_BYTE_0_to_3_Rx, system-signal=STS_CORE_ACTV_FLT_BYTE_0_to_3_Rx}, {application-record-element=STS_CORE_ACTV_FLT_BYTE_11_to_15_Rx, system-signal=STS_CORE_ACTV_FLT_BYTE_11_to_15_Rx}, {application-record-element=STS_CORE_ACTV_FLT_BYTE_4_to_7_Rx, system-signal=STS_CORE_ACTV_FLT_BYTE_4_to_7_Rx}, {application-record-element=STS_CORE_ACTV_FLT_BYTE_8_to_11_Rx, system-signal=STS_CORE_ACTV_FLT_BYTE_8_to_11_Rx}, {application-record-element=STS_First_CAN_Det_Inst_Latency_Rx, system-signal=STS_First_CAN_Det_Inst_Latency_Rx}, {application-record-element=STS_Gear_Position_Rx, system-signal=STS_Gear_Position_Rx}, {application-record-element=STS_INTRFC_VERSION_ID_MAJOR_Rx, system-signal=STS_INTRFC_VERSION_ID_MAJOR_Rx}, {application-record-element=STS_INTRFC_VERSION_ID_MINOR_Rx, system-signal=STS_INTRFC_VERSION_ID_MINOR_Rx}, {application-record-element=STS_INTRFC_VERSION_ID_PATCH_Rx, system-signal=STS_INTRFC_VERSION_ID_PATCH_Rx}, {application-record-element=STS_Last_CAN_Det_Inst_Latency_Rx, system-signal=STS_Last_CAN_Det_Inst_Latency_Rx}, {application-record-element=STS_MCU_TEMP_Rx, system-signal=STS_MCU_TEMP_Rx}, {application-record-element=STS_MH_002_CRC16_Rx, system-signal=STS_MH_002_CRC16_Rx}, {application-record-element=STS_MH_002_CYCLE_COUNTER_Rx, system-signal=STS_MH_002_CYCLE_COUNTER_Rx}, {application-record-element=STS_MMIC_RE_INIT_COUNT_Rx, system-signal=STS_MMIC_RE_INIT_COUNT_Rx}, {application-record-element=STS_MMIC_TEMP_RX_Rx, system-signal=STS_MMIC_TEMP_RX_Rx}, {application-record-element=STS_MMIC_TEMP_TX0_Rx, system-signal=STS_MMIC_TEMP_TX0_Rx}, {application-record-element=STS_MMIC_TEMP_TX1_2_Rx, system-signal=STS_MMIC_TEMP_TX1_2_Rx}, {application-record-element=STS_MMIC_TEMP_TX3_4_Rx, system-signal=STS_MMIC_TEMP_TX3_4_Rx}, {application-record-element=STS_NO_TSYN_ERROR_Rx, system-signal=STS_NO_TSYN_ERROR_Rx}, {application-record-element=STS_POINT_OF_TRIGGER_Rx, system-signal=STS_POINT_OF_TRIGGER_Rx}, {application-record-element=STS_RAIN_COUNT_Rx, system-signal=STS_RAIN_COUNT_Rx}, {application-record-element=STS_RDD_CORE_THROUGHPUT_Rx, system-signal=STS_RDD_CORE_THROUGHPUT_Rx}, {application-record-element=STS_SCAN_TYPE_Rx, system-signal=STS_SCAN_TYPE_Rx}, {application-record-element=STS_STEERING_ANGLE_Rx, system-signal=STS_STEERING_ANGLE_Rx}, {application-record-element=STS_STEERING_ANGLE_SIGN_Rx, system-signal=STS_STEERING_ANGLE_SIGN_Rx}, {application-record-element=STS_TIME_SYNC_OFFSET_Rx, system-signal=STS_TIME_SYNC_OFFSET_Rx}, {application-record-element=STS_TKEY_ACTV_FLT_BYTE_0_to_3_Rx, system-signal=STS_TKEY_ACTV_FLT_BYTE_0_to_3_Rx}, {application-record-element=STS_TKEY_ACTV_FLT_BYTE_4_to_5_Rx, system-signal=STS_TKEY_ACTV_FLT_BYTE_4_to_5_Rx}, {application-record-element=STS_VEHICLE_SPEED_CALC_Rx, system-signal=STS_VEHICLE_SPEED_CALC_Rx}, {application-record-element=STS_VEHICLE_SUPPLY_VOLTAGE_Rx, system-signal=STS_VEHICLE_SUPPLY_VOLTAGE_Rx}, {application-record-element=STS_VEH_SPEED_DIRECTION_Rx, system-signal=STS_VEH_SPEED_DIRECTION_Rx}, {application-record-element=STS_Vehicle_Speed_Calc_QF_Rx, system-signal=STS_Vehicle_Speed_Calc_QF_Rx}, {application-record-element=STS_XCVR_OPERATIONAL_Rx, system-signal=STS_XCVR_OPERATIONAL_Rx}, {application-record-element=STS_YAW_RATE_BIAS_Rx, system-signal=STS_YAW_RATE_BIAS_Rx}, {application-record-element=STS_Yaw_Rate_Calc_QF_Rx, system-signal=STS_Yaw_Rate_Calc_QF_Rx}]}
        sender-receiver-to-signal-group-mapping={data-element=Rp_SG_GW_ADAS_FN_Enable_disable_sts_ALPCAN.Vdp_SG_GW_ADAS_FN_Enable_disable_sts_ALPCAN, signal-group=SG_GW_ADAS_FN_Enable_disable_sts, type-mapping=sender-rec-record-type-mapping=record-element-mappings=[{implementation-record-element=AEBS_FN_Switch_sts, system-signal=AEBS_FN_Switch_sts}, {implementation-record-element=BSIS_fn_Switch_Sts, system-signal=BSIS_fn_Switch_Sts}, {implementation-record-element=DDAW_fn_switch_sts, system-signal=DDAW_fn_switch_sts}, {implementation-record-element=DDAW_warning_suppression, system-signal=DDAW_warning_suppression}, {implementation-record-element=LDWS_FN_Switch_sts, system-signal=LDWS_FN_Switch_sts}, {implementation-record-element=MOIS_Fn_Switch_sts, system-signal=MOIS_Fn_Switch_sts}, {implementation-record-element=MessageAliveCounter, system-signal=MessageAliveCounter}, {implementation-record-element=MessageCRC, system-signal=MessageCRC}]}
        sender-receiver-to-signal-group-mapping={data-element=Rp_SG_GW_CCVS1_ALPCAN.Vdp_SG_GW_CCVS1_ALPCAN, signal-group=SG_GW_CCVS1, type-mapping=sender-rec-record-type-mapping=record-element-mappings=[{application-record-element=BrakeSwitch, system-signal=BrakeSwitch}, {application-record-element=ParkingBrakeSwitch, system-signal=ParkingBrakeSwitch}, {application-record-element=WheelBasedVehicleSpeed, system-signal=WheelBasedVehicleSpeed}]}
        sender-receiver-to-signal-group-mapping={data-element=Rp_SG_GW_CLS_Tx_16_ALPCAN.Vdp_SG_GW_CLS_Tx_16_ALPCAN, signal-group=SG_GW_CLS_Tx_16, type-mapping=sender-rec-record-type-mapping=record-element-mappings=[{implementation-record-element=Crawler_confi_status_info, system-signal=Crawler_confi_status_info}, {implementation-record-element=Transmission_type_info, system-signal=Transmission_type_info}]}
        sender-receiver-to-signal-group-mapping={data-element=Rp_SG_GW_CLS_Tx_4_ALPCAN.Vdp_SG_GW_CLS_Tx_4_ALPCAN, signal-group=SG_GW_CLS_Tx_4, type-mapping=sender-rec-record-type-mapping=record-element-mappings=[{implementation-record-element=Ignition, system-signal=Ignition}, {implementation-record-element=ReverseSwitchInfo, system-signal=ReverseSwitchInfo}]}
        sender-receiver-to-signal-group-mapping={data-element=Rp_SG_GW_ETC2_ALPCAN.Vdp_SG_GW_ETC2_ALPCAN, signal-group=SG_GW_ETC2, type-mapping=sender-rec-record-type-mapping=sender-rec-record-element-mapping{application-record-element=TransCurrentGear_00, system-signal=TransCurrentGear_00}}
        sender-receiver-to-signal-group-mapping={data-element=Rp_SG_GW_OEL_ALPCAN.Vdp_SG_GW_OEL_ALPCAN, signal-group=SG_GW_OEL, type-mapping=sender-rec-record-type-mapping=record-element-mappings=[{implementation-record-element=HazardLightSwitch, system-signal=HazardLightSwitch}, {implementation-record-element=HighLowBeamSwitch, system-signal=HighLowBeamSwitch}, {implementation-record-element=TurnSignalSwitch, system-signal=TurnSignalSwitch}]}
        sender-receiver-to-signal-group-mapping={data-element=Rp_SG_GW_SAS_ALPCAN.Vdp_SG_GW_SAS_ALPCAN, signal-group=SG_GW_SAS, type-mapping=sender-rec-record-type-mapping=record-element-mappings=[{application-record-element=MessageChecksum, system-signal=MessageChecksum}, {application-record-element=MessageCounter, system-signal=MessageCounter}, {application-record-element=SteerAngleSensorActiveMode, system-signal=SteerAngleSensorActiveMode}, {application-record-element=SteerAngleSensorCalibrated, system-signal=SteerAngleSensorCalibrated}, {application-record-element=SteerWheelAngle, system-signal=SteerWheelAngle}, {application-record-element=SteerWheelAngleRange, system-signal=SteerWheelAngleRange}, {application-record-element=SteerWheelAngleRangeCounter, system-signal=SteerWheelAngleRangeCounter}, {application-record-element=SteerWheelAngleRangeCounterType, system-signal=SteerWheelAngleRangeCounterType}]}
        sender-receiver-to-signal-group-mapping={data-element=Rp_SG_GW_TD_ALPCAN.Vdp_SG_GW_TD_ALPCAN, signal-group=SG_GW_TD, type-mapping=sender-rec-record-type-mapping=record-element-mappings=[{application-record-element=Day, system-signal=Day}, {application-record-element=Hours, system-signal=Hours}, {application-record-element=LocalHourOffset, system-signal=LocalHourOffset}, {application-record-element=LocalMinuteOffset, system-signal=LocalMinuteOffset}, {application-record-element=Minutes, system-signal=Minutes}, {application-record-element=Month, system-signal=Month}, {application-record-element=Seconds, system-signal=Seconds}, {application-record-element=Year, system-signal=Year}]}
        sender-receiver-to-signal-group-mapping={data-element=Rp_SG_GW_VD_ALPCAN.Vdp_SG_GW_VD_ALPCAN, signal-group=SG_GW_VD, type-mapping=sender-rec-record-type-mapping=sender-rec-record-element-mapping{application-record-element=TotalVehicleDistance, system-signal=TotalVehicleDistance}}
        sender-receiver-to-signal-group-mapping={data-element=Rp_SG_GW_VI_ALPCAN.Vdp_SG_GW_VI_ALPCAN, signal-group=SG_GW_VI, type-mapping=sender-rec-record-type-mapping=sender-rec-record-element-mapping{implementation-record-element=VehicleIdentification, system-signal=VehicleIdentification}}
        sender-receiver-to-signal-group-mapping={data-element=Rp_SG_GW_ETC2_03_ALPCAN.Vdp_SG_GW_ETC2_03_ALPCAN, signal-group=SG_GW_ETC2_03, type-mapping=sender-rec-record-type-mapping=sender-rec-record-element-mapping{application-record-element=TransCurrentGear_03, system-signal=TransCurrentGear_03}}
        sender-receiver-to-signal-group-mapping={data-element=Rp_SG_GW_VDC2_ALPCAN.Vdp_SG_GW_VDC2_ALPCAN, signal-group=SG_GW_VDC2, type-mapping=sender-rec-record-type-mapping=record-element-mappings=[{application-record-element=LateralAcceleration, system-signal=LateralAcceleration}, {application-record-element=LongitudinalAcceleration, system-signal=LongitudinalAcceleration}, {application-record-element=SteerWheelAngle, system-signal=SteerWheelAngle}, {application-record-element=YawRate, system-signal=YawRate}]}
        sender-receiver-to-signal-group-mapping={data-element=Pp_SG_GW_prop_ADAS_BSIS_info_ALPCAN.Vdp_SG_GW_prop_ADAS_BSIS_info_ALPCAN, signal-group=SG_GW_prop_ADAS_BSIS_info, type-mapping=sender-rec-record-type-mapping=record-element-mappings=[{implementation-record-element=BlindSpotCollisionWarningLevel, system-signal=BlindSpotCollisionWarningLevel}, {implementation-record-element=BlindSpotDetectionState, system-signal=BlindSpotDetectionState}]}
        sender-receiver-to-signal-group-mapping={data-element=Pp_SG_RDR_BSD1_Tx_ALPCAN.Vdp_SG_RDR_BSD1_Tx_ALPCAN, signal-group=SG_RDR_BSD1_Tx, type-mapping=sender-rec-record-type-mapping=record-element-mappings=[{implementation-record-element=BlindSpotCollisionWarningLevel_Tx, system-signal=BlindSpotCollisionWarningLevel_Tx}, {implementation-record-element=BlindSpotDetectionState_Tx, system-signal=BlindSpotDetectionState_Tx}]}
        sender-receiver-to-signal-group-mapping={data-element=Pp_SG_MOIS_ALVCAN.Vdp_SG_MOIS_ALVCAN, signal-group=SG_MOIS, type-mapping=sender-rec-record-type-mapping=record-element-mappings=[{implementation-record-element=MOISCollisionWarningLevel, system-signal=MOISCollisionWarningLevel}, {implementation-record-element=MovingObjectDetectionState, system-signal=MovingObjectDetectionState}]}
        sender-receiver-to-signal-group-mapping={data-element=Pp_SG_prop_ADAS_MOIS_info_ALVCAN.Vdp_SG_prop_ADAS_MOIS_info_ALVCAN, signal-group=SG_prop_ADAS_MOIS_info, type-mapping=sender-rec-record-type-mapping=record-element-mappings=[{implementation-record-element=rdn_MOISCollisionWarningLevel, system-signal=rdn_MOISCollisionWarningLevel}, {implementation-record-element=rdn_MovingObjectDetectionState, system-signal=rdn_MovingObjectDetectionState}]}
        sender-receiver-to-signal-group-mapping={data-element=Rp_SG_Fusion_RadarHeader_ALPCAN.Vdp_SG_Fusion_RadarHeader_ALPCAN, signal-group=SG_Fusion_RadarHeader, type-mapping=sender-rec-record-type-mapping=record-element-mappings=[{application-record-element=HED_ALIGN_HOR_REF_Rx, system-signal=HED_ALIGN_HOR_REF_Rx}, {application-record-element=HED_ALIGN_VER_REF_Rx, system-signal=HED_ALIGN_VER_REF_Rx}, {application-record-element=HED_Auth_CRC32_Rx, system-signal=HED_Auth_CRC32_Rx}, {application-record-element=HED_DATA_QUALIFIER_Rx, system-signal=HED_DATA_QUALIFIER_Rx}, {application-record-element=HED_DET_BI_STATIC_COUNT_Rx, system-signal=HED_DET_BI_STATIC_COUNT_Rx}, {application-record-element=HED_DET_NUM_OF_1PASS_Rx, system-signal=HED_DET_NUM_OF_1PASS_Rx}, {application-record-element=HED_DET_NUM_OF_2PASS_Rx, system-signal=HED_DET_NUM_OF_2PASS_Rx}, {application-record-element=HED_DET_RANGE_MAX_Rx, system-signal=HED_DET_RANGE_MAX_Rx}, {application-record-element=HED_DET_RANGE_MIN_Rx, system-signal=HED_DET_RANGE_MIN_Rx}, {application-record-element=HED_DET_SPEED_RANGE_MAX_Rx, system-signal=HED_DET_SPEED_RANGE_MAX_Rx}, {application-record-element=HED_DET_SPEED_RANGE_MIN_Rx, system-signal=HED_DET_SPEED_RANGE_MIN_Rx}, {application-record-element=HED_FOV_HOR_MAX_Rx, system-signal=HED_FOV_HOR_MAX_Rx}, {application-record-element=HED_FOV_HOR_MIN_Rx, system-signal=HED_FOV_HOR_MIN_Rx}, {application-record-element=HED_FOV_VER_MAX_Rx, system-signal=HED_FOV_VER_MAX_Rx}, {application-record-element=HED_FOV_VER_MIN_Rx, system-signal=HED_FOV_VER_MIN_Rx}, {application-record-element=HED_LOOK_ID_Rx, system-signal=HED_LOOK_ID_Rx}, {application-record-element=HED_LOOK_INDEX_Rx, system-signal=HED_LOOK_INDEX_Rx}, {application-record-element=HED_MAX_NUM_OF_DETECTIONS_Rx, system-signal=HED_MAX_NUM_OF_DETECTIONS_Rx}, {application-record-element=HED_MH_CRC16_Rx, system-signal=HED_MH_CRC16_Rx}, {application-record-element=HED_MH_CYCLE_COUNTER_Rx, system-signal=HED_MH_CYCLE_COUNTER_Rx}, {application-record-element=HED_NUM_OF_RESTBINS_USED_Rx, system-signal=HED_NUM_OF_RESTBINS_USED_Rx}, {application-record-element=HED_NUM_OF_VALID_DETECTIONS_Rx, system-signal=HED_NUM_OF_VALID_DETECTIONS_Rx}, {application-record-element=HED_OPERATION_MODE_Rx, system-signal=HED_OPERATION_MODE_Rx}, {application-record-element=HED_PROCESSED_RANGE_Rx, system-signal=HED_PROCESSED_RANGE_Rx}, {application-record-element=HED_RDR_HEADER_CMAC_Rx, system-signal=HED_RDR_HEADER_CMAC_Rx}, {application-record-element=HED_RDR_HEADER_FV_Rx, system-signal=HED_RDR_HEADER_FV_Rx}, {application-record-element=HED_R_WRAPPING_Rx, system-signal=HED_R_WRAPPING_Rx}, {application-record-element=HED_Rain_Level_Rx, system-signal=HED_Rain_Level_Rx}, {application-record-element=HED_SCAN_INDEX_Rx, system-signal=HED_SCAN_INDEX_Rx}, {application-record-element=HED_SENSOR_TIME_STAMP_NS_Rx, system-signal=HED_SENSOR_TIME_STAMP_NS_Rx}, {application-record-element=HED_SENSOR_TIME_STAMP_SEC_Rx, system-signal=HED_SENSOR_TIME_STAMP_SEC_Rx}, {application-record-element=HED_SLOPE_CORR_EXECUTIONFLAG_Rx, system-signal=HED_SLOPE_CORR_EXECUTIONFLAG_Rx}, {application-record-element=HED_TIME_SYNC_SRC_MASTER_Rx, system-signal=HED_TIME_SYNC_SRC_MASTER_Rx}, {application-record-element=HED_TIME_SYNC_VALIDITY_FLAG_Rx, system-signal=HED_TIME_SYNC_VALIDITY_FLAG_Rx}, {application-record-element=HED_TRIGGER_TIME_Rx, system-signal=HED_TRIGGER_TIME_Rx}, {application-record-element=HED_V_WRAPPING_Rx, system-signal=HED_V_WRAPPING_Rx}]}
        sender-receiver-to-signal-group-mapping={data-element=Rp_SG_Fusion_RadarStatus_ALPCAN.Vdp_SG_Fusion_RadarStatus_ALPCAN, signal-group=SG_Fusion_RadarStatus, type-mapping=sender-rec-record-type-mapping=record-element-mappings=[{application-record-element=STS_AF_TIME_INST_Rx, system-signal=STS_AF_TIME_INST_Rx}, {application-record-element=STS_AF_TIME_PEAK_Rx, system-signal=STS_AF_TIME_PEAK_Rx}, {application-record-element=STS_DET_DBC_BASE_VER_MAJOR_Rx, system-signal=STS_DET_DBC_BASE_VER_MAJOR_Rx}, {application-record-element=STS_DET_DBC_BASE_VER_MINOR_Rx, system-signal=STS_DET_DBC_BASE_VER_MINOR_Rx}, {application-record-element=STS_DIST_FRNT_BMPR_TO_RR_AXL_Rx, system-signal=STS_DIST_FRNT_BMPR_TO_RR_AXL_Rx}, {application-record-element=STS_HARDWARE_VERSION_Rx, system-signal=STS_HARDWARE_VERSION_Rx}, {application-record-element=STS_MAIN_CORE_TIME_INST_Rx, system-signal=STS_MAIN_CORE_TIME_INST_Rx}, {application-record-element=STS_MAIN_CORE_TIME_PEAK_Rx, system-signal=STS_MAIN_CORE_TIME_PEAK_Rx}, {application-record-element=STS_MH_001_CRC16_Rx, system-signal=STS_MH_001_CRC16_Rx}, {application-record-element=STS_MH_001_CYCLE_COUNTER_Rx, system-signal=STS_MH_001_CYCLE_COUNTER_Rx}, {application-record-element=STS_PBL_VERSION_FIELD1_Rx, system-signal=STS_PBL_VERSION_FIELD1_Rx}, {application-record-element=STS_PBL_VERSION_FIELD2_Rx, system-signal=STS_PBL_VERSION_FIELD2_Rx}, {application-record-element=STS_PBL_VERSION_FIELD3_Rx, system-signal=STS_PBL_VERSION_FIELD3_Rx}, {application-record-element=STS_PBL_VERSION_FIELD4_Rx, system-signal=STS_PBL_VERSION_FIELD4_Rx}, {application-record-element=STS_PCAN_PROTOCOL_VER_MAJOR_Rx, system-signal=STS_PCAN_PROTOCOL_VER_MAJOR_Rx}, {application-record-element=STS_PCAN_PROTOCOL_VER_MINOR_Rx, system-signal=STS_PCAN_PROTOCOL_VER_MINOR_Rx}, {application-record-element=STS_PLATFORM_VARIANT_Rx, system-signal=STS_PLATFORM_VARIANT_Rx}, {application-record-element=STS_RDD_CORE_TIME_INST_Rx, system-signal=STS_RDD_CORE_TIME_INST_Rx}, {application-record-element=STS_RDD_CORE_TIME_PEAK_Rx, system-signal=STS_RDD_CORE_TIME_PEAK_Rx}, {application-record-element=STS_SENSOR_HEIGHT_Rx, system-signal=STS_SENSOR_HEIGHT_Rx}, {application-record-element=STS_SENSOR_MOUNT_ORNT_PITCH_Rx, system-signal=STS_SENSOR_MOUNT_ORNT_PITCH_Rx}, {application-record-element=STS_SENSOR_MOUNT_ORNT_ROLL_Rx, system-signal=STS_SENSOR_MOUNT_ORNT_ROLL_Rx}, {application-record-element=STS_SENSOR_MOUNT_ORNT_YAW_Rx, system-signal=STS_SENSOR_MOUNT_ORNT_YAW_Rx}, {application-record-element=STS_SENSOR_MOUNT_POS_X_Rx, system-signal=STS_SENSOR_MOUNT_POS_X_Rx}, {application-record-element=STS_SENSOR_MOUNT_POS_Y_Rx, system-signal=STS_SENSOR_MOUNT_POS_Y_Rx}, {application-record-element=STS_SENSOR_MOUNT_POS_Z_Rx, system-signal=STS_SENSOR_MOUNT_POS_Z_Rx}, {application-record-element=STS_SENSOR_POLARITY_Rx, system-signal=STS_SENSOR_POLARITY_Rx}, {application-record-element=STS_SENSOR_POSITION_Rx, system-signal=STS_SENSOR_POSITION_Rx}, {application-record-element=STS_SERIAL_NUMBER_SEQUENCE_Rx, system-signal=STS_SERIAL_NUMBER_SEQUENCE_Rx}, {application-record-element=STS_SERIAL_NUM_JULIAN_DAY_Rx, system-signal=STS_SERIAL_NUM_JULIAN_DAY_Rx}, {application-record-element=STS_SERIAL_NUM_JULIAN_YEAR_Rx, system-signal=STS_SERIAL_NUM_JULIAN_YEAR_Rx}, {application-record-element=STS_SMC_CAL_VER_MAJOR_Rx, system-signal=STS_SMC_CAL_VER_MAJOR_Rx}, {application-record-element=STS_SMC_CAL_VER_MINOR_Rx, system-signal=STS_SMC_CAL_VER_MINOR_Rx}, {application-record-element=STS_SMC_PLATFROM_VERSION_Rx, system-signal=STS_SMC_PLATFROM_VERSION_Rx}, {application-record-element=STS_SMC_SECTION_COMPTBLITY_Rx, system-signal=STS_SMC_SECTION_COMPTBLITY_Rx}, {application-record-element=STS_SP_CORE_TIME_INST_Rx, system-signal=STS_SP_CORE_TIME_INST_Rx}, {application-record-element=STS_SP_CORE_TIME_PEAK_Rx, system-signal=STS_SP_CORE_TIME_PEAK_Rx}, {application-record-element=STS_SW_VERSION_FIELD1_Rx, system-signal=STS_SW_VERSION_FIELD1_Rx}, {application-record-element=STS_SW_VERSION_FIELD2_Rx, system-signal=STS_SW_VERSION_FIELD2_Rx}, {application-record-element=STS_SW_VERSION_FIELD3_Rx, system-signal=STS_SW_VERSION_FIELD3_Rx}, {application-record-element=STS_SW_VERSION_FIELD4_Rx, system-signal=STS_SW_VERSION_FIELD4_Rx}, {application-record-element=STS_TIME_SINCE_POWER_ON_Rx, system-signal=STS_TIME_SINCE_POWER_ON_Rx}, {application-record-element=STS_USC_CAL_VER_MAJOR_Rx, system-signal=STS_USC_CAL_VER_MAJOR_Rx}, {application-record-element=STS_USC_CAL_VER_MINOR_Rx, system-signal=STS_USC_CAL_VER_MINOR_Rx}, {application-record-element=STS_USC_SECTION_COMPTBLITY_Rx, system-signal=STS_USC_SECTION_COMPTBLITY_Rx}, {application-record-element=STS_VIN_Status_Rx, system-signal=STS_VIN_Status_Rx}]}
