[part 2 of 10: package /System]
AUTOSAR XML (schema 00053)
package /System  (continued)
  system System  (continued)
    system mapping System_MPPNG  (continued)
      data-mappings:  (continued)
        sender-receiver-to-signal-group-mapping={data-element=Pp_SG_TrackerObject008.Vdp_SG_TrackerObject008, signal-group=SG_TrackerObject008, type-mapping=sender-rec-record-type-mapping=record-element-mappings=[{implementation-record-element=OBJ_CLS_TYPE2_001, system-signal=OBJ_CLS_TYPE2_008}, {implementation-record-element=OBJ_MH_CRC16_001, system-signal=OBJ_MH_CRC16_008}, {implementation-record-element=OBJ_ALIVE_TIME_001, system-signal=OBJ_ALIVE_TIME_008}, {implementation-record-element=OBJ_MH_CYCLE_COUNTER_001, system-signal=OBJ_MH_CYCLE_COUNTER_008}, {implementation-record-element=OBJ_MOVEMENT_STATUS_001, system-signal=OBJ_MOVEMENT_STATUS_008}, {implementation-record-element=OBJ_POS_ERR_CRR_COEF_001, system-signal=OBJ_POS_ERR_CRR_COEF_008}, {implementation-record-element=OBJ_ACCEL_ERR_CRR_COEF_001, system-signal=OBJ_ACCEL_ERR_CRR_COEF_008}, {implementation-record-element=OBJ_ACCELERATION_LAT_ERR_001, system-signal=OBJ_ACCELERATION_LAT_ERR_008}, {implementation-record-element=OBJ_ACCELERATION_LONG_001, system-signal=OBJ_ACCELERATION_LONG_008}, {implementation-record-element=OBJ_POS_LAT_001, system-signal=OBJ_POS_LAT_008}, {implementation-record-element=OBJ_POS_LONG_ERR_001, system-signal=OBJ_POS_LONG_ERR_008}, {implementation-record-element=OBJ_RCS_001, system-signal=OBJ_RCS_008}, {implementation-record-element=OBJ_DIMENSION_LENGTH_001, system-signal=OBJ_DIMENSION_LENGTH_008}, {implementation-record-element=OBJ_REF_PT_LAT_OFFSET_001, system-signal=OBJ_REF_PT_LAT_OFFSET_008}, {implementation-record-element=OBJ_REF_PT_LONG_OFFSET_001, system-signal=OBJ_REF_PT_LONG_OFFSET_008}, {implementation-record-element=OBJ_CLS_TYPE4_PROB_001, system-signal=OBJ_CLS_TYPE4_PROB_008}, {implementation-record-element=OBJ_TIMESTAMP_OFFSET_001, system-signal=OBJ_TIMESTAMP_OFFSET_008}, {implementation-record-element=OBJ_CLS_TYPE4_001, system-signal=OBJ_CLS_TYPE4_008}, {implementation-record-element=OBJ_CLS_TYPE3_001, system-signal=OBJ_CLS_TYPE3_008}, {implementation-record-element=OBJ_CLS_TYPE2_PROB_001, system-signal=OBJ_CLS_TYPE2_PROB_008}, {implementation-record-element=OBJ_CLS_TYPE3_PROB_001, system-signal=OBJ_CLS_TYPE3_PROB_008}, {implementation-record-element=OBJ_CLS_TYPE5_001, system-signal=OBJ_CLS_TYPE5_008}, {implementation-record-element=OBJ_DIMENSION_WIDTH_ERR_001, system-signal=OBJ_DIMENSION_WIDTH_ERR_008}, {implementation-record-element=OBJ_POS_LAT_ERR_001, system-signal=OBJ_POS_LAT_ERR_008}, {implementation-record-element=OBJ_GROUP_ID_001, system-signal=OBJ_GROUP_ID_008}, {implementation-record-element=OBJ_POS_LONG_001, system-signal=OBJ_POS_LONG_008}, {implementation-record-element=OBJ_CLS_TYPE6_PROB_001, system-signal=OBJ_CLS_TYPE6_PROB_008}, {implementation-record-element=OBJ_CLS_TYPE1_001, system-signal=OBJ_CLS_TYPE1_008}, {implementation-record-element=OBJ_CLS_TYPE1_PROB_001, system-signal=OBJ_CLS_TYPE1_PROB_008}, {implementation-record-element=OBJ_DIMENSION_LENGTH_ERR_001, system-signal=OBJ_DIMENSION_LENGTH_ERR_008}, {implementation-record-element=OBJ_EXISTENCE_PROB_001, system-signal=OBJ_EXISTENCE_PROB_008}, {implementation-record-element=OBJ_ID_001, system-signal=OBJ_ID_008}, {implementation-record-element=OBJ_MEASUREMENT_STATUS_001, system-signal=OBJ_MEASUREMENT_STATUS_008}, {implementation-record-element=OBJ_TRACK_MOTION_MODEL_001, system-signal=OBJ_TRACK_MOTION_MODEL_008}, {implementation-record-element=OBJ_VEH_TRACK_FLAG_001, system-signal=OBJ_VEH_TRACK_FLAG_008}, {implementation-record-element=OBJ_ACCELERATION_LAT_001, system-signal=OBJ_ACCELERATION_LAT_008}, {implementation-record-element=OBJ_CLS_TYPE6_001, system-signal=OBJ_CLS_TYPE6_008}, {implementation-record-element=OBJ_ACCELERATION_LONG_ERR_001, system-signal=OBJ_ACCELERATION_LONG_ERR_008}, {implementation-record-element=OBJ_CLS_TYPE5_PROB_001, system-signal=OBJ_CLS_TYPE5_PROB_008}, {implementation-record-element=OBJ_DIMENSION_WIDTH_001, system-signal=OBJ_DIMENSION_WIDTH_008}, {implementation-record-element=OBJ_YAW_RATE_ERR_001, system-signal=OBJ_YAW_RATE_ERR_008}, {implementation-record-element=OBJ_VELOCITY_LONG_ERR_001, system-signal=OBJ_VELOCITY_LONG_ERR_008}, {implementation-record-element=OBJ_YAW_ANGLE_001, system-signal=OBJ_YAW_ANGLE_008}, {implementation-record-element=OBJ_YAW_RATE_001, system-signal=OBJ_YAW_RATE_008}, {implementation-record-element=OBJ_VELOCITY_ERR_CRR_COEF_001, system-signal=OBJ_VELOCITY_ERR_CRR_COEF_008}, {implementation-record-element=OBJ_YAW_ANGLE_ERR_001, system-signal=OBJ_YAW_ANGLE_ERR_008}, {implementation-record-element=OBJ_VELOCITY_LAT_001, system-signal=OBJ_VELOCITY_LAT_008}, {implementation-record-element=OBJ_VELOCITY_LAT_ERR_001, system-signal=OBJ_VELOCITY_LAT_ERR_008}, {implementation-record-element=OBJ_VELOCITY_LONG_001, system-signal=OBJ_VELOCITY_LONG_008}]}
        sender-receiver-to-signal-group-mapping={data-element=Pp_SG_TrackerObject009.Vdp_SG_TrackerObject009, signal-group=SG_TrackerObject009, type-mapping=sender-rec-record-type-mapping=record-element-mappings=[{implementation-record-element=OBJ_CLS_TYPE2_001, system-signal=OBJ_CLS_TYPE2_009}, {implementation-record-element=OBJ_ALIVE_TIME_001, system-signal=OBJ_ALIVE_TIME_009}, {implementation-record-element=OBJ_CLS_TYPE5_001, system-signal=OBJ_CLS_TYPE5_009}, {implementation-record-element=OBJ_DIMENSION_LENGTH_001, system-signal=OBJ_DIMENSION_LENGTH_009}, {implementation-record-element=OBJ_MH_CYCLE_COUNTER_001, system-signal=OBJ_MH_CYCLE_COUNTER_009}, {implementation-record-element=OBJ_REF_PT_LAT_OFFSET_001, system-signal=OBJ_REF_PT_LAT_OFFSET_009}, {implementation-record-element=OBJ_VEH_TRACK_FLAG_001, system-signal=OBJ_VEH_TRACK_FLAG_009}, {implementation-record-element=OBJ_VELOCITY_LAT_ERR_001, system-signal=OBJ_VELOCITY_LAT_ERR_009}, {implementation-record-element=OBJ_CLS_TYPE5_PROB_001, system-signal=OBJ_CLS_TYPE5_PROB_009}, {implementation-record-element=OBJ_REF_PT_LONG_OFFSET_001, system-signal=OBJ_REF_PT_LONG_OFFSET_009}, {implementation-record-element=OBJ_POS_ERR_CRR_COEF_001, system-signal=OBJ_POS_ERR_CRR_COEF_009}, {implementation-record-element=OBJ_MOVEMENT_STATUS_001, system-signal=OBJ_MOVEMENT_STATUS_009}, {implementation-record-element=OBJ_POS_LAT_001, system-signal=OBJ_POS_LAT_009}, {implementation-record-element=OBJ_CLS_TYPE6_PROB_001, system-signal=OBJ_CLS_TYPE6_PROB_009}, {implementation-record-element=OBJ_CLS_TYPE2_PROB_001, system-signal=OBJ_CLS_TYPE2_PROB_009}, {implementation-record-element=OBJ_CLS_TYPE3_001, system-signal=OBJ_CLS_TYPE3_009}, {implementation-record-element=OBJ_DIMENSION_LENGTH_ERR_001, system-signal=OBJ_DIMENSION_LENGTH_ERR_009}, {implementation-record-element=OBJ_CLS_TYPE1_PROB_001, system-signal=OBJ_CLS_TYPE1_PROB_009}, {implementation-record-element=OBJ_DIMENSION_WIDTH_ERR_001, system-signal=OBJ_DIMENSION_WIDTH_ERR_009}, {implementation-record-element=OBJ_POS_LONG_001, system-signal=OBJ_POS_LONG_009}, {implementation-record-element=OBJ_TIMESTAMP_OFFSET_001, system-signal=OBJ_TIMESTAMP_OFFSET_009}, {implementation-record-element=OBJ_ACCELERATION_LAT_ERR_001, system-signal=OBJ_ACCELERATION_LAT_ERR_009}, {implementation-record-element=OBJ_DIMENSION_WIDTH_001, system-signal=OBJ_DIMENSION_WIDTH_009}, {implementation-record-element=OBJ_GROUP_ID_001, system-signal=OBJ_GROUP_ID_009}, {implementation-record-element=OBJ_TRACK_MOTION_MODEL_001, system-signal=OBJ_TRACK_MOTION_MODEL_009}, {implementation-record-element=OBJ_ACCELERATION_LAT_001, system-signal=OBJ_ACCELERATION_LAT_009}, {implementation-record-element=OBJ_CLS_TYPE6_001, system-signal=OBJ_CLS_TYPE6_009}, {implementation-record-element=OBJ_MEASUREMENT_STATUS_001, system-signal=OBJ_MEASUREMENT_STATUS_009}, {implementation-record-element=OBJ_VELOCITY_LAT_001, system-signal=OBJ_VELOCITY_LAT_009}, {implementation-record-element=OBJ_VELOCITY_LONG_001, system-signal=OBJ_VELOCITY_LONG_009}, {implementation-record-element=OBJ_EXISTENCE_PROB_001, system-signal=OBJ_EXISTENCE_PROB_009}, {implementation-record-element=OBJ_MH_CRC16_001, system-signal=OBJ_MH_CRC16_009}, {implementation-record-element=OBJ_POS_LAT_ERR_001, system-signal=OBJ_POS_LAT_ERR_009}, {implementation-record-element=OBJ_VELOCITY_LONG_ERR_001, system-signal=OBJ_VELOCITY_LONG_ERR_009}, {implementation-record-element=OBJ_CLS_TYPE3_PROB_001, system-signal=OBJ_CLS_TYPE3_PROB_009}, {implementation-record-element=OBJ_VELOCITY_ERR_CRR_COEF_001, system-signal=OBJ_VELOCITY_ERR_CRR_COEF_009}, {implementation-record-element=OBJ_YAW_ANGLE_ERR_001, system-signal=OBJ_YAW_ANGLE_ERR_009}, {implementation-record-element=OBJ_YAW_RATE_ERR_001, system-signal=OBJ_YAW_RATE_ERR_009}, {implementation-record-element=OBJ_YAW_RATE_001, system-signal=OBJ_YAW_RATE_009}, {implementation-record-element=OBJ_YAW_ANGLE_001, system-signal=OBJ_YAW_ANGLE_009}, {implementation-record-element=OBJ_ACCELERATION_LONG_001, system-signal=OBJ_ACCELERATION_LONG_009}, {implementation-record-element=OBJ_CLS_TYPE4_001, system-signal=OBJ_CLS_TYPE4_009}, {implementation-record-element=OBJ_CLS_TYPE4_PROB_001, system-signal=OBJ_CLS_TYPE4_PROB_009}, {implementation-record-element=OBJ_CLS_TYPE1_001, system-signal=OBJ_CLS_TYPE1_009}, {implementation-record-element=OBJ_ID_001, system-signal=OBJ_ID_009}, {implementation-record-element=OBJ_POS_LONG_ERR_001, system-signal=OBJ_POS_LONG_ERR_009}, {implementation-record-element=OBJ_RCS_001, system-signal=OBJ_RCS_009}, {implementation-record-element=OBJ_ACCELERATION_LONG_ERR_001, system-signal=OBJ_ACCELERATION_LONG_ERR_009}, {implementation-record-element=OBJ_ACCEL_ERR_CRR_COEF_001, system-signal=OBJ_ACCEL_ERR_CRR_COEF_009}]}
        sender-receiver-to-signal-group-mapping={data-element=Pp_SG_TrackerObject010.Vdp_SG_TrackerObject010, signal-group=SG_TrackerObject010, type-mapping=sender-rec-record-type-mapping=record-element-mappings=[{implementation-record-element=OBJ_ACCEL_ERR_CRR_COEF_001, system-signal=OBJ_ACCEL_ERR_CRR_COEF_010}, {implementation-record-element=OBJ_ACCELERATION_LAT_001, system-signal=OBJ_ACCELERATION_LAT_010}, {implementation-record-element=OBJ_ACCELERATION_LAT_ERR_001, system-signal=OBJ_ACCELERATION_LAT_ERR_010}, {implementation-record-element=OBJ_ACCELERATION_LONG_001, system-signal=OBJ_ACCELERATION_LONG_010}, {implementation-record-element=OBJ_CLS_TYPE6_PROB_001, system-signal=OBJ_CLS_TYPE6_PROB_010}, {implementation-record-element=OBJ_VELOCITY_LAT_001, system-signal=OBJ_VELOCITY_LAT_010}, {implementation-record-element=OBJ_CLS_TYPE1_001, system-signal=OBJ_CLS_TYPE1_010}, {implementation-record-element=OBJ_ALIVE_TIME_001, system-signal=OBJ_ALIVE_TIME_010}, {implementation-record-element=OBJ_CLS_TYPE2_PROB_001, system-signal=OBJ_CLS_TYPE2_PROB_010}, {implementation-record-element=OBJ_CLS_TYPE3_001, system-signal=OBJ_CLS_TYPE3_010}, {implementation-record-element=OBJ_MEASUREMENT_STATUS_001, system-signal=OBJ_MEASUREMENT_STATUS_010}, {implementation-record-element=OBJ_POS_ERR_CRR_COEF_001, system-signal=OBJ_POS_ERR_CRR_COEF_010}, {implementation-record-element=OBJ_POS_LAT_001, system-signal=OBJ_POS_LAT_010}, {implementation-record-element=OBJ_POS_LONG_ERR_001, system-signal=OBJ_POS_LONG_ERR_010}, {implementation-record-element=OBJ_RCS_001, system-signal=OBJ_RCS_010}, {implementation-record-element=OBJ_VELOCITY_LAT_ERR_001, system-signal=OBJ_VELOCITY_LAT_ERR_010}, {implementation-record-element=OBJ_YAW_RATE_ERR_001, system-signal=OBJ_YAW_RATE_ERR_010}, {implementation-record-element=OBJ_CLS_TYPE5_001, system-signal=OBJ_CLS_TYPE5_010}, {implementation-record-element=OBJ_CLS_TYPE5_PROB_001, system-signal=OBJ_CLS_TYPE5_PROB_010}, {implementation-record-element=OBJ_TRACK_MOTION_MODEL_001, system-signal=OBJ_TRACK_MOTION_MODEL_010}, {implementation-record-element=OBJ_CLS_TYPE3_PROB_001, system-signal=OBJ_CLS_TYPE3_PROB_010}, {implementation-record-element=OBJ_REF_PT_LAT_OFFSET_001, system-signal=OBJ_REF_PT_LAT_OFFSET_010}, {implementation-record-element=OBJ_VEH_TRACK_FLAG_001, system-signal=OBJ_VEH_TRACK_FLAG_010}, {implementation-record-element=OBJ_YAW_RATE_001, system-signal=OBJ_YAW_RATE_010}, {implementation-record-element=OBJ_ID_001, system-signal=OBJ_ID_010}, {implementation-record-element=OBJ_CLS_TYPE2_001, system-signal=OBJ_CLS_TYPE2_010}, {implementation-record-element=OBJ_POS_LONG_001, system-signal=OBJ_POS_LONG_010}, {implementation-record-element=OBJ_MH_CRC16_001, system-signal=OBJ_MH_CRC16_010}, {implementation-record-element=OBJ_CLS_TYPE4_001, system-signal=OBJ_CLS_TYPE4_010}, {implementation-record-element=OBJ_EXISTENCE_PROB_001, system-signal=OBJ_EXISTENCE_PROB_010}, {implementation-record-element=OBJ_ACCELERATION_LONG_ERR_001, system-signal=OBJ_ACCELERATION_LONG_ERR_010}, {implementation-record-element=OBJ_GROUP_ID_001, system-signal=OBJ_GROUP_ID_010}, {implementation-record-element=OBJ_MOVEMENT_STATUS_001, system-signal=OBJ_MOVEMENT_STATUS_010}, {implementation-record-element=OBJ_REF_PT_LONG_OFFSET_001, system-signal=OBJ_REF_PT_LONG_OFFSET_010}, {implementation-record-element=OBJ_DIMENSION_LENGTH_ERR_001, system-signal=OBJ_DIMENSION_LENGTH_ERR_010}, {implementation-record-element=OBJ_DIMENSION_WIDTH_001, system-signal=OBJ_DIMENSION_WIDTH_010}, {implementation-record-element=OBJ_CLS_TYPE4_PROB_001, system-signal=OBJ_CLS_TYPE4_PROB_010}, {implementation-record-element=OBJ_DIMENSION_LENGTH_001, system-signal=OBJ_DIMENSION_LENGTH_010}, {implementation-record-element=OBJ_TIMESTAMP_OFFSET_001, system-signal=OBJ_TIMESTAMP_OFFSET_010}, {implementation-record-element=OBJ_MH_CYCLE_COUNTER_001, system-signal=OBJ_MH_CYCLE_COUNTER_010}, {implementation-record-element=OBJ_VELOCITY_LONG_001, system-signal=OBJ_VELOCITY_LONG_010}, {implementation-record-element=OBJ_CLS_TYPE6_001, system-signal=OBJ_CLS_TYPE6_010}, {implementation-record-element=OBJ_DIMENSION_WIDTH_ERR_001, system-signal=OBJ_DIMENSION_WIDTH_ERR_010}, {implementation-record-element=OBJ_VELOCITY_ERR_CRR_COEF_001, system-signal=OBJ_VELOCITY_ERR_CRR_COEF_010}, {implementation-record-element=OBJ_CLS_TYPE1_PROB_001, system-signal=OBJ_CLS_TYPE1_PROB_010}, {implementation-record-element=OBJ_POS_LAT_ERR_001, system-signal=OBJ_POS_LAT_ERR_010}, {implementation-record-element=OBJ_VELOCITY_LONG_ERR_001, system-signal=OBJ_VELOCITY_LONG_ERR_010}, {implementation-record-element=OBJ_YAW_ANGLE_001, system-signal=OBJ_YAW_ANGLE_010}, {implementation-record-element=OBJ_YAW_ANGLE_ERR_001, system-signal=OBJ_YAW_ANGLE_ERR_010}]}
        sender-receiver-to-signal-group-mapping={data-element=Pp_SG_TrackerObject011.Vdp_SG_TrackerObject011, signal-group=SG_TrackerObject011, type-mapping=sender-rec-record-type-mapping=record-element-mappings=[{implementation-record-element=OBJ_ACCEL_ERR_CRR_COEF_001, system-signal=OBJ_ACCEL_ERR_CRR_COEF_011}, {implementation-record-element=OBJ_ACCELERATION_LAT_001, system-signal=OBJ_ACCELERATION_LAT_011}, {implementation-record-element=OBJ_ACCELERATION_LONG_001, system-signal=OBJ_ACCELERATION_LONG_011}, {implementation-record-element=OBJ_CLS_TYPE1_PROB_001, system-signal=OBJ_CLS_TYPE1_PROB_011}, {implementation-record-element=OBJ_ALIVE_TIME_001, system-signal=OBJ_ALIVE_TIME_011}, {implementation-record-element=OBJ_CLS_TYPE2_001, system-signal=OBJ_CLS_TYPE2_011}, {implementation-record-element=OBJ_CLS_TYPE2_PROB_001, system-signal=OBJ_CLS_TYPE2_PROB_011}, {implementation-record-element=OBJ_ACCELERATION_LONG_ERR_001, system-signal=OBJ_ACCELERATION_LONG_ERR_011}, {implementation-record-element=OBJ_CLS_TYPE4_PROB_001, system-signal=OBJ_CLS_TYPE4_PROB_011}, {implementation-record-element=OBJ_CLS_TYPE5_001, system-signal=OBJ_CLS_TYPE5_011}, {implementation-record-element=OBJ_CLS_TYPE3_PROB_001, system-signal=OBJ_CLS_TYPE3_PROB_011}, {implementation-record-element=OBJ_ACCELERATION_LAT_ERR_001, system-signal=OBJ_ACCELERATION_LAT_ERR_011}, {implementation-record-element=OBJ_CLS_TYPE3_001, system-signal=OBJ_CLS_TYPE3_011}, {implementation-record-element=OBJ_CLS_TYPE5_PROB_001, system-signal=OBJ_CLS_TYPE5_PROB_011}, {implementation-record-element=OBJ_CLS_TYPE6_001, system-signal=OBJ_CLS_TYPE6_011}, {implementation-record-element=OBJ_CLS_TYPE4_001, system-signal=OBJ_CLS_TYPE4_011}, {implementation-record-element=OBJ_CLS_TYPE6_PROB_001, system-signal=OBJ_CLS_TYPE6_PROB_011}, {implementation-record-element=OBJ_CLS_TYPE1_001, system-signal=OBJ_CLS_TYPE1_011}, {implementation-record-element=OBJ_POS_LAT_001, system-signal=OBJ_POS_LAT_011}, {implementation-record-element=OBJ_POS_LONG_001, system-signal=OBJ_POS_LONG_011}, {implementation-record-element=OBJ_VEH_TRACK_FLAG_001, system-signal=OBJ_VEH_TRACK_FLAG_011}, {implementation-record-element=OBJ_YAW_RATE_001, system-signal=OBJ_YAW_RATE_011}, {implementation-record-element=OBJ_MEASUREMENT_STATUS_001, system-signal=OBJ_MEASUREMENT_STATUS_011}, {implementation-record-element=OBJ_MH_CRC16_001, system-signal=OBJ_MH_CRC16_011}, {implementation-record-element=OBJ_YAW_ANGLE_001, system-signal=OBJ_YAW_ANGLE_011}, {implementation-record-element=OBJ_GROUP_ID_001, system-signal=OBJ_GROUP_ID_011}, {implementation-record-element=OBJ_DIMENSION_LENGTH_001, system-signal=OBJ_DIMENSION_LENGTH_011}, {implementation-record-element=OBJ_YAW_ANGLE_ERR_001, system-signal=OBJ_YAW_ANGLE_ERR_011}, {implementation-record-element=OBJ_YAW_RATE_ERR_001, system-signal=OBJ_YAW_RATE_ERR_011}, {implementation-record-element=OBJ_DIMENSION_WIDTH_001, system-signal=OBJ_DIMENSION_WIDTH_011}, {implementation-record-element=OBJ_DIMENSION_WIDTH_ERR_001, system-signal=OBJ_DIMENSION_WIDTH_ERR_011}, {implementation-record-element=OBJ_DIMENSION_LENGTH_ERR_001, system-signal=OBJ_DIMENSION_LENGTH_ERR_011}, {implementation-record-element=OBJ_TRACK_MOTION_MODEL_001, system-signal=OBJ_TRACK_MOTION_MODEL_011}, {implementation-record-element=OBJ_POS_ERR_CRR_COEF_001, system-signal=OBJ_POS_ERR_CRR_COEF_011}, {implementation-record-element=OBJ_REF_PT_LAT_OFFSET_001, system-signal=OBJ_REF_PT_LAT_OFFSET_011}, {implementation-record-element=OBJ_MOVEMENT_STATUS_001, system-signal=OBJ_MOVEMENT_STATUS_011}, {implementation-record-element=OBJ_VELOCITY_LAT_001, system-signal=OBJ_VELOCITY_LAT_011}, {implementation-record-element=OBJ_MH_CYCLE_COUNTER_001, system-signal=OBJ_MH_CYCLE_COUNTER_011}, {implementation-record-element=OBJ_VELOCITY_ERR_CRR_COEF_001, system-signal=OBJ_VELOCITY_ERR_CRR_COEF_011}, {implementation-record-element=OBJ_VELOCITY_LAT_ERR_001, system-signal=OBJ_VELOCITY_LAT_ERR_011}, {implementation-record-element=OBJ_VELOCITY_LONG_ERR_001, system-signal=OBJ_VELOCITY_LONG_ERR_011}, {implementation-record-element=OBJ_ID_001, system-signal=OBJ_ID_011}, {implementation-record-element=OBJ_POS_LONG_ERR_001, system-signal=OBJ_POS_LONG_ERR_011}, {implementation-record-element=OBJ_RCS_001, system-signal=OBJ_RCS_011}, {implementation-record-element=OBJ_VELOCITY_LONG_001, system-signal=OBJ_VELOCITY_LONG_011}, {implementation-record-element=OBJ_POS_LAT_ERR_001, system-signal=OBJ_POS_LAT_ERR_011}, {implementation-record-element=OBJ_EXISTENCE_PROB_001, system-signal=OBJ_EXISTENCE_PROB_011}, {implementation-record-element=OBJ_REF_PT_LONG_OFFSET_001, system-signal=OBJ_REF_PT_LONG_OFFSET_011}, {implementation-record-element=OBJ_TIMESTAMP_OFFSET_001, system-signal=OBJ_TIMESTAMP_OFFSET_011}]}
        sender-receiver-to-signal-group-mapping={data-element=Pp_SG_TrackerObject012.Vdp_SG_TrackerObject012, signal-group=SG_TrackerObject012, type-mapping=sender-rec-record-type-mapping=record-element-mappings=[{implementation-record-element=OBJ_ACCEL_ERR_CRR_COEF_001, system-signal=OBJ_ACCEL_ERR_CRR_COEF_012}, {implementation-record-element=OBJ_CLS_TYPE3_001, system-signal=OBJ_CLS_TYPE3_012}, {implementation-record-element=OBJ_CLS_TYPE2_PROB_001, system-signal=OBJ_CLS_TYPE2_PROB_012}, {implementation-record-element=OBJ_CLS_TYPE5_001, system-signal=OBJ_CLS_TYPE5_012}, {implementation-record-element=OBJ_CLS_TYPE5_PROB_001, system-signal=OBJ_CLS_TYPE5_PROB_012}, {implementation-record-element=OBJ_CLS_TYPE3_PROB_001, system-signal=OBJ_CLS_TYPE3_PROB_012}, {implementation-record-element=OBJ_CLS_TYPE4_001, system-signal=OBJ_CLS_TYPE4_012}, {implementation-record-element=OBJ_CLS_TYPE6_001, system-signal=OBJ_CLS_TYPE6_012}, {implementation-record-element=OBJ_CLS_TYPE1_001, system-signal=OBJ_CLS_TYPE1_012}, {implementation-record-element=OBJ_CLS_TYPE6_PROB_001, system-signal=OBJ_CLS_TYPE6_PROB_012}, {implementation-record-element=OBJ_DIMENSION_LENGTH_001, system-signal=OBJ_DIMENSION_LENGTH_012}, {implementation-record-element=OBJ_DIMENSION_WIDTH_001, system-signal=OBJ_DIMENSION_WIDTH_012}, {implementation-record-element=OBJ_DIMENSION_WIDTH_ERR_001, system-signal=OBJ_DIMENSION_WIDTH_ERR_012}, {implementation-record-element=OBJ_GROUP_ID_001, system-signal=OBJ_GROUP_ID_012}, {implementation-record-element=OBJ_ID_001, system-signal=OBJ_ID_012}, {implementation-record-element=OBJ_MEASUREMENT_STATUS_001, system-signal=OBJ_MEASUREMENT_STATUS_012}, {implementation-record-element=OBJ_MH_CRC16_001, system-signal=OBJ_MH_CRC16_012}, {implementation-record-element=OBJ_POS_ERR_CRR_COEF_001, system-signal=OBJ_POS_ERR_CRR_COEF_012}, {implementation-record-element=OBJ_CLS_TYPE2_001, system-signal=OBJ_CLS_TYPE2_012}, {implementation-record-element=OBJ_EXISTENCE_PROB_001, system-signal=OBJ_EXISTENCE_PROB_012}, {implementation-record-element=OBJ_POS_LAT_001, system-signal=OBJ_POS_LAT_012}, {implementation-record-element=OBJ_MH_CYCLE_COUNTER_001, system-signal=OBJ_MH_CYCLE_COUNTER_012}, {implementation-record-element=OBJ_POS_LAT_ERR_001, system-signal=OBJ_POS_LAT_ERR_012}, {implementation-record-element=OBJ_ALIVE_TIME_001, system-signal=OBJ_ALIVE_TIME_012}, {implementation-record-element=OBJ_DIMENSION_LENGTH_ERR_001, system-signal=OBJ_DIMENSION_LENGTH_ERR_012}, {implementation-record-element=OBJ_MOVEMENT_STATUS_001, system-signal=OBJ_MOVEMENT_STATUS_012}, {implementation-record-element=OBJ_ACCELERATION_LAT_001, system-signal=OBJ_ACCELERATION_LAT_012}, {implementation-record-element=OBJ_ACCELERATION_LONG_001, system-signal=OBJ_ACCELERATION_LONG_012}, {implementation-record-element=OBJ_ACCELERATION_LONG_ERR_001, system-signal=OBJ_ACCELERATION_LONG_ERR_012}, {implementation-record-element=OBJ_CLS_TYPE4_PROB_001, system-signal=OBJ_CLS_TYPE4_PROB_012}, {implementation-record-element=OBJ_CLS_TYPE1_PROB_001, system-signal=OBJ_CLS_TYPE1_PROB_012}, {implementation-record-element=OBJ_ACCELERATION_LAT_ERR_001, system-signal=OBJ_ACCELERATION_LAT_ERR_012}, {implementation-record-element=OBJ_TRACK_MOTION_MODEL_001, system-signal=OBJ_TRACK_MOTION_MODEL_012}, {implementation-record-element=OBJ_YAW_ANGLE_ERR_001, system-signal=OBJ_YAW_ANGLE_ERR_012}, {implementation-record-element=OBJ_VEH_TRACK_FLAG_001, system-signal=OBJ_VEH_TRACK_FLAG_012}, {implementation-record-element=OBJ_REF_PT_LONG_OFFSET_001, system-signal=OBJ_REF_PT_LONG_OFFSET_012}, {implementation-record-element=OBJ_TIMESTAMP_OFFSET_001, system-signal=OBJ_TIMESTAMP_OFFSET_012}, {implementation-record-element=OBJ_RCS_001, system-signal=OBJ_RCS_012}, {implementation-record-element=OBJ_YAW_ANGLE_001, system-signal=OBJ_YAW_ANGLE_012}, {implementation-record-element=OBJ_YAW_RATE_001, system-signal=OBJ_YAW_RATE_012}, {implementation-record-element=OBJ_POS_LONG_ERR_001, system-signal=OBJ_POS_LONG_ERR_012}, {implementation-record-element=OBJ_VELOCITY_LONG_001, system-signal=OBJ_VELOCITY_LONG_012}, {implementation-record-element=OBJ_VELOCITY_LONG_ERR_001, system-signal=OBJ_VELOCITY_LONG_ERR_012}, {implementation-record-element=OBJ_REF_PT_LAT_OFFSET_001, system-signal=OBJ_REF_PT_LAT_OFFSET_012}, {implementation-record-element=OBJ_VELOCITY_ERR_CRR_COEF_001, system-signal=OBJ_VELOCITY_ERR_CRR_COEF_012}, {implementation-record-element=OBJ_VELOCITY_LAT_001, system-signal=OBJ_VELOCITY_LAT_012}, {implementation-record-element=OBJ_POS_LONG_001, system-signal=OBJ_POS_LONG_012}, {implementation-record-element=OBJ_YAW_RATE_ERR_001, system-signal=OBJ_YAW_RATE_ERR_012}, {implementation-record-element=OBJ_VELOCITY_LAT_ERR_001, system-signal=OBJ_VELOCITY_LAT_ERR_012}]}
        sender-receiver-to-signal-group-mapping={data-element=Pp_SG_TrackerObject013.Vdp_SG_TrackerObject013, signal-group=SG_TrackerObject013, type-mapping=sender-rec-record-type-mapping=record-element-mappings=[{implementation-record-element=OBJ_ACCELERATION_LAT_ERR_001, system-signal=OBJ_ACCELERATION_LAT_ERR_013}, {implementation-record-element=OBJ_CLS_TYPE3_PROB_001, system-signal=OBJ_CLS_TYPE3_PROB_013}, {implementation-record-element=OBJ_ACCELERATION_LONG_001, system-signal=OBJ_ACCELERATION_LONG_013}, {implementation-record-element=OBJ_ACCELERATION_LONG_ERR_001, system-signal=OBJ_ACCELERATION_LONG_ERR_013}, {implementation-record-element=OBJ_GROUP_ID_001, system-signal=OBJ_GROUP_ID_013}, {implementation-record-element=OBJ_POS_LAT_ERR_001, system-signal=OBJ_POS_LAT_ERR_013}, {implementation-record-element=OBJ_DIMENSION_WIDTH_ERR_001, system-signal=OBJ_DIMENSION_WIDTH_ERR_013}, {implementation-record-element=OBJ_REF_PT_LAT_OFFSET_001, system-signal=OBJ_REF_PT_LAT_OFFSET_013}, {implementation-record-element=OBJ_TIMESTAMP_OFFSET_001, system-signal=OBJ_TIMESTAMP_OFFSET_013}, {implementation-record-element=OBJ_TRACK_MOTION_MODEL_001, system-signal=OBJ_TRACK_MOTION_MODEL_013}, {implementation-record-element=OBJ_MH_CYCLE_COUNTER_001, system-signal=OBJ_MH_CYCLE_COUNTER_013}, {implementation-record-element=OBJ_POS_LONG_ERR_001, system-signal=OBJ_POS_LONG_ERR_013}, {implementation-record-element=OBJ_POS_LONG_001, system-signal=OBJ_POS_LONG_013}, {implementation-record-element=OBJ_DIMENSION_WIDTH_001, system-signal=OBJ_DIMENSION_WIDTH_013}, {implementation-record-element=OBJ_RCS_001, system-signal=OBJ_RCS_013}, {implementation-record-element=OBJ_REF_PT_LONG_OFFSET_001, system-signal=OBJ_REF_PT_LONG_OFFSET_013}, {implementation-record-element=OBJ_CLS_TYPE2_001, system-signal=OBJ_CLS_TYPE2_013}, {implementation-record-element=OBJ_CLS_TYPE2_PROB_001, system-signal=OBJ_CLS_TYPE2_PROB_013}, {implementation-record-element=OBJ_EXISTENCE_PROB_001, system-signal=OBJ_EXISTENCE_PROB_013}, {implementation-record-element=OBJ_CLS_TYPE6_PROB_001, system-signal=OBJ_CLS_TYPE6_PROB_013}, {implementation-record-element=OBJ_VEH_TRACK_FLAG_001, system-signal=OBJ_VEH_TRACK_FLAG_013}, {implementation-record-element=OBJ_VELOCITY_ERR_CRR_COEF_001, system-signal=OBJ_VELOCITY_ERR_CRR_COEF_013}, {implementation-record-element=OBJ_VELOCITY_LAT_001, system-signal=OBJ_VELOCITY_LAT_013}, {implementation-record-element=OBJ_VELOCITY_LAT_ERR_001, system-signal=OBJ_VELOCITY_LAT_ERR_013}, {implementation-record-element=OBJ_VELOCITY_LONG_001, system-signal=OBJ_VELOCITY_LONG_013}, {implementation-record-element=OBJ_CLS_TYPE1_001, system-signal=OBJ_CLS_TYPE1_013}, {implementation-record-element=OBJ_VELOCITY_LONG_ERR_001, system-signal=OBJ_VELOCITY_LONG_ERR_013}, {implementation-record-element=OBJ_YAW_ANGLE_001, system-signal=OBJ_YAW_ANGLE_013}, {implementation-record-element=OBJ_ACCEL_ERR_CRR_COEF_001, system-signal=OBJ_ACCEL_ERR_CRR_COEF_013}, {implementation-record-element=OBJ_DIMENSION_LENGTH_ERR_001, system-signal=OBJ_DIMENSION_LENGTH_ERR_013}, {implementation-record-element=OBJ_ID_001, system-signal=OBJ_ID_013}, {implementation-record-element=OBJ_CLS_TYPE6_001, system-signal=OBJ_CLS_TYPE6_013}, {implementation-record-element=OBJ_MOVEMENT_STATUS_001, system-signal=OBJ_MOVEMENT_STATUS_013}, {implementation-record-element=OBJ_POS_LAT_001, system-signal=OBJ_POS_LAT_013}, {implementation-record-element=OBJ_CLS_TYPE1_PROB_001, system-signal=OBJ_CLS_TYPE1_PROB_013}, {implementation-record-element=OBJ_CLS_TYPE4_001, system-signal=OBJ_CLS_TYPE4_013}, {implementation-record-element=OBJ_CLS_TYPE5_001, system-signal=OBJ_CLS_TYPE5_013}, {implementation-record-element=OBJ_ACCELERATION_LAT_001, system-signal=OBJ_ACCELERATION_LAT_013}, {implementation-record-element=OBJ_CLS_TYPE3_001, system-signal=OBJ_CLS_TYPE3_013}, {implementation-record-element=OBJ_CLS_TYPE5_PROB_001, system-signal=OBJ_CLS_TYPE5_PROB_013}, {implementation-record-element=OBJ_MEASUREMENT_STATUS_001, system-signal=OBJ_MEASUREMENT_STATUS_013}, {implementation-record-element=OBJ_DIMENSION_LENGTH_001, system-signal=OBJ_DIMENSION_LENGTH_013}, {implementation-record-element=OBJ_MH_CRC16_001, system-signal=OBJ_MH_CRC16_013}, {implementation-record-element=OBJ_POS_ERR_CRR_COEF_001, system-signal=OBJ_POS_ERR_CRR_COEF_013}, {implementation-record-element=OBJ_CLS_TYPE4_PROB_001, system-signal=OBJ_CLS_TYPE4_PROB_013}, {implementation-record-element=OBJ_ALIVE_TIME_001, system-signal=OBJ_ALIVE_TIME_013}, {implementation-record-element=OBJ_YAW_RATE_ERR_001, system-signal=OBJ_YAW_RATE_ERR_013}, {implementation-record-element=OBJ_YAW_RATE_001, system-signal=OBJ_YAW_RATE_013}, {implementation-record-element=OBJ_YAW_ANGLE_ERR_001, system-signal=OBJ_YAW_ANGLE_ERR_013}]}
        sender-receiver-to-signal-group-mapping={data-element=Pp_SG_TrackerObject015.Vdp_SG_TrackerObject015, signal-group=SG_TrackerObject015, type-mapping=sender-rec-record-type-mapping=record-element-mappings=[{implementation-record-element=OBJ_ACCELERATION_LONG_001, system-signal=OBJ_ACCELERATION_LONG_015}, {implementation-record-element=OBJ_ALIVE_TIME_001, system-signal=OBJ_ALIVE_TIME_015}, {implementation-record-element=OBJ_CLS_TYPE1_001, system-signal=OBJ_CLS_TYPE1_015}, {implementation-record-element=OBJ_ACCEL_ERR_CRR_COEF_001, system-signal=OBJ_ACCEL_ERR_CRR_COEF_015}, {implementation-record-element=OBJ_CLS_TYPE2_001, system-signal=OBJ_CLS_TYPE2_015}, {implementation-record-element=OBJ_CLS_TYPE2_PROB_001, system-signal=OBJ_CLS_TYPE2_PROB_015}, {implementation-record-element=OBJ_ACCELERATION_LONG_ERR_001, system-signal=OBJ_ACCELERATION_LONG_ERR_015}, {implementation-record-element=OBJ_CLS_TYPE1_PROB_001, system-signal=OBJ_CLS_TYPE1_PROB_015}, {implementation-record-element=OBJ_ACCELERATION_LAT_001, system-signal=OBJ_ACCELERATION_LAT_015}, {implementation-record-element=OBJ_ACCELERATION_LAT_ERR_001, system-signal=OBJ_ACCELERATION_LAT_ERR_015}, {implementation-record-element=OBJ_MH_CRC16_001, system-signal=OBJ_MH_CRC16_015}, {implementation-record-element=OBJ_DIMENSION_LENGTH_001, system-signal=OBJ_DIMENSION_LENGTH_015}, {implementation-record-element=OBJ_RCS_001, system-signal=OBJ_RCS_015}, {implementation-record-element=OBJ_TRACK_MOTION_MODEL_001, system-signal=OBJ_TRACK_MOTION_MODEL_015}, {implementation-record-element=OBJ_VELOCITY_LAT_ERR_001, system-signal=OBJ_VELOCITY_LAT_ERR_015}, {implementation-record-element=OBJ_VELOCITY_LONG_001, system-signal=OBJ_VELOCITY_LONG_015}, {implementation-record-element=OBJ_CLS_TYPE5_PROB_001, system-signal=OBJ_CLS_TYPE5_PROB_015}, {implementation-record-element=OBJ_MH_CYCLE_COUNTER_001, system-signal=OBJ_MH_CYCLE_COUNTER_015}, {implementation-record-element=OBJ_CLS_TYPE4_001, system-signal=OBJ_CLS_TYPE4_015}, {implementation-record-element=OBJ_CLS_TYPE4_PROB_001, system-signal=OBJ_CLS_TYPE4_PROB_015}, {implementation-record-element=OBJ_ID_001, system-signal=OBJ_ID_015}, {implementation-record-element=OBJ_MEASUREMENT_STATUS_001, system-signal=OBJ_MEASUREMENT_STATUS_015}, {implementation-record-element=OBJ_CLS_TYPE3_PROB_001, system-signal=OBJ_CLS_TYPE3_PROB_015}, {implementation-record-element=OBJ_VEH_TRACK_FLAG_001, system-signal=OBJ_VEH_TRACK_FLAG_015}, {implementation-record-element=OBJ_VELOCITY_LONG_ERR_001, system-signal=OBJ_VELOCITY_LONG_ERR_015}, {implementation-record-element=OBJ_EXISTENCE_PROB_001, system-signal=OBJ_EXISTENCE_PROB_015}, {implementation-record-element=OBJ_POS_LONG_ERR_001, system-signal=OBJ_POS_LONG_ERR_015}, {implementation-record-element=OBJ_DIMENSION_WIDTH_001, system-signal=OBJ_DIMENSION_WIDTH_015}, {implementation-record-element=OBJ_DIMENSION_LENGTH_ERR_001, system-signal=OBJ_DIMENSION_LENGTH_ERR_015}, {implementation-record-element=OBJ_DIMENSION_WIDTH_ERR_001, system-signal=OBJ_DIMENSION_WIDTH_ERR_015}, {implementation-record-element=OBJ_REF_PT_LAT_OFFSET_001, system-signal=OBJ_REF_PT_LAT_OFFSET_015}, {implementation-record-element=OBJ_VELOCITY_LAT_001, system-signal=OBJ_VELOCITY_LAT_015}, {implementation-record-element=OBJ_POS_LAT_ERR_001, system-signal=OBJ_POS_LAT_ERR_015}, {implementation-record-element=OBJ_YAW_ANGLE_001, system-signal=OBJ_YAW_ANGLE_015}, {implementation-record-element=OBJ_TIMESTAMP_OFFSET_001, system-signal=OBJ_TIMESTAMP_OFFSET_015}, {implementation-record-element=OBJ_POS_LONG_001, system-signal=OBJ_POS_LONG_015}, {implementation-record-element=OBJ_CLS_TYPE6_001, system-signal=OBJ_CLS_TYPE6_015}, {implementation-record-element=OBJ_CLS_TYPE6_PROB_001, system-signal=OBJ_CLS_TYPE6_PROB_015}, {implementation-record-element=OBJ_YAW_ANGLE_ERR_001, system-signal=OBJ_YAW_ANGLE_ERR_015}, {implementation-record-element=OBJ_GROUP_ID_001, system-signal=OBJ_GROUP_ID_015}, {implementation-record-element=OBJ_MOVEMENT_STATUS_001, system-signal=OBJ_MOVEMENT_STATUS_015}, {implementation-record-element=OBJ_POS_ERR_CRR_COEF_001, system-signal=OBJ_POS_ERR_CRR_COEF_015}, {implementation-record-element=OBJ_YAW_RATE_001, system-signal=OBJ_YAW_RATE_015}, {implementation-record-element=OBJ_REF_PT_LONG_OFFSET_001, system-signal=OBJ_REF_PT_LONG_OFFSET_015}, {implementation-record-element=OBJ_CLS_TYPE3_001, system-signal=OBJ_CLS_TYPE3_015}, {implementation-record-element=OBJ_POS_LAT_001, system-signal=OBJ_POS_LAT_015}, {implementation-record-element=OBJ_CLS_TYPE5_001, system-signal=OBJ_CLS_TYPE5_015}, {implementation-record-element=OBJ_VELOCITY_ERR_CRR_COEF_001, system-signal=OBJ_VELOCITY_ERR_CRR_COEF_015}, {implementation-record-element=OBJ_YAW_RATE_ERR_001, system-signal=OBJ_YAW_RATE_ERR_015}]}
        sender-receiver-to-signal-group-mapping={data-element=Pp_SG_TrackerObject014.Vdp_SG_TrackerObject014, signal-group=SG_TrackerObject014, type-mapping=sender-rec-record-type-mapping=record-element-mappings=[{implementation-record-element=OBJ_YAW_RATE_001, system-signal=OBJ_YAW_RATE_014}, {implementation-record-element=OBJ_RCS_001, system-signal=OBJ_RCS_014}, {implementation-record-element=OBJ_ACCELERATION_LAT_ERR_001, system-signal=OBJ_ACCELERATION_LAT_ERR_014}, {implementation-record-element=OBJ_VELOCITY_LONG_ERR_001, system-signal=OBJ_VELOCITY_LONG_ERR_014}, {implementation-record-element=OBJ_GROUP_ID_001, system-signal=OBJ_GROUP_ID_014}, {implementation-record-element=OBJ_POS_LAT_ERR_001, system-signal=OBJ_POS_LAT_ERR_014}, {implementation-record-element=OBJ_DIMENSION_LENGTH_ERR_001, system-signal=OBJ_DIMENSION_LENGTH_ERR_014}, {implementation-record-element=OBJ_REF_PT_LONG_OFFSET_001, system-signal=OBJ_REF_PT_LONG_OFFSET_014}, {implementation-record-element=OBJ_MH_CYCLE_COUNTER_001, system-signal=OBJ_MH_CYCLE_COUNTER_014}, {implementation-record-element=OBJ_YAW_ANGLE_001, system-signal=OBJ_YAW_ANGLE_014}, {implementation-record-element=OBJ_POS_LONG_001, system-signal=OBJ_POS_LONG_014}, {implementation-record-element=OBJ_VELOCITY_LAT_001, system-signal=OBJ_VELOCITY_LAT_014}, {implementation-record-element=OBJ_VEH_TRACK_FLAG_001, system-signal=OBJ_VEH_TRACK_FLAG_014}, {implementation-record-element=OBJ_CLS_TYPE3_001, system-signal=OBJ_CLS_TYPE3_014}, {implementation-record-element=OBJ_ALIVE_TIME_001, system-signal=OBJ_ALIVE_TIME_014}, {implementation-record-element=OBJ_POS_LONG_ERR_001, system-signal=OBJ_POS_LONG_ERR_014}, {implementation-record-element=OBJ_TRACK_MOTION_MODEL_001, system-signal=OBJ_TRACK_MOTION_MODEL_014}, {implementation-record-element=OBJ_ACCEL_ERR_CRR_COEF_001, system-signal=OBJ_ACCEL_ERR_CRR_COEF_014}, {implementation-record-element=OBJ_ACCELERATION_LONG_ERR_001, system-signal=OBJ_ACCELERATION_LONG_ERR_014}, {implementation-record-element=OBJ_EXISTENCE_PROB_001, system-signal=OBJ_EXISTENCE_PROB_014}, {implementation-record-element=OBJ_ACCELERATION_LAT_001, system-signal=OBJ_ACCELERATION_LAT_014}, {implementation-record-element=OBJ_ACCELERATION_LONG_001, system-signal=OBJ_ACCELERATION_LONG_014}, {implementation-record-element=OBJ_CLS_TYPE1_001, system-signal=OBJ_CLS_TYPE1_014}, {implementation-record-element=OBJ_CLS_TYPE4_PROB_001, system-signal=OBJ_CLS_TYPE4_PROB_014}, {implementation-record-element=OBJ_MEASUREMENT_STATUS_001, system-signal=OBJ_MEASUREMENT_STATUS_014}, {implementation-record-element=OBJ_MH_CRC16_001, system-signal=OBJ_MH_CRC16_014}, {implementation-record-element=OBJ_CLS_TYPE5_PROB_001, system-signal=OBJ_CLS_TYPE5_PROB_014}, {implementation-record-element=OBJ_VELOCITY_LONG_001, system-signal=OBJ_VELOCITY_LONG_014}, {implementation-record-element=OBJ_CLS_TYPE2_PROB_001, system-signal=OBJ_CLS_TYPE2_PROB_014}, {implementation-record-element=OBJ_CLS_TYPE6_001, system-signal=OBJ_CLS_TYPE6_014}, {implementation-record-element=OBJ_CLS_TYPE6_PROB_001, system-signal=OBJ_CLS_TYPE6_PROB_014}, {implementation-record-element=OBJ_CLS_TYPE5_001, system-signal=OBJ_CLS_TYPE5_014}, {implementation-record-element=OBJ_CLS_TYPE3_PROB_001, system-signal=OBJ_CLS_TYPE3_PROB_014}, {implementation-record-element=OBJ_REF_PT_LAT_OFFSET_001, system-signal=OBJ_REF_PT_LAT_OFFSET_014}, {implementation-record-element=OBJ_VELOCITY_LAT_ERR_001, system-signal=OBJ_VELOCITY_LAT_ERR_014}, {implementation-record-element=OBJ_YAW_ANGLE_ERR_001, system-signal=OBJ_YAW_ANGLE_ERR_014}, {implementation-record-element=OBJ_DIMENSION_LENGTH_001, system-signal=OBJ_DIMENSION_LENGTH_014}, {implementation-record-element=OBJ_CLS_TYPE2_001, system-signal=OBJ_CLS_TYPE2_014}, {implementation-record-element=OBJ_CLS_TYPE4_001, system-signal=OBJ_CLS_TYPE4_014}, {implementation-record-element=OBJ_DIMENSION_WIDTH_001, system-signal=OBJ_DIMENSION_WIDTH_014}, {implementation-record-element=OBJ_TIMESTAMP_OFFSET_001, system-signal=OBJ_TIMESTAMP_OFFSET_014}, {implementation-record-element=OBJ_POS_ERR_CRR_COEF_001, system-signal=OBJ_POS_ERR_CRR_COEF_014}, {implementation-record-element=OBJ_POS_LAT_001, system-signal=OBJ_POS_LAT_014}, {implementation-record-element=OBJ_VELOCITY_ERR_CRR_COEF_001, system-signal=OBJ_VELOCITY_ERR_CRR_COEF_014}, {implementation-record-element=OBJ_CLS_TYPE1_PROB_001, system-signal=OBJ_CLS_TYPE1_PROB_014}, {implementation-record-element=OBJ_ID_001, system-signal=OBJ_ID_014}, {implementation-record-element=OBJ_MOVEMENT_STATUS_001, system-signal=OBJ_MOVEMENT_STATUS_014}, {implementation-record-element=OBJ_YAW_RATE_ERR_001, system-signal=OBJ_YAW_RATE_ERR_014}, {implementation-record-element=OBJ_DIMENSION_WIDTH_ERR_001, system-signal=OBJ_DIMENSION_WIDTH_ERR_014}]}
        sender-receiver-to-signal-group-mapping={data-element=Pp_SG_TrackerObject016.Vdp_SG_TrackerObject016, signal-group=SG_TrackerObject016, type-mapping=sender-rec-record-type-mapping=record-element-mappings=[{implementation-record-element=OBJ_ACCELERATION_LAT_ERR_001, system-signal=OBJ_ACCELERATION_LAT_ERR_016}, {implementation-record-element=OBJ_CLS_TYPE3_PROB_001, system-signal=OBJ_CLS_TYPE3_PROB_016}, {implementation-record-element=OBJ_CLS_TYPE6_PROB_001, system-signal=OBJ_CLS_TYPE6_PROB_016}, {implementation-record-element=OBJ_EXISTENCE_PROB_001, system-signal=OBJ_EXISTENCE_PROB_016}, {implementation-record-element=OBJ_CLS_TYPE1_001, system-signal=OBJ_CLS_TYPE1_016}, {implementation-record-element=OBJ_GROUP_ID_001, system-signal=OBJ_GROUP_ID_016}, {implementation-record-element=OBJ_ACCELERATION_LAT_001, system-signal=OBJ_ACCELERATION_LAT_016}, {implementation-record-element=OBJ_CLS_TYPE5_001, system-signal=OBJ_CLS_TYPE5_016}, {implementation-record-element=OBJ_ACCELERATION_LONG_001, system-signal=OBJ_ACCELERATION_LONG_016}, {implementation-record-element=OBJ_CLS_TYPE2_PROB_001, system-signal=OBJ_CLS_TYPE2_PROB_016}, {implementation-record-element=OBJ_CLS_TYPE1_PROB_001, system-signal=OBJ_CLS_TYPE1_PROB_016}, {implementation-record-element=OBJ_CLS_TYPE4_PROB_001, system-signal=OBJ_CLS_TYPE4_PROB_016}, {implementation-record-element=OBJ_CLS_TYPE5_PROB_001, system-signal=OBJ_CLS_TYPE5_PROB_016}, {implementation-record-element=OBJ_ACCEL_ERR_CRR_COEF_001, system-signal=OBJ_ACCEL_ERR_CRR_COEF_016}, {implementation-record-element=OBJ_ALIVE_TIME_001, system-signal=OBJ_ALIVE_TIME_016}, {implementation-record-element=OBJ_CLS_TYPE2_001, system-signal=OBJ_CLS_TYPE2_016}, {implementation-record-element=OBJ_CLS_TYPE3_001, system-signal=OBJ_CLS_TYPE3_016}, {implementation-record-element=OBJ_DIMENSION_LENGTH_001, system-signal=OBJ_DIMENSION_LENGTH_016}, {implementation-record-element=OBJ_ACCELERATION_LONG_ERR_001, system-signal=OBJ_ACCELERATION_LONG_ERR_016}, {implementation-record-element=OBJ_DIMENSION_WIDTH_001, system-signal=OBJ_DIMENSION_WIDTH_016}, {implementation-record-element=OBJ_CLS_TYPE4_001, system-signal=OBJ_CLS_TYPE4_016}, {implementation-record-element=OBJ_CLS_TYPE6_001, system-signal=OBJ_CLS_TYPE6_016}, {implementation-record-element=OBJ_DIMENSION_LENGTH_ERR_001, system-signal=OBJ_DIMENSION_LENGTH_ERR_016}, {implementation-record-element=OBJ_DIMENSION_WIDTH_ERR_001, system-signal=OBJ_DIMENSION_WIDTH_ERR_016}, {implementation-record-element=OBJ_POS_ERR_CRR_COEF_001, system-signal=OBJ_POS_ERR_CRR_COEF_016}, {implementation-record-element=OBJ_MEASUREMENT_STATUS_001, system-signal=OBJ_MEASUREMENT_STATUS_016}, {implementation-record-element=OBJ_TIMESTAMP_OFFSET_001, system-signal=OBJ_TIMESTAMP_OFFSET_016}, {implementation-record-element=OBJ_YAW_RATE_001, system-signal=OBJ_YAW_RATE_016}, {implementation-record-element=OBJ_YAW_RATE_ERR_001, system-signal=OBJ_YAW_RATE_ERR_016}, {implementation-record-element=OBJ_MH_CRC16_001, system-signal=OBJ_MH_CRC16_016}, {implementation-record-element=OBJ_VELOCITY_LAT_001, system-signal=OBJ_VELOCITY_LAT_016}, {implementation-record-element=OBJ_MOVEMENT_STATUS_001, system-signal=OBJ_MOVEMENT_STATUS_016}, {implementation-record-element=OBJ_POS_LAT_001, system-signal=OBJ_POS_LAT_016}, {implementation-record-element=OBJ_REF_PT_LONG_OFFSET_001, system-signal=OBJ_REF_PT_LONG_OFFSET_016}, {implementation-record-element=OBJ_YAW_ANGLE_ERR_001, system-signal=OBJ_YAW_ANGLE_ERR_016}, {implementation-record-element=OBJ_POS_LONG_001, system-signal=OBJ_POS_LONG_016}, {implementation-record-element=OBJ_TRACK_MOTION_MODEL_001, system-signal=OBJ_TRACK_MOTION_MODEL_016}, {implementation-record-element=OBJ_POS_LAT_ERR_001, system-signal=OBJ_POS_LAT_ERR_016}, {implementation-record-element=OBJ_MH_CYCLE_COUNTER_001, system-signal=OBJ_MH_CYCLE_COUNTER_016}, {implementation-record-element=OBJ_RCS_001, system-signal=OBJ_RCS_016}, {implementation-record-element=OBJ_REF_PT_LAT_OFFSET_001, system-signal=OBJ_REF_PT_LAT_OFFSET_016}, {implementation-record-element=OBJ_VELOCITY_ERR_CRR_COEF_001, system-signal=OBJ_VELOCITY_ERR_CRR_COEF_016}, {implementation-record-element=OBJ_POS_LONG_ERR_001, system-signal=OBJ_POS_LONG_ERR_016}, {implementation-record-element=OBJ_VEH_TRACK_FLAG_001, system-signal=OBJ_VEH_TRACK_FLAG_016}, {implementation-record-element=OBJ_VELOCITY_LAT_ERR_001, system-signal=OBJ_VELOCITY_LAT_ERR_016}, {implementation-record-element=OBJ_ID_001, system-signal=OBJ_ID_016}, {implementation-record-element=OBJ_VELOCITY_LONG_001, system-signal=OBJ_VELOCITY_LONG_016}, {implementation-record-element=OBJ_VELOCITY_LONG_ERR_001, system-signal=OBJ_VELOCITY_LONG_ERR_016}, {implementation-record-element=OBJ_YAW_ANGLE_001, system-signal=OBJ_YAW_ANGLE_016}]}
        sender-receiver-to-signal-group-mapping={data-element=Pp_SG_TrackerObject017.Vdp_SG_TrackerObject017, signal-group=SG_TrackerObject017, type-mapping=sender-rec-record-type-mapping=record-element-mappings=[{implementation-record-element=OBJ_MOVEMENT_STATUS_001, system-signal=OBJ_MOVEMENT_STATUS_017}, {implementation-record-element=OBJ_CLS_TYPE6_001, system-signal=OBJ_CLS_TYPE6_017}, {implementation-record-element=OBJ_POS_ERR_CRR_COEF_001, system-signal=OBJ_POS_ERR_CRR_COEF_017}, {implementation-record-element=OBJ_POS_LAT_001, system-signal=OBJ_POS_LAT_017}, {implementation-record-element=OBJ_POS_LAT_ERR_001, system-signal=OBJ_POS_LAT_ERR_017}, {implementation-record-element=OBJ_POS_LONG_001, system-signal=OBJ_POS_LONG_017}, {implementation-record-element=OBJ_POS_LONG_ERR_001, system-signal=OBJ_POS_LONG_ERR_017}, {implementation-record-element=OBJ_RCS_001, system-signal=OBJ_RCS_017}, {implementation-record-element=OBJ_REF_PT_LAT_OFFSET_001, system-signal=OBJ_REF_PT_LAT_OFFSET_017}, {implementation-record-element=OBJ_REF_PT_LONG_OFFSET_001, system-signal=OBJ_REF_PT_LONG_OFFSET_017}, {implementation-record-element=OBJ_TIMESTAMP_OFFSET_001, system-signal=OBJ_TIMESTAMP_OFFSET_017}, {implementation-record-element=OBJ_ACCELERATION_LONG_ERR_001, system-signal=OBJ_ACCELERATION_LONG_ERR_017}, {implementation-record-element=OBJ_CLS_TYPE2_PROB_001, system-signal=OBJ_CLS_TYPE2_PROB_017}, {implementation-record-element=OBJ_DIMENSION_WIDTH_ERR_001, system-signal=OBJ_DIMENSION_WIDTH_ERR_017}, {implementation-record-element=OBJ_ACCELERATION_LONG_001, system-signal=OBJ_ACCELERATION_LONG_017}, {implementation-record-element=OBJ_DIMENSION_WIDTH_001, system-signal=OBJ_DIMENSION_WIDTH_017}, {implementation-record-element=OBJ_ACCEL_ERR_CRR_COEF_001, system-signal=OBJ_ACCEL_ERR_CRR_COEF_017}, {implementation-record-element=OBJ_ACCELERATION_LAT_001, system-signal=OBJ_ACCELERATION_LAT_017}, {implementation-record-element=OBJ_ACCELERATION_LAT_ERR_001, system-signal=OBJ_ACCELERATION_LAT_ERR_017}, {implementation-record-element=OBJ_ALIVE_TIME_001, system-signal=OBJ_ALIVE_TIME_017}, {implementation-record-element=OBJ_CLS_TYPE4_001, system-signal=OBJ_CLS_TYPE4_017}, {implementation-record-element=OBJ_CLS_TYPE5_001, system-signal=OBJ_CLS_TYPE5_017}, {implementation-record-element=OBJ_CLS_TYPE2_001, system-signal=OBJ_CLS_TYPE2_017}, {implementation-record-element=OBJ_CLS_TYPE5_PROB_001, system-signal=OBJ_CLS_TYPE5_PROB_017}, {implementation-record-element=OBJ_CLS_TYPE6_PROB_001, system-signal=OBJ_CLS_TYPE6_PROB_017}, {implementation-record-element=OBJ_CLS_TYPE4_PROB_001, system-signal=OBJ_CLS_TYPE4_PROB_017}, {implementation-record-element=OBJ_CLS_TYPE3_001, system-signal=OBJ_CLS_TYPE3_017}, {implementation-record-element=OBJ_DIMENSION_LENGTH_001, system-signal=OBJ_DIMENSION_LENGTH_017}, {implementation-record-element=OBJ_DIMENSION_LENGTH_ERR_001, system-signal=OBJ_DIMENSION_LENGTH_ERR_017}, {implementation-record-element=OBJ_EXISTENCE_PROB_001, system-signal=OBJ_EXISTENCE_PROB_017}, {implementation-record-element=OBJ_CLS_TYPE1_PROB_001, system-signal=OBJ_CLS_TYPE1_PROB_017}, {implementation-record-element=OBJ_CLS_TYPE3_PROB_001, system-signal=OBJ_CLS_TYPE3_PROB_017}, {implementation-record-element=OBJ_ID_001, system-signal=OBJ_ID_017}, {implementation-record-element=OBJ_CLS_TYPE1_001, system-signal=OBJ_CLS_TYPE1_017}, {implementation-record-element=OBJ_GROUP_ID_001, system-signal=OBJ_GROUP_ID_017}, {implementation-record-element=OBJ_MEASUREMENT_STATUS_001, system-signal=OBJ_MEASUREMENT_STATUS_017}, {implementation-record-element=OBJ_MH_CRC16_001, system-signal=OBJ_MH_CRC16_017}, {implementation-record-element=OBJ_MH_CYCLE_COUNTER_001, system-signal=OBJ_MH_CYCLE_COUNTER_017}, {implementation-record-element=OBJ_YAW_RATE_001, system-signal=OBJ_YAW_RATE_017}, {implementation-record-element=OBJ_TRACK_MOTION_MODEL_001, system-signal=OBJ_TRACK_MOTION_MODEL_017}, {implementation-record-element=OBJ_VELOCITY_LONG_ERR_001, system-signal=OBJ_VELOCITY_LONG_ERR_017}, {implementation-record-element=OBJ_VELOCITY_LAT_001, system-signal=OBJ_VELOCITY_LAT_017}, {implementation-record-element=OBJ_VELOCITY_LAT_ERR_001, system-signal=OBJ_VELOCITY_LAT_ERR_017}, {implementation-record-element=OBJ_VELOCITY_ERR_CRR_COEF_001, system-signal=OBJ_VELOCITY_ERR_CRR_COEF_017}, {implementation-record-element=OBJ_YAW_RATE_ERR_001, system-signal=OBJ_YAW_RATE_ERR_017}, {implementation-record-element=OBJ_YAW_ANGLE_001, system-signal=OBJ_YAW_ANGLE_017}, {implementation-record-element=OBJ_YAW_ANGLE_ERR_001, system-signal=OBJ_YAW_ANGLE_ERR_017}, {implementation-record-element=OBJ_VEH_TRACK_FLAG_001, system-signal=OBJ_VEH_TRACK_FLAG_017}, {implementation-record-element=OBJ_VELOCITY_LONG_001, system-signal=OBJ_VELOCITY_LONG_017}]}
        sender-receiver-to-signal-group-mapping={data-element=Pp_SG_TrackerObject018.Vdp_SG_TrackerObject018, signal-group=SG_TrackerObject018, type-mapping=sender-rec-record-type-mapping=record-element-mappings=[{implementation-record-element=OBJ_REF_PT_LAT_OFFSET_001, system-signal=OBJ_REF_PT_LAT_OFFSET_018}, {implementation-record-element=OBJ_CLS_TYPE3_PROB_001, system-signal=OBJ_CLS_TYPE3_PROB_018}, {implementation-record-element=OBJ_MOVEMENT_STATUS_001, system-signal=OBJ_MOVEMENT_STATUS_018}, {implementation-record-element=OBJ_CLS_TYPE4_001, system-signal=OBJ_CLS_TYPE4_018}, {implementation-record-element=OBJ_CLS_TYPE4_PROB_001, system-signal=OBJ_CLS_TYPE4_PROB_018}, {implementation-record-element=OBJ_DIMENSION_WIDTH_001, system-signal=OBJ_DIMENSION_WIDTH_018}, {implementation-record-element=OBJ_DIMENSION_WIDTH_ERR_001, system-signal=OBJ_DIMENSION_WIDTH_ERR_018}, {implementation-record-element=OBJ_EXISTENCE_PROB_001, system-signal=OBJ_EXISTENCE_PROB_018}, {implementation-record-element=OBJ_CLS_TYPE1_PROB_001, system-signal=OBJ_CLS_TYPE1_PROB_018}, {implementation-record-element=OBJ_DIMENSION_LENGTH_ERR_001, system-signal=OBJ_DIMENSION_LENGTH_ERR_018}, {implementation-record-element=OBJ_POS_ERR_CRR_COEF_001, system-signal=OBJ_POS_ERR_CRR_COEF_018}, {implementation-record-element=OBJ_ACCEL_ERR_CRR_COEF_001, system-signal=OBJ_ACCEL_ERR_CRR_COEF_018}, {implementation-record-element=OBJ_ACCELERATION_LAT_001, system-signal=OBJ_ACCELERATION_LAT_018}, {implementation-record-element=OBJ_ACCELERATION_LONG_001, system-signal=OBJ_ACCELERATION_LONG_018}, {implementation-record-element=OBJ_CLS_TYPE2_001, system-signal=OBJ_CLS_TYPE2_018}, {implementation-record-element=OBJ_CLS_TYPE6_001, system-signal=OBJ_CLS_TYPE6_018}, {implementation-record-element=OBJ_DIMENSION_LENGTH_001, system-signal=OBJ_DIMENSION_LENGTH_018}, {implementation-record-element=OBJ_POS_LAT_001, system-signal=OBJ_POS_LAT_018}, {implementation-record-element=OBJ_REF_PT_LONG_OFFSET_001, system-signal=OBJ_REF_PT_LONG_OFFSET_018}, {implementation-record-element=OBJ_MEASUREMENT_STATUS_001, system-signal=OBJ_MEASUREMENT_STATUS_018}, {implementation-record-element=OBJ_TIMESTAMP_OFFSET_001, system-signal=OBJ_TIMESTAMP_OFFSET_018}, {implementation-record-element=OBJ_CLS_TYPE2_PROB_001, system-signal=OBJ_CLS_TYPE2_PROB_018}, {implementation-record-element=OBJ_POS_LONG_ERR_001, system-signal=OBJ_POS_LONG_ERR_018}, {implementation-record-element=OBJ_TRACK_MOTION_MODEL_001, system-signal=OBJ_TRACK_MOTION_MODEL_018}, {implementation-record-element=OBJ_GROUP_ID_001, system-signal=OBJ_GROUP_ID_018}, {implementation-record-element=OBJ_POS_LONG_001, system-signal=OBJ_POS_LONG_018}, {implementation-record-element=OBJ_VELOCITY_ERR_CRR_COEF_001, system-signal=OBJ_VELOCITY_ERR_CRR_COEF_018}, {implementation-record-element=OBJ_VELOCITY_LONG_001, system-signal=OBJ_VELOCITY_LONG_018}, {implementation-record-element=OBJ_VELOCITY_LONG_ERR_001, system-signal=OBJ_VELOCITY_LONG_ERR_018}, {implementation-record-element=OBJ_ACCELERATION_LAT_ERR_001, system-signal=OBJ_ACCELERATION_LAT_ERR_018}, {implementation-record-element=OBJ_CLS_TYPE5_001, system-signal=OBJ_CLS_TYPE5_018}, {implementation-record-element=OBJ_RCS_001, system-signal=OBJ_RCS_018}, {implementation-record-element=OBJ_ID_001, system-signal=OBJ_ID_018}, {implementation-record-element=OBJ_MH_CRC16_001, system-signal=OBJ_MH_CRC16_018}, {implementation-record-element=OBJ_VEH_TRACK_FLAG_001, system-signal=OBJ_VEH_TRACK_FLAG_018}, {implementation-record-element=OBJ_YAW_ANGLE_001, system-signal=OBJ_YAW_ANGLE_018}, {implementation-record-element=OBJ_YAW_ANGLE_ERR_001, system-signal=OBJ_YAW_ANGLE_ERR_018}, {implementation-record-element=OBJ_YAW_RATE_001, system-signal=OBJ_YAW_RATE_018}, {implementation-record-element=OBJ_CLS_TYPE3_001, system-signal=OBJ_CLS_TYPE3_018}, {implementation-record-element=OBJ_YAW_RATE_ERR_001, system-signal=OBJ_YAW_RATE_ERR_018}, {implementation-record-element=OBJ_CLS_TYPE6_PROB_001, system-signal=OBJ_CLS_TYPE6_PROB_018}, {implementation-record-element=OBJ_MH_CYCLE_COUNTER_001, system-signal=OBJ_MH_CYCLE_COUNTER_018}, {implementation-record-element=OBJ_ALIVE_TIME_001, system-signal=OBJ_ALIVE_TIME_018}, {implementation-record-element=OBJ_CLS_TYPE1_001, system-signal=OBJ_CLS_TYPE1_018}, {implementation-record-element=OBJ_ACCELERATION_LONG_ERR_001, system-signal=OBJ_ACCELERATION_LONG_ERR_018}, {implementation-record-element=OBJ_CLS_TYPE5_PROB_001, system-signal=OBJ_CLS_TYPE5_PROB_018}, {implementation-record-element=OBJ_VELOCITY_LAT_001, system-signal=OBJ_VELOCITY_LAT_018}, {implementation-record-element=OBJ_VELOCITY_LAT_ERR_001, system-signal=OBJ_VELOCITY_LAT_ERR_018}, {implementation-record-element=OBJ_POS_LAT_ERR_001, system-signal=OBJ_POS_LAT_ERR_018}]}
        sender-receiver-to-signal-group-mapping={data-element=Pp_SG_TrackerObject019.Vdp_SG_TrackerObject019, signal-group=SG_TrackerObject019, type-mapping=sender-rec-record-type-mapping=record-element-mappings=[{implementation-record-element=OBJ_ACCEL_ERR_CRR_COEF_001, system-signal=OBJ_ACCEL_ERR_CRR_COEF_019}, {implementation-record-element=OBJ_ACCELERATION_LAT_001, system-signal=OBJ_ACCELERATION_LAT_019}, {implementation-record-element=OBJ_CLS_TYPE6_PROB_001, system-signal=OBJ_CLS_TYPE6_PROB_019}, {implementation-record-element=OBJ_YAW_ANGLE_001, system-signal=OBJ_YAW_ANGLE_019}, {implementation-record-element=OBJ_CLS_TYPE2_PROB_001, system-signal=OBJ_CLS_TYPE2_PROB_019}, {implementation-record-element=OBJ_CLS_TYPE1_001, system-signal=OBJ_CLS_TYPE1_019}, {implementation-record-element=OBJ_CLS_TYPE3_001, system-signal=OBJ_CLS_TYPE3_019}, {implementation-record-element=OBJ_DIMENSION_WIDTH_ERR_001, system-signal=OBJ_DIMENSION_WIDTH_ERR_019}, {implementation-record-element=OBJ_MH_CYCLE_COUNTER_001, system-signal=OBJ_MH_CYCLE_COUNTER_019}, {implementation-record-element=OBJ_YAW_RATE_001, system-signal=OBJ_YAW_RATE_019}, {implementation-record-element=OBJ_VELOCITY_LONG_001, system-signal=OBJ_VELOCITY_LONG_019}, {implementation-record-element=OBJ_MH_CRC16_001, system-signal=OBJ_MH_CRC16_019}, {implementation-record-element=OBJ_CLS_TYPE5_001, system-signal=OBJ_CLS_TYPE5_019}, {implementation-record-element=OBJ_CLS_TYPE5_PROB_001, system-signal=OBJ_CLS_TYPE5_PROB_019}, {implementation-record-element=OBJ_RCS_001, system-signal=OBJ_RCS_019}, {implementation-record-element=OBJ_CLS_TYPE3_PROB_001, system-signal=OBJ_CLS_TYPE3_PROB_019}, {implementation-record-element=OBJ_GROUP_ID_001, system-signal=OBJ_GROUP_ID_019}, {implementation-record-element=OBJ_MOVEMENT_STATUS_001, system-signal=OBJ_MOVEMENT_STATUS_019}, {implementation-record-element=OBJ_TIMESTAMP_OFFSET_001, system-signal=OBJ_TIMESTAMP_OFFSET_019}, {implementation-record-element=OBJ_ACCELERATION_LONG_ERR_001, system-signal=OBJ_ACCELERATION_LONG_ERR_019}, {implementation-record-element=OBJ_CLS_TYPE2_001, system-signal=OBJ_CLS_TYPE2_019}, {implementation-record-element=OBJ_YAW_ANGLE_ERR_001, system-signal=OBJ_YAW_ANGLE_ERR_019}, {implementation-record-element=OBJ_ALIVE_TIME_001, system-signal=OBJ_ALIVE_TIME_019}, {implementation-record-element=OBJ_ACCELERATION_LONG_001, system-signal=OBJ_ACCELERATION_LONG_019}, {implementation-record-element=OBJ_CLS_TYPE4_001, system-signal=OBJ_CLS_TYPE4_019}, {implementation-record-element=OBJ_MEASUREMENT_STATUS_001, system-signal=OBJ_MEASUREMENT_STATUS_019}, {implementation-record-element=OBJ_VEH_TRACK_FLAG_001, system-signal=OBJ_VEH_TRACK_FLAG_019}, {implementation-record-element=OBJ_ACCELERATION_LAT_ERR_001, system-signal=OBJ_ACCELERATION_LAT_ERR_019}, {implementation-record-element=OBJ_POS_LAT_001, system-signal=OBJ_POS_LAT_019}, {implementation-record-element=OBJ_POS_LONG_ERR_001, system-signal=OBJ_POS_LONG_ERR_019}, {implementation-record-element=OBJ_VELOCITY_ERR_CRR_COEF_001, system-signal=OBJ_VELOCITY_ERR_CRR_COEF_019}, {implementation-record-element=OBJ_EXISTENCE_PROB_001, system-signal=OBJ_EXISTENCE_PROB_019}, {implementation-record-element=OBJ_REF_PT_LAT_OFFSET_001, system-signal=OBJ_REF_PT_LAT_OFFSET_019}, {implementation-record-element=OBJ_TRACK_MOTION_MODEL_001, system-signal=OBJ_TRACK_MOTION_MODEL_019}, {implementation-record-element=OBJ_VELOCITY_LAT_001, system-signal=OBJ_VELOCITY_LAT_019}, {implementation-record-element=OBJ_VELOCITY_LAT_ERR_001, system-signal=OBJ_VELOCITY_LAT_ERR_019}, {implementation-record-element=OBJ_CLS_TYPE4_PROB_001, system-signal=OBJ_CLS_TYPE4_PROB_019}, {implementation-record-element=OBJ_DIMENSION_LENGTH_001, system-signal=OBJ_DIMENSION_LENGTH_019}, {implementation-record-element=OBJ_DIMENSION_WIDTH_001, system-signal=OBJ_DIMENSION_WIDTH_019}, {implementation-record-element=OBJ_POS_LONG_001, system-signal=OBJ_POS_LONG_019}, {implementation-record-element=OBJ_REF_PT_LONG_OFFSET_001, system-signal=OBJ_REF_PT_LONG_OFFSET_019}, {implementation-record-element=OBJ_VELOCITY_LONG_ERR_001, system-signal=OBJ_VELOCITY_LONG_ERR_019}, {implementation-record-element=OBJ_CLS_TYPE6_001, system-signal=OBJ_CLS_TYPE6_019}, {implementation-record-element=OBJ_CLS_TYPE1_PROB_001, system-signal=OBJ_CLS_TYPE1_PROB_019}, {implementation-record-element=OBJ_ID_001, system-signal=OBJ_ID_019}, {implementation-record-element=OBJ_POS_LAT_ERR_001, system-signal=OBJ_POS_LAT_ERR_019}, {implementation-record-element=OBJ_YAW_RATE_ERR_001, system-signal=OBJ_YAW_RATE_ERR_019}, {implementation-record-element=OBJ_DIMENSION_LENGTH_ERR_001, system-signal=OBJ_DIMENSION_LENGTH_ERR_019}, {implementation-record-element=OBJ_POS_ERR_CRR_COEF_001, system-signal=OBJ_POS_ERR_CRR_COEF_019}]}
        sender-receiver-to-signal-group-mapping={data-element=Pp_SG_TrackerObject020.Vdp_SG_TrackerObject020, signal-group=SG_TrackerObject020, type-mapping=sender-rec-record-type-mapping=record-element-mappings=[{implementation-record-element=OBJ_ACCEL_ERR_CRR_COEF_001, system-signal=OBJ_ACCEL_ERR_CRR_COEF_020}, {implementation-record-element=OBJ_CLS_TYPE1_PROB_001, system-signal=OBJ_CLS_TYPE1_PROB_020}, {implementation-record-element=OBJ_ACCELERATION_LONG_ERR_001, system-signal=OBJ_ACCELERATION_LONG_ERR_020}, {implementation-record-element=OBJ_CLS_TYPE3_001, system-signal=OBJ_CLS_TYPE3_020}, {implementation-record-element=OBJ_CLS_TYPE3_PROB_001, system-signal=OBJ_CLS_TYPE3_PROB_020}, {implementation-record-element=OBJ_ALIVE_TIME_001, system-signal=OBJ_ALIVE_TIME_020}, {implementation-record-element=OBJ_CLS_TYPE4_001, system-signal=OBJ_CLS_TYPE4_020}, {implementation-record-element=OBJ_ACCELERATION_LAT_ERR_001, system-signal=OBJ_ACCELERATION_LAT_ERR_020}, {implementation-record-element=OBJ_CLS_TYPE2_PROB_001, system-signal=OBJ_CLS_TYPE2_PROB_020}, {implementation-record-element=OBJ_CLS_TYPE4_PROB_001, system-signal=OBJ_CLS_TYPE4_PROB_020}, {implementation-record-element=OBJ_ACCELERATION_LAT_001, system-signal=OBJ_ACCELERATION_LAT_020}, {implementation-record-element=OBJ_ACCELERATION_LONG_001, system-signal=OBJ_ACCELERATION_LONG_020}, {implementation-record-element=OBJ_CLS_TYPE2_001, system-signal=OBJ_CLS_TYPE2_020}, {implementation-record-element=OBJ_CLS_TYPE5_PROB_001, system-signal=OBJ_CLS_TYPE5_PROB_020}, {implementation-record-element=OBJ_CLS_TYPE1_001, system-signal=OBJ_CLS_TYPE1_020}, {implementation-record-element=OBJ_CLS_TYPE5_001, system-signal=OBJ_CLS_TYPE5_020}, {implementation-record-element=OBJ_YAW_ANGLE_ERR_001, system-signal=OBJ_YAW_ANGLE_ERR_020}, {implementation-record-element=OBJ_REF_PT_LAT_OFFSET_001, system-signal=OBJ_REF_PT_LAT_OFFSET_020}, {implementation-record-element=OBJ_MEASUREMENT_STATUS_001, system-signal=OBJ_MEASUREMENT_STATUS_020}, {implementation-record-element=OBJ_VELOCITY_LONG_001, system-signal=OBJ_VELOCITY_LONG_020}, {implementation-record-element=OBJ_REF_PT_LONG_OFFSET_001, system-signal=OBJ_REF_PT_LONG_OFFSET_020}, {implementation-record-element=OBJ_TIMESTAMP_OFFSET_001, system-signal=OBJ_TIMESTAMP_OFFSET_020}, {implementation-record-element=OBJ_MH_CYCLE_COUNTER_001, system-signal=OBJ_MH_CYCLE_COUNTER_020}, {implementation-record-element=OBJ_DIMENSION_LENGTH_001, system-signal=OBJ_DIMENSION_LENGTH_020}, {implementation-record-element=OBJ_MOVEMENT_STATUS_001, system-signal=OBJ_MOVEMENT_STATUS_020}, {implementation-record-element=OBJ_POS_ERR_CRR_COEF_001, system-signal=OBJ_POS_ERR_CRR_COEF_020}, {implementation-record-element=OBJ_YAW_RATE_ERR_001, system-signal=OBJ_YAW_RATE_ERR_020}, {implementation-record-element=OBJ_ID_001, system-signal=OBJ_ID_020}, {implementation-record-element=OBJ_YAW_RATE_001, system-signal=OBJ_YAW_RATE_020}, {implementation-record-element=OBJ_YAW_ANGLE_001, system-signal=OBJ_YAW_ANGLE_020}, {implementation-record-element=OBJ_POS_LONG_001, system-signal=OBJ_POS_LONG_020}, {implementation-record-element=OBJ_DIMENSION_WIDTH_001, system-signal=OBJ_DIMENSION_WIDTH_020}, {implementation-record-element=OBJ_VELOCITY_ERR_CRR_COEF_001, system-signal=OBJ_VELOCITY_ERR_CRR_COEF_020}, {implementation-record-element=OBJ_DIMENSION_LENGTH_ERR_001, system-signal=OBJ_DIMENSION_LENGTH_ERR_020}, {implementation-record-element=OBJ_POS_LAT_001, system-signal=OBJ_POS_LAT_020}, {implementation-record-element=OBJ_VEH_TRACK_FLAG_001, system-signal=OBJ_VEH_TRACK_FLAG_020}, {implementation-record-element=OBJ_GROUP_ID_001, system-signal=OBJ_GROUP_ID_020}, {implementation-record-element=OBJ_DIMENSION_WIDTH_ERR_001, system-signal=OBJ_DIMENSION_WIDTH_ERR_020}, {implementation-record-element=OBJ_POS_LAT_ERR_001, system-signal=OBJ_POS_LAT_ERR_020}, {implementation-record-element=OBJ_POS_LONG_ERR_001, system-signal=OBJ_POS_LONG_ERR_020}, {implementation-record-element=OBJ_MH_CRC16_001, system-signal=OBJ_MH_CRC16_020}, {implementation-record-element=OBJ_CLS_TYPE6_PROB_001, system-signal=OBJ_CLS_TYPE6_PROB_020}, {implementation-record-element=OBJ_CLS_TYPE6_001, system-signal=OBJ_CLS_TYPE6_020}, {implementation-record-element=OBJ_RCS_001, system-signal=OBJ_RCS_020}, {implementation-record-element=OBJ_EXISTENCE_PROB_001, system-signal=OBJ_EXISTENCE_PROB_020}, {implementation-record-element=OBJ_VELOCITY_LAT_001, system-signal=OBJ_VELOCITY_LAT_020}, {implementation-record-element=OBJ_VELOCITY_LONG_ERR_001, system-signal=OBJ_VELOCITY_LONG_ERR_020}, {implementation-record-element=OBJ_VELOCITY_LAT_ERR_001, system-signal=OBJ_VELOCITY_LAT_ERR_020}, {implementation-record-element=OBJ_TRACK_MOTION_MODEL_001, system-signal=OBJ_TRACK_MOTION_MODEL_020}]}
        sender-receiver-to-signal-group-mapping={data-element=Pp_SG_TrackerObject021.Vdp_SG_TrackerObject021, signal-group=SG_TrackerObject021, type-mapping=sender-rec-record-type-mapping=record-element-mappings=[{implementation-record-element=OBJ_ACCELERATION_LONG_ERR_001, system-signal=OBJ_ACCELERATION_LONG_ERR_021}, {implementation-record-element=OBJ_CLS_TYPE1_PROB_001, system-signal=OBJ_CLS_TYPE1_PROB_021}, {implementation-record-element=OBJ_MEASUREMENT_STATUS_001, system-signal=OBJ_MEASUREMENT_STATUS_021}, {implementation-record-element=OBJ_MH_CRC16_001, system-signal=OBJ_MH_CRC16_021}, {implementation-record-element=OBJ_MH_CYCLE_COUNTER_001, system-signal=OBJ_MH_CYCLE_COUNTER_021}, {implementation-record-element=OBJ_ACCELERATION_LAT_001, system-signal=OBJ_ACCELERATION_LAT_021}, {implementation-record-element=OBJ_ACCELERATION_LAT_ERR_001, system-signal=OBJ_ACCELERATION_LAT_ERR_021}, {implementation-record-element=OBJ_MOVEMENT_STATUS_001, system-signal=OBJ_MOVEMENT_STATUS_021}, {implementation-record-element=OBJ_POS_ERR_CRR_COEF_001, system-signal=OBJ_POS_ERR_CRR_COEF_021}, {implementation-record-element=OBJ_ACCEL_ERR_CRR_COEF_001, system-signal=OBJ_ACCEL_ERR_CRR_COEF_021}, {implementation-record-element=OBJ_CLS_TYPE6_PROB_001, system-signal=OBJ_CLS_TYPE6_PROB_021}, {implementation-record-element=OBJ_CLS_TYPE4_001, system-signal=OBJ_CLS_TYPE4_021}, {implementation-record-element=OBJ_CLS_TYPE3_PROB_001, system-signal=OBJ_CLS_TYPE3_PROB_021}, {implementation-record-element=OBJ_CLS_TYPE2_001, system-signal=OBJ_CLS_TYPE2_021}, {implementation-record-element=OBJ_CLS_TYPE2_PROB_001, system-signal=OBJ_CLS_TYPE2_PROB_021}, {implementation-record-element=OBJ_CLS_TYPE3_001, system-signal=OBJ_CLS_TYPE3_021}, {implementation-record-element=OBJ_CLS_TYPE4_PROB_001, system-signal=OBJ_CLS_TYPE4_PROB_021}, {implementation-record-element=OBJ_DIMENSION_WIDTH_001, system-signal=OBJ_DIMENSION_WIDTH_021}, {implementation-record-element=OBJ_ALIVE_TIME_001, system-signal=OBJ_ALIVE_TIME_021}, {implementation-record-element=OBJ_CLS_TYPE1_001, system-signal=OBJ_CLS_TYPE1_021}, {implementation-record-element=OBJ_CLS_TYPE6_001, system-signal=OBJ_CLS_TYPE6_021}, {implementation-record-element=OBJ_DIMENSION_LENGTH_001, system-signal=OBJ_DIMENSION_LENGTH_021}, {implementation-record-element=OBJ_CLS_TYPE5_PROB_001, system-signal=OBJ_CLS_TYPE5_PROB_021}, {implementation-record-element=OBJ_DIMENSION_LENGTH_ERR_001, system-signal=OBJ_DIMENSION_LENGTH_ERR_021}, {implementation-record-element=OBJ_DIMENSION_WIDTH_ERR_001, system-signal=OBJ_DIMENSION_WIDTH_ERR_021}, {implementation-record-element=OBJ_EXISTENCE_PROB_001, system-signal=OBJ_EXISTENCE_PROB_021}, {implementation-record-element=OBJ_ACCELERATION_LONG_001, system-signal=OBJ_ACCELERATION_LONG_021}, {implementation-record-element=OBJ_CLS_TYPE5_001, system-signal=OBJ_CLS_TYPE5_021}, {implementation-record-element=OBJ_GROUP_ID_001, system-signal=OBJ_GROUP_ID_021}, {implementation-record-element=OBJ_ID_001, system-signal=OBJ_ID_021}, {implementation-record-element=OBJ_VELOCITY_LAT_001, system-signal=OBJ_VELOCITY_LAT_021}, {implementation-record-element=OBJ_POS_LONG_ERR_001, system-signal=OBJ_POS_LONG_ERR_021}, {implementation-record-element=OBJ_YAW_ANGLE_001, system-signal=OBJ_YAW_ANGLE_021}, {implementation-record-element=OBJ_RCS_001, system-signal=OBJ_RCS_021}, {implementation-record-element=OBJ_VELOCITY_LONG_ERR_001, system-signal=OBJ_VELOCITY_LONG_ERR_021}, {implementation-record-element=OBJ_POS_LAT_001, system-signal=OBJ_POS_LAT_021}, {implementation-record-element=OBJ_TRACK_MOTION_MODEL_001, system-signal=OBJ_TRACK_MOTION_MODEL_021}, {implementation-record-element=OBJ_VEH_TRACK_FLAG_001, system-signal=OBJ_VEH_TRACK_FLAG_021}, {implementation-record-element=OBJ_REF_PT_LAT_OFFSET_001, system-signal=OBJ_REF_PT_LAT_OFFSET_021}, {implementation-record-element=OBJ_VELOCITY_LAT_ERR_001, system-signal=OBJ_VELOCITY_LAT_ERR_021}, {implementation-record-element=OBJ_POS_LONG_001, system-signal=OBJ_POS_LONG_021}, {implementation-record-element=OBJ_REF_PT_LONG_OFFSET_001, system-signal=OBJ_REF_PT_LONG_OFFSET_021}, {implementation-record-element=OBJ_VELOCITY_LONG_001, system-signal=OBJ_VELOCITY_LONG_021}, {implementation-record-element=OBJ_YAW_ANGLE_ERR_001, system-signal=OBJ_YAW_ANGLE_ERR_021}, {implementation-record-element=OBJ_YAW_RATE_ERR_001, system-signal=OBJ_YAW_RATE_ERR_021}, {implementation-record-element=OBJ_TIMESTAMP_OFFSET_001, system-signal=OBJ_TIMESTAMP_OFFSET_021}, {implementation-record-element=OBJ_YAW_RATE_001, system-signal=OBJ_YAW_RATE_021}, {implementation-record-element=OBJ_VELOCITY_ERR_CRR_COEF_001, system-signal=OBJ_VELOCITY_ERR_CRR_COEF_021}, {implementation-record-element=OBJ_POS_LAT_ERR_001, system-signal=OBJ_POS_LAT_ERR_021}]}
        sender-receiver-to-signal-group-mapping={data-element=Pp_SG_TrackerObject022.Vdp_SG_TrackerObject022, signal-group=SG_TrackerObject022, type-mapping=sender-rec-record-type-mapping=record-element-mappings=[{implementation-record-element=OBJ_VEH_TRACK_FLAG_001, system-signal=OBJ_VEH_TRACK_FLAG_022}, {implementation-record-element=OBJ_EXISTENCE_PROB_001, system-signal=OBJ_EXISTENCE_PROB_022}, {implementation-record-element=OBJ_CLS_TYPE2_001, system-signal=OBJ_CLS_TYPE2_022}, {implementation-record-element=OBJ_CLS_TYPE5_001, system-signal=OBJ_CLS_TYPE5_022}, {implementation-record-element=OBJ_DIMENSION_WIDTH_001, system-signal=OBJ_DIMENSION_WIDTH_022}, {implementation-record-element=OBJ_DIMENSION_WIDTH_ERR_001, system-signal=OBJ_DIMENSION_WIDTH_ERR_022}, {implementation-record-element=OBJ_GROUP_ID_001, system-signal=OBJ_GROUP_ID_022}, {implementation-record-element=OBJ_ID_001, system-signal=OBJ_ID_022}, {implementation-record-element=OBJ_POS_LAT_001, system-signal=OBJ_POS_LAT_022}, {implementation-record-element=OBJ_POS_LAT_ERR_001, system-signal=OBJ_POS_LAT_ERR_022}, {implementation-record-element=OBJ_POS_LONG_001, system-signal=OBJ_POS_LONG_022}, {implementation-record-element=OBJ_CLS_TYPE4_PROB_001, system-signal=OBJ_CLS_TYPE4_PROB_022}, {implementation-record-element=OBJ_POS_LONG_ERR_001, system-signal=OBJ_POS_LONG_ERR_022}, {implementation-record-element=OBJ_POS_ERR_CRR_COEF_001, system-signal=OBJ_POS_ERR_CRR_COEF_022}, {implementation-record-element=OBJ_ACCELERATION_LAT_001, system-signal=OBJ_ACCELERATION_LAT_022}, {implementation-record-element=OBJ_ACCELERATION_LAT_ERR_001, system-signal=OBJ_ACCELERATION_LAT_ERR_022}, {implementation-record-element=OBJ_CLS_TYPE3_001, system-signal=OBJ_CLS_TYPE3_022}, {implementation-record-element=OBJ_CLS_TYPE5_PROB_001, system-signal=OBJ_CLS_TYPE5_PROB_022}, {implementation-record-element=OBJ_MH_CRC16_001, system-signal=OBJ_MH_CRC16_022}, {implementation-record-element=OBJ_ACCELERATION_LONG_ERR_001, system-signal=OBJ_ACCELERATION_LONG_ERR_022}, {implementation-record-element=OBJ_MH_CYCLE_COUNTER_001, system-signal=OBJ_MH_CYCLE_COUNTER_022}, {implementation-record-element=OBJ_RCS_001, system-signal=OBJ_RCS_022}, {implementation-record-element=OBJ_REF_PT_LONG_OFFSET_001, system-signal=OBJ_REF_PT_LONG_OFFSET_022}, {implementation-record-element=OBJ_VELOCITY_ERR_CRR_COEF_001, system-signal=OBJ_VELOCITY_ERR_CRR_COEF_022}, {implementation-record-element=OBJ_CLS_TYPE4_001, system-signal=OBJ_CLS_TYPE4_022}, {implementation-record-element=OBJ_MEASUREMENT_STATUS_001, system-signal=OBJ_MEASUREMENT_STATUS_022}, {implementation-record-element=OBJ_CLS_TYPE6_PROB_001, system-signal=OBJ_CLS_TYPE6_PROB_022}, {implementation-record-element=OBJ_REF_PT_LAT_OFFSET_001, system-signal=OBJ_REF_PT_LAT_OFFSET_022}, {implementation-record-element=OBJ_TIMESTAMP_OFFSET_001, system-signal=OBJ_TIMESTAMP_OFFSET_022}, {implementation-record-element=OBJ_CLS_TYPE2_PROB_001, system-signal=OBJ_CLS_TYPE2_PROB_022}, {implementation-record-element=OBJ_VELOCITY_LAT_001, system-signal=OBJ_VELOCITY_LAT_022}, {implementation-record-element=OBJ_DIMENSION_LENGTH_ERR_001, system-signal=OBJ_DIMENSION_LENGTH_ERR_022}, {implementation-record-element=OBJ_VELOCITY_LAT_ERR_001, system-signal=OBJ_VELOCITY_LAT_ERR_022}, {implementation-record-element=OBJ_ACCEL_ERR_CRR_COEF_001, system-signal=OBJ_ACCEL_ERR_CRR_COEF_022}, {implementation-record-element=OBJ_ALIVE_TIME_001, system-signal=OBJ_ALIVE_TIME_022}, {implementation-record-element=OBJ_CLS_TYPE1_PROB_001, system-signal=OBJ_CLS_TYPE1_PROB_022}, {implementation-record-element=OBJ_DIMENSION_LENGTH_001, system-signal=OBJ_DIMENSION_LENGTH_022}, {implementation-record-element=OBJ_ACCELERATION_LONG_001, system-signal=OBJ_ACCELERATION_LONG_022}, {implementation-record-element=OBJ_MOVEMENT_STATUS_001, system-signal=OBJ_MOVEMENT_STATUS_022}, {implementation-record-element=OBJ_CLS_TYPE3_PROB_001, system-signal=OBJ_CLS_TYPE3_PROB_022}, {implementation-record-element=OBJ_TRACK_MOTION_MODEL_001, system-signal=OBJ_TRACK_MOTION_MODEL_022}, {implementation-record-element=OBJ_VELOCITY_LONG_001, system-signal=OBJ_VELOCITY_LONG_022}, {implementation-record-element=OBJ_CLS_TYPE1_001, system-signal=OBJ_CLS_TYPE1_022}, {implementation-record-element=OBJ_CLS_TYPE6_001, system-signal=OBJ_CLS_TYPE6_022}, {implementation-record-element=OBJ_YAW_RATE_001, system-signal=OBJ_YAW_RATE_022}, {implementation-record-element=OBJ_YAW_ANGLE_ERR_001, system-signal=OBJ_YAW_ANGLE_ERR_022}, {implementation-record-element=OBJ_VELOCITY_LONG_ERR_001, system-signal=OBJ_VELOCITY_LONG_ERR_022}, {implementation-record-element=OBJ_YAW_RATE_ERR_001, system-signal=OBJ_YAW_RATE_ERR_022}, {implementation-record-element=OBJ_YAW_ANGLE_001, system-signal=OBJ_YAW_ANGLE_022}]}
        sender-receiver-to-signal-group-mapping={data-element=Pp_SG_TrackerObject023.Vdp_SG_TrackerObject023, signal-group=SG_TrackerObject023, type-mapping=sender-rec-record-type-mapping=record-element-mappings=[{implementation-record-element=OBJ_EXISTENCE_PROB_001, system-signal=OBJ_EXISTENCE_PROB_023}, {implementation-record-element=OBJ_ACCEL_ERR_CRR_COEF_001, system-signal=OBJ_ACCEL_ERR_CRR_COEF_023}, {implementation-record-element=OBJ_POS_LAT_001, system-signal=OBJ_POS_LAT_023}, {implementation-record-element=OBJ_YAW_ANGLE_ERR_001, system-signal=OBJ_YAW_ANGLE_ERR_023}, {implementation-record-element=OBJ_VELOCITY_LAT_ERR_001, system-signal=OBJ_VELOCITY_LAT_ERR_023}, {implementation-record-element=OBJ_DIMENSION_WIDTH_ERR_001, system-signal=OBJ_DIMENSION_WIDTH_ERR_023}, {implementation-record-element=OBJ_CLS_TYPE3_PROB_001, system-signal=OBJ_CLS_TYPE3_PROB_023}, {implementation-record-element=OBJ_MEASUREMENT_STATUS_001, system-signal=OBJ_MEASUREMENT_STATUS_023}, {implementation-record-element=OBJ_ALIVE_TIME_001, system-signal=OBJ_ALIVE_TIME_023}, {implementation-record-element=OBJ_VELOCITY_LONG_001, system-signal=OBJ_VELOCITY_LONG_023}, {implementation-record-element=OBJ_ACCELERATION_LAT_ERR_001, system-signal=OBJ_ACCELERATION_LAT_ERR_023}, {implementation-record-element=OBJ_CLS_TYPE6_001, system-signal=OBJ_CLS_TYPE6_023}, {implementation-record-element=OBJ_MOVEMENT_STATUS_001, system-signal=OBJ_MOVEMENT_STATUS_023}, {implementation-record-element=OBJ_POS_ERR_CRR_COEF_001, system-signal=OBJ_POS_ERR_CRR_COEF_023}, {implementation-record-element=OBJ_ID_001, system-signal=OBJ_ID_023}, {implementation-record-element=OBJ_TRACK_MOTION_MODEL_001, system-signal=OBJ_TRACK_MOTION_MODEL_023}, {implementation-record-element=OBJ_YAW_ANGLE_001, system-signal=OBJ_YAW_ANGLE_023}, {implementation-record-element=OBJ_GROUP_ID_001, system-signal=OBJ_GROUP_ID_023}, {implementation-record-element=OBJ_ACCELERATION_LAT_001, system-signal=OBJ_ACCELERATION_LAT_023}, {implementation-record-element=OBJ_CLS_TYPE4_PROB_001, system-signal=OBJ_CLS_TYPE4_PROB_023}, {implementation-record-element=OBJ_YAW_RATE_001, system-signal=OBJ_YAW_RATE_023}, {implementation-record-element=OBJ_MH_CRC16_001, system-signal=OBJ_MH_CRC16_023}, {implementation-record-element=OBJ_DIMENSION_LENGTH_ERR_001, system-signal=OBJ_DIMENSION_LENGTH_ERR_023}, {implementation-record-element=OBJ_CLS_TYPE4_001, system-signal=OBJ_CLS_TYPE4_023}, {implementation-record-element=OBJ_DIMENSION_WIDTH_001, system-signal=OBJ_DIMENSION_WIDTH_023}, {implementation-record-element=OBJ_TIMESTAMP_OFFSET_001, system-signal=OBJ_TIMESTAMP_OFFSET_023}, {implementation-record-element=OBJ_VELOCITY_LONG_ERR_001, system-signal=OBJ_VELOCITY_LONG_ERR_023}, {implementation-record-element=OBJ_CLS_TYPE2_001, system-signal=OBJ_CLS_TYPE2_023}, {implementation-record-element=OBJ_CLS_TYPE5_001, system-signal=OBJ_CLS_TYPE5_023}, {implementation-record-element=OBJ_CLS_TYPE1_PROB_001, system-signal=OBJ_CLS_TYPE1_PROB_023}, {implementation-record-element=OBJ_CLS_TYPE6_PROB_001, system-signal=OBJ_CLS_TYPE6_PROB_023}, {implementation-record-element=OBJ_DIMENSION_LENGTH_001, system-signal=OBJ_DIMENSION_LENGTH_023}, {implementation-record-element=OBJ_REF_PT_LONG_OFFSET_001, system-signal=OBJ_REF_PT_LONG_OFFSET_023}, {implementation-record-element=OBJ_VEH_TRACK_FLAG_001, system-signal=OBJ_VEH_TRACK_FLAG_023}, {implementation-record-element=OBJ_MH_CYCLE_COUNTER_001, system-signal=OBJ_MH_CYCLE_COUNTER_023}, {implementation-record-element=OBJ_POS_LAT_ERR_001, system-signal=OBJ_POS_LAT_ERR_023}, {implementation-record-element=OBJ_CLS_TYPE5_PROB_001, system-signal=OBJ_CLS_TYPE5_PROB_023}, {implementation-record-element=OBJ_POS_LONG_001, system-signal=OBJ_POS_LONG_023}, {implementation-record-element=OBJ_CLS_TYPE3_001, system-signal=OBJ_CLS_TYPE3_023}, {implementation-record-element=OBJ_CLS_TYPE2_PROB_001, system-signal=OBJ_CLS_TYPE2_PROB_023}, {implementation-record-element=OBJ_POS_LONG_ERR_001, system-signal=OBJ_POS_LONG_ERR_023}, {implementation-record-element=OBJ_REF_PT_LAT_OFFSET_001, system-signal=OBJ_REF_PT_LAT_OFFSET_023}, {implementation-record-element=OBJ_YAW_RATE_ERR_001, system-signal=OBJ_YAW_RATE_ERR_023}, {implementation-record-element=OBJ_VELOCITY_ERR_CRR_COEF_001, system-signal=OBJ_VELOCITY_ERR_CRR_COEF_023}, {implementation-record-element=OBJ_VELOCITY_LAT_001, system-signal=OBJ_VELOCITY_LAT_023}, {implementation-record-element=OBJ_RCS_001, system-signal=OBJ_RCS_023}, {implementation-record-element=OBJ_ACCELERATION_LONG_001, system-signal=OBJ_ACCELERATION_LONG_023}, {implementation-record-element=OBJ_ACCELERATION_LONG_ERR_001, system-signal=OBJ_ACCELERATION_LONG_ERR_023}, {implementation-record-element=OBJ_CLS_TYPE1_001, system-signal=OBJ_CLS_TYPE1_023}]}
        sender-receiver-to-signal-group-mapping={data-element=Pp_SG_TrackerObject024.Vdp_SG_TrackerObject024, signal-group=SG_TrackerObject024, type-mapping=sender-rec-record-type-mapping=record-element-mappings=[{implementation-record-element=OBJ_ACCELERATION_LAT_001, system-signal=OBJ_ACCELERATION_LAT_024}, {implementation-record-element=OBJ_ACCELERATION_LAT_ERR_001, system-signal=OBJ_ACCELERATION_LAT_ERR_024}, {implementation-record-element=OBJ_ACCELERATION_LONG_ERR_001, system-signal=OBJ_ACCELERATION_LONG_ERR_024}, {implementation-record-element=OBJ_ACCEL_ERR_CRR_COEF_001, system-signal=OBJ_ACCEL_ERR_CRR_COEF_024}, {implementation-record-element=OBJ_ALIVE_TIME_001, system-signal=OBJ_ALIVE_TIME_024}, {implementation-record-element=OBJ_CLS_TYPE1_PROB_001, system-signal=OBJ_CLS_TYPE1_PROB_024}, {implementation-record-element=OBJ_ACCELERATION_LONG_001, system-signal=OBJ_ACCELERATION_LONG_024}, {implementation-record-element=OBJ_CLS_TYPE1_001, system-signal=OBJ_CLS_TYPE1_024}, {implementation-record-element=OBJ_CLS_TYPE2_PROB_001, system-signal=OBJ_CLS_TYPE2_PROB_024}, {implementation-record-element=OBJ_DIMENSION_LENGTH_ERR_001, system-signal=OBJ_DIMENSION_LENGTH_ERR_024}, {implementation-record-element=OBJ_MH_CYCLE_COUNTER_001, system-signal=OBJ_MH_CYCLE_COUNTER_024}, {implementation-record-element=OBJ_VEH_TRACK_FLAG_001, system-signal=OBJ_VEH_TRACK_FLAG_024}, {implementation-record-element=OBJ_YAW_RATE_001, system-signal=OBJ_YAW_RATE_024}, {implementation-record-element=OBJ_DIMENSION_LENGTH_001, system-signal=OBJ_DIMENSION_LENGTH_024}, {implementation-record-element=OBJ_YAW_ANGLE_001, system-signal=OBJ_YAW_ANGLE_024}, {implementation-record-element=OBJ_EXISTENCE_PROB_001, system-signal=OBJ_EXISTENCE_PROB_024}, {implementation-record-element=OBJ_YAW_RATE_ERR_001, system-signal=OBJ_YAW_RATE_ERR_024}, {implementation-record-element=OBJ_CLS_TYPE2_001, system-signal=OBJ_CLS_TYPE2_024}, {implementation-record-element=OBJ_YAW_ANGLE_ERR_001, system-signal=OBJ_YAW_ANGLE_ERR_024}, {implementation-record-element=OBJ_CLS_TYPE4_PROB_001, system-signal=OBJ_CLS_TYPE4_PROB_024}, {implementation-record-element=OBJ_MEASUREMENT_STATUS_001, system-signal=OBJ_MEASUREMENT_STATUS_024}, {implementation-record-element=OBJ_MH_CRC16_001, system-signal=OBJ_MH_CRC16_024}, {implementation-record-element=OBJ_DIMENSION_WIDTH_ERR_001, system-signal=OBJ_DIMENSION_WIDTH_ERR_024}, {implementation-record-element=OBJ_TRACK_MOTION_MODEL_001, system-signal=OBJ_TRACK_MOTION_MODEL_024}, {implementation-record-element=OBJ_DIMENSION_WIDTH_001, system-signal=OBJ_DIMENSION_WIDTH_024}, {implementation-record-element=OBJ_CLS_TYPE3_PROB_001, system-signal=OBJ_CLS_TYPE3_PROB_024}, {implementation-record-element=OBJ_GROUP_ID_001, system-signal=OBJ_GROUP_ID_024}, {implementation-record-element=OBJ_CLS_TYPE6_001, system-signal=OBJ_CLS_TYPE6_024}, {implementation-record-element=OBJ_RCS_001, system-signal=OBJ_RCS_024}, {implementation-record-element=OBJ_CLS_TYPE6_PROB_001, system-signal=OBJ_CLS_TYPE6_PROB_024}, {implementation-record-element=OBJ_TIMESTAMP_OFFSET_001, system-signal=OBJ_TIMESTAMP_OFFSET_024}, {implementation-record-element=OBJ_CLS_TYPE5_PROB_001, system-signal=OBJ_CLS_TYPE5_PROB_024}, {implementation-record-element=OBJ_REF_PT_LAT_OFFSET_001, system-signal=OBJ_REF_PT_LAT_OFFSET_024}, {implementation-record-element=OBJ_CLS_TYPE5_001, system-signal=OBJ_CLS_TYPE5_024}, {implementation-record-element=OBJ_POS_LONG_ERR_001, system-signal=OBJ_POS_LONG_ERR_024}, {implementation-record-element=OBJ_VELOCITY_LAT_001, system-signal=OBJ_VELOCITY_LAT_024}, {implementation-record-element=OBJ_ID_001, system-signal=OBJ_ID_024}, {implementation-record-element=OBJ_MOVEMENT_STATUS_001, system-signal=OBJ_MOVEMENT_STATUS_024}, {implementation-record-element=OBJ_CLS_TYPE4_001, system-signal=OBJ_CLS_TYPE4_024}, {implementation-record-element=OBJ_POS_ERR_CRR_COEF_001, system-signal=OBJ_POS_ERR_CRR_COEF_024}, {implementation-record-element=OBJ_POS_LAT_001, system-signal=OBJ_POS_LAT_024}, {implementation-record-element=OBJ_POS_LONG_001, system-signal=OBJ_POS_LONG_024}, {implementation-record-element=OBJ_VELOCITY_ERR_CRR_COEF_001, system-signal=OBJ_VELOCITY_ERR_CRR_COEF_024}, {implementation-record-element=OBJ_VELOCITY_LAT_ERR_001, system-signal=OBJ_VELOCITY_LAT_ERR_024}, {implementation-record-element=OBJ_VELOCITY_LONG_ERR_001, system-signal=OBJ_VELOCITY_LONG_ERR_024}, {implementation-record-element=OBJ_VELOCITY_LONG_001, system-signal=OBJ_VELOCITY_LONG_024}, {implementation-record-element=OBJ_CLS_TYPE3_001, system-signal=OBJ_CLS_TYPE3_024}, {implementation-record-element=OBJ_POS_LAT_ERR_001, system-signal=OBJ_POS_LAT_ERR_024}, {implementation-record-element=OBJ_REF_PT_LONG_OFFSET_001, system-signal=OBJ_REF_PT_LONG_OFFSET_024}]}
        sender-receiver-to-signal-group-mapping={data-element=Pp_SG_TrackerObject025.Vdp_SG_TrackerObject025, signal-group=SG_TrackerObject025, type-mapping=sender-rec-record-type-mapping=record-element-mappings=[{implementation-record-element=OBJ_ACCELERATION_LONG_ERR_001, system-signal=OBJ_ACCELERATION_LONG_ERR_025}, {implementation-record-element=OBJ_CLS_TYPE5_PROB_001, system-signal=OBJ_CLS_TYPE5_PROB_025}, {implementation-record-element=OBJ_CLS_TYPE6_001, system-signal=OBJ_CLS_TYPE6_025}, {implementation-record-element=OBJ_CLS_TYPE6_PROB_001, system-signal=OBJ_CLS_TYPE6_PROB_025}, {implementation-record-element=OBJ_DIMENSION_LENGTH_001, system-signal=OBJ_DIMENSION_LENGTH_025}, {implementation-record-element=OBJ_DIMENSION_WIDTH_001, system-signal=OBJ_DIMENSION_WIDTH_025}, {implementation-record-element=OBJ_CLS_TYPE3_001, system-signal=OBJ_CLS_TYPE3_025}, {implementation-record-element=OBJ_CLS_TYPE1_001, system-signal=OBJ_CLS_TYPE1_025}, {implementation-record-element=OBJ_CLS_TYPE3_PROB_001, system-signal=OBJ_CLS_TYPE3_PROB_025}, {implementation-record-element=OBJ_ACCEL_ERR_CRR_COEF_001, system-signal=OBJ_ACCEL_ERR_CRR_COEF_025}, {implementation-record-element=OBJ_CLS_TYPE4_PROB_001, system-signal=OBJ_CLS_TYPE4_PROB_025}, {implementation-record-element=OBJ_CLS_TYPE2_001, system-signal=OBJ_CLS_TYPE2_025}, {implementation-record-element=OBJ_DIMENSION_LENGTH_ERR_001, system-signal=OBJ_DIMENSION_LENGTH_ERR_025}, {implementation-record-element=OBJ_DIMENSION_WIDTH_ERR_001, system-signal=OBJ_DIMENSION_WIDTH_ERR_025}, {implementation-record-element=OBJ_ACCELERATION_LAT_001, system-signal=OBJ_ACCELERATION_LAT_025}, {implementation-record-element=OBJ_ACCELERATION_LONG_001, system-signal=OBJ_ACCELERATION_LONG_025}, {implementation-record-element=OBJ_ALIVE_TIME_001, system-signal=OBJ_ALIVE_TIME_025}, {implementation-record-element=OBJ_CLS_TYPE1_PROB_001, system-signal=OBJ_CLS_TYPE1_PROB_025}, {implementation-record-element=OBJ_CLS_TYPE2_PROB_001, system-signal=OBJ_CLS_TYPE2_PROB_025}, {implementation-record-element=OBJ_CLS_TYPE4_001, system-signal=OBJ_CLS_TYPE4_025}, {implementation-record-element=OBJ_ACCELERATION_LAT_ERR_001, system-signal=OBJ_ACCELERATION_LAT_ERR_025}, {implementation-record-element=OBJ_CLS_TYPE5_001, system-signal=OBJ_CLS_TYPE5_025}, {implementation-record-element=OBJ_MH_CYCLE_COUNTER_001, system-signal=OBJ_MH_CYCLE_COUNTER_025}, {implementation-record-element=OBJ_POS_LONG_001, system-signal=OBJ_POS_LONG_025}, {implementation-record-element=OBJ_VELOCITY_ERR_CRR_COEF_001, system-signal=OBJ_VELOCITY_ERR_CRR_COEF_025}, {implementation-record-element=OBJ_VELOCITY_LAT_ERR_001, system-signal=OBJ_VELOCITY_LAT_ERR_025}, {implementation-record-element=OBJ_VELOCITY_LAT_001, system-signal=OBJ_VELOCITY_LAT_025}, {implementation-record-element=OBJ_TRACK_MOTION_MODEL_001, system-signal=OBJ_TRACK_MOTION_MODEL_025}, {implementation-record-element=OBJ_ID_001, system-signal=OBJ_ID_025}, {implementation-record-element=OBJ_VEH_TRACK_FLAG_001, system-signal=OBJ_VEH_TRACK_FLAG_025}, {implementation-record-element=OBJ_YAW_RATE_ERR_001, system-signal=OBJ_YAW_RATE_ERR_025}, {implementation-record-element=OBJ_EXISTENCE_PROB_001, system-signal=OBJ_EXISTENCE_PROB_025}, {implementation-record-element=OBJ_YAW_RATE_001, system-signal=OBJ_YAW_RATE_025}, {implementation-record-element=OBJ_YAW_ANGLE_001, system-signal=OBJ_YAW_ANGLE_025}, {implementation-record-element=OBJ_POS_LAT_ERR_001, system-signal=OBJ_POS_LAT_ERR_025}, {implementation-record-element=OBJ_VELOCITY_LONG_ERR_001, system-signal=OBJ_VELOCITY_LONG_ERR_025}, {implementation-record-element=OBJ_POS_ERR_CRR_COEF_001, system-signal=OBJ_POS_ERR_CRR_COEF_025}, {implementation-record-element=OBJ_MOVEMENT_STATUS_001, system-signal=OBJ_MOVEMENT_STATUS_025}, {implementation-record-element=OBJ_POS_LAT_001, system-signal=OBJ_POS_LAT_025}, {implementation-record-element=OBJ_VELOCITY_LONG_001, system-signal=OBJ_VELOCITY_LONG_025}, {implementation-record-element=OBJ_MEASUREMENT_STATUS_001, system-signal=OBJ_MEASUREMENT_STATUS_025}, {implementation-record-element=OBJ_MH_CRC16_001, system-signal=OBJ_MH_CRC16_025}, {implementation-record-element=OBJ_RCS_001, system-signal=OBJ_RCS_025}, {implementation-record-element=OBJ_POS_LONG_ERR_001, system-signal=OBJ_POS_LONG_ERR_025}, {implementation-record-element=OBJ_REF_PT_LAT_OFFSET_001, system-signal=OBJ_REF_PT_LAT_OFFSET_025}, {implementation-record-element=OBJ_TIMESTAMP_OFFSET_001, system-signal=OBJ_TIMESTAMP_OFFSET_025}, {implementation-record-element=OBJ_YAW_ANGLE_ERR_001, system-signal=OBJ_YAW_ANGLE_ERR_025}, {implementation-record-element=OBJ_REF_PT_LONG_OFFSET_001, system-signal=OBJ_REF_PT_LONG_OFFSET_025}, {implementation-record-element=OBJ_GROUP_ID_001, system-signal=OBJ_GROUP_ID_025}]}
        sender-receiver-to-signal-group-mapping={data-element=Pp_SG_TrackerObject026.Vdp_SG_TrackerObject026, signal-group=SG_TrackerObject026, type-mapping=sender-rec-record-type-mapping=record-element-mappings=[{implementation-record-element=OBJ_REF_PT_LAT_OFFSET_001, system-signal=OBJ_REF_PT_LAT_OFFSET_026}, {implementation-record-element=OBJ_ACCELERATION_LONG_001, system-signal=OBJ_ACCELERATION_LONG_026}, {implementation-record-element=OBJ_CLS_TYPE3_001, system-signal=OBJ_CLS_TYPE3_026}, {implementation-record-element=OBJ_CLS_TYPE3_PROB_001, system-signal=OBJ_CLS_TYPE3_PROB_026}, {implementation-record-element=OBJ_CLS_TYPE4_001, system-signal=OBJ_CLS_TYPE4_026}, {implementation-record-element=OBJ_CLS_TYPE2_PROB_001, system-signal=OBJ_CLS_TYPE2_PROB_026}, {implementation-record-element=OBJ_ACCELERATION_LAT_ERR_001, system-signal=OBJ_ACCELERATION_LAT_ERR_026}, {implementation-record-element=OBJ_DIMENSION_WIDTH_ERR_001, system-signal=OBJ_DIMENSION_WIDTH_ERR_026}, {implementation-record-element=OBJ_MH_CRC16_001, system-signal=OBJ_MH_CRC16_026}, {implementation-record-element=OBJ_POS_ERR_CRR_COEF_001, system-signal=OBJ_POS_ERR_CRR_COEF_026}, {implementation-record-element=OBJ_CLS_TYPE6_001, system-signal=OBJ_CLS_TYPE6_026}, {implementation-record-element=OBJ_DIMENSION_LENGTH_ERR_001, system-signal=OBJ_DIMENSION_LENGTH_ERR_026}, {implementation-record-element=OBJ_POS_LAT_001, system-signal=OBJ_POS_LAT_026}, {implementation-record-element=OBJ_CLS_TYPE6_PROB_001, system-signal=OBJ_CLS_TYPE6_PROB_026}, {implementation-record-element=OBJ_DIMENSION_WIDTH_001, system-signal=OBJ_DIMENSION_WIDTH_026}, {implementation-record-element=OBJ_ID_001, system-signal=OBJ_ID_026}, {implementation-record-element=OBJ_MEASUREMENT_STATUS_001, system-signal=OBJ_MEASUREMENT_STATUS_026}, {implementation-record-element=OBJ_ALIVE_TIME_001, system-signal=OBJ_ALIVE_TIME_026}, {implementation-record-element=OBJ_GROUP_ID_001, system-signal=OBJ_GROUP_ID_026}, {implementation-record-element=OBJ_ACCELERATION_LAT_001, system-signal=OBJ_ACCELERATION_LAT_026}, {implementation-record-element=OBJ_CLS_TYPE2_001, system-signal=OBJ_CLS_TYPE2_026}, {implementation-record-element=OBJ_CLS_TYPE5_PROB_001, system-signal=OBJ_CLS_TYPE5_PROB_026}, {implementation-record-element=OBJ_CLS_TYPE1_PROB_001, system-signal=OBJ_CLS_TYPE1_PROB_026}, {implementation-record-element=OBJ_DIMENSION_LENGTH_001, system-signal=OBJ_DIMENSION_LENGTH_026}, {implementation-record-element=OBJ_EXISTENCE_PROB_001, system-signal=OBJ_EXISTENCE_PROB_026}, {implementation-record-element=OBJ_MOVEMENT_STATUS_001, system-signal=OBJ_MOVEMENT_STATUS_026}, {implementation-record-element=OBJ_CLS_TYPE1_001, system-signal=OBJ_CLS_TYPE1_026}, {implementation-record-element=OBJ_CLS_TYPE4_PROB_001, system-signal=OBJ_CLS_TYPE4_PROB_026}, {implementation-record-element=OBJ_CLS_TYPE5_001, system-signal=OBJ_CLS_TYPE5_026}, {implementation-record-element=OBJ_MH_CYCLE_COUNTER_001, system-signal=OBJ_MH_CYCLE_COUNTER_026}, {implementation-record-element=OBJ_POS_LAT_ERR_001, system-signal=OBJ_POS_LAT_ERR_026}, {implementation-record-element=OBJ_ACCEL_ERR_CRR_COEF_001, system-signal=OBJ_ACCEL_ERR_CRR_COEF_026}, {implementation-record-element=OBJ_ACCELERATION_LONG_ERR_001, system-signal=OBJ_ACCELERATION_LONG_ERR_026}, {implementation-record-element=OBJ_POS_LONG_001, system-signal=OBJ_POS_LONG_026}, {implementation-record-element=OBJ_POS_LONG_ERR_001, system-signal=OBJ_POS_LONG_ERR_026}, {implementation-record-element=OBJ_RCS_001, system-signal=OBJ_RCS_026}, {implementation-record-element=OBJ_YAW_ANGLE_001, system-signal=OBJ_YAW_ANGLE_026}, {implementation-record-element=OBJ_TRACK_MOTION_MODEL_001, system-signal=OBJ_TRACK_MOTION_MODEL_026}, {implementation-record-element=OBJ_VEH_TRACK_FLAG_001, system-signal=OBJ_VEH_TRACK_FLAG_026}, {implementation-record-element=OBJ_YAW_RATE_001, system-signal=OBJ_YAW_RATE_026}, {implementation-record-element=OBJ_VELOCITY_LAT_001, system-signal=OBJ_VELOCITY_LAT_026}, {implementation-record-element=OBJ_REF_PT_LONG_OFFSET_001, system-signal=OBJ_REF_PT_LONG_OFFSET_026}, {implementation-record-element=OBJ_YAW_ANGLE_ERR_001, system-signal=OBJ_YAW_ANGLE_ERR_026}, {implementation-record-element=OBJ_TIMESTAMP_OFFSET_001, system-signal=OBJ_TIMESTAMP_OFFSET_026}, {implementation-record-element=OBJ_VELOCITY_LAT_ERR_001, system-signal=OBJ_VELOCITY_LAT_ERR_026}, {implementation-record-element=OBJ_VELOCITY_LONG_ERR_001, system-signal=OBJ_VELOCITY_LONG_ERR_026}, {implementation-record-element=OBJ_VELOCITY_ERR_CRR_COEF_001, system-signal=OBJ_VELOCITY_ERR_CRR_COEF_026}, {implementation-record-element=OBJ_YAW_RATE_ERR_001, system-signal=OBJ_YAW_RATE_ERR_026}, {implementation-record-element=OBJ_VELOCITY_LONG_001, system-signal=OBJ_VELOCITY_LONG_026}]}
        sender-receiver-to-signal-group-mapping={data-element=Pp_SG_TrackerObject028.Vdp_SG_TrackerObject028, signal-group=SG_TrackerObject028, type-mapping=sender-rec-record-type-mapping=record-element-mappings=[{implementation-record-element=OBJ_MH_CYCLE_COUNTER_001, system-signal=OBJ_MH_CYCLE_COUNTER_028}, {implementation-record-element=OBJ_DIMENSION_WIDTH_001, system-signal=OBJ_DIMENSION_WIDTH_028}, {implementation-record-element=OBJ_ACCELERATION_LAT_ERR_001, system-signal=OBJ_ACCELERATION_LAT_ERR_028}, {implementation-record-element=OBJ_MOVEMENT_STATUS_001, system-signal=OBJ_MOVEMENT_STATUS_028}, {implementation-record-element=OBJ_DIMENSION_WIDTH_ERR_001, system-signal=OBJ_DIMENSION_WIDTH_ERR_028}, {implementation-record-element=OBJ_ACCELERATION_LONG_001, system-signal=OBJ_ACCELERATION_LONG_028}, {implementation-record-element=OBJ_EXISTENCE_PROB_001, system-signal=OBJ_EXISTENCE_PROB_028}, {implementation-record-element=OBJ_CLS_TYPE5_001, system-signal=OBJ_CLS_TYPE5_028}, {implementation-record-element=OBJ_POS_LAT_ERR_001, system-signal=OBJ_POS_LAT_ERR_028}, {implementation-record-element=OBJ_TIMESTAMP_OFFSET_001, system-signal=OBJ_TIMESTAMP_OFFSET_028}, {implementation-record-element=OBJ_VELOCITY_LAT_001, system-signal=OBJ_VELOCITY_LAT_028}, {implementation-record-element=OBJ_TRACK_MOTION_MODEL_001, system-signal=OBJ_TRACK_MOTION_MODEL_028}, {implementation-record-element=OBJ_VELOCITY_LONG_ERR_001, system-signal=OBJ_VELOCITY_LONG_ERR_028}, {implementation-record-element=OBJ_YAW_ANGLE_001, system-signal=OBJ_YAW_ANGLE_028}, {implementation-record-element=OBJ_VELOCITY_ERR_CRR_COEF_001, system-signal=OBJ_VELOCITY_ERR_CRR_COEF_028}, {implementation-record-element=OBJ_VELOCITY_LAT_ERR_001, system-signal=OBJ_VELOCITY_LAT_ERR_028}, {implementation-record-element=OBJ_POS_LONG_ERR_001, system-signal=OBJ_POS_LONG_ERR_028}, {implementation-record-element=OBJ_CLS_TYPE1_PROB_001, system-signal=OBJ_CLS_TYPE1_PROB_028}, {implementation-record-element=OBJ_CLS_TYPE2_001, system-signal=OBJ_CLS_TYPE2_028}, {implementation-record-element=OBJ_POS_LONG_001, system-signal=OBJ_POS_LONG_028}, {implementation-record-element=OBJ_ACCELERATION_LONG_ERR_001, system-signal=OBJ_ACCELERATION_LONG_ERR_028}, {implementation-record-element=OBJ_CLS_TYPE6_001, system-signal=OBJ_CLS_TYPE6_028}, {implementation-record-element=OBJ_MEASUREMENT_STATUS_001, system-signal=OBJ_MEASUREMENT_STATUS_028}, {implementation-record-element=OBJ_POS_LAT_001, system-signal=OBJ_POS_LAT_028}, {implementation-record-element=OBJ_ACCELERATION_LAT_001, system-signal=OBJ_ACCELERATION_LAT_028}, {implementation-record-element=OBJ_CLS_TYPE3_001, system-signal=OBJ_CLS_TYPE3_028}, {implementation-record-element=OBJ_ID_001, system-signal=OBJ_ID_028}, {implementation-record-element=OBJ_VEH_TRACK_FLAG_001, system-signal=OBJ_VEH_TRACK_FLAG_028}, {implementation-record-element=OBJ_YAW_RATE_001, system-signal=OBJ_YAW_RATE_028}, {implementation-record-element=OBJ_ALIVE_TIME_001, system-signal=OBJ_ALIVE_TIME_028}, {implementation-record-element=OBJ_DIMENSION_LENGTH_001, system-signal=OBJ_DIMENSION_LENGTH_028}, {implementation-record-element=OBJ_YAW_ANGLE_ERR_001, system-signal=OBJ_YAW_ANGLE_ERR_028}, {implementation-record-element=OBJ_RCS_001, system-signal=OBJ_RCS_028}, {implementation-record-element=OBJ_CLS_TYPE5_PROB_001, system-signal=OBJ_CLS_TYPE5_PROB_028}, {implementation-record-element=OBJ_YAW_RATE_ERR_001, system-signal=OBJ_YAW_RATE_ERR_028}, {implementation-record-element=OBJ_CLS_TYPE1_001, system-signal=OBJ_CLS_TYPE1_028}, {implementation-record-element=OBJ_CLS_TYPE3_PROB_001, system-signal=OBJ_CLS_TYPE3_PROB_028}, {implementation-record-element=OBJ_CLS_TYPE4_PROB_001, system-signal=OBJ_CLS_TYPE4_PROB_028}, {implementation-record-element=OBJ_DIMENSION_LENGTH_ERR_001, system-signal=OBJ_DIMENSION_LENGTH_ERR_028}, {implementation-record-element=OBJ_MH_CRC16_001, system-signal=OBJ_MH_CRC16_028}, {implementation-record-element=OBJ_CLS_TYPE2_PROB_001, system-signal=OBJ_CLS_TYPE2_PROB_028}, {implementation-record-element=OBJ_REF_PT_LAT_OFFSET_001, system-signal=OBJ_REF_PT_LAT_OFFSET_028}, {implementation-record-element=OBJ_REF_PT_LONG_OFFSET_001, system-signal=OBJ_REF_PT_LONG_OFFSET_028}, {implementation-record-element=OBJ_ACCEL_ERR_CRR_COEF_001, system-signal=OBJ_ACCEL_ERR_CRR_COEF_028}, {implementation-record-element=OBJ_CLS_TYPE6_PROB_001, system-signal=OBJ_CLS_TYPE6_PROB_028}, {implementation-record-element=OBJ_POS_ERR_CRR_COEF_001, system-signal=OBJ_POS_ERR_CRR_COEF_028}, {implementation-record-element=OBJ_VELOCITY_LONG_001, system-signal=OBJ_VELOCITY_LONG_028}, {implementation-record-element=OBJ_CLS_TYPE4_001, system-signal=OBJ_CLS_TYPE4_028}, {implementation-record-element=OBJ_GROUP_ID_001, system-signal=OBJ_GROUP_ID_028}]}
        sender-receiver-to-signal-group-mapping={data-element=Pp_SG_TrackerObject027.Vdp_SG_TrackerObject027, signal-group=SG_TrackerObject027, type-mapping=sender-rec-record-type-mapping=record-element-mappings=[{implementation-record-element=OBJ_ACCELERATION_LAT_ERR_001, system-signal=OBJ_ACCELERATION_LAT_ERR_027}, {implementation-record-element=OBJ_GROUP_ID_001, system-signal=OBJ_GROUP_ID_027}, {implementation-record-element=OBJ_DIMENSION_LENGTH_001, system-signal=OBJ_DIMENSION_LENGTH_027}, {implementation-record-element=OBJ_CLS_TYPE5_001, system-signal=OBJ_CLS_TYPE5_027}, {implementation-record-element=OBJ_VEH_TRACK_FLAG_001, system-signal=OBJ_VEH_TRACK_FLAG_027}, {implementation-record-element=OBJ_DIMENSION_LENGTH_ERR_001, system-signal=OBJ_DIMENSION_LENGTH_ERR_027}, {implementation-record-element=OBJ_POS_LAT_ERR_001, system-signal=OBJ_POS_LAT_ERR_027}, {implementation-record-element=OBJ_VELOCITY_ERR_CRR_COEF_001, system-signal=OBJ_VELOCITY_ERR_CRR_COEF_027}, {implementation-record-element=OBJ_VELOCITY_LAT_ERR_001, system-signal=OBJ_VELOCITY_LAT_ERR_027}, {implementation-record-element=OBJ_YAW_ANGLE_001, system-signal=OBJ_YAW_ANGLE_027}, {implementation-record-element=OBJ_YAW_ANGLE_ERR_001, system-signal=OBJ_YAW_ANGLE_ERR_027}, {implementation-record-element=OBJ_YAW_RATE_001, system-signal=OBJ_YAW_RATE_027}, {implementation-record-element=OBJ_YAW_RATE_ERR_001, system-signal=OBJ_YAW_RATE_ERR_027}, {implementation-record-element=OBJ_VELOCITY_LONG_001, system-signal=OBJ_VELOCITY_LONG_027}, {implementation-record-element=OBJ_VELOCITY_LONG_ERR_001, system-signal=OBJ_VELOCITY_LONG_ERR_027}, {implementation-record-element=OBJ_POS_LAT_001, system-signal=OBJ_POS_LAT_027}, {implementation-record-element=OBJ_ID_001, system-signal=OBJ_ID_027}, {implementation-record-element=OBJ_ACCEL_ERR_CRR_COEF_001, system-signal=OBJ_ACCEL_ERR_CRR_COEF_027}, {implementation-record-element=OBJ_ACCELERATION_LAT_001, system-signal=OBJ_ACCELERATION_LAT_027}, {implementation-record-element=OBJ_CLS_TYPE5_PROB_001, system-signal=OBJ_CLS_TYPE5_PROB_027}, {implementation-record-element=OBJ_DIMENSION_WIDTH_001, system-signal=OBJ_DIMENSION_WIDTH_027}, {implementation-record-element=OBJ_MH_CRC16_001, system-signal=OBJ_MH_CRC16_027}, {implementation-record-element=OBJ_MEASUREMENT_STATUS_001, system-signal=OBJ_MEASUREMENT_STATUS_027}, {implementation-record-element=OBJ_POS_LONG_001, system-signal=OBJ_POS_LONG_027}, {implementation-record-element=OBJ_CLS_TYPE2_PROB_001, system-signal=OBJ_CLS_TYPE2_PROB_027}, {implementation-record-element=OBJ_CLS_TYPE6_PROB_001, system-signal=OBJ_CLS_TYPE6_PROB_027}, {implementation-record-element=OBJ_CLS_TYPE3_PROB_001, system-signal=OBJ_CLS_TYPE3_PROB_027}, {implementation-record-element=OBJ_REF_PT_LAT_OFFSET_001, system-signal=OBJ_REF_PT_LAT_OFFSET_027}, {implementation-record-element=OBJ_MOVEMENT_STATUS_001, system-signal=OBJ_MOVEMENT_STATUS_027}, {implementation-record-element=OBJ_POS_ERR_CRR_COEF_001, system-signal=OBJ_POS_ERR_CRR_COEF_027}, {implementation-record-element=OBJ_CLS_TYPE4_PROB_001, system-signal=OBJ_CLS_TYPE4_PROB_027}, {implementation-record-element=OBJ_CLS_TYPE2_001, system-signal=OBJ_CLS_TYPE2_027}, {implementation-record-element=OBJ_DIMENSION_WIDTH_ERR_001, system-signal=OBJ_DIMENSION_WIDTH_ERR_027}, {implementation-record-element=OBJ_REF_PT_LONG_OFFSET_001, system-signal=OBJ_REF_PT_LONG_OFFSET_027}, {implementation-record-element=OBJ_TIMESTAMP_OFFSET_001, system-signal=OBJ_TIMESTAMP_OFFSET_027}, {implementation-record-element=OBJ_ACCELERATION_LONG_001, system-signal=OBJ_ACCELERATION_LONG_027}, {implementation-record-element=OBJ_ACCELERATION_LONG_ERR_001, system-signal=OBJ_ACCELERATION_LONG_ERR_027}, {implementation-record-element=OBJ_RCS_001, system-signal=OBJ_RCS_027}, {implementation-record-element=OBJ_ALIVE_TIME_001, system-signal=OBJ_ALIVE_TIME_027}, {implementation-record-element=OBJ_CLS_TYPE1_PROB_001, system-signal=OBJ_CLS_TYPE1_PROB_027}, {implementation-record-element=OBJ_CLS_TYPE3_001, system-signal=OBJ_CLS_TYPE3_027}, {implementation-record-element=OBJ_CLS_TYPE4_001, system-signal=OBJ_CLS_TYPE4_027}, {implementation-record-element=OBJ_EXISTENCE_PROB_001, system-signal=OBJ_EXISTENCE_PROB_027}, {implementation-record-element=OBJ_CLS_TYPE1_001, system-signal=OBJ_CLS_TYPE1_027}, {implementation-record-element=OBJ_MH_CYCLE_COUNTER_001, system-signal=OBJ_MH_CYCLE_COUNTER_027}, {implementation-record-element=OBJ_CLS_TYPE6_001, system-signal=OBJ_CLS_TYPE6_027}, {implementation-record-element=OBJ_POS_LONG_ERR_001, system-signal=OBJ_POS_LONG_ERR_027}, {implementation-record-element=OBJ_TRACK_MOTION_MODEL_001, system-signal=OBJ_TRACK_MOTION_MODEL_027}, {implementation-record-element=OBJ_VELOCITY_LAT_001, system-signal=OBJ_VELOCITY_LAT_027}]}
        sender-receiver-to-signal-group-mapping={data-element=Pp_SG_TrackerObject029.Vdp_SG_TrackerObject029, signal-group=SG_TrackerObject029, type-mapping=sender-rec-record-type-mapping=record-element-mappings=[{implementation-record-element=OBJ_ACCELERATION_LONG_ERR_001, system-signal=OBJ_ACCELERATION_LONG_ERR_029}, {implementation-record-element=OBJ_CLS_TYPE1_001, system-signal=OBJ_CLS_TYPE1_029}, {implementation-record-element=OBJ_CLS_TYPE2_001, system-signal=OBJ_CLS_TYPE2_029}, {implementation-record-element=OBJ_CLS_TYPE1_PROB_001, system-signal=OBJ_CLS_TYPE1_PROB_029}, {implementation-record-element=OBJ_CLS_TYPE3_001, system-signal=OBJ_CLS_TYPE3_029}, {implementation-record-element=OBJ_ACCELERATION_LAT_001, system-signal=OBJ_ACCELERATION_LAT_029}, {implementation-record-element=OBJ_ACCELERATION_LONG_001, system-signal=OBJ_ACCELERATION_LONG_029}, {implementation-record-element=OBJ_ACCEL_ERR_CRR_COEF_001, system-signal=OBJ_ACCEL_ERR_CRR_COEF_029}, {implementation-record-element=OBJ_ALIVE_TIME_001, system-signal=OBJ_ALIVE_TIME_029}, {implementation-record-element=OBJ_CLS_TYPE2_PROB_001, system-signal=OBJ_CLS_TYPE2_PROB_029}, {implementation-record-element=OBJ_CLS_TYPE3_PROB_001, system-signal=OBJ_CLS_TYPE3_PROB_029}, {implementation-record-element=OBJ_CLS_TYPE4_001, system-signal=OBJ_CLS_TYPE4_029}, {implementation-record-element=OBJ_CLS_TYPE4_PROB_001, system-signal=OBJ_CLS_TYPE4_PROB_029}, {implementation-record-element=OBJ_ACCELERATION_LAT_ERR_001, system-signal=OBJ_ACCELERATION_LAT_ERR_029}, {implementation-record-element=OBJ_EXISTENCE_PROB_001, system-signal=OBJ_EXISTENCE_PROB_029}, {implementation-record-element=OBJ_MEASUREMENT_STATUS_001, system-signal=OBJ_MEASUREMENT_STATUS_029}, {implementation-record-element=OBJ_POS_ERR_CRR_COEF_001, system-signal=OBJ_POS_ERR_CRR_COEF_029}, {implementation-record-element=OBJ_POS_LAT_001, system-signal=OBJ_POS_LAT_029}, {implementation-record-element=OBJ_GROUP_ID_001, system-signal=OBJ_GROUP_ID_029}, {implementation-record-element=OBJ_CLS_TYPE5_PROB_001, system-signal=OBJ_CLS_TYPE5_PROB_029}, {implementation-record-element=OBJ_ID_001, system-signal=OBJ_ID_029}, {implementation-record-element=OBJ_POS_LAT_ERR_001, system-signal=OBJ_POS_LAT_ERR_029}, {implementation-record-element=OBJ_POS_LONG_ERR_001, system-signal=OBJ_POS_LONG_ERR_029}, {implementation-record-element=OBJ_TRACK_MOTION_MODEL_001, system-signal=OBJ_TRACK_MOTION_MODEL_029}, {implementation-record-element=OBJ_YAW_RATE_ERR_001, system-signal=OBJ_YAW_RATE_ERR_029}, {implementation-record-element=OBJ_YAW_ANGLE_ERR_001, system-signal=OBJ_YAW_ANGLE_ERR_029}, {implementation-record-element=OBJ_DIMENSION_LENGTH_ERR_001, system-signal=OBJ_DIMENSION_LENGTH_ERR_029}, {implementation-record-element=OBJ_CLS_TYPE6_PROB_001, system-signal=OBJ_CLS_TYPE6_PROB_029}, {implementation-record-element=OBJ_MH_CYCLE_COUNTER_001, system-signal=OBJ_MH_CYCLE_COUNTER_029}, {implementation-record-element=OBJ_RCS_001, system-signal=OBJ_RCS_029}, {implementation-record-element=OBJ_REF_PT_LAT_OFFSET_001, system-signal=OBJ_REF_PT_LAT_OFFSET_029}, {implementation-record-element=OBJ_MH_CRC16_001, system-signal=OBJ_MH_CRC16_029}, {implementation-record-element=OBJ_VEH_TRACK_FLAG_001, system-signal=OBJ_VEH_TRACK_FLAG_029}, {implementation-record-element=OBJ_POS_LONG_001, system-signal=OBJ_POS_LONG_029}, {implementation-record-element=OBJ_VELOCITY_LAT_001, system-signal=OBJ_VELOCITY_LAT_029}, {implementation-record-element=OBJ_VELOCITY_ERR_CRR_COEF_001, system-signal=OBJ_VELOCITY_ERR_CRR_COEF_029}, {implementation-record-element=OBJ_DIMENSION_LENGTH_001, system-signal=OBJ_DIMENSION_LENGTH_029}, {implementation-record-element=OBJ_CLS_TYPE6_001, system-signal=OBJ_CLS_TYPE6_029}, {implementation-record-element=OBJ_DIMENSION_WIDTH_001, system-signal=OBJ_DIMENSION_WIDTH_029}, {implementation-record-element=OBJ_YAW_ANGLE_001, system-signal=OBJ_YAW_ANGLE_029}, {implementation-record-element=OBJ_YAW_RATE_001, system-signal=OBJ_YAW_RATE_029}, {implementation-record-element=OBJ_VELOCITY_LONG_001, system-signal=OBJ_VELOCITY_LONG_029}, {implementation-record-element=OBJ_VELOCITY_LONG_ERR_001, system-signal=OBJ_VELOCITY_LONG_ERR_029}, {implementation-record-element=OBJ_CLS_TYPE5_001, system-signal=OBJ_CLS_TYPE5_029}, {implementation-record-element=OBJ_REF_PT_LONG_OFFSET_001, system-signal=OBJ_REF_PT_LONG_OFFSET_029}, {implementation-record-element=OBJ_DIMENSION_WIDTH_ERR_001, system-signal=OBJ_DIMENSION_WIDTH_ERR_029}, {implementation-record-element=OBJ_MOVEMENT_STATUS_001, system-signal=OBJ_MOVEMENT_STATUS_029}, {implementation-record-element=OBJ_VELOCITY_LAT_ERR_001, system-signal=OBJ_VELOCITY_LAT_ERR_029}, {implementation-record-element=OBJ_TIMESTAMP_OFFSET_001, system-signal=OBJ_TIMESTAMP_OFFSET_029}]}
        sender-receiver-to-signal-group-mapping={data-element=Pp_SG_TrackerObject030.Vdp_SG_TrackerObject030, signal-group=SG_TrackerObject030, type-mapping=sender-rec-record-type-mapping=record-element-mappings=[{implementation-record-element=OBJ_DIMENSION_WIDTH_001, system-signal=OBJ_DIMENSION_WIDTH_030}, {implementation-record-element=OBJ_REF_PT_LONG_OFFSET_001, system-signal=OBJ_REF_PT_LONG_OFFSET_030}, {implementation-record-element=OBJ_VELOCITY_LONG_ERR_001, system-signal=OBJ_VELOCITY_LONG_ERR_030}, {implementation-record-element=OBJ_YAW_ANGLE_ERR_001, system-signal=OBJ_YAW_ANGLE_ERR_030}, {implementation-record-element=OBJ_YAW_ANGLE_001, system-signal=OBJ_YAW_ANGLE_030}, {implementation-record-element=OBJ_VELOCITY_LAT_ERR_001, system-signal=OBJ_VELOCITY_LAT_ERR_030}, {implementation-record-element=OBJ_VELOCITY_LONG_001, system-signal=OBJ_VELOCITY_LONG_030}, {implementation-record-element=OBJ_REF_PT_LAT_OFFSET_001, system-signal=OBJ_REF_PT_LAT_OFFSET_030}, {implementation-record-element=OBJ_POS_LAT_001, system-signal=OBJ_POS_LAT_030}, {implementation-record-element=OBJ_YAW_RATE_ERR_001, system-signal=OBJ_YAW_RATE_ERR_030}, {implementation-record-element=OBJ_MEASUREMENT_STATUS_001, system-signal=OBJ_MEASUREMENT_STATUS_030}, {implementation-record-element=OBJ_POS_LONG_ERR_001, system-signal=OBJ_POS_LONG_ERR_030}, {implementation-record-element=OBJ_ID_001, system-signal=OBJ_ID_030}, {implementation-record-element=OBJ_EXISTENCE_PROB_001, system-signal=OBJ_EXISTENCE_PROB_030}, {implementation-record-element=OBJ_DIMENSION_WIDTH_ERR_001, system-signal=OBJ_DIMENSION_WIDTH_ERR_030}, {implementation-record-element=OBJ_GROUP_ID_001, system-signal=OBJ_GROUP_ID_030}, {implementation-record-element=OBJ_MH_CRC16_001, system-signal=OBJ_MH_CRC16_030}, {implementation-record-element=OBJ_YAW_RATE_001, system-signal=OBJ_YAW_RATE_030}, {implementation-record-element=OBJ_CLS_TYPE6_PROB_001, system-signal=OBJ_CLS_TYPE6_PROB_030}, {implementation-record-element=OBJ_DIMENSION_LENGTH_001, system-signal=OBJ_DIMENSION_LENGTH_030}, {implementation-record-element=OBJ_DIMENSION_LENGTH_ERR_001, system-signal=OBJ_DIMENSION_LENGTH_ERR_030}, {implementation-record-element=OBJ_POS_ERR_CRR_COEF_001, system-signal=OBJ_POS_ERR_CRR_COEF_030}, {implementation-record-element=OBJ_POS_LAT_ERR_001, system-signal=OBJ_POS_LAT_ERR_030}, {implementation-record-element=OBJ_RCS_001, system-signal=OBJ_RCS_030}, {implementation-record-element=OBJ_TIMESTAMP_OFFSET_001, system-signal=OBJ_TIMESTAMP_OFFSET_030}, {implementation-record-element=OBJ_TRACK_MOTION_MODEL_001, system-signal=OBJ_TRACK_MOTION_MODEL_030}, {implementation-record-element=OBJ_VEH_TRACK_FLAG_001, system-signal=OBJ_VEH_TRACK_FLAG_030}, {implementation-record-element=OBJ_VELOCITY_LAT_001, system-signal=OBJ_VELOCITY_LAT_030}, {implementation-record-element=OBJ_MOVEMENT_STATUS_001, system-signal=OBJ_MOVEMENT_STATUS_030}, {implementation-record-element=OBJ_POS_LONG_001, system-signal=OBJ_POS_LONG_030}, {implementation-record-element=OBJ_VELOCITY_ERR_CRR_COEF_001, system-signal=OBJ_VELOCITY_ERR_CRR_COEF_030}, {implementation-record-element=OBJ_MH_CYCLE_COUNTER_001, system-signal=OBJ_MH_CYCLE_COUNTER_030}, {implementation-record-element=OBJ_ACCELERATION_LAT_001, system-signal=OBJ_ACCELERATION_LAT_030}, {implementation-record-element=OBJ_ACCELERATION_LAT_ERR_001, system-signal=OBJ_ACCELERATION_LAT_ERR_030}, {implementation-record-element=OBJ_ACCELERATION_LONG_ERR_001, system-signal=OBJ_ACCELERATION_LONG_ERR_030}, {implementation-record-element=OBJ_ACCELERATION_LONG_001, system-signal=OBJ_ACCELERATION_LONG_030}, {implementation-record-element=OBJ_ALIVE_TIME_001, system-signal=OBJ_ALIVE_TIME_030}, {implementation-record-element=OBJ_CLS_TYPE2_001, system-signal=OBJ_CLS_TYPE2_030}, {implementation-record-element=OBJ_ACCEL_ERR_CRR_COEF_001, system-signal=OBJ_ACCEL_ERR_CRR_COEF_030}, {implementation-record-element=OBJ_CLS_TYPE2_PROB_001, system-signal=OBJ_CLS_TYPE2_PROB_030}, {implementation-record-element=OBJ_CLS_TYPE4_PROB_001, system-signal=OBJ_CLS_TYPE4_PROB_030}, {implementation-record-element=OBJ_CLS_TYPE5_001, system-signal=OBJ_CLS_TYPE5_030}, {implementation-record-element=OBJ_CLS_TYPE6_001, system-signal=OBJ_CLS_TYPE6_030}, {implementation-record-element=OBJ_CLS_TYPE1_001, system-signal=OBJ_CLS_TYPE1_030}, {implementation-record-element=OBJ_CLS_TYPE1_PROB_001, system-signal=OBJ_CLS_TYPE1_PROB_030}, {implementation-record-element=OBJ_CLS_TYPE3_PROB_001, system-signal=OBJ_CLS_TYPE3_PROB_030}, {implementation-record-element=OBJ_CLS_TYPE4_001, system-signal=OBJ_CLS_TYPE4_030}, {implementation-record-element=OBJ_CLS_TYPE5_PROB_001, system-signal=OBJ_CLS_TYPE5_PROB_030}, {implementation-record-element=OBJ_CLS_TYPE3_001, system-signal=OBJ_CLS_TYPE3_030}]}
        sender-receiver-to-signal-group-mapping={data-element=Pp_SG_TrackerObject002.Vdp_SG_TrackerObject002, signal-group=SG_TrackerObject002, type-mapping=sender-rec-record-type-mapping=record-element-mappings=[{implementation-record-element=OBJ_CLS_TYPE5_001, system-signal=OBJ_CLS_TYPE5_002}, {implementation-record-element=OBJ_CLS_TYPE4_001, system-signal=OBJ_CLS_TYPE4_002}, {implementation-record-element=OBJ_CLS_TYPE6_PROB_001, system-signal=OBJ_CLS_TYPE6_PROB_002}, {implementation-record-element=OBJ_CLS_TYPE3_PROB_001, system-signal=OBJ_CLS_TYPE3_PROB_002}, {implementation-record-element=OBJ_CLS_TYPE1_PROB_001, system-signal=OBJ_CLS_TYPE1_PROB_002}, {implementation-record-element=OBJ_CLS_TYPE3_001, system-signal=OBJ_CLS_TYPE3_002}, {implementation-record-element=OBJ_DIMENSION_LENGTH_ERR_001, system-signal=OBJ_DIMENSION_LENGTH_ERR_002}, {implementation-record-element=OBJ_DIMENSION_WIDTH_ERR_001, system-signal=OBJ_DIMENSION_WIDTH_ERR_002}, {implementation-record-element=OBJ_MEASUREMENT_STATUS_001, system-signal=OBJ_MEASUREMENT_STATUS_002}, {implementation-record-element=OBJ_MH_CYCLE_COUNTER_001, system-signal=OBJ_MH_CYCLE_COUNTER_002}, {implementation-record-element=OBJ_CLS_TYPE2_PROB_001, system-signal=OBJ_CLS_TYPE2_PROB_002}, {implementation-record-element=OBJ_MH_CRC16_001, system-signal=OBJ_MH_CRC16_002}, {implementation-record-element=OBJ_CLS_TYPE5_PROB_001, system-signal=OBJ_CLS_TYPE5_PROB_002}, {implementation-record-element=OBJ_CLS_TYPE1_001, system-signal=OBJ_CLS_TYPE1_002}, {implementation-record-element=OBJ_CLS_TYPE2_001, system-signal=OBJ_CLS_TYPE2_002}, {implementation-record-element=OBJ_ID_001, system-signal=OBJ_ID_002}, {implementation-record-element=OBJ_ACCELERATION_LONG_ERR_001, system-signal=OBJ_ACCELERATION_LONG_ERR_002}, {implementation-record-element=OBJ_ACCELERATION_LAT_ERR_001, system-signal=OBJ_ACCELERATION_LAT_ERR_002}, {implementation-record-element=OBJ_CLS_TYPE6_001, system-signal=OBJ_CLS_TYPE6_002}, {implementation-record-element=OBJ_EXISTENCE_PROB_001, system-signal=OBJ_EXISTENCE_PROB_002}, {implementation-record-element=OBJ_CLS_TYPE4_PROB_001, system-signal=OBJ_CLS_TYPE4_PROB_002}, {implementation-record-element=OBJ_DIMENSION_WIDTH_001, system-signal=OBJ_DIMENSION_WIDTH_002}, {implementation-record-element=OBJ_ACCELERATION_LAT_001, system-signal=OBJ_ACCELERATION_LAT_002}, {implementation-record-element=OBJ_DIMENSION_LENGTH_001, system-signal=OBJ_DIMENSION_LENGTH_002}, {implementation-record-element=OBJ_ACCELERATION_LONG_001, system-signal=OBJ_ACCELERATION_LONG_002}, {implementation-record-element=OBJ_GROUP_ID_001, system-signal=OBJ_GROUP_ID_002}, {implementation-record-element=OBJ_ALIVE_TIME_001, system-signal=OBJ_ALIVE_TIME_002}, {implementation-record-element=OBJ_ACCEL_ERR_CRR_COEF_001, system-signal=OBJ_ACCEL_ERR_CRR_COEF_002}, {implementation-record-element=OBJ_POS_ERR_CRR_COEF_001, system-signal=OBJ_POS_ERR_CRR_COEF_002}, {implementation-record-element=OBJ_VELOCITY_LAT_001, system-signal=OBJ_VELOCITY_LAT_002}, {implementation-record-element=OBJ_TRACK_MOTION_MODEL_001, system-signal=OBJ_TRACK_MOTION_MODEL_002}, {implementation-record-element=OBJ_VELOCITY_LONG_001, system-signal=OBJ_VELOCITY_LONG_002}, {implementation-record-element=OBJ_VELOCITY_LONG_ERR_001, system-signal=OBJ_VELOCITY_LONG_ERR_002}, {implementation-record-element=OBJ_YAW_ANGLE_001, system-signal=OBJ_YAW_ANGLE_002}, {implementation-record-element=OBJ_YAW_RATE_001, system-signal=OBJ_YAW_RATE_002}, {implementation-record-element=OBJ_REF_PT_LONG_OFFSET_001, system-signal=OBJ_REF_PT_LONG_OFFSET_002}, {implementation-record-element=OBJ_RCS_001, system-signal=OBJ_RCS_002}, {implementation-record-element=OBJ_VELOCITY_LAT_ERR_001, system-signal=OBJ_VELOCITY_LAT_ERR_002}, {implementation-record-element=OBJ_YAW_RATE_ERR_001, system-signal=OBJ_YAW_RATE_ERR_002}, {implementation-record-element=OBJ_REF_PT_LAT_OFFSET_001, system-signal=OBJ_REF_PT_LAT_OFFSET_002}, {implementation-record-element=OBJ_YAW_ANGLE_ERR_001, system-signal=OBJ_YAW_ANGLE_ERR_002}, {implementation-record-element=OBJ_POS_LONG_001, system-signal=OBJ_POS_LONG_002}, {implementation-record-element=OBJ_VEH_TRACK_FLAG_001, system-signal=OBJ_VEH_TRACK_FLAG_002}, {implementation-record-element=OBJ_MOVEMENT_STATUS_001, system-signal=OBJ_MOVEMENT_STATUS_002}, {implementation-record-element=OBJ_POS_LAT_001, system-signal=OBJ_POS_LAT_002}, {implementation-record-element=OBJ_POS_LONG_ERR_001, system-signal=OBJ_POS_LONG_ERR_002}, {implementation-record-element=OBJ_VELOCITY_ERR_CRR_COEF_001, system-signal=OBJ_VELOCITY_ERR_CRR_COEF_002}, {implementation-record-element=OBJ_TIMESTAMP_OFFSET_001, system-signal=OBJ_TIMESTAMP_OFFSET_002}, {implementation-record-element=OBJ_POS_LAT_ERR_001, system-signal=OBJ_POS_LAT_ERR_002}]}
        sender-receiver-to-signal-group-mapping={data-element=Pp_SG_AlignmentStatus1_AL.Vdp_SG_AlignmentStatus1_AL, signal-group=SG_AlignmentStatus1, type-mapping=sender-rec-record-type-mapping=record-element-mappings=[{application-record-element=AL_STS_001_CYCLE_COUNTER, system-signal=AL_STS_001_CYCLE_COUNTER}, {application-record-element=AL_STS_001_MH_CRC16, system-signal=AL_STS_001_MH_CRC16}, {application-record-element=STS_AAAzimuthStd, system-signal=STS_AAAzimuthStd}, {application-record-element=STS_AACurrentAzimuth, system-signal=STS_AACurrentAzimuth}, {application-record-element=STS_AACurrentElevation, system-signal=STS_AACurrentElevation}, {application-record-element=STS_AACurrentRoll, system-signal=STS_AACurrentRoll}, {application-record-element=STS_AAElevationStd, system-signal=STS_AAElevationStd}, {application-record-element=STS_AARoll_Std, system-signal=STS_AARoll_Std}, {application-record-element=STS_AlignmentAutoStatus, system-signal=STS_AlignmentAutoStatus}, {application-record-element=STS_AlignmentAzimuth, system-signal=STS_AlignmentAzimuth}, {application-record-element=STS_AlignmentElevation, system-signal=STS_AlignmentElevation}, {application-record-element=STS_AlignmentError, system-signal=STS_AlignmentError}, {application-record-element=STS_AlignmentModeIn, system-signal=STS_AlignmentModeIn}, {application-record-element=STS_AlignmentModeOut, system-signal=STS_AlignmentModeOut}, {application-record-element=STS_AutoAlignmentFailRootCause, system-signal=STS_AutoAlignmentFailRootCause}, {application-record-element=STS_AzimuthErrorNegative, system-signal=STS_AzimuthErrorNegative}, {application-record-element=STS_AzimuthErrorPositive, system-signal=STS_AzimuthErrorPositive}, {application-record-element=STS_AzimuthStd, system-signal=STS_AzimuthStd}, {application-record-element=STS_AzimuthUpdates, system-signal=STS_AzimuthUpdates}, {application-record-element=STS_CalDisplay, system-signal=STS_CalDisplay}, {application-record-element=STS_CalTime, system-signal=STS_CalTime}, {application-record-element=STS_CoordinateSystemInput, system-signal=STS_CoordinateSystemInput}, {application-record-element=STS_ElevationErrorNegative, system-signal=STS_ElevationErrorNegative}, {application-record-element=STS_ElevationErrorPositive, system-signal=STS_ElevationErrorPositive}, {application-record-element=STS_ElevationStd, system-signal=STS_ElevationStd}, {application-record-element=STS_ElevationUpdates, system-signal=STS_ElevationUpdates}, {application-record-element=STS_HostSpdCompensationFactorQF, system-signal=STS_HostSpdCompensationFactorQF}, {application-record-element=STS_HostSpeedCompensationFactor, system-signal=STS_HostSpeedCompensationFactor}, {application-record-element=STS_InitAlignResultAzimuthUpdate, system-signal=STS_InitAlignResultAzimuthUpdate}, {application-record-element=STS_InitAlignRsltElevationUpdate, system-signal=STS_InitAlignRsltElevationUpdate}, {application-record-element=STS_InitAlignRsltHostSpdCompFac, system-signal=STS_InitAlignRsltHostSpdCompFac}, {application-record-element=STS_InitAlignmentResultAzimuth, system-signal=STS_InitAlignmentResultAzimuth}, {application-record-element=STS_InitAlignmentResultElevation, system-signal=STS_InitAlignmentResultElevation}, {application-record-element=STS_InitLastSuccessfulAlignMode, system-signal=STS_InitLastSuccessfulAlignMode}, {application-record-element=STS_ProgressPercent, system-signal=STS_ProgressPercent}, {application-record-element=STS_RadarTypeInput, system-signal=STS_RadarTypeInput}, {application-record-element=STS_RollErrorNegative, system-signal=STS_RollErrorNegative}, {application-record-element=STS_RollErrorPositive, system-signal=STS_RollErrorPositive}, {application-record-element=STS_Roll_Updates, system-signal=STS_Roll_Updates}, {application-record-element=STS_StartAzimuth, system-signal=STS_StartAzimuth}, {application-record-element=STS_StartElevation, system-signal=STS_StartElevation}, {application-record-element=STS_StartRoll, system-signal=STS_StartRoll}]}
        sender-receiver-to-signal-group-mapping={data-element=Pp_SG_AlignmentStatus2_AL.Vdp_SG_AlignmentStatus2_AL, signal-group=SG_AlignmentStatus2, type-mapping=sender-rec-record-type-mapping=record-element-mappings=[{application-record-element=AL_STS_002_CYCLE_COUNTER, system-signal=AL_STS_002_CYCLE_COUNTER}, {application-record-element=AL_STS_002_MH_CRC16, system-signal=AL_STS_002_MH_CRC16}, {application-record-element=STS_AlignmentServiceStatus, system-signal=STS_AlignmentServiceStatus}, {application-record-element=STS_AlignmentShortTrackStatus, system-signal=STS_AlignmentShortTrackStatus}, {application-record-element=STS_AlignmentStaticStatus, system-signal=STS_AlignmentStaticStatus}, {application-record-element=STS_AverageNumberOfDetections, system-signal=STS_AverageNumberOfDetections}, {application-record-element=STS_AverageSpeed, system-signal=STS_AverageSpeed}, {application-record-element=STS_DistanceAbsolute, system-signal=STS_DistanceAbsolute}, {application-record-element=STS_DistanceEffective, system-signal=STS_DistanceEffective}, {application-record-element=STS_DurationAbsolute, system-signal=STS_DurationAbsolute}, {application-record-element=STS_DurationEffective, system-signal=STS_DurationEffective}, {application-record-element=STS_ImpactByInterference, system-signal=STS_ImpactByInterference}, {application-record-element=STS_MeasuredAmpSTD, system-signal=STS_MeasuredAmpSTD}, {application-record-element=STS_MeasuredRangeRate, system-signal=STS_MeasuredRangeRate}, {application-record-element=STS_MeasuredRangeRateStd, system-signal=STS_MeasuredRangeRateStd}, {application-record-element=STS_MeasuredRangeStd, system-signal=STS_MeasuredRangeStd}, {application-record-element=STS_MeasuredRawAmplitude, system-signal=STS_MeasuredRawAmplitude}, {application-record-element=STS_Measured_Range, system-signal=STS_Measured_Range}, {application-record-element=STS_VehicleCondition, system-signal=STS_VehicleCondition}]}
        sender-receiver-to-signal-group-mapping={data-element=Pp_SG_Detections_001_004_AL.Vdp_SG_Detections_001_004_AL, signal-group=SG_Detections_001_004, type-mapping=sender-rec-record-type-mapping=record-element-mappings=[{application-record-element=DET_AZIMUTH_001, system-signal=DET_AZIMUTH_001}, {application-record-element=DET_AZIMUTH_002, system-signal=DET_AZIMUTH_002}, {application-record-element=DET_AZIMUTH_003, system-signal=DET_AZIMUTH_003}, {application-record-element=DET_AZIMUTH_004, system-signal=DET_AZIMUTH_004}, {application-record-element=DET_AZIMUTH_ERR_001, system-signal=DET_AZIMUTH_ERR_001}, {application-record-element=DET_AZIMUTH_ERR_002, system-signal=DET_AZIMUTH_ERR_002}, {application-record-element=DET_AZIMUTH_ERR_003, system-signal=DET_AZIMUTH_ERR_003}, {application-record-element=DET_AZIMUTH_ERR_004, system-signal=DET_AZIMUTH_ERR_004}, {application-record-element=DET_BELOW_RAIN_THOLD_001, system-signal=DET_BELOW_RAIN_THOLD_001}, {application-record-element=DET_BELOW_RAIN_THOLD_002, system-signal=DET_BELOW_RAIN_THOLD_002}, {application-record-element=DET_BELOW_RAIN_THOLD_003, system-signal=DET_BELOW_RAIN_THOLD_003}, {application-record-element=DET_BELOW_RAIN_THOLD_004, system-signal=DET_BELOW_RAIN_THOLD_004}, {application-record-element=DET_BI_STATIC_FLAG_001, system-signal=DET_BI_STATIC_FLAG_001}, {application-record-element=DET_BI_STATIC_FLAG_002, system-signal=DET_BI_STATIC_FLAG_002}, {application-record-element=DET_BI_STATIC_FLAG_003, system-signal=DET_BI_STATIC_FLAG_003}, {application-record-element=DET_BI_STATIC_FLAG_004, system-signal=DET_BI_STATIC_FLAG_004}, {application-record-element=DET_CONFD_AZIMUTH_001, system-signal=DET_CONFD_AZIMUTH_001}, {application-record-element=DET_CONFD_AZIMUTH_002, system-signal=DET_CONFD_AZIMUTH_002}, {application-record-element=DET_CONFD_AZIMUTH_003, system-signal=DET_CONFD_AZIMUTH_003}, {application-record-element=DET_CONFD_AZIMUTH_004, system-signal=DET_CONFD_AZIMUTH_004}, {application-record-element=DET_CONFD_ELEVATION_001, system-signal=DET_CONFD_ELEVATION_001}, {application-record-element=DET_CONFD_ELEVATION_002, system-signal=DET_CONFD_ELEVATION_002}, {application-record-element=DET_CONFD_ELEVATION_003, system-signal=DET_CONFD_ELEVATION_003}, {application-record-element=DET_CONFD_ELEVATION_004, system-signal=DET_CONFD_ELEVATION_004}, {application-record-element=DET_ELEVATION_001, system-signal=DET_ELEVATION_001}, {application-record-element=DET_ELEVATION_002, system-signal=DET_ELEVATION_002}, {application-record-element=DET_ELEVATION_003, system-signal=DET_ELEVATION_003}, {application-record-element=DET_ELEVATION_004, system-signal=DET_ELEVATION_004}, {application-record-element=DET_ELEVATION_ERR_001, system-signal=DET_ELEVATION_ERR_001}, {application-record-element=DET_ELEVATION_ERR_002, system-signal=DET_ELEVATION_ERR_002}, {application-record-element=DET_ELEVATION_ERR_003, system-signal=DET_ELEVATION_ERR_003}, {application-record-element=DET_ELEVATION_ERR_004, system-signal=DET_ELEVATION_ERR_004}, {application-record-element=DET_EXISTENCE_PROB_001, system-signal=DET_EXISTENCE_PROB_001}, {application-record-element=DET_EXISTENCE_PROB_002, system-signal=DET_EXISTENCE_PROB_002}, {application-record-element=DET_EXISTENCE_PROB_003, system-signal=DET_EXISTENCE_PROB_003}, {application-record-element=DET_EXISTENCE_PROB_004, system-signal=DET_EXISTENCE_PROB_004}, {application-record-element=DET_HVC_FLAG_001, system-signal=DET_HVC_FLAG_001}, {application-record-element=DET_HVC_FLAG_002, system-signal=DET_HVC_FLAG_002}, {application-record-element=DET_HVC_FLAG_003, system-signal=DET_HVC_FLAG_003}, {application-record-element=DET_HVC_FLAG_004, system-signal=DET_HVC_FLAG_004}, {application-record-element=DET_IDM_001, system-signal=DET_IDM_001}, {application-record-element=DET_IDM_002, system-signal=DET_IDM_002}, {application-record-element=DET_IDM_003, system-signal=DET_IDM_003}, {application-record-element=DET_IDM_004, system-signal=DET_IDM_004}, {application-record-element=DET_MH_CRC16_001_004, system-signal=DET_MH_CRC16_001_004}, {application-record-element=DET_MH_CYCLE_COUNTER_001_004, system-signal=DET_MH_CYCLE_COUNTER_001_004}, {application-record-element=DET_MH_SCAN_INDEX_4LSB_001_004, system-signal=DET_MH_SCAN_INDEX_4LSB_001_004}, {application-record-element=DET_MTD_001, system-signal=DET_MTD_001}, {application-record-element=DET_MTD_002, system-signal=DET_MTD_002}, {application-record-element=DET_MTD_003, system-signal=DET_MTD_003}, {application-record-element=DET_MTD_004, system-signal=DET_MTD_004}, {application-record-element=DET_PROB_1STAZHYPO_001, system-signal=DET_PROB_1STAZHYPO_001}, {application-record-element=DET_PROB_1STAZHYPO_002, system-signal=DET_PROB_1STAZHYPO_002}, {application-record-element=DET_PROB_1STAZHYPO_003, system-signal=DET_PROB_1STAZHYPO_003}, {application-record-element=DET_PROB_1STAZHYPO_004, system-signal=DET_PROB_1STAZHYPO_004}, {application-record-element=DET_RANGE_001, system-signal=DET_RANGE_001}, {application-record-element=DET_RANGE_002, system-signal=DET_RANGE_002}, {application-record-element=DET_RANGE_003, system-signal=DET_RANGE_003}, {application-record-element=DET_RANGE_004, system-signal=DET_RANGE_004}, {application-record-element=DET_RANGE_ERR_001, system-signal=DET_RANGE_ERR_001}, {application-record-element=DET_RANGE_ERR_002, system-signal=DET_RANGE_ERR_002}, {application-record-element=DET_RANGE_ERR_003, system-signal=DET_RANGE_ERR_003}, {application-record-element=DET_RANGE_ERR_004, system-signal=DET_RANGE_ERR_004}, {application-record-element=DET_RANGE_VELOCITY_001, system-signal=DET_RANGE_VELOCITY_001}, {application-record-element=DET_RANGE_VELOCITY_002, system-signal=DET_RANGE_VELOCITY_002}, {application-record-element=DET_RANGE_VELOCITY_003, system-signal=DET_RANGE_VELOCITY_003}, {application-record-element=DET_RANGE_VELOCITY_004, system-signal=DET_RANGE_VELOCITY_004}, {application-record-element=DET_RANGE_VELOCITY_ERR_001, system-signal=DET_RANGE_VELOCITY_ERR_001}, {application-record-element=DET_RANGE_VELOCITY_ERR_002, system-signal=DET_RANGE_VELOCITY_ERR_002}, {application-record-element=DET_RANGE_VELOCITY_ERR_003, system-signal=DET_RANGE_VELOCITY_ERR_003}, {application-record-element=DET_RANGE_VELOCITY_ERR_004, system-signal=DET_RANGE_VELOCITY_ERR_004}, {application-record-element=DET_RCS_001, system-signal=DET_RCS_001}, {application-record-element=DET_RCS_002, system-signal=DET_RCS_002}, {application-record-element=DET_RCS_003, system-signal=DET_RCS_003}, {application-record-element=DET_RCS_004, system-signal=DET_RCS_004}, {application-record-element=DET_SNR_001, system-signal=DET_SNR_001}, {application-record-element=DET_SNR_002, system-signal=DET_SNR_002}, {application-record-element=DET_SNR_003, system-signal=DET_SNR_003}, {application-record-element=DET_SNR_004, system-signal=DET_SNR_004}, {application-record-element=DET_SUPER_RES_TARGET_001, system-signal=DET_SUPER_RES_TARGET_001}, {application-record-element=DET_SUPER_RES_TARGET_002, system-signal=DET_SUPER_RES_TARGET_002}, {application-record-element=DET_SUPER_RES_TARGET_003, system-signal=DET_SUPER_RES_TARGET_003}, {application-record-element=DET_SUPER_RES_TARGET_004, system-signal=DET_SUPER_RES_TARGET_004}]}
        sender-receiver-to-signal-group-mapping={data-element=Pp_SG_Detections_005_008_AL.Vdp_SG_Detections_005_008_AL, signal-group=SG_Detections_005_008, type-mapping=sender-rec-record-type-mapping=record-element-mappings=[{application-record-element=DET_AZIMUTH_005, system-signal=DET_AZIMUTH_005}, {application-record-element=DET_AZIMUTH_006, system-signal=DET_AZIMUTH_006}, {application-record-element=DET_AZIMUTH_007, system-signal=DET_AZIMUTH_007}, {application-record-element=DET_AZIMUTH_008, system-signal=DET_AZIMUTH_008}, {application-record-element=DET_AZIMUTH_ERR_005, system-signal=DET_AZIMUTH_ERR_005}, {application-record-element=DET_AZIMUTH_ERR_006, system-signal=DET_AZIMUTH_ERR_006}, {application-record-element=DET_AZIMUTH_ERR_007, system-signal=DET_AZIMUTH_ERR_007}, {application-record-element=DET_AZIMUTH_ERR_008, system-signal=DET_AZIMUTH_ERR_008}, {application-record-element=DET_BELOW_RAIN_THOLD_005, system-signal=DET_BELOW_RAIN_THOLD_005}, {application-record-element=DET_BELOW_RAIN_THOLD_006, system-signal=DET_BELOW_RAIN_THOLD_006}, {application-record-element=DET_BELOW_RAIN_THOLD_007, system-signal=DET_BELOW_RAIN_THOLD_007}, {application-record-element=DET_BELOW_RAIN_THOLD_008, system-signal=DET_BELOW_RAIN_THOLD_008}, {application-record-element=DET_BI_STATIC_FLAG_005, system-signal=DET_BI_STATIC_FLAG_005}, {application-record-element=DET_BI_STATIC_FLAG_006, system-signal=DET_BI_STATIC_FLAG_006}, {application-record-element=DET_BI_STATIC_FLAG_007, system-signal=DET_BI_STATIC_FLAG_007}, {application-record-element=DET_BI_STATIC_FLAG_008, system-signal=DET_BI_STATIC_FLAG_008}, {application-record-element=DET_CONFD_AZIMUTH_005, system-signal=DET_CONFD_AZIMUTH_005}, {application-record-element=DET_CONFD_AZIMUTH_006, system-signal=DET_CONFD_AZIMUTH_006}, {application-record-element=DET_CONFD_AZIMUTH_007, system-signal=DET_CONFD_AZIMUTH_007}, {application-record-element=DET_CONFD_AZIMUTH_008, system-signal=DET_CONFD_AZIMUTH_008}, {application-record-element=DET_CONFD_ELEVATION_005, system-signal=DET_CONFD_ELEVATION_005}, {application-record-element=DET_CONFD_ELEVATION_006, system-signal=DET_CONFD_ELEVATION_006}, {application-record-element=DET_CONFD_ELEVATION_007, system-signal=DET_CONFD_ELEVATION_007}, {application-record-element=DET_CONFD_ELEVATION_008, system-signal=DET_CONFD_ELEVATION_008}, {application-record-element=DET_ELEVATION_005, system-signal=DET_ELEVATION_005}, {application-record-element=DET_ELEVATION_006, system-signal=DET_ELEVATION_006}, {application-record-element=DET_ELEVATION_007, system-signal=DET_ELEVATION_007}, {application-record-element=DET_ELEVATION_008, system-signal=DET_ELEVATION_008}, {application-record-element=DET_ELEVATION_ERR_005, system-signal=DET_ELEVATION_ERR_005}, {application-record-element=DET_ELEVATION_ERR_006, system-signal=DET_ELEVATION_ERR_006}, {application-record-element=DET_ELEVATION_ERR_007, system-signal=DET_ELEVATION_ERR_007}, {application-record-element=DET_ELEVATION_ERR_008, system-signal=DET_ELEVATION_ERR_008}, {application-record-element=DET_EXISTENCE_PROB_005, system-signal=DET_EXISTENCE_PROB_005}, {application-record-element=DET_EXISTENCE_PROB_006, system-signal=DET_EXISTENCE_PROB_006}, {application-record-element=DET_EXISTENCE_PROB_007, system-signal=DET_EXISTENCE_PROB_007}, {application-record-element=DET_EXISTENCE_PROB_008, system-signal=DET_EXISTENCE_PROB_008}, {application-record-element=DET_HVC_FLAG_005, system-signal=DET_HVC_FLAG_005}, {application-record-element=DET_HVC_FLAG_006, system-signal=DET_HVC_FLAG_006}, {application-record-element=DET_HVC_FLAG_007, system-signal=DET_HVC_FLAG_007}, {application-record-element=DET_HVC_FLAG_008, system-signal=DET_HVC_FLAG_008}, {application-record-element=DET_IDM_005, system-signal=DET_IDM_005}, {application-record-element=DET_IDM_006, system-signal=DET_IDM_006}, {application-record-element=DET_IDM_007, system-signal=DET_IDM_007}, {application-record-element=DET_IDM_008, system-signal=DET_IDM_008}, {application-record-element=DET_MH_CRC16_005_008, system-signal=DET_MH_CRC16_005_008}, {application-record-element=DET_MH_CYCLE_COUNTER_005_008, system-signal=DET_MH_CYCLE_COUNTER_005_008}, {application-record-element=DET_MH_SCAN_INDEX_4LSB_005_008, system-signal=DET_MH_SCAN_INDEX_4LSB_005_008}, {application-record-element=DET_MTD_005, system-signal=DET_MTD_005}, {application-record-element=DET_MTD_006, system-signal=DET_MTD_006}, {application-record-element=DET_MTD_007, system-signal=DET_MTD_007}, {application-record-element=DET_MTD_008, system-signal=DET_MTD_008}, {application-record-element=DET_PROB_1STAZHYPO_005, system-signal=DET_PROB_1STAZHYPO_005}, {application-record-element=DET_PROB_1STAZHYPO_006, system-signal=DET_PROB_1STAZHYPO_006}, {application-record-element=DET_PROB_1STAZHYPO_007, system-signal=DET_PROB_1STAZHYPO_007}, {application-record-element=DET_PROB_1STAZHYPO_008, system-signal=DET_PROB_1STAZHYPO_008}, {application-record-element=DET_RANGE_005, system-signal=DET_RANGE_005}, {application-record-element=DET_RANGE_006, system-signal=DET_RANGE_006}, {application-record-element=DET_RANGE_007, system-signal=DET_RANGE_007}, {application-record-element=DET_RANGE_008, system-signal=DET_RANGE_008}, {application-record-element=DET_RANGE_ERR_005, system-signal=DET_RANGE_ERR_005}, {application-record-element=DET_RANGE_ERR_006, system-signal=DET_RANGE_ERR_006}, {application-record-element=DET_RANGE_ERR_007, system-signal=DET_RANGE_ERR_007}, {application-record-element=DET_RANGE_ERR_008, system-signal=DET_RANGE_ERR_008}, {application-record-element=DET_RANGE_VELOCITY_005, system-signal=DET_RANGE_VELOCITY_005}, {application-record-element=DET_RANGE_VELOCITY_006, system-signal=DET_RANGE_VELOCITY_006}, {application-record-element=DET_RANGE_VELOCITY_007, system-signal=DET_RANGE_VELOCITY_007}, {application-record-element=DET_RANGE_VELOCITY_008, system-signal=DET_RANGE_VELOCITY_008}, {application-record-element=DET_RANGE_VELOCITY_ERR_005, system-signal=DET_RANGE_VELOCITY_ERR_005}, {application-record-element=DET_RANGE_VELOCITY_ERR_006, system-signal=DET_RANGE_VELOCITY_ERR_006}, {application-record-element=DET_RANGE_VELOCITY_ERR_007, system-signal=DET_RANGE_VELOCITY_ERR_007}, {application-record-element=DET_RANGE_VELOCITY_ERR_008, system-signal=DET_RANGE_VELOCITY_ERR_008}, {application-record-element=DET_RCS_005, system-signal=DET_RCS_005}, {application-record-element=DET_RCS_006, system-signal=DET_RCS_006}, {application-record-element=DET_RCS_007, system-signal=DET_RCS_007}, {application-record-element=DET_RCS_008, system-signal=DET_RCS_008}, {application-record-element=DET_SNR_005, system-signal=DET_SNR_005}, {application-record-element=DET_SNR_006, system-signal=DET_SNR_006}, {application-record-element=DET_SNR_007, system-signal=DET_SNR_007}, {application-record-element=DET_SNR_008, system-signal=DET_SNR_008}, {application-record-element=DET_SUPER_RES_TARGET_005, system-signal=DET_SUPER_RES_TARGET_005}, {application-record-element=DET_SUPER_RES_TARGET_006, system-signal=DET_SUPER_RES_TARGET_006}, {application-record-element=DET_SUPER_RES_TARGET_007, system-signal=DET_SUPER_RES_TARGET_007}, {application-record-element=DET_SUPER_RES_TARGET_008, system-signal=DET_SUPER_RES_TARGET_008}]}
        sender-receiver-to-signal-group-mapping={data-element=Pp_SG_Detections_009_012_AL.Vdp_SG_Detections_009_012_AL, signal-group=SG_Detections_009_012, type-mapping=sender-rec-record-type-mapping=record-element-mappings=[{application-record-element=DET_AZIMUTH_009, system-signal=DET_AZIMUTH_009}, {application-record-element=DET_AZIMUTH_010, system-signal=DET_AZIMUTH_010}, {application-record-element=DET_AZIMUTH_011, system-signal=DET_AZIMUTH_011}, {application-record-element=DET_AZIMUTH_012, system-signal=DET_AZIMUTH_012}, {application-record-element=DET_AZIMUTH_ERR_009, system-signal=DET_AZIMUTH_ERR_009}, {application-record-element=DET_AZIMUTH_ERR_010, system-signal=DET_AZIMUTH_ERR_010}, {application-record-element=DET_AZIMUTH_ERR_011, system-signal=DET_AZIMUTH_ERR_011}, {application-record-element=DET_AZIMUTH_ERR_012, system-signal=DET_AZIMUTH_ERR_012}, {application-record-element=DET_BELOW_RAIN_THOLD_009, system-signal=DET_BELOW_RAIN_THOLD_009}, {application-record-element=DET_BELOW_RAIN_THOLD_010, system-signal=DET_BELOW_RAIN_THOLD_010}, {application-record-element=DET_BELOW_RAIN_THOLD_011, system-signal=DET_BELOW_RAIN_THOLD_011}, {application-record-element=DET_BELOW_RAIN_THOLD_012, system-signal=DET_BELOW_RAIN_THOLD_012}, {application-record-element=DET_BI_STATIC_FLAG_009, system-signal=DET_BI_STATIC_FLAG_009}, {application-record-element=DET_BI_STATIC_FLAG_010, system-signal=DET_BI_STATIC_FLAG_010}, {application-record-element=DET_BI_STATIC_FLAG_011, system-signal=DET_BI_STATIC_FLAG_011}, {application-record-element=DET_BI_STATIC_FLAG_012, system-signal=DET_BI_STATIC_FLAG_012}, {application-record-element=DET_CONFD_AZIMUTH_009, system-signal=DET_CONFD_AZIMUTH_009}, {application-record-element=DET_CONFD_AZIMUTH_010, system-signal=DET_CONFD_AZIMUTH_010}, {application-record-element=DET_CONFD_AZIMUTH_011, system-signal=DET_CONFD_AZIMUTH_011}, {application-record-element=DET_CONFD_AZIMUTH_012, system-signal=DET_CONFD_AZIMUTH_012}, {application-record-element=DET_CONFD_ELEVATION_009, system-signal=DET_CONFD_ELEVATION_009}, {application-record-element=DET_CONFD_ELEVATION_010, system-signal=DET_CONFD_ELEVATION_010}, {application-record-element=DET_CONFD_ELEVATION_011, system-signal=DET_CONFD_ELEVATION_011}, {application-record-element=DET_CONFD_ELEVATION_012, system-signal=DET_CONFD_ELEVATION_012}, {application-record-element=DET_ELEVATION_009, system-signal=DET_ELEVATION_009}, {application-record-element=DET_ELEVATION_010, system-signal=DET_ELEVATION_010}, {application-record-element=DET_ELEVATION_011, system-signal=DET_ELEVATION_011}, {application-record-element=DET_ELEVATION_012, system-signal=DET_ELEVATION_012}, {application-record-element=DET_ELEVATION_ERR_009, system-signal=DET_ELEVATION_ERR_009}, {application-record-element=DET_ELEVATION_ERR_010, system-signal=DET_ELEVATION_ERR_010}, {application-record-element=DET_ELEVATION_ERR_011, system-signal=DET_ELEVATION_ERR_011}, {application-record-element=DET_ELEVATION_ERR_012, system-signal=DET_ELEVATION_ERR_012}, {application-record-element=DET_EXISTENCE_PROB_009, system-signal=DET_EXISTENCE_PROB_009}, {application-record-element=DET_EXISTENCE_PROB_010, system-signal=DET_EXISTENCE_PROB_010}, {application-record-element=DET_EXISTENCE_PROB_011, system-signal=DET_EXISTENCE_PROB_011}, {application-record-element=DET_EXISTENCE_PROB_012, system-signal=DET_EXISTENCE_PROB_012}, {application-record-element=DET_HVC_FLAG_009, system-signal=DET_HVC_FLAG_009}, {application-record-element=DET_HVC_FLAG_010, system-signal=DET_HVC_FLAG_010}, {application-record-element=DET_HVC_FLAG_011, system-signal=DET_HVC_FLAG_011}, {application-record-element=DET_HVC_FLAG_012, system-signal=DET_HVC_FLAG_012}, {application-record-element=DET_IDM_009, system-signal=DET_IDM_009}, {application-record-element=DET_IDM_010, system-signal=DET_IDM_010}, {application-record-element=DET_IDM_011, system-signal=DET_IDM_011}, {application-record-element=DET_IDM_012, system-signal=DET_IDM_012}, {application-record-element=DET_MH_CRC16_009_012, system-signal=DET_MH_CRC16_009_012}, {application-record-element=DET_MH_CYCLE_COUNTER_009_012, system-signal=DET_MH_CYCLE_COUNTER_009_012}, {application-record-element=DET_MH_SCAN_INDEX_4LSB_009_012, system-signal=DET_MH_SCAN_INDEX_4LSB_009_012}, {application-record-element=DET_MTD_009, system-signal=DET_MTD_009}, {application-record-element=DET_MTD_010, system-signal=DET_MTD_010}, {application-record-element=DET_MTD_011, system-signal=DET_MTD_011}, {application-record-element=DET_MTD_012, system-signal=DET_MTD_012}, {application-record-element=DET_PROB_1STAZHYPO_009, system-signal=DET_PROB_1STAZHYPO_009}, {application-record-element=DET_PROB_1STAZHYPO_010, system-signal=DET_PROB_1STAZHYPO_010}, {application-record-element=DET_PROB_1STAZHYPO_011, system-signal=DET_PROB_1STAZHYPO_011}, {application-record-element=DET_PROB_1STAZHYPO_012, system-signal=DET_PROB_1STAZHYPO_012}, {application-record-element=DET_RANGE_009, system-signal=DET_RANGE_009}, {application-record-element=DET_RANGE_010, system-signal=DET_RANGE_010}, {application-record-element=DET_RANGE_011, system-signal=DET_RANGE_011}, {application-record-element=DET_RANGE_012, system-signal=DET_RANGE_012}, {application-record-element=DET_RANGE_ERR_009, system-signal=DET_RANGE_ERR_009}, {application-record-element=DET_RANGE_ERR_010, system-signal=DET_RANGE_ERR_010}, {application-record-element=DET_RANGE_ERR_011, system-signal=DET_RANGE_ERR_011}, {application-record-element=DET_RANGE_ERR_012, system-signal=DET_RANGE_ERR_012}, {application-record-element=DET_RANGE_VELOCITY_009, system-signal=DET_RANGE_VELOCITY_009}, {application-record-element=DET_RANGE_VELOCITY_010, system-signal=DET_RANGE_VELOCITY_010}, {application-record-element=DET_RANGE_VELOCITY_011, system-signal=DET_RANGE_VELOCITY_011}, {application-record-element=DET_RANGE_VELOCITY_012, system-signal=DET_RANGE_VELOCITY_012}, {application-record-element=DET_RANGE_VELOCITY_ERR_009, system-signal=DET_RANGE_VELOCITY_ERR_009}, {application-record-element=DET_RANGE_VELOCITY_ERR_010, system-signal=DET_RANGE_VELOCITY_ERR_010}, {application-record-element=DET_RANGE_VELOCITY_ERR_011, system-signal=DET_RANGE_VELOCITY_ERR_011}, {application-record-element=DET_RANGE_VELOCITY_ERR_012, system-signal=DET_RANGE_VELOCITY_ERR_012}, {application-record-element=DET_RCS_009, system-signal=DET_RCS_009}, {application-record-element=DET_RCS_010, system-signal=DET_RCS_010}, {application-record-element=DET_RCS_011, system-signal=DET_RCS_011}, {application-record-element=DET_RCS_012, system-signal=DET_RCS_012}, {application-record-element=DET_SNR_009, system-signal=DET_SNR_009}, {application-record-element=DET_SNR_010, system-signal=DET_SNR_010}, {application-record-element=DET_SNR_011, system-signal=DET_SNR_011}, {application-record-element=DET_SNR_012, system-signal=DET_SNR_012}, {application-record-element=DET_SUPER_RES_TARGET_009, system-signal=DET_SUPER_RES_TARGET_009}, {application-record-element=DET_SUPER_RES_TARGET_010, system-signal=DET_SUPER_RES_TARGET_010}, {application-record-element=DET_SUPER_RES_TARGET_011, system-signal=DET_SUPER_RES_TARGET_011}, {application-record-element=DET_SUPER_RES_TARGET_012, system-signal=DET_SUPER_RES_TARGET_012}]}
        sender-receiver-to-signal-group-mapping={data-element=Pp_SG_Detections_013_016_AL.Vdp_SG_Detections_013_016_AL, signal-group=SG_Detections_013_016, type-mapping=sender-rec-record-type-mapping=record-element-mappings=[{application-record-element=DET_AZIMUTH_013, system-signal=DET_AZIMUTH_013}, {application-record-element=DET_AZIMUTH_014, system-signal=DET_AZIMUTH_014}, {application-record-element=DET_AZIMUTH_015, system-signal=DET_AZIMUTH_015}, {application-record-element=DET_AZIMUTH_016, system-signal=DET_AZIMUTH_016}, {application-record-element=DET_AZIMUTH_ERR_013, system-signal=DET_AZIMUTH_ERR_013}, {application-record-element=DET_AZIMUTH_ERR_014, system-signal=DET_AZIMUTH_ERR_014}, {application-record-element=DET_AZIMUTH_ERR_015, system-signal=DET_AZIMUTH_ERR_015}, {application-record-element=DET_AZIMUTH_ERR_016, system-signal=DET_AZIMUTH_ERR_016}, {application-record-element=DET_BELOW_RAIN_THOLD_013, system-signal=DET_BELOW_RAIN_THOLD_013}, {application-record-element=DET_BELOW_RAIN_THOLD_014, system-signal=DET_BELOW_RAIN_THOLD_014}, {application-record-element=DET_BELOW_RAIN_THOLD_015, system-signal=DET_BELOW_RAIN_THOLD_015}, {application-record-element=DET_BELOW_RAIN_THOLD_016, system-signal=DET_BELOW_RAIN_THOLD_016}, {application-record-element=DET_BI_STATIC_FLAG_013, system-signal=DET_BI_STATIC_FLAG_013}, {application-record-element=DET_BI_STATIC_FLAG_014, system-signal=DET_BI_STATIC_FLAG_014}, {application-record-element=DET_BI_STATIC_FLAG_015, system-signal=DET_BI_STATIC_FLAG_015}, {application-record-element=DET_BI_STATIC_FLAG_016, system-signal=DET_BI_STATIC_FLAG_016}, {application-record-element=DET_CONFD_AZIMUTH_013, system-signal=DET_CONFD_AZIMUTH_013}, {application-record-element=DET_CONFD_AZIMUTH_014, system-signal=DET_CONFD_AZIMUTH_014}, {application-record-element=DET_CONFD_AZIMUTH_015, system-signal=DET_CONFD_AZIMUTH_015}, {application-record-element=DET_CONFD_AZIMUTH_016, system-signal=DET_CONFD_AZIMUTH_016}, {application-record-element=DET_CONFD_ELEVATION_013, system-signal=DET_CONFD_ELEVATION_013}, {application-record-element=DET_CONFD_ELEVATION_014, system-signal=DET_CONFD_ELEVATION_014}, {application-record-element=DET_CONFD_ELEVATION_015, system-signal=DET_CONFD_ELEVATION_015}, {application-record-element=DET_CONFD_ELEVATION_016, system-signal=DET_CONFD_ELEVATION_016}, {application-record-element=DET_ELEVATION_013, system-signal=DET_ELEVATION_013}, {application-record-element=DET_ELEVATION_014, system-signal=DET_ELEVATION_014}, {application-record-element=DET_ELEVATION_015, system-signal=DET_ELEVATION_015}, {application-record-element=DET_ELEVATION_016, system-signal=DET_ELEVATION_016}, {application-record-element=DET_ELEVATION_ERR_013, system-signal=DET_ELEVATION_ERR_013}, {application-record-element=DET_ELEVATION_ERR_014, system-signal=DET_ELEVATION_ERR_014}, {application-record-element=DET_ELEVATION_ERR_015, system-signal=DET_ELEVATION_ERR_015}, {application-record-element=DET_ELEVATION_ERR_016, system-signal=DET_ELEVATION_ERR_016}, {application-record-element=DET_EXISTENCE_PROB_013, system-signal=DET_EXISTENCE_PROB_013}, {application-record-element=DET_EXISTENCE_PROB_014, system-signal=DET_EXISTENCE_PROB_014}, {application-record-element=DET_EXISTENCE_PROB_015, system-signal=DET_EXISTENCE_PROB_015}, {application-record-element=DET_EXISTENCE_PROB_016, system-signal=DET_EXISTENCE_PROB_016}, {application-record-element=DET_HVC_FLAG_013, system-signal=DET_HVC_FLAG_013}, {application-record-element=DET_HVC_FLAG_014, system-signal=DET_HVC_FLAG_014}, {application-record-element=DET_HVC_FLAG_015, system-signal=DET_HVC_FLAG_015}, {application-record-element=DET_HVC_FLAG_016, system-signal=DET_HVC_FLAG_016}, {application-record-element=DET_IDM_013, system-signal=DET_IDM_013}, {application-record-element=DET_IDM_014, system-signal=DET_IDM_014}, {application-record-element=DET_IDM_015, system-signal=DET_IDM_015}, {application-record-element=DET_IDM_016, system-signal=DET_IDM_016}, {application-record-element=DET_MH_CRC16_013_016, system-signal=DET_MH_CRC16_013_016}, {application-record-element=DET_MH_CYCLE_COUNTER_013_016, system-signal=DET_MH_CYCLE_COUNTER_013_016}, {application-record-element=DET_MH_SCAN_INDEX_4LSB_013_016, system-signal=DET_MH_SCAN_INDEX_4LSB_013_016}, {application-record-element=DET_MTD_013, system-signal=DET_MTD_013}, {application-record-element=DET_MTD_014, system-signal=DET_MTD_014}, {application-record-element=DET_MTD_015, system-signal=DET_MTD_015}, {application-record-element=DET_MTD_016, system-signal=DET_MTD_016}, {application-record-element=DET_PROB_1STAZHYPO_013, system-signal=DET_PROB_1STAZHYPO_013}, {application-record-element=DET_PROB_1STAZHYPO_014, system-signal=DET_PROB_1STAZHYPO_014}, {application-record-element=DET_PROB_1STAZHYPO_015, system-signal=DET_PROB_1STAZHYPO_015}, {application-record-element=DET_PROB_1STAZHYPO_016, system-signal=DET_PROB_1STAZHYPO_016}, {application-record-element=DET_RANGE_013, system-signal=DET_RANGE_013}, {application-record-element=DET_RANGE_014, system-signal=DET_RANGE_014}, {application-record-element=DET_RANGE_015, system-signal=DET_RANGE_015}, {application-record-element=DET_RANGE_016, system-signal=DET_RANGE_016}, {application-record-element=DET_RANGE_ERR_013, system-signal=DET_RANGE_ERR_013}, {application-record-element=DET_RANGE_ERR_014, system-signal=DET_RANGE_ERR_014}, {application-record-element=DET_RANGE_ERR_015, system-signal=DET_RANGE_ERR_015}, {application-record-element=DET_RANGE_ERR_016, system-signal=DET_RANGE_ERR_016}, {application-record-element=DET_RANGE_VELOCITY_013, system-signal=DET_RANGE_VELOCITY_013}, {application-record-element=DET_RANGE_VELOCITY_014, system-signal=DET_RANGE_VELOCITY_014}, {application-record-element=DET_RANGE_VELOCITY_015, system-signal=DET_RANGE_VELOCITY_015}, {application-record-element=DET_RANGE_VELOCITY_016, system-signal=DET_RANGE_VELOCITY_016}, {application-record-element=DET_RANGE_VELOCITY_ERR_013, system-signal=DET_RANGE_VELOCITY_ERR_013}, {application-record-element=DET_RANGE_VELOCITY_ERR_014, system-signal=DET_RANGE_VELOCITY_ERR_014}, {application-record-element=DET_RANGE_VELOCITY_ERR_015, system-signal=DET_RANGE_VELOCITY_ERR_015}, {application-record-element=DET_RANGE_VELOCITY_ERR_016, system-signal=DET_RANGE_VELOCITY_ERR_016}, {application-record-element=DET_RCS_013, system-signal=DET_RCS_013}, {application-record-element=DET_RCS_014, system-signal=DET_RCS_014}, {application-record-element=DET_RCS_015, system-signal=DET_RCS_015}, {application-record-element=DET_RCS_016, system-signal=DET_RCS_016}, {application-record-element=DET_SNR_013, system-signal=DET_SNR_013}, {application-record-element=DET_SNR_014, system-signal=DET_SNR_014}, {application-record-element=DET_SNR_015, system-signal=DET_SNR_015}, {application-record-element=DET_SNR_016, system-signal=DET_SNR_016}, {application-record-element=DET_SUPER_RES_TARGET_013, system-signal=DET_SUPER_RES_TARGET_013}, {application-record-element=DET_SUPER_RES_TARGET_014, system-signal=DET_SUPER_RES_TARGET_014}, {application-record-element=DET_SUPER_RES_TARGET_015, system-signal=DET_SUPER_RES_TARGET_015}, {application-record-element=DET_SUPER_RES_TARGET_016, system-signal=DET_SUPER_RES_TARGET_016}]}
        sender-receiver-to-signal-group-mapping={data-element=Pp_SG_Detections_017_020_AL.Vdp_SG_Detections_017_020_AL, signal-group=SG_Detections_017_020, type-mapping=sender-rec-record-type-mapping=record-element-mappings=[{application-record-element=DET_AZIMUTH_017, system-signal=DET_AZIMUTH_017}, {application-record-element=DET_AZIMUTH_018, system-signal=DET_AZIMUTH_018}, {application-record-element=DET_AZIMUTH_019, system-signal=DET_AZIMUTH_019}, {application-record-element=DET_AZIMUTH_020, system-signal=DET_AZIMUTH_020}, {application-record-element=DET_AZIMUTH_ERR_017, system-signal=DET_AZIMUTH_ERR_017}, {application-record-element=DET_AZIMUTH_ERR_018, system-signal=DET_AZIMUTH_ERR_018}, {application-record-element=DET_AZIMUTH_ERR_019, system-signal=DET_AZIMUTH_ERR_019}, {application-record-element=DET_AZIMUTH_ERR_020, system-signal=DET_AZIMUTH_ERR_020}, {application-record-element=DET_BELOW_RAIN_THOLD_017, system-signal=DET_BELOW_RAIN_THOLD_017}, {application-record-element=DET_BELOW_RAIN_THOLD_018, system-signal=DET_BELOW_RAIN_THOLD_018}, {application-record-element=DET_BELOW_RAIN_THOLD_019, system-signal=DET_BELOW_RAIN_THOLD_019}, {application-record-element=DET_BELOW_RAIN_THOLD_020, system-signal=DET_BELOW_RAIN_THOLD_020}, {application-record-element=DET_BI_STATIC_FLAG_017, system-signal=DET_BI_STATIC_FLAG_017}, {application-record-element=DET_BI_STATIC_FLAG_018, system-signal=DET_BI_STATIC_FLAG_018}, {application-record-element=DET_BI_STATIC_FLAG_019, system-signal=DET_BI_STATIC_FLAG_019}, {application-record-element=DET_BI_STATIC_FLAG_020, system-signal=DET_BI_STATIC_FLAG_020}, {application-record-element=DET_CONFD_AZIMUTH_017, system-signal=DET_CONFD_AZIMUTH_017}, {application-record-element=DET_CONFD_AZIMUTH_018, system-signal=DET_CONFD_AZIMUTH_018}, {application-record-element=DET_CONFD_AZIMUTH_019, system-signal=DET_CONFD_AZIMUTH_019}, {application-record-element=DET_CONFD_AZIMUTH_020, system-signal=DET_CONFD_AZIMUTH_020}, {application-record-element=DET_CONFD_ELEVATION_017, system-signal=DET_CONFD_ELEVATION_017}, {application-record-element=DET_CONFD_ELEVATION_018, system-signal=DET_CONFD_ELEVATION_018}, {application-record-element=DET_CONFD_ELEVATION_019, system-signal=DET_CONFD_ELEVATION_019}, {application-record-element=DET_CONFD_ELEVATION_020, system-signal=DET_CONFD_ELEVATION_020}, {application-record-element=DET_ELEVATION_017, system-signal=DET_ELEVATION_017}, {application-record-element=DET_ELEVATION_018, system-signal=DET_ELEVATION_018}, {application-record-element=DET_ELEVATION_019, system-signal=DET_ELEVATION_019}, {application-record-element=DET_ELEVATION_020, system-signal=DET_ELEVATION_020}, {application-record-element=DET_ELEVATION_ERR_017, system-signal=DET_ELEVATION_ERR_017}, {application-record-element=DET_ELEVATION_ERR_018, system-signal=DET_ELEVATION_ERR_018}, {application-record-element=DET_ELEVATION_ERR_019, system-signal=DET_ELEVATION_ERR_019}, {application-record-element=DET_ELEVATION_ERR_020, system-signal=DET_ELEVATION_ERR_020}, {application-record-element=DET_EXISTENCE_PROB_017, system-signal=DET_EXISTENCE_PROB_017}, {application-record-element=DET_EXISTENCE_PROB_018, system-signal=DET_EXISTENCE_PROB_018}, {application-record-element=DET_EXISTENCE_PROB_019, system-signal=DET_EXISTENCE_PROB_019}, {application-record-element=DET_EXISTENCE_PROB_020, system-signal=DET_EXISTENCE_PROB_020}, {application-record-element=DET_HVC_FLAG_017, system-signal=DET_HVC_FLAG_017}, {application-record-element=DET_HVC_FLAG_018, system-signal=DET_HVC_FLAG_018}, {application-record-element=DET_HVC_FLAG_019, system-signal=DET_HVC_FLAG_019}, {application-record-element=DET_HVC_FLAG_020, system-signal=DET_HVC_FLAG_020}, {application-record-element=DET_IDM_017, system-signal=DET_IDM_017}, {application-record-element=DET_IDM_018, system-signal=DET_IDM_018}, {application-record-element=DET_IDM_019, system-signal=DET_IDM_019}, {application-record-element=DET_IDM_020, system-signal=DET_IDM_020}, {application-record-element=DET_MH_CRC16_017_020, system-signal=DET_MH_CRC16_017_020}, {application-record-element=DET_MH_CYCLE_COUNTER_017_020, system-signal=DET_MH_CYCLE_COUNTER_017_020}, {application-record-element=DET_MH_SCAN_INDEX_4LSB_017_020, system-signal=DET_MH_SCAN_INDEX_4LSB_017_020}, {application-record-element=DET_MTD_017, system-signal=DET_MTD_017}, {application-record-element=DET_MTD_018, system-signal=DET_MTD_018}, {application-record-element=DET_MTD_019, system-signal=DET_MTD_019}, {application-record-element=DET_MTD_020, system-signal=DET_MTD_020}, {application-record-element=DET_PROB_1STAZHYPO_017, system-signal=DET_PROB_1STAZHYPO_017}, {application-record-element=DET_PROB_1STAZHYPO_018, system-signal=DET_PROB_1STAZHYPO_018}, {application-record-element=DET_PROB_1STAZHYPO_019, system-signal=DET_PROB_1STAZHYPO_019}, {application-record-element=DET_PROB_1STAZHYPO_020, system-signal=DET_PROB_1STAZHYPO_020}, {application-record-element=DET_RANGE_017, system-signal=DET_RANGE_017}, {application-record-element=DET_RANGE_018, system-signal=DET_RANGE_018}, {application-record-element=DET_RANGE_019, system-signal=DET_RANGE_019}, {application-record-element=DET_RANGE_020, system-signal=DET_RANGE_020}, {application-record-element=DET_RANGE_ERR_017, system-signal=DET_RANGE_ERR_017}, {application-record-element=DET_RANGE_ERR_018, system-signal=DET_RANGE_ERR_018}, {application-record-element=DET_RANGE_ERR_019, system-signal=DET_RANGE_ERR_019}, {application-record-element=DET_RANGE_ERR_020, system-signal=DET_RANGE_ERR_020}, {application-record-element=DET_RANGE_VELOCITY_017, system-signal=DET_RANGE_VELOCITY_017}, {application-record-element=DET_RANGE_VELOCITY_018, system-signal=DET_RANGE_VELOCITY_018}, {application-record-element=DET_RANGE_VELOCITY_019, system-signal=DET_RANGE_VELOCITY_019}, {application-record-element=DET_RANGE_VELOCITY_020, system-signal=DET_RANGE_VELOCITY_020}, {application-record-element=DET_RANGE_VELOCITY_ERR_017, system-signal=DET_RANGE_VELOCITY_ERR_017}, {application-record-element=DET_RANGE_VELOCITY_ERR_018, system-signal=DET_RANGE_VELOCITY_ERR_018}, {application-record-element=DET_RANGE_VELOCITY_ERR_019, system-signal=DET_RANGE_VELOCITY_ERR_019}, {application-record-element=DET_RANGE_VELOCITY_ERR_020, system-signal=DET_RANGE_VELOCITY_ERR_020}, {application-record-element=DET_RCS_017, system-signal=DET_RCS_017}, {application-record-element=DET_RCS_018, system-signal=DET_RCS_018}, {application-record-element=DET_RCS_019, system-signal=DET_RCS_019}, {application-record-element=DET_RCS_020, system-signal=DET_RCS_020}, {application-record-element=DET_SNR_017, system-signal=DET_SNR_017}, {application-record-element=DET_SNR_018, system-signal=DET_SNR_018}, {application-record-element=DET_SNR_019, system-signal=DET_SNR_019}, {application-record-element=DET_SNR_020, system-signal=DET_SNR_020}, {application-record-element=DET_SUPER_RES_TARGET_017, system-signal=DET_SUPER_RES_TARGET_017}, {application-record-element=DET_SUPER_RES_TARGET_018, system-signal=DET_SUPER_RES_TARGET_018}, {application-record-element=DET_SUPER_RES_TARGET_019, system-signal=DET_SUPER_RES_TARGET_019}, {application-record-element=DET_SUPER_RES_TARGET_020, system-signal=DET_SUPER_RES_TARGET_020}]}
        sender-receiver-to-signal-group-mapping={data-element=Pp_SG_Detections_021_024_AL.Vdp_SG_Detections_021_024_AL, signal-group=SG_Detections_021_024, type-mapping=sender-rec-record-type-mapping=record-element-mappings=[{application-record-element=DET_AZIMUTH_021, system-signal=DET_AZIMUTH_021}, {application-record-element=DET_AZIMUTH_022, system-signal=DET_AZIMUTH_022}, {application-record-element=DET_AZIMUTH_023, system-signal=DET_AZIMUTH_023}, {application-record-element=DET_AZIMUTH_024, system-signal=DET_AZIMUTH_024}, {application-record-element=DET_AZIMUTH_ERR_021, system-signal=DET_AZIMUTH_ERR_021}, {application-record-element=DET_AZIMUTH_ERR_022, system-signal=DET_AZIMUTH_ERR_022}, {application-record-element=DET_AZIMUTH_ERR_023, system-signal=DET_AZIMUTH_ERR_023}, {application-record-element=DET_AZIMUTH_ERR_024, system-signal=DET_AZIMUTH_ERR_024}, {application-record-element=DET_BELOW_RAIN_THOLD_021, system-signal=DET_BELOW_RAIN_THOLD_021}, {application-record-element=DET_BELOW_RAIN_THOLD_022, system-signal=DET_BELOW_RAIN_THOLD_022}, {application-record-element=DET_BELOW_RAIN_THOLD_023, system-signal=DET_BELOW_RAIN_THOLD_023}, {application-record-element=DET_BELOW_RAIN_THOLD_024, system-signal=DET_BELOW_RAIN_THOLD_024}, {application-record-element=DET_BI_STATIC_FLAG_021, system-signal=DET_BI_STATIC_FLAG_021}, {application-record-element=DET_BI_STATIC_FLAG_022, system-signal=DET_BI_STATIC_FLAG_022}, {application-record-element=DET_BI_STATIC_FLAG_023, system-signal=DET_BI_STATIC_FLAG_023}, {application-record-element=DET_BI_STATIC_FLAG_024, system-signal=DET_BI_STATIC_FLAG_024}, {application-record-element=DET_CONFD_AZIMUTH_021, system-signal=DET_CONFD_AZIMUTH_021}, {application-record-element=DET_CONFD_AZIMUTH_022, system-signal=DET_CONFD_AZIMUTH_022}, {application-record-element=DET_CONFD_AZIMUTH_023, system-signal=DET_CONFD_AZIMUTH_023}, {application-record-element=DET_CONFD_AZIMUTH_024, system-signal=DET_CONFD_AZIMUTH_024}, {application-record-element=DET_CONFD_ELEVATION_021, system-signal=DET_CONFD_ELEVATION_021}, {application-record-element=DET_CONFD_ELEVATION_022, system-signal=DET_CONFD_ELEVATION_022}, {application-record-element=DET_CONFD_ELEVATION_023, system-signal=DET_CONFD_ELEVATION_023}, {application-record-element=DET_CONFD_ELEVATION_024, system-signal=DET_CONFD_ELEVATION_024}, {application-record-element=DET_ELEVATION_021, system-signal=DET_ELEVATION_021}, {application-record-element=DET_ELEVATION_022, system-signal=DET_ELEVATION_022}, {application-record-element=DET_ELEVATION_023, system-signal=DET_ELEVATION_023}, {application-record-element=DET_ELEVATION_024, system-signal=DET_ELEVATION_024}, {application-record-element=DET_ELEVATION_ERR_021, system-signal=DET_ELEVATION_ERR_021}, {application-record-element=DET_ELEVATION_ERR_022, system-signal=DET_ELEVATION_ERR_022}, {application-record-element=DET_ELEVATION_ERR_023, system-signal=DET_ELEVATION_ERR_023}, {application-record-element=DET_ELEVATION_ERR_024, system-signal=DET_ELEVATION_ERR_024}, {application-record-element=DET_EXISTENCE_PROB_021, system-signal=DET_EXISTENCE_PROB_021}, {application-record-element=DET_EXISTENCE_PROB_022, system-signal=DET_EXISTENCE_PROB_022}, {application-record-element=DET_EXISTENCE_PROB_023, system-signal=DET_EXISTENCE_PROB_023}, {application-record-element=DET_EXISTENCE_PROB_024, system-signal=DET_EXISTENCE_PROB_024}, {application-record-element=DET_HVC_FLAG_021, system-signal=DET_HVC_FLAG_021}, {application-record-element=DET_HVC_FLAG_022, system-signal=DET_HVC_FLAG_022}, {application-record-element=DET_HVC_FLAG_023, system-signal=DET_HVC_FLAG_023}, {application-record-element=DET_HVC_FLAG_024, system-signal=DET_HVC_FLAG_024}, {application-record-element=DET_IDM_021, system-signal=DET_IDM_021}, {application-record-element=DET_IDM_022, system-signal=DET_IDM_022}, {application-record-element=DET_IDM_023, system-signal=DET_IDM_023}, {application-record-element=DET_IDM_024, system-signal=DET_IDM_024}, {application-record-element=DET_MH_CRC16_021_024, system-signal=DET_MH_CRC16_021_024}, {application-record-element=DET_MH_CYCLE_COUNTER_021_024, system-signal=DET_MH_CYCLE_COUNTER_021_024}, {application-record-element=DET_MH_SCAN_INDEX_4LSB_021_024, system-signal=DET_MH_SCAN_INDEX_4LSB_021_024}, {application-record-element=DET_MTD_021, system-signal=DET_MTD_021}, {application-record-element=DET_MTD_022, system-signal=DET_MTD_022}, {application-record-element=DET_MTD_023, system-signal=DET_MTD_023}, {application-record-element=DET_MTD_024, system-signal=DET_MTD_024}, {application-record-element=DET_PROB_1STAZHYPO_021, system-signal=DET_PROB_1STAZHYPO_021}, {application-record-element=DET_PROB_1STAZHYPO_022, system-signal=DET_PROB_1STAZHYPO_022}, {application-record-element=DET_PROB_1STAZHYPO_023, system-signal=DET_PROB_1STAZHYPO_023}, {application-record-element=DET_PROB_1STAZHYPO_024, system-signal=DET_PROB_1STAZHYPO_024}, {application-record-element=DET_RANGE_021, system-signal=DET_RANGE_021}, {application-record-element=DET_RANGE_022, system-signal=DET_RANGE_022}, {application-record-element=DET_RANGE_023, system-signal=DET_RANGE_023}, {application-record-element=DET_RANGE_024, system-signal=DET_RANGE_024}, {application-record-element=DET_RANGE_ERR_021, system-signal=DET_RANGE_ERR_021}, {application-record-element=DET_RANGE_ERR_022, system-signal=DET_RANGE_ERR_022}, {application-record-element=DET_RANGE_ERR_023, system-signal=DET_RANGE_ERR_023}, {application-record-element=DET_RANGE_ERR_024, system-signal=DET_RANGE_ERR_024}, {application-record-element=DET_RANGE_VELOCITY_021, system-signal=DET_RANGE_VELOCITY_021}, {application-record-element=DET_RANGE_VELOCITY_022, system-signal=DET_RANGE_VELOCITY_022}, {application-record-element=DET_RANGE_VELOCITY_023, system-signal=DET_RANGE_VELOCITY_023}, {application-record-element=DET_RANGE_VELOCITY_024, system-signal=DET_RANGE_VELOCITY_024}, {application-record-element=DET_RANGE_VELOCITY_ERR_021, system-signal=DET_RANGE_VELOCITY_ERR_021}, {application-record-element=DET_RANGE_VELOCITY_ERR_022, system-signal=DET_RANGE_VELOCITY_ERR_022}, {application-record-element=DET_RANGE_VELOCITY_ERR_023, system-signal=DET_RANGE_VELOCITY_ERR_023}, {application-record-element=DET_RANGE_VELOCITY_ERR_024, system-signal=DET_RANGE_VELOCITY_ERR_024}, {application-record-element=DET_RCS_021, system-signal=DET_RCS_021}, {application-record-element=DET_RCS_022, system-signal=DET_RCS_022}, {application-record-element=DET_RCS_023, system-signal=DET_RCS_023}, {application-record-element=DET_RCS_024, system-signal=DET_RCS_024}, {application-record-element=DET_SNR_021, system-signal=DET_SNR_021}, {application-record-element=DET_SNR_022, system-signal=DET_SNR_022}, {application-record-element=DET_SNR_023, system-signal=DET_SNR_023}, {application-record-element=DET_SNR_024, system-signal=DET_SNR_024}, {application-record-element=DET_SUPER_RES_TARGET_021, system-signal=DET_SUPER_RES_TARGET_021}, {application-record-element=DET_SUPER_RES_TARGET_022, system-signal=DET_SUPER_RES_TARGET_022}, {application-record-element=DET_SUPER_RES_TARGET_023, system-signal=DET_SUPER_RES_TARGET_023}, {application-record-element=DET_SUPER_RES_TARGET_024, system-signal=DET_SUPER_RES_TARGET_024}]}
        sender-receiver-to-signal-group-mapping={data-element=Pp_SG_Detections_025_028_AL.Vdp_SG_Detections_025_028_AL, signal-group=SG_Detections_025_028, type-mapping=sender-rec-record-type-mapping=record-element-mappings=[{application-record-element=DET_AZIMUTH_025, system-signal=DET_AZIMUTH_025}, {application-record-element=DET_AZIMUTH_026, system-signal=DET_AZIMUTH_026}, {application-record-element=DET_AZIMUTH_027, system-signal=DET_AZIMUTH_027}, {application-record-element=DET_AZIMUTH_028, system-signal=DET_AZIMUTH_028}, {application-record-element=DET_AZIMUTH_ERR_025, system-signal=DET_AZIMUTH_ERR_025}, {application-record-element=DET_AZIMUTH_ERR_026, system-signal=DET_AZIMUTH_ERR_026}, {application-record-element=DET_AZIMUTH_ERR_027, system-signal=DET_AZIMUTH_ERR_027}, {application-record-element=DET_AZIMUTH_ERR_028, system-signal=DET_AZIMUTH_ERR_028}, {application-record-element=DET_BELOW_RAIN_THOLD_025, system-signal=DET_BELOW_RAIN_THOLD_025}, {application-record-element=DET_BELOW_RAIN_THOLD_026, system-signal=DET_BELOW_RAIN_THOLD_026}, {application-record-element=DET_BELOW_RAIN_THOLD_027, system-signal=DET_BELOW_RAIN_THOLD_027}, {application-record-element=DET_BELOW_RAIN_THOLD_028, system-signal=DET_BELOW_RAIN_THOLD_028}, {application-record-element=DET_BI_STATIC_FLAG_025, system-signal=DET_BI_STATIC_FLAG_025}, {application-record-element=DET_BI_STATIC_FLAG_026, system-signal=DET_BI_STATIC_FLAG_026}, {application-record-element=DET_BI_STATIC_FLAG_027, system-signal=DET_BI_STATIC_FLAG_027}, {application-record-element=DET_BI_STATIC_FLAG_028, system-signal=DET_BI_STATIC_FLAG_028}, {application-record-element=DET_CONFD_AZIMUTH_025, system-signal=DET_CONFD_AZIMUTH_025}, {application-record-element=DET_CONFD_AZIMUTH_026, system-signal=DET_CONFD_AZIMUTH_026}, {application-record-element=DET_CONFD_AZIMUTH_027, system-signal=DET_CONFD_AZIMUTH_027}, {application-record-element=DET_CONFD_AZIMUTH_028, system-signal=DET_CONFD_AZIMUTH_028}, {application-record-element=DET_CONFD_ELEVATION_025, system-signal=DET_CONFD_ELEVATION_025}, {application-record-element=DET_CONFD_ELEVATION_026, system-signal=DET_CONFD_ELEVATION_026}, {application-record-element=DET_CONFD_ELEVATION_027, system-signal=DET_CONFD_ELEVATION_027}, {application-record-element=DET_CONFD_ELEVATION_028, system-signal=DET_CONFD_ELEVATION_028}, {application-record-element=DET_ELEVATION_025, system-signal=DET_ELEVATION_025}, {application-record-element=DET_ELEVATION_026, system-signal=DET_ELEVATION_026}, {application-record-element=DET_ELEVATION_027, system-signal=DET_ELEVATION_027}, {application-record-element=DET_ELEVATION_028, system-signal=DET_ELEVATION_028}, {application-record-element=DET_ELEVATION_ERR_025, system-signal=DET_ELEVATION_ERR_025}, {application-record-element=DET_ELEVATION_ERR_026, system-signal=DET_ELEVATION_ERR_026}, {application-record-element=DET_ELEVATION_ERR_027, system-signal=DET_ELEVATION_ERR_027}, {application-record-element=DET_ELEVATION_ERR_028, system-signal=DET_ELEVATION_ERR_028}, {application-record-element=DET_EXISTENCE_PROB_025, system-signal=DET_EXISTENCE_PROB_025}, {application-record-element=DET_EXISTENCE_PROB_026, system-signal=DET_EXISTENCE_PROB_026}, {application-record-element=DET_EXISTENCE_PROB_027, system-signal=DET_EXISTENCE_PROB_027}, {application-record-element=DET_EXISTENCE_PROB_028, system-signal=DET_EXISTENCE_PROB_028}, {application-record-element=DET_HVC_FLAG_025, system-signal=DET_HVC_FLAG_025}, {application-record-element=DET_HVC_FLAG_026, system-signal=DET_HVC_FLAG_026}, {application-record-element=DET_HVC_FLAG_027, system-signal=DET_HVC_FLAG_027}, {application-record-element=DET_HVC_FLAG_028, system-signal=DET_HVC_FLAG_028}, {application-record-element=DET_IDM_025, system-signal=DET_IDM_025}, {application-record-element=DET_IDM_026, system-signal=DET_IDM_026}, {application-record-element=DET_IDM_027, system-signal=DET_IDM_027}, {application-record-element=DET_IDM_028, system-signal=DET_IDM_028}, {application-record-element=DET_MH_CRC16_025_028, system-signal=DET_MH_CRC16_025_028}, {application-record-element=DET_MH_CYCLE_COUNTER_025_028, system-signal=DET_MH_CYCLE_COUNTER_025_028}, {application-record-element=DET_MH_SCAN_INDEX_4LSB_025_028, system-signal=DET_MH_SCAN_INDEX_4LSB_025_028}, {application-record-element=DET_MTD_025, system-signal=DET_MTD_025}, {application-record-element=DET_MTD_026, system-signal=DET_MTD_026}, {application-record-element=DET_MTD_027, system-signal=DET_MTD_027}, {application-record-element=DET_MTD_028, system-signal=DET_MTD_028}, {application-record-element=DET_PROB_1STAZHYPO_025, system-signal=DET_PROB_1STAZHYPO_025}, {application-record-element=DET_PROB_1STAZHYPO_026, system-signal=DET_PROB_1STAZHYPO_026}, {application-record-element=DET_PROB_1STAZHYPO_027, system-signal=DET_PROB_1STAZHYPO_027}, {application-record-element=DET_PROB_1STAZHYPO_028, system-signal=DET_PROB_1STAZHYPO_028}, {application-record-element=DET_RANGE_025, system-signal=DET_RANGE_025}, {application-record-element=DET_RANGE_026, system-signal=DET_RANGE_026}, {application-record-element=DET_RANGE_027, system-signal=DET_RANGE_027}, {application-record-element=DET_RANGE_028, system-signal=DET_RANGE_028}, {application-record-element=DET_RANGE_ERR_025, system-signal=DET_RANGE_ERR_025}, {application-record-element=DET_RANGE_ERR_026, system-signal=DET_RANGE_ERR_026}, {application-record-element=DET_RANGE_ERR_027, system-signal=DET_RANGE_ERR_027}, {application-record-element=DET_RANGE_ERR_028, system-signal=DET_RANGE_ERR_028}, {application-record-element=DET_RANGE_VELOCITY_025, system-signal=DET_RANGE_VELOCITY_025}, {application-record-element=DET_RANGE_VELOCITY_026, system-signal=DET_RANGE_VELOCITY_026}, {application-record-element=DET_RANGE_VELOCITY_027, system-signal=DET_RANGE_VELOCITY_027}, {application-record-element=DET_RANGE_VELOCITY_028, system-signal=DET_RANGE_VELOCITY_028}, {application-record-element=DET_RANGE_VELOCITY_ERR_025, system-signal=DET_RANGE_VELOCITY_ERR_025}, {application-record-element=DET_RANGE_VELOCITY_ERR_026, system-signal=DET_RANGE_VELOCITY_ERR_026}, {application-record-element=DET_RANGE_VELOCITY_ERR_027, system-signal=DET_RANGE_VELOCITY_ERR_027}, {application-record-element=DET_RANGE_VELOCITY_ERR_028, system-signal=DET_RANGE_VELOCITY_ERR_028}, {application-record-element=DET_RCS_025, system-signal=DET_RCS_025}, {application-record-element=DET_RCS_026, system-signal=DET_RCS_026}, {application-record-element=DET_RCS_027, system-signal=DET_RCS_027}, {application-record-element=DET_RCS_028, system-signal=DET_RCS_028}, {application-record-element=DET_SNR_025, system-signal=DET_SNR_025}, {application-record-element=DET_SNR_026, system-signal=DET_SNR_026}, {application-record-element=DET_SNR_027, system-signal=DET_SNR_027}, {application-record-element=DET_SNR_028, system-signal=DET_SNR_028}, {application-record-element=DET_SUPER_RES_TARGET_025, system-signal=DET_SUPER_RES_TARGET_025}, {application-record-element=DET_SUPER_RES_TARGET_026, system-signal=DET_SUPER_RES_TARGET_026}, {application-record-element=DET_SUPER_RES_TARGET_027, system-signal=DET_SUPER_RES_TARGET_027}, {application-record-element=DET_SUPER_RES_TARGET_028, system-signal=DET_SUPER_RES_TARGET_028}]}
        sender-receiver-to-signal-group-mapping={data-element=Pp_SG_Detections_045_048_AL.Vdp_SG_Detections_045_048_AL, signal-group=SG_Detections_045_048, type-mapping=sender-rec-record-type-mapping=record-element-mappings=[{application-record-element=DET_AZIMUTH_045, system-signal=DET_AZIMUTH_045}, {application-record-element=DET_AZIMUTH_046, system-signal=DET_AZIMUTH_046}, {application-record-element=DET_AZIMUTH_047, system-signal=DET_AZIMUTH_047}, {application-record-element=DET_AZIMUTH_048, system-signal=DET_AZIMUTH_048}, {application-record-element=DET_AZIMUTH_ERR_045, system-signal=DET_AZIMUTH_ERR_045}, {application-record-element=DET_AZIMUTH_ERR_046, system-signal=DET_AZIMUTH_ERR_046}, {application-record-element=DET_AZIMUTH_ERR_047, system-signal=DET_AZIMUTH_ERR_047}, {application-record-element=DET_AZIMUTH_ERR_048, system-signal=DET_AZIMUTH_ERR_048}, {application-record-element=DET_BELOW_RAIN_THOLD_045, system-signal=DET_BELOW_RAIN_THOLD_045}, {application-record-element=DET_BELOW_RAIN_THOLD_046, system-signal=DET_BELOW_RAIN_THOLD_046}, {application-record-element=DET_BELOW_RAIN_THOLD_047, system-signal=DET_BELOW_RAIN_THOLD_047}, {application-record-element=DET_BELOW_RAIN_THOLD_048, system-signal=DET_BELOW_RAIN_THOLD_048}, {application-record-element=DET_BI_STATIC_FLAG_045, system-signal=DET_BI_STATIC_FLAG_045}, {application-record-element=DET_BI_STATIC_FLAG_046, system-signal=DET_BI_STATIC_FLAG_046}, {application-record-element=DET_BI_STATIC_FLAG_047, system-signal=DET_BI_STATIC_FLAG_047}, {application-record-element=DET_BI_STATIC_FLAG_048, system-signal=DET_BI_STATIC_FLAG_048}, {application-record-element=DET_CONFD_AZIMUTH_045, system-signal=DET_CONFD_AZIMUTH_045}, {application-record-element=DET_CONFD_AZIMUTH_046, system-signal=DET_CONFD_AZIMUTH_046}, {application-record-element=DET_CONFD_AZIMUTH_047, system-signal=DET_CONFD_AZIMUTH_047}, {application-record-element=DET_CONFD_AZIMUTH_048, system-signal=DET_CONFD_AZIMUTH_048}, {application-record-element=DET_CONFD_ELEVATION_045, system-signal=DET_CONFD_ELEVATION_045}, {application-record-element=DET_CONFD_ELEVATION_046, system-signal=DET_CONFD_ELEVATION_046}, {application-record-element=DET_CONFD_ELEVATION_047, system-signal=DET_CONFD_ELEVATION_047}, {application-record-element=DET_CONFD_ELEVATION_048, system-signal=DET_CONFD_ELEVATION_048}, {application-record-element=DET_ELEVATION_045, system-signal=DET_ELEVATION_045}, {application-record-element=DET_ELEVATION_046, system-signal=DET_ELEVATION_046}, {application-record-element=DET_ELEVATION_047, system-signal=DET_ELEVATION_047}, {application-record-element=DET_ELEVATION_048, system-signal=DET_ELEVATION_048}, {application-record-element=DET_ELEVATION_ERR_045, system-signal=DET_ELEVATION_ERR_045}, {application-record-element=DET_ELEVATION_ERR_046, system-signal=DET_ELEVATION_ERR_046}, {application-record-element=DET_ELEVATION_ERR_047, system-signal=DET_ELEVATION_ERR_047}, {application-record-element=DET_ELEVATION_ERR_048, system-signal=DET_ELEVATION_ERR_048}, {application-record-element=DET_EXISTENCE_PROB_045, system-signal=DET_EXISTENCE_PROB_045}, {application-record-element=DET_EXISTENCE_PROB_046, system-signal=DET_EXISTENCE_PROB_046}, {application-record-element=DET_EXISTENCE_PROB_047, system-signal=DET_EXISTENCE_PROB_047}, {application-record-element=DET_EXISTENCE_PROB_048, system-signal=DET_EXISTENCE_PROB_048}, {application-record-element=DET_HVC_FLAG_045, system-signal=DET_HVC_FLAG_045}, {application-record-element=DET_HVC_FLAG_046, system-signal=DET_HVC_FLAG_046}, {application-record-element=DET_HVC_FLAG_047, system-signal=DET_HVC_FLAG_047}, {application-record-element=DET_HVC_FLAG_048, system-signal=DET_HVC_FLAG_048}, {application-record-element=DET_IDM_045, system-signal=DET_IDM_045}, {application-record-element=DET_IDM_046, system-signal=DET_IDM_046}, {application-record-element=DET_IDM_047, system-signal=DET_IDM_047}, {application-record-element=DET_IDM_048, system-signal=DET_IDM_048}, {application-record-element=DET_MH_CRC16_045_048, system-signal=DET_MH_CRC16_045_048}, {application-record-element=DET_MH_CYCLE_COUNTER_045_048, system-signal=DET_MH_CYCLE_COUNTER_045_048}, {application-record-element=DET_MH_SCAN_INDEX_4LSB_045_048, system-signal=DET_MH_SCAN_INDEX_4LSB_045_048}, {application-record-element=DET_MTD_045, system-signal=DET_MTD_045}, {application-record-element=DET_MTD_046, system-signal=DET_MTD_046}, {application-record-element=DET_MTD_047, system-signal=DET_MTD_047}, {application-record-element=DET_MTD_048, system-signal=DET_MTD_048}, {application-record-element=DET_PROB_1STAZHYPO_045, system-signal=DET_PROB_1STAZHYPO_045}, {application-record-element=DET_PROB_1STAZHYPO_046, system-signal=DET_PROB_1STAZHYPO_046}, {application-record-element=DET_PROB_1STAZHYPO_047, system-signal=DET_PROB_1STAZHYPO_047}, {application-record-element=DET_PROB_1STAZHYPO_048, system-signal=DET_PROB_1STAZHYPO_048}, {application-record-element=DET_RANGE_045, system-signal=DET_RANGE_045}, {application-record-element=DET_RANGE_046, system-signal=DET_RANGE_046}, {application-record-element=DET_RANGE_047, system-signal=DET_RANGE_047}, {application-record-element=DET_RANGE_048, system-signal=DET_RANGE_048}, {application-record-element=DET_RANGE_ERR_045, system-signal=DET_RANGE_ERR_045}, {application-record-element=DET_RANGE_ERR_046, system-signal=DET_RANGE_ERR_046}, {application-record-element=DET_RANGE_ERR_047, system-signal=DET_RANGE_ERR_047}, {application-record-element=DET_RANGE_ERR_048, system-signal=DET_RANGE_ERR_048}, {application-record-element=DET_RANGE_VELOCITY_045, system-signal=DET_RANGE_VELOCITY_045}, {application-record-element=DET_RANGE_VELOCITY_046, system-signal=DET_RANGE_VELOCITY_046}, {application-record-element=DET_RANGE_VELOCITY_047, system-signal=DET_RANGE_VELOCITY_047}, {application-record-element=DET_RANGE_VELOCITY_048, system-signal=DET_RANGE_VELOCITY_048}, {application-record-element=DET_RANGE_VELOCITY_ERR_045, system-signal=DET_RANGE_VELOCITY_ERR_045}, {application-record-element=DET_RANGE_VELOCITY_ERR_046, system-signal=DET_RANGE_VELOCITY_ERR_046}, {application-record-element=DET_RANGE_VELOCITY_ERR_047, system-signal=DET_RANGE_VELOCITY_ERR_047}, {application-record-element=DET_RANGE_VELOCITY_ERR_048, system-signal=DET_RANGE_VELOCITY_ERR_048}, {application-record-element=DET_RCS_045, system-signal=DET_RCS_045}, {application-record-element=DET_RCS_046, system-signal=DET_RCS_046}, {application-record-element=DET_RCS_047, system-signal=DET_RCS_047}, {application-record-element=DET_RCS_048, system-signal=DET_RCS_048}, {application-record-element=DET_SNR_045, system-signal=DET_SNR_045}, {application-record-element=DET_SNR_046, system-signal=DET_SNR_046}, {application-record-element=DET_SNR_047, system-signal=DET_SNR_047}, {application-record-element=DET_SNR_048, system-signal=DET_SNR_048}, {application-record-element=DET_SUPER_RES_TARGET_045, system-signal=DET_SUPER_RES_TARGET_045}, {application-record-element=DET_SUPER_RES_TARGET_046, system-signal=DET_SUPER_RES_TARGET_046}, {application-record-element=DET_SUPER_RES_TARGET_047, system-signal=DET_SUPER_RES_TARGET_047}, {application-record-element=DET_SUPER_RES_TARGET_048, system-signal=DET_SUPER_RES_TARGET_048}]}
        sender-receiver-to-signal-group-mapping={data-element=Pp_SG_Detections_029_032_AL.Vdp_SG_Detections_029_032_AL, signal-group=SG_Detections_029_032, type-mapping=sender-rec-record-type-mapping=record-element-mappings=[{application-record-element=DET_AZIMUTH_029, system-signal=DET_AZIMUTH_029}, {application-record-element=DET_AZIMUTH_030, system-signal=DET_AZIMUTH_030}, {application-record-element=DET_AZIMUTH_031, system-signal=DET_AZIMUTH_031}, {application-record-element=DET_AZIMUTH_032, system-signal=DET_AZIMUTH_032}, {application-record-element=DET_AZIMUTH_ERR_029, system-signal=DET_AZIMUTH_ERR_029}, {application-record-element=DET_AZIMUTH_ERR_030, system-signal=DET_AZIMUTH_ERR_030}, {application-record-element=DET_AZIMUTH_ERR_031, system-signal=DET_AZIMUTH_ERR_031}, {application-record-element=DET_AZIMUTH_ERR_032, system-signal=DET_AZIMUTH_ERR_032}, {application-record-element=DET_BELOW_RAIN_THOLD_029, system-signal=DET_BELOW_RAIN_THOLD_029}, {application-record-element=DET_BELOW_RAIN_THOLD_030, system-signal=DET_BELOW_RAIN_THOLD_030}, {application-record-element=DET_BELOW_RAIN_THOLD_031, system-signal=DET_BELOW_RAIN_THOLD_031}, {application-record-element=DET_BELOW_RAIN_THOLD_032, system-signal=DET_BELOW_RAIN_THOLD_032}, {application-record-element=DET_BI_STATIC_FLAG_029, system-signal=DET_BI_STATIC_FLAG_029}, {application-record-element=DET_BI_STATIC_FLAG_030, system-signal=DET_BI_STATIC_FLAG_030}, {application-record-element=DET_BI_STATIC_FLAG_031, system-signal=DET_BI_STATIC_FLAG_031}, {application-record-element=DET_BI_STATIC_FLAG_032, system-signal=DET_BI_STATIC_FLAG_032}, {application-record-element=DET_CONFD_AZIMUTH_029, system-signal=DET_CONFD_AZIMUTH_029}, {application-record-element=DET_CONFD_AZIMUTH_030, system-signal=DET_CONFD_AZIMUTH_030}, {application-record-element=DET_CONFD_AZIMUTH_031, system-signal=DET_CONFD_AZIMUTH_031}, {application-record-element=DET_CONFD_AZIMUTH_032, system-signal=DET_CONFD_AZIMUTH_032}, {application-record-element=DET_CONFD_ELEVATION_029, system-signal=DET_CONFD_ELEVATION_029}, {application-record-element=DET_CONFD_ELEVATION_030, system-signal=DET_CONFD_ELEVATION_030}, {application-record-element=DET_CONFD_ELEVATION_031, system-signal=DET_CONFD_ELEVATION_031}, {application-record-element=DET_CONFD_ELEVATION_032, system-signal=DET_CONFD_ELEVATION_032}, {application-record-element=DET_ELEVATION_029, system-signal=DET_ELEVATION_029}, {application-record-element=DET_ELEVATION_030, system-signal=DET_ELEVATION_030}, {application-record-element=DET_ELEVATION_031, system-signal=DET_ELEVATION_031}, {application-record-element=DET_ELEVATION_032, system-signal=DET_ELEVATION_032}, {application-record-element=DET_ELEVATION_ERR_029, system-signal=DET_ELEVATION_ERR_029}, {application-record-element=DET_ELEVATION_ERR_030, system-signal=DET_ELEVATION_ERR_030}, {application-record-element=DET_ELEVATION_ERR_031, system-signal=DET_ELEVATION_ERR_031}, {application-record-element=DET_ELEVATION_ERR_032, system-signal=DET_ELEVATION_ERR_032}, {application-record-element=DET_EXISTENCE_PROB_029, system-signal=DET_EXISTENCE_PROB_029}, {application-record-element=DET_EXISTENCE_PROB_030, system-signal=DET_EXISTENCE_PROB_030}, {application-record-element=DET_EXISTENCE_PROB_031, system-signal=DET_EXISTENCE_PROB_031}, {application-record-element=DET_EXISTENCE_PROB_032, system-signal=DET_EXISTENCE_PROB_032}, {application-record-element=DET_HVC_FLAG_029, system-signal=DET_HVC_FLAG_029}, {application-record-element=DET_HVC_FLAG_030, system-signal=DET_HVC_FLAG_030}, {application-record-element=DET_HVC_FLAG_031, system-signal=DET_HVC_FLAG_031}, {application-record-element=DET_HVC_FLAG_032, system-signal=DET_HVC_FLAG_032}, {application-record-element=DET_IDM_029, system-signal=DET_IDM_029}, {application-record-element=DET_IDM_030, system-signal=DET_IDM_030}, {application-record-element=DET_IDM_031, system-signal=DET_IDM_031}, {application-record-element=DET_IDM_032, system-signal=DET_IDM_032}, {application-record-element=DET_MH_CRC16_029_032, system-signal=DET_MH_CRC16_029_032}, {application-record-element=DET_MH_CYCLE_COUNTER_029_032, system-signal=DET_MH_CYCLE_COUNTER_029_032}, {application-record-element=DET_MH_SCAN_INDEX_4LSB_029_032, system-signal=DET_MH_SCAN_INDEX_4LSB_029_032}, {application-record-element=DET_MTD_029, system-signal=DET_MTD_029}, {application-record-element=DET_MTD_030, system-signal=DET_MTD_030}, {application-record-element=DET_MTD_031, system-signal=DET_MTD_031}, {application-record-element=DET_MTD_032, system-signal=DET_MTD_032}, {application-record-element=DET_PROB_1STAZHYPO_029, system-signal=DET_PROB_1STAZHYPO_029}, {application-record-element=DET_PROB_1STAZHYPO_030, system-signal=DET_PROB_1STAZHYPO_030}, {application-record-element=DET_PROB_1STAZHYPO_031, system-signal=DET_PROB_1STAZHYPO_031}, {application-record-element=DET_PROB_1STAZHYPO_032, system-signal=DET_PROB_1STAZHYPO_032}, {application-record-element=DET_RANGE_029, system-signal=DET_RANGE_029}, {application-record-element=DET_RANGE_030, system-signal=DET_RANGE_030}, {application-record-element=DET_RANGE_031, system-signal=DET_RANGE_031}, {application-record-element=DET_RANGE_032, system-signal=DET_RANGE_032}, {application-record-element=DET_RANGE_ERR_029, system-signal=DET_RANGE_ERR_029}, {application-record-element=DET_RANGE_ERR_030, system-signal=DET_RANGE_ERR_030}, {application-record-element=DET_RANGE_ERR_031, system-signal=DET_RANGE_ERR_031}, {application-record-element=DET_RANGE_ERR_032, system-signal=DET_RANGE_ERR_032}, {application-record-element=DET_RANGE_VELOCITY_029, system-signal=DET_RANGE_VELOCITY_029}, {application-record-element=DET_RANGE_VELOCITY_030, system-signal=DET_RANGE_VELOCITY_030}, {application-record-element=DET_RANGE_VELOCITY_031, system-signal=DET_RANGE_VELOCITY_031}, {application-record-element=DET_RANGE_VELOCITY_032, system-signal=DET_RANGE_VELOCITY_032}, {application-record-element=DET_RANGE_VELOCITY_ERR_029, system-signal=DET_RANGE_VELOCITY_ERR_029}, {application-record-element=DET_RANGE_VELOCITY_ERR_030, system-signal=DET_RANGE_VELOCITY_ERR_030}, {application-record-element=DET_RANGE_VELOCITY_ERR_031, system-signal=DET_RANGE_VELOCITY_ERR_031}, {application-record-element=DET_RANGE_VELOCITY_ERR_032, system-signal=DET_RANGE_VELOCITY_ERR_032}, {application-record-element=DET_RCS_029, system-signal=DET_RCS_029}, {application-record-element=DET_RCS_030, system-signal=DET_RCS_030}, {application-record-element=DET_RCS_031, system-signal=DET_RCS_031}, {application-record-element=DET_RCS_032, system-signal=DET_RCS_032}, {application-record-element=DET_SNR_029, system-signal=DET_SNR_029}, {application-record-element=DET_SNR_030, system-signal=DET_SNR_030}, {application-record-element=DET_SNR_031, system-signal=DET_SNR_031}, {application-record-element=DET_SNR_032, system-signal=DET_SNR_032}, {application-record-element=DET_SUPER_RES_TARGET_029, system-signal=DET_SUPER_RES_TARGET_029}, {application-record-element=DET_SUPER_RES_TARGET_030, system-signal=DET_SUPER_RES_TARGET_030}, {application-record-element=DET_SUPER_RES_TARGET_031, system-signal=DET_SUPER_RES_TARGET_031}, {application-record-element=DET_SUPER_RES_TARGET_032, system-signal=DET_SUPER_RES_TARGET_032}]}
        sender-receiver-to-signal-group-mapping={data-element=Pp_SG_Detections_033_036_AL.Vdp_SG_Detections_033_036_AL, signal-group=SG_Detections_033_036, type-mapping=sender-rec-record-type-mapping=record-element-mappings=[{application-record-element=DET_AZIMUTH_033, system-signal=DET_AZIMUTH_033}, {application-record-element=DET_AZIMUTH_034, system-signal=DET_AZIMUTH_034}, {application-record-element=DET_AZIMUTH_035, system-signal=DET_AZIMUTH_035}, {application-record-element=DET_AZIMUTH_036, system-signal=DET_AZIMUTH_036}, {application-record-element=DET_AZIMUTH_ERR_033, system-signal=DET_AZIMUTH_ERR_033}, {application-record-element=DET_AZIMUTH_ERR_034, system-signal=DET_AZIMUTH_ERR_034}, {application-record-element=DET_AZIMUTH_ERR_035, system-signal=DET_AZIMUTH_ERR_035}, {application-record-element=DET_AZIMUTH_ERR_036, system-signal=DET_AZIMUTH_ERR_036}, {application-record-element=DET_BELOW_RAIN_THOLD_033, system-signal=DET_BELOW_RAIN_THOLD_033}, {application-record-element=DET_BELOW_RAIN_THOLD_034, system-signal=DET_BELOW_RAIN_THOLD_034}, {application-record-element=DET_BELOW_RAIN_THOLD_035, system-signal=DET_BELOW_RAIN_THOLD_035}, {application-record-element=DET_BELOW_RAIN_THOLD_036, system-signal=DET_BELOW_RAIN_THOLD_036}, {application-record-element=DET_BI_STATIC_FLAG_033, system-signal=DET_BI_STATIC_FLAG_033}, {application-record-element=DET_BI_STATIC_FLAG_034, system-signal=DET_BI_STATIC_FLAG_034}, {application-record-element=DET_BI_STATIC_FLAG_035, system-signal=DET_BI_STATIC_FLAG_035}, {application-record-element=DET_BI_STATIC_FLAG_036, system-signal=DET_BI_STATIC_FLAG_036}, {application-record-element=DET_CONFD_AZIMUTH_033, system-signal=DET_CONFD_AZIMUTH_033}, {application-record-element=DET_CONFD_AZIMUTH_034, system-signal=DET_CONFD_AZIMUTH_034}, {application-record-element=DET_CONFD_AZIMUTH_035, system-signal=DET_CONFD_AZIMUTH_035}, {application-record-element=DET_CONFD_AZIMUTH_036, system-signal=DET_CONFD_AZIMUTH_036}, {application-record-element=DET_CONFD_ELEVATION_033, system-signal=DET_CONFD_ELEVATION_033}, {application-record-element=DET_CONFD_ELEVATION_034, system-signal=DET_CONFD_ELEVATION_034}, {application-record-element=DET_CONFD_ELEVATION_035, system-signal=DET_CONFD_ELEVATION_035}, {application-record-element=DET_CONFD_ELEVATION_036, system-signal=DET_CONFD_ELEVATION_036}, {application-record-element=DET_ELEVATION_033, system-signal=DET_ELEVATION_033}, {application-record-element=DET_ELEVATION_034, system-signal=DET_ELEVATION_034}, {application-record-element=DET_ELEVATION_035, system-signal=DET_ELEVATION_035}, {application-record-element=DET_ELEVATION_036, system-signal=DET_ELEVATION_036}, {application-record-element=DET_ELEVATION_ERR_033, system-signal=DET_ELEVATION_ERR_033}, {application-record-element=DET_ELEVATION_ERR_034, system-signal=DET_ELEVATION_ERR_034}, {application-record-element=DET_ELEVATION_ERR_035, system-signal=DET_ELEVATION_ERR_035}, {application-record-element=DET_ELEVATION_ERR_036, system-signal=DET_ELEVATION_ERR_036}, {application-record-element=DET_EXISTENCE_PROB_033, system-signal=DET_EXISTENCE_PROB_033}, {application-record-element=DET_EXISTENCE_PROB_034, system-signal=DET_EXISTENCE_PROB_034}, {application-record-element=DET_EXISTENCE_PROB_035, system-signal=DET_EXISTENCE_PROB_035}, {application-record-element=DET_EXISTENCE_PROB_036, system-signal=DET_EXISTENCE_PROB_036}, {application-record-element=DET_HVC_FLAG_033, system-signal=DET_HVC_FLAG_033}, {application-record-element=DET_HVC_FLAG_034, system-signal=DET_HVC_FLAG_034}, {application-record-element=DET_HVC_FLAG_035, system-signal=DET_HVC_FLAG_035}, {application-record-element=DET_HVC_FLAG_036, system-signal=DET_HVC_FLAG_036}, {application-record-element=DET_IDM_033, system-signal=DET_IDM_033}, {application-record-element=DET_IDM_034, system-signal=DET_IDM_034}, {application-record-element=DET_IDM_035, system-signal=DET_IDM_035}, {application-record-element=DET_IDM_036, system-signal=DET_IDM_036}, {application-record-element=DET_MH_CRC16_033_036, system-signal=DET_MH_CRC16_033_036}, {application-record-element=DET_MH_CYCLE_COUNTER_033_036, system-signal=DET_MH_CYCLE_COUNTER_033_036}, {application-record-element=DET_MH_SCAN_INDEX_4LSB_033_036, system-signal=DET_MH_SCAN_INDEX_4LSB_033_036}, {application-record-element=DET_MTD_033, system-signal=DET_MTD_033}, {application-record-element=DET_MTD_034, system-signal=DET_MTD_034}, {application-record-element=DET_MTD_035, system-signal=DET_MTD_035}, {application-record-element=DET_MTD_036, system-signal=DET_MTD_036}, {application-record-element=DET_PROB_1STAZHYPO_033, system-signal=DET_PROB_1STAZHYPO_033}, {application-record-element=DET_PROB_1STAZHYPO_034, system-signal=DET_PROB_1STAZHYPO_034}, {application-record-element=DET_PROB_1STAZHYPO_035, system-signal=DET_PROB_1STAZHYPO_035}, {application-record-element=DET_PROB_1STAZHYPO_036, system-signal=DET_PROB_1STAZHYPO_036}, {application-record-element=DET_RANGE_033, system-signal=DET_RANGE_033}, {application-record-element=DET_RANGE_034, system-signal=DET_RANGE_034}, {application-record-element=DET_RANGE_035, system-signal=DET_RANGE_035}, {application-record-element=DET_RANGE_036, system-signal=DET_RANGE_036}, {application-record-element=DET_RANGE_ERR_033, system-signal=DET_RANGE_ERR_033}, {application-record-element=DET_RANGE_ERR_034, system-signal=DET_RANGE_ERR_034}, {application-record-element=DET_RANGE_ERR_035, system-signal=DET_RANGE_ERR_035}, {application-record-element=DET_RANGE_ERR_036, system-signal=DET_RANGE_ERR_036}, {application-record-element=DET_RANGE_VELOCITY_033, system-signal=DET_RANGE_VELOCITY_033}, {application-record-element=DET_RANGE_VELOCITY_034, system-signal=DET_RANGE_VELOCITY_034}, {application-record-element=DET_RANGE_VELOCITY_035, system-signal=DET_RANGE_VELOCITY_035}, {application-record-element=DET_RANGE_VELOCITY_036, system-signal=DET_RANGE_VELOCITY_036}, {application-record-element=DET_RANGE_VELOCITY_ERR_033, system-signal=DET_RANGE_VELOCITY_ERR_033}, {application-record-element=DET_RANGE_VELOCITY_ERR_034, system-signal=DET_RANGE_VELOCITY_ERR_034}, {application-record-element=DET_RANGE_VELOCITY_ERR_035, system-signal=DET_RANGE_VELOCITY_ERR_035}, {application-record-element=DET_RANGE_VELOCITY_ERR_036, system-signal=DET_RANGE_VELOCITY_ERR_036}, {application-record-element=DET_RCS_033, system-signal=DET_RCS_033}, {application-record-element=DET_RCS_034, system-signal=DET_RCS_034}, {application-record-element=DET_RCS_035, system-signal=DET_RCS_035}, {application-record-element=DET_RCS_036, system-signal=DET_RCS_036}, {application-record-element=DET_SNR_033, system-signal=DET_SNR_033}, {application-record-element=DET_SNR_034, system-signal=DET_SNR_034}, {application-record-element=DET_SNR_035, system-signal=DET_SNR_035}, {application-record-element=DET_SNR_036, system-signal=DET_SNR_036}, {application-record-element=DET_SUPER_RES_TARGET_033, system-signal=DET_SUPER_RES_TARGET_033}, {application-record-element=DET_SUPER_RES_TARGET_034, system-signal=DET_SUPER_RES_TARGET_034}, {application-record-element=DET_SUPER_RES_TARGET_035, system-signal=DET_SUPER_RES_TARGET_035}, {application-record-element=DET_SUPER_RES_TARGET_036, system-signal=DET_SUPER_RES_TARGET_036}]}
