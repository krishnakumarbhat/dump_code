[part 3 of 10: package /System]
AUTOSAR XML (schema 00053)
package /System  (continued)
  system System  (continued)
    system mapping System_MPPNG  (continued)
      data-mappings:  (continued)
        sender-receiver-to-signal-group-mapping={data-element=Pp_SG_Detections_037_040_AL.Vdp_SG_Detections_037_040_AL, signal-group=SG_Detections_037_040, type-mapping=sender-rec-record-type-mapping=record-element-mappings=[{application-record-element=DET_AZIMUTH_037, system-signal=DET_AZIMUTH_037}, {application-record-element=DET_AZIMUTH_038, system-signal=DET_AZIMUTH_038}, {application-record-element=DET_AZIMUTH_039, system-signal=DET_AZIMUTH_039}, {application-record-element=DET_AZIMUTH_040, system-signal=DET_AZIMUTH_040}, {application-record-element=DET_AZIMUTH_ERR_037, system-signal=DET_AZIMUTH_ERR_037}, {application-record-element=DET_AZIMUTH_ERR_038, system-signal=DET_AZIMUTH_ERR_038}, {application-record-element=DET_AZIMUTH_ERR_039, system-signal=DET_AZIMUTH_ERR_039}, {application-record-element=DET_AZIMUTH_ERR_040, system-signal=DET_AZIMUTH_ERR_040}, {application-record-element=DET_BELOW_RAIN_THOLD_037, system-signal=DET_BELOW_RAIN_THOLD_037}, {application-record-element=DET_BELOW_RAIN_THOLD_038, system-signal=DET_BELOW_RAIN_THOLD_038}, {application-record-element=DET_BELOW_RAIN_THOLD_039, system-signal=DET_BELOW_RAIN_THOLD_039}, {application-record-element=DET_BELOW_RAIN_THOLD_040, system-signal=DET_BELOW_RAIN_THOLD_040}, {application-record-element=DET_BI_STATIC_FLAG_037, system-signal=DET_BI_STATIC_FLAG_037}, {application-record-element=DET_BI_STATIC_FLAG_038, system-signal=DET_BI_STATIC_FLAG_038}, {application-record-element=DET_BI_STATIC_FLAG_039, system-signal=DET_BI_STATIC_FLAG_039}, {application-record-element=DET_BI_STATIC_FLAG_040, system-signal=DET_BI_STATIC_FLAG_040}, {application-record-element=DET_CONFD_AZIMUTH_037, system-signal=DET_CONFD_AZIMUTH_037}, {application-record-element=DET_CONFD_AZIMUTH_038, system-signal=DET_CONFD_AZIMUTH_038}, {application-record-element=DET_CONFD_AZIMUTH_039, system-signal=DET_CONFD_AZIMUTH_039}, {application-record-element=DET_CONFD_AZIMUTH_040, system-signal=DET_CONFD_AZIMUTH_040}, {application-record-element=DET_CONFD_ELEVATION_037, system-signal=DET_CONFD_ELEVATION_037}, {application-record-element=DET_CONFD_ELEVATION_038, system-signal=DET_CONFD_ELEVATION_038}, {application-record-element=DET_CONFD_ELEVATION_039, system-signal=DET_CONFD_ELEVATION_039}, {application-record-element=DET_CONFD_ELEVATION_040, system-signal=DET_CONFD_ELEVATION_040}, {application-record-element=DET_ELEVATION_037, system-signal=DET_ELEVATION_037}, {application-record-element=DET_ELEVATION_038, system-signal=DET_ELEVATION_038}, {application-record-element=DET_ELEVATION_039, system-signal=DET_ELEVATION_039}, {application-record-element=DET_ELEVATION_040, system-signal=DET_ELEVATION_040}, {application-record-element=DET_ELEVATION_ERR_037, system-signal=DET_ELEVATION_ERR_037}, {application-record-element=DET_ELEVATION_ERR_038, system-signal=DET_ELEVATION_ERR_038}, {application-record-element=DET_ELEVATION_ERR_039, system-signal=DET_ELEVATION_ERR_039}, {application-record-element=DET_ELEVATION_ERR_040, system-signal=DET_ELEVATION_ERR_040}, {application-record-element=DET_EXISTENCE_PROB_037, system-signal=DET_EXISTENCE_PROB_037}, {application-record-element=DET_EXISTENCE_PROB_038, system-signal=DET_EXISTENCE_PROB_038}, {application-record-element=DET_EXISTENCE_PROB_039, system-signal=DET_EXISTENCE_PROB_039}, {application-record-element=DET_EXISTENCE_PROB_040, system-signal=DET_EXISTENCE_PROB_040}, {application-record-element=DET_HVC_FLAG_037, system-signal=DET_HVC_FLAG_037}, {application-record-element=DET_HVC_FLAG_038, system-signal=DET_HVC_FLAG_038}, {application-record-element=DET_HVC_FLAG_039, system-signal=DET_HVC_FLAG_039}, {application-record-element=DET_HVC_FLAG_040, system-signal=DET_HVC_FLAG_040}, {application-record-element=DET_IDM_037, system-signal=DET_IDM_037}, {application-record-element=DET_IDM_038, system-signal=DET_IDM_038}, {application-record-element=DET_IDM_039, system-signal=DET_IDM_039}, {application-record-element=DET_IDM_040, system-signal=DET_IDM_040}, {application-record-element=DET_MH_CRC16_037_040, system-signal=DET_MH_CRC16_037_040}, {application-record-element=DET_MH_CYCLE_COUNTER_037_040, system-signal=DET_MH_CYCLE_COUNTER_037_040}, {application-record-element=DET_MH_SCAN_INDEX_4LSB_037_040, system-signal=DET_MH_SCAN_INDEX_4LSB_037_040}, {application-record-element=DET_MTD_037, system-signal=DET_MTD_037}, {application-record-element=DET_MTD_038, system-signal=DET_MTD_038}, {application-record-element=DET_MTD_039, system-signal=DET_MTD_039}, {application-record-element=DET_MTD_040, system-signal=DET_MTD_040}, {application-record-element=DET_PROB_1STAZHYPO_037, system-signal=DET_PROB_1STAZHYPO_037}, {application-record-element=DET_PROB_1STAZHYPO_038, system-signal=DET_PROB_1STAZHYPO_038}, {application-record-element=DET_PROB_1STAZHYPO_039, system-signal=DET_PROB_1STAZHYPO_039}, {application-record-element=DET_PROB_1STAZHYPO_040, system-signal=DET_PROB_1STAZHYPO_040}, {application-record-element=DET_RANGE_037, system-signal=DET_RANGE_037}, {application-record-element=DET_RANGE_038, system-signal=DET_RANGE_038}, {application-record-element=DET_RANGE_039, system-signal=DET_RANGE_039}, {application-record-element=DET_RANGE_040, system-signal=DET_RANGE_040}, {application-record-element=DET_RANGE_ERR_037, system-signal=DET_RANGE_ERR_037}, {application-record-element=DET_RANGE_ERR_038, system-signal=DET_RANGE_ERR_038}, {application-record-element=DET_RANGE_ERR_039, system-signal=DET_RANGE_ERR_039}, {application-record-element=DET_RANGE_ERR_040, system-signal=DET_RANGE_ERR_040}, {application-record-element=DET_RANGE_VELOCITY_037, system-signal=DET_RANGE_VELOCITY_037}, {application-record-element=DET_RANGE_VELOCITY_038, system-signal=DET_RANGE_VELOCITY_038}, {application-record-element=DET_RANGE_VELOCITY_039, system-signal=DET_RANGE_VELOCITY_039}, {application-record-element=DET_RANGE_VELOCITY_040, system-signal=DET_RANGE_VELOCITY_040}, {application-record-element=DET_RANGE_VELOCITY_ERR_037, system-signal=DET_RANGE_VELOCITY_ERR_037}, {application-record-element=DET_RANGE_VELOCITY_ERR_038, system-signal=DET_RANGE_VELOCITY_ERR_038}, {application-record-element=DET_RANGE_VELOCITY_ERR_039, system-signal=DET_RANGE_VELOCITY_ERR_039}, {application-record-element=DET_RANGE_VELOCITY_ERR_040, system-signal=DET_RANGE_VELOCITY_ERR_040}, {application-record-element=DET_RCS_037, system-signal=DET_RCS_037}, {application-record-element=DET_RCS_038, system-signal=DET_RCS_038}, {application-record-element=DET_RCS_039, system-signal=DET_RCS_039}, {application-record-element=DET_RCS_040, system-signal=DET_RCS_040}, {application-record-element=DET_SNR_037, system-signal=DET_SNR_037}, {application-record-element=DET_SNR_038, system-signal=DET_SNR_038}, {application-record-element=DET_SNR_039, system-signal=DET_SNR_039}, {application-record-element=DET_SNR_040, system-signal=DET_SNR_040}, {application-record-element=DET_SUPER_RES_TARGET_037, system-signal=DET_SUPER_RES_TARGET_037}, {application-record-element=DET_SUPER_RES_TARGET_038, system-signal=DET_SUPER_RES_TARGET_038}, {application-record-element=DET_SUPER_RES_TARGET_039, system-signal=DET_SUPER_RES_TARGET_039}, {application-record-element=DET_SUPER_RES_TARGET_040, system-signal=DET_SUPER_RES_TARGET_040}]}
        sender-receiver-to-signal-group-mapping={data-element=Pp_SG_Detections_041_044_AL.Vdp_SG_Detections_041_044_AL, signal-group=SG_Detections_041_044, type-mapping=sender-rec-record-type-mapping=record-element-mappings=[{application-record-element=DET_AZIMUTH_041, system-signal=DET_AZIMUTH_041}, {application-record-element=DET_AZIMUTH_042, system-signal=DET_AZIMUTH_042}, {application-record-element=DET_AZIMUTH_043, system-signal=DET_AZIMUTH_043}, {application-record-element=DET_AZIMUTH_044, system-signal=DET_AZIMUTH_044}, {application-record-element=DET_AZIMUTH_ERR_041, system-signal=DET_AZIMUTH_ERR_041}, {application-record-element=DET_AZIMUTH_ERR_042, system-signal=DET_AZIMUTH_ERR_042}, {application-record-element=DET_AZIMUTH_ERR_043, system-signal=DET_AZIMUTH_ERR_043}, {application-record-element=DET_AZIMUTH_ERR_044, system-signal=DET_AZIMUTH_ERR_044}, {application-record-element=DET_BELOW_RAIN_THOLD_041, system-signal=DET_BELOW_RAIN_THOLD_041}, {application-record-element=DET_BELOW_RAIN_THOLD_042, system-signal=DET_BELOW_RAIN_THOLD_042}, {application-record-element=DET_BELOW_RAIN_THOLD_043, system-signal=DET_BELOW_RAIN_THOLD_043}, {application-record-element=DET_BELOW_RAIN_THOLD_044, system-signal=DET_BELOW_RAIN_THOLD_044}, {application-record-element=DET_BI_STATIC_FLAG_041, system-signal=DET_BI_STATIC_FLAG_041}, {application-record-element=DET_BI_STATIC_FLAG_042, system-signal=DET_BI_STATIC_FLAG_042}, {application-record-element=DET_BI_STATIC_FLAG_043, system-signal=DET_BI_STATIC_FLAG_043}, {application-record-element=DET_BI_STATIC_FLAG_044, system-signal=DET_BI_STATIC_FLAG_044}, {application-record-element=DET_CONFD_AZIMUTH_041, system-signal=DET_CONFD_AZIMUTH_041}, {application-record-element=DET_CONFD_AZIMUTH_042, system-signal=DET_CONFD_AZIMUTH_042}, {application-record-element=DET_CONFD_AZIMUTH_043, system-signal=DET_CONFD_AZIMUTH_043}, {application-record-element=DET_CONFD_AZIMUTH_044, system-signal=DET_CONFD_AZIMUTH_044}, {application-record-element=DET_CONFD_ELEVATION_041, system-signal=DET_CONFD_ELEVATION_041}, {application-record-element=DET_CONFD_ELEVATION_042, system-signal=DET_CONFD_ELEVATION_042}, {application-record-element=DET_CONFD_ELEVATION_043, system-signal=DET_CONFD_ELEVATION_043}, {application-record-element=DET_CONFD_ELEVATION_044, system-signal=DET_CONFD_ELEVATION_044}, {application-record-element=DET_ELEVATION_041, system-signal=DET_ELEVATION_041}, {application-record-element=DET_ELEVATION_042, system-signal=DET_ELEVATION_042}, {application-record-element=DET_ELEVATION_043, system-signal=DET_ELEVATION_043}, {application-record-element=DET_ELEVATION_044, system-signal=DET_ELEVATION_044}, {application-record-element=DET_ELEVATION_ERR_041, system-signal=DET_ELEVATION_ERR_041}, {application-record-element=DET_ELEVATION_ERR_042, system-signal=DET_ELEVATION_ERR_042}, {application-record-element=DET_ELEVATION_ERR_043, system-signal=DET_ELEVATION_ERR_043}, {application-record-element=DET_ELEVATION_ERR_044, system-signal=DET_ELEVATION_ERR_044}, {application-record-element=DET_EXISTENCE_PROB_041, system-signal=DET_EXISTENCE_PROB_041}, {application-record-element=DET_EXISTENCE_PROB_042, system-signal=DET_EXISTENCE_PROB_042}, {application-record-element=DET_EXISTENCE_PROB_043, system-signal=DET_EXISTENCE_PROB_043}, {application-record-element=DET_EXISTENCE_PROB_044, system-signal=DET_EXISTENCE_PROB_044}, {application-record-element=DET_HVC_FLAG_041, system-signal=DET_HVC_FLAG_041}, {application-record-element=DET_HVC_FLAG_042, system-signal=DET_HVC_FLAG_042}, {application-record-element=DET_HVC_FLAG_043, system-signal=DET_HVC_FLAG_043}, {application-record-element=DET_HVC_FLAG_044, system-signal=DET_HVC_FLAG_044}, {application-record-element=DET_IDM_041, system-signal=DET_IDM_041}, {application-record-element=DET_IDM_042, system-signal=DET_IDM_042}, {application-record-element=DET_IDM_043, system-signal=DET_IDM_043}, {application-record-element=DET_IDM_044, system-signal=DET_IDM_044}, {application-record-element=DET_MH_CRC16_041_044, system-signal=DET_MH_CRC16_041_044}, {application-record-element=DET_MH_CYCLE_COUNTER_041_044, system-signal=DET_MH_CYCLE_COUNTER_041_044}, {application-record-element=DET_MH_SCAN_INDEX_4LSB_041_044, system-signal=DET_MH_SCAN_INDEX_4LSB_041_044}, {application-record-element=DET_MTD_041, system-signal=DET_MTD_041}, {application-record-element=DET_MTD_042, system-signal=DET_MTD_042}, {application-record-element=DET_MTD_043, system-signal=DET_MTD_043}, {application-record-element=DET_MTD_044, system-signal=DET_MTD_044}, {application-record-element=DET_PROB_1STAZHYPO_041, system-signal=DET_PROB_1STAZHYPO_041}, {application-record-element=DET_PROB_1STAZHYPO_042, system-signal=DET_PROB_1STAZHYPO_042}, {application-record-element=DET_PROB_1STAZHYPO_043, system-signal=DET_PROB_1STAZHYPO_043}, {application-record-element=DET_PROB_1STAZHYPO_044, system-signal=DET_PROB_1STAZHYPO_044}, {application-record-element=DET_RANGE_041, system-signal=DET_RANGE_041}, {application-record-element=DET_RANGE_042, system-signal=DET_RANGE_042}, {application-record-element=DET_RANGE_043, system-signal=DET_RANGE_043}, {application-record-element=DET_RANGE_044, system-signal=DET_RANGE_044}, {application-record-element=DET_RANGE_ERR_041, system-signal=DET_RANGE_ERR_041}, {application-record-element=DET_RANGE_ERR_042, system-signal=DET_RANGE_ERR_042}, {application-record-element=DET_RANGE_ERR_043, system-signal=DET_RANGE_ERR_043}, {application-record-element=DET_RANGE_ERR_044, system-signal=DET_RANGE_ERR_044}, {application-record-element=DET_RANGE_VELOCITY_041, system-signal=DET_RANGE_VELOCITY_041}, {application-record-element=DET_RANGE_VELOCITY_042, system-signal=DET_RANGE_VELOCITY_042}, {application-record-element=DET_RANGE_VELOCITY_043, system-signal=DET_RANGE_VELOCITY_043}, {application-record-element=DET_RANGE_VELOCITY_044, system-signal=DET_RANGE_VELOCITY_044}, {application-record-element=DET_RANGE_VELOCITY_ERR_041, system-signal=DET_RANGE_VELOCITY_ERR_041}, {application-record-element=DET_RANGE_VELOCITY_ERR_042, system-signal=DET_RANGE_VELOCITY_ERR_042}, {application-record-element=DET_RANGE_VELOCITY_ERR_043, system-signal=DET_RANGE_VELOCITY_ERR_043}, {application-record-element=DET_RANGE_VELOCITY_ERR_044, system-signal=DET_RANGE_VELOCITY_ERR_044}, {application-record-element=DET_RCS_041, system-signal=DET_RCS_041}, {application-record-element=DET_RCS_042, system-signal=DET_RCS_042}, {application-record-element=DET_RCS_043, system-signal=DET_RCS_043}, {application-record-element=DET_RCS_044, system-signal=DET_RCS_044}, {application-record-element=DET_SNR_041, system-signal=DET_SNR_041}, {application-record-element=DET_SNR_042, system-signal=DET_SNR_042}, {application-record-element=DET_SNR_043, system-signal=DET_SNR_043}, {application-record-element=DET_SNR_044, system-signal=DET_SNR_044}, {application-record-element=DET_SUPER_RES_TARGET_041, system-signal=DET_SUPER_RES_TARGET_041}, {application-record-element=DET_SUPER_RES_TARGET_042, system-signal=DET_SUPER_RES_TARGET_042}, {application-record-element=DET_SUPER_RES_TARGET_043, system-signal=DET_SUPER_RES_TARGET_043}, {application-record-element=DET_SUPER_RES_TARGET_044, system-signal=DET_SUPER_RES_TARGET_044}]}
        sender-receiver-to-signal-group-mapping={data-element=Pp_SG_Detections_097_100_AL.Vdp_SG_Detections_097_100_AL, signal-group=SG_Detections_097_100, type-mapping=sender-rec-record-type-mapping=record-element-mappings=[{application-record-element=DET_AZIMUTH_097, system-signal=DET_AZIMUTH_097}, {application-record-element=DET_AZIMUTH_098, system-signal=DET_AZIMUTH_098}, {application-record-element=DET_AZIMUTH_099, system-signal=DET_AZIMUTH_099}, {application-record-element=DET_AZIMUTH_100, system-signal=DET_AZIMUTH_100}, {application-record-element=DET_AZIMUTH_ERR_097, system-signal=DET_AZIMUTH_ERR_097}, {application-record-element=DET_AZIMUTH_ERR_098, system-signal=DET_AZIMUTH_ERR_098}, {application-record-element=DET_AZIMUTH_ERR_099, system-signal=DET_AZIMUTH_ERR_099}, {application-record-element=DET_AZIMUTH_ERR_100, system-signal=DET_AZIMUTH_ERR_100}, {application-record-element=DET_BELOW_RAIN_THOLD_097, system-signal=DET_BELOW_RAIN_THOLD_097}, {application-record-element=DET_BELOW_RAIN_THOLD_098, system-signal=DET_BELOW_RAIN_THOLD_098}, {application-record-element=DET_BELOW_RAIN_THOLD_099, system-signal=DET_BELOW_RAIN_THOLD_099}, {application-record-element=DET_BELOW_RAIN_THOLD_100, system-signal=DET_BELOW_RAIN_THOLD_100}, {application-record-element=DET_BI_STATIC_FLAG_097, system-signal=DET_BI_STATIC_FLAG_097}, {application-record-element=DET_BI_STATIC_FLAG_098, system-signal=DET_BI_STATIC_FLAG_098}, {application-record-element=DET_BI_STATIC_FLAG_099, system-signal=DET_BI_STATIC_FLAG_099}, {application-record-element=DET_BI_STATIC_FLAG_100, system-signal=DET_BI_STATIC_FLAG_100}, {application-record-element=DET_CONFD_AZIMUTH_097, system-signal=DET_CONFD_AZIMUTH_097}, {application-record-element=DET_CONFD_AZIMUTH_098, system-signal=DET_CONFD_AZIMUTH_098}, {application-record-element=DET_CONFD_AZIMUTH_099, system-signal=DET_CONFD_AZIMUTH_099}, {application-record-element=DET_CONFD_AZIMUTH_100, system-signal=DET_CONFD_AZIMUTH_100}, {application-record-element=DET_CONFD_ELEVATION_097, system-signal=DET_CONFD_ELEVATION_097}, {application-record-element=DET_CONFD_ELEVATION_098, system-signal=DET_CONFD_ELEVATION_098}, {application-record-element=DET_CONFD_ELEVATION_099, system-signal=DET_CONFD_ELEVATION_099}, {application-record-element=DET_CONFD_ELEVATION_100, system-signal=DET_CONFD_ELEVATION_100}, {application-record-element=DET_ELEVATION_097, system-signal=DET_ELEVATION_097}, {application-record-element=DET_ELEVATION_098, system-signal=DET_ELEVATION_098}, {application-record-element=DET_ELEVATION_099, system-signal=DET_ELEVATION_099}, {application-record-element=DET_ELEVATION_100, system-signal=DET_ELEVATION_100}, {application-record-element=DET_ELEVATION_ERR_097, system-signal=DET_ELEVATION_ERR_097}, {application-record-element=DET_ELEVATION_ERR_098, system-signal=DET_ELEVATION_ERR_098}, {application-record-element=DET_ELEVATION_ERR_099, system-signal=DET_ELEVATION_ERR_099}, {application-record-element=DET_ELEVATION_ERR_100, system-signal=DET_ELEVATION_ERR_100}, {application-record-element=DET_EXISTENCE_PROB_097, system-signal=DET_EXISTENCE_PROB_097}, {application-record-element=DET_EXISTENCE_PROB_098, system-signal=DET_EXISTENCE_PROB_098}, {application-record-element=DET_EXISTENCE_PROB_099, system-signal=DET_EXISTENCE_PROB_099}, {application-record-element=DET_EXISTENCE_PROB_100, system-signal=DET_EXISTENCE_PROB_100}, {application-record-element=DET_HVC_FLAG_097, system-signal=DET_HVC_FLAG_097}, {application-record-element=DET_HVC_FLAG_098, system-signal=DET_HVC_FLAG_098}, {application-record-element=DET_HVC_FLAG_099, system-signal=DET_HVC_FLAG_099}, {application-record-element=DET_HVC_FLAG_100, system-signal=DET_HVC_FLAG_100}, {application-record-element=DET_IDM_097, system-signal=DET_IDM_097}, {application-record-element=DET_IDM_098, system-signal=DET_IDM_098}, {application-record-element=DET_IDM_099, system-signal=DET_IDM_099}, {application-record-element=DET_IDM_100, system-signal=DET_IDM_100}, {application-record-element=DET_MH_CRC16_097_100, system-signal=DET_MH_CRC16_097_100}, {application-record-element=DET_MH_CYCLE_COUNTER_097_100, system-signal=DET_MH_CYCLE_COUNTER_097_100}, {application-record-element=DET_MH_SCAN_INDEX_4LSB_097_100, system-signal=DET_MH_SCAN_INDEX_4LSB_097_100}, {application-record-element=DET_MTD_097, system-signal=DET_MTD_097}, {application-record-element=DET_MTD_098, system-signal=DET_MTD_098}, {application-record-element=DET_MTD_099, system-signal=DET_MTD_099}, {application-record-element=DET_MTD_100, system-signal=DET_MTD_100}, {application-record-element=DET_PROB_1STAZHYPO_097, system-signal=DET_PROB_1STAZHYPO_097}, {application-record-element=DET_PROB_1STAZHYPO_098, system-signal=DET_PROB_1STAZHYPO_098}, {application-record-element=DET_PROB_1STAZHYPO_099, system-signal=DET_PROB_1STAZHYPO_099}, {application-record-element=DET_PROB_1STAZHYPO_100, system-signal=DET_PROB_1STAZHYPO_100}, {application-record-element=DET_RANGE_097, system-signal=DET_RANGE_097}, {application-record-element=DET_RANGE_098, system-signal=DET_RANGE_098}, {application-record-element=DET_RANGE_099, system-signal=DET_RANGE_099}, {application-record-element=DET_RANGE_100, system-signal=DET_RANGE_100}, {application-record-element=DET_RANGE_ERR_097, system-signal=DET_RANGE_ERR_097}, {application-record-element=DET_RANGE_ERR_098, system-signal=DET_RANGE_ERR_098}, {application-record-element=DET_RANGE_ERR_099, system-signal=DET_RANGE_ERR_099}, {application-record-element=DET_RANGE_ERR_100, system-signal=DET_RANGE_ERR_100}, {application-record-element=DET_RANGE_VELOCITY_097, system-signal=DET_RANGE_VELOCITY_097}, {application-record-element=DET_RANGE_VELOCITY_098, system-signal=DET_RANGE_VELOCITY_098}, {application-record-element=DET_RANGE_VELOCITY_099, system-signal=DET_RANGE_VELOCITY_099}, {application-record-element=DET_RANGE_VELOCITY_100, system-signal=DET_RANGE_VELOCITY_100}, {application-record-element=DET_RANGE_VELOCITY_ERR_097, system-signal=DET_RANGE_VELOCITY_ERR_097}, {application-record-element=DET_RANGE_VELOCITY_ERR_098, system-signal=DET_RANGE_VELOCITY_ERR_098}, {application-record-element=DET_RANGE_VELOCITY_ERR_099, system-signal=DET_RANGE_VELOCITY_ERR_099}, {application-record-element=DET_RANGE_VELOCITY_ERR_100, system-signal=DET_RANGE_VELOCITY_ERR_100}, {application-record-element=DET_RCS_097, system-signal=DET_RCS_097}, {application-record-element=DET_RCS_098, system-signal=DET_RCS_098}, {application-record-element=DET_RCS_099, system-signal=DET_RCS_099}, {application-record-element=DET_RCS_100, system-signal=DET_RCS_100}, {application-record-element=DET_SNR_097, system-signal=DET_SNR_097}, {application-record-element=DET_SNR_098, system-signal=DET_SNR_098}, {application-record-element=DET_SNR_099, system-signal=DET_SNR_099}, {application-record-element=DET_SNR_100, system-signal=DET_SNR_100}, {application-record-element=DET_SUPER_RES_TARGET_097, system-signal=DET_SUPER_RES_TARGET_097}, {application-record-element=DET_SUPER_RES_TARGET_098, system-signal=DET_SUPER_RES_TARGET_098}, {application-record-element=DET_SUPER_RES_TARGET_099, system-signal=DET_SUPER_RES_TARGET_099}, {application-record-element=DET_SUPER_RES_TARGET_100, system-signal=DET_SUPER_RES_TARGET_100}]}
        sender-receiver-to-signal-group-mapping={data-element=Pp_SG_Detections_049_052_AL.Vdp_SG_Detections_049_052_AL, signal-group=SG_Detections_049_052, type-mapping=sender-rec-record-type-mapping=record-element-mappings=[{application-record-element=DET_AZIMUTH_049, system-signal=DET_AZIMUTH_049}, {application-record-element=DET_AZIMUTH_050, system-signal=DET_AZIMUTH_050}, {application-record-element=DET_AZIMUTH_051, system-signal=DET_AZIMUTH_051}, {application-record-element=DET_AZIMUTH_052, system-signal=DET_AZIMUTH_052}, {application-record-element=DET_AZIMUTH_ERR_049, system-signal=DET_AZIMUTH_ERR_049}, {application-record-element=DET_AZIMUTH_ERR_050, system-signal=DET_AZIMUTH_ERR_050}, {application-record-element=DET_AZIMUTH_ERR_051, system-signal=DET_AZIMUTH_ERR_051}, {application-record-element=DET_AZIMUTH_ERR_052, system-signal=DET_AZIMUTH_ERR_052}, {application-record-element=DET_BELOW_RAIN_THOLD_049, system-signal=DET_BELOW_RAIN_THOLD_049}, {application-record-element=DET_BELOW_RAIN_THOLD_050, system-signal=DET_BELOW_RAIN_THOLD_050}, {application-record-element=DET_BELOW_RAIN_THOLD_051, system-signal=DET_BELOW_RAIN_THOLD_051}, {application-record-element=DET_BELOW_RAIN_THOLD_052, system-signal=DET_BELOW_RAIN_THOLD_052}, {application-record-element=DET_BI_STATIC_FLAG_049, system-signal=DET_BI_STATIC_FLAG_049}, {application-record-element=DET_BI_STATIC_FLAG_050, system-signal=DET_BI_STATIC_FLAG_050}, {application-record-element=DET_BI_STATIC_FLAG_051, system-signal=DET_BI_STATIC_FLAG_051}, {application-record-element=DET_BI_STATIC_FLAG_052, system-signal=DET_BI_STATIC_FLAG_052}, {application-record-element=DET_CONFD_AZIMUTH_049, system-signal=DET_CONFD_AZIMUTH_049}, {application-record-element=DET_CONFD_AZIMUTH_050, system-signal=DET_CONFD_AZIMUTH_050}, {application-record-element=DET_CONFD_AZIMUTH_051, system-signal=DET_CONFD_AZIMUTH_051}, {application-record-element=DET_CONFD_AZIMUTH_052, system-signal=DET_CONFD_AZIMUTH_052}, {application-record-element=DET_CONFD_ELEVATION_049, system-signal=DET_CONFD_ELEVATION_049}, {application-record-element=DET_CONFD_ELEVATION_050, system-signal=DET_CONFD_ELEVATION_050}, {application-record-element=DET_CONFD_ELEVATION_051, system-signal=DET_CONFD_ELEVATION_051}, {application-record-element=DET_CONFD_ELEVATION_052, system-signal=DET_CONFD_ELEVATION_052}, {application-record-element=DET_ELEVATION_049, system-signal=DET_ELEVATION_049}, {application-record-element=DET_ELEVATION_050, system-signal=DET_ELEVATION_050}, {application-record-element=DET_ELEVATION_051, system-signal=DET_ELEVATION_051}, {application-record-element=DET_ELEVATION_052, system-signal=DET_ELEVATION_052}, {application-record-element=DET_ELEVATION_ERR_049, system-signal=DET_ELEVATION_ERR_049}, {application-record-element=DET_ELEVATION_ERR_050, system-signal=DET_ELEVATION_ERR_050}, {application-record-element=DET_ELEVATION_ERR_051, system-signal=DET_ELEVATION_ERR_051}, {application-record-element=DET_ELEVATION_ERR_052, system-signal=DET_ELEVATION_ERR_052}, {application-record-element=DET_EXISTENCE_PROB_049, system-signal=DET_EXISTENCE_PROB_049}, {application-record-element=DET_EXISTENCE_PROB_050, system-signal=DET_EXISTENCE_PROB_050}, {application-record-element=DET_EXISTENCE_PROB_051, system-signal=DET_EXISTENCE_PROB_051}, {application-record-element=DET_EXISTENCE_PROB_052, system-signal=DET_EXISTENCE_PROB_052}, {application-record-element=DET_HVC_FLAG_049, system-signal=DET_HVC_FLAG_049}, {application-record-element=DET_HVC_FLAG_050, system-signal=DET_HVC_FLAG_050}, {application-record-element=DET_HVC_FLAG_051, system-signal=DET_HVC_FLAG_051}, {application-record-element=DET_HVC_FLAG_052, system-signal=DET_HVC_FLAG_052}, {application-record-element=DET_IDM_049, system-signal=DET_IDM_049}, {application-record-element=DET_IDM_050, system-signal=DET_IDM_050}, {application-record-element=DET_IDM_051, system-signal=DET_IDM_051}, {application-record-element=DET_IDM_052, system-signal=DET_IDM_052}, {application-record-element=DET_MH_CRC16_049_052, system-signal=DET_MH_CRC16_049_052}, {application-record-element=DET_MH_CYCLE_COUNTER_049_052, system-signal=DET_MH_CYCLE_COUNTER_049_052}, {application-record-element=DET_MH_SCAN_INDEX_4LSB_049_052, system-signal=DET_MH_SCAN_INDEX_4LSB_049_052}, {application-record-element=DET_MTD_049, system-signal=DET_MTD_049}, {application-record-element=DET_MTD_050, system-signal=DET_MTD_050}, {application-record-element=DET_MTD_051, system-signal=DET_MTD_051}, {application-record-element=DET_MTD_052, system-signal=DET_MTD_052}, {application-record-element=DET_PROB_1STAZHYPO_049, system-signal=DET_PROB_1STAZHYPO_049}, {application-record-element=DET_PROB_1STAZHYPO_050, system-signal=DET_PROB_1STAZHYPO_050}, {application-record-element=DET_PROB_1STAZHYPO_051, system-signal=DET_PROB_1STAZHYPO_051}, {application-record-element=DET_PROB_1STAZHYPO_052, system-signal=DET_PROB_1STAZHYPO_052}, {application-record-element=DET_RANGE_049, system-signal=DET_RANGE_049}, {application-record-element=DET_RANGE_050, system-signal=DET_RANGE_050}, {application-record-element=DET_RANGE_051, system-signal=DET_RANGE_051}, {application-record-element=DET_RANGE_052, system-signal=DET_RANGE_052}, {application-record-element=DET_RANGE_ERR_049, system-signal=DET_RANGE_ERR_049}, {application-record-element=DET_RANGE_ERR_050, system-signal=DET_RANGE_ERR_050}, {application-record-element=DET_RANGE_ERR_051, system-signal=DET_RANGE_ERR_051}, {application-record-element=DET_RANGE_ERR_052, system-signal=DET_RANGE_ERR_052}, {application-record-element=DET_RANGE_VELOCITY_049, system-signal=DET_RANGE_VELOCITY_049}, {application-record-element=DET_RANGE_VELOCITY_050, system-signal=DET_RANGE_VELOCITY_050}, {application-record-element=DET_RANGE_VELOCITY_051, system-signal=DET_RANGE_VELOCITY_051}, {application-record-element=DET_RANGE_VELOCITY_052, system-signal=DET_RANGE_VELOCITY_052}, {application-record-element=DET_RANGE_VELOCITY_ERR_049, system-signal=DET_RANGE_VELOCITY_ERR_049}, {application-record-element=DET_RANGE_VELOCITY_ERR_050, system-signal=DET_RANGE_VELOCITY_ERR_050}, {application-record-element=DET_RANGE_VELOCITY_ERR_051, system-signal=DET_RANGE_VELOCITY_ERR_051}, {application-record-element=DET_RANGE_VELOCITY_ERR_052, system-signal=DET_RANGE_VELOCITY_ERR_052}, {application-record-element=DET_RCS_049, system-signal=DET_RCS_049}, {application-record-element=DET_RCS_050, system-signal=DET_RCS_050}, {application-record-element=DET_RCS_051, system-signal=DET_RCS_051}, {application-record-element=DET_RCS_052, system-signal=DET_RCS_052}, {application-record-element=DET_SNR_049, system-signal=DET_SNR_049}, {application-record-element=DET_SNR_050, system-signal=DET_SNR_050}, {application-record-element=DET_SNR_051, system-signal=DET_SNR_051}, {application-record-element=DET_SNR_052, system-signal=DET_SNR_052}, {application-record-element=DET_SUPER_RES_TARGET_049, system-signal=DET_SUPER_RES_TARGET_049}, {application-record-element=DET_SUPER_RES_TARGET_050, system-signal=DET_SUPER_RES_TARGET_050}, {application-record-element=DET_SUPER_RES_TARGET_051, system-signal=DET_SUPER_RES_TARGET_051}, {application-record-element=DET_SUPER_RES_TARGET_052, system-signal=DET_SUPER_RES_TARGET_052}]}
        sender-receiver-to-signal-group-mapping={data-element=Pp_SG_Detections_053_056_AL.Vdp_SG_Detections_053_056_AL, signal-group=SG_Detections_053_056, type-mapping=sender-rec-record-type-mapping=record-element-mappings=[{application-record-element=DET_AZIMUTH_053, system-signal=DET_AZIMUTH_053}, {application-record-element=DET_AZIMUTH_054, system-signal=DET_AZIMUTH_054}, {application-record-element=DET_AZIMUTH_055, system-signal=DET_AZIMUTH_055}, {application-record-element=DET_AZIMUTH_056, system-signal=DET_AZIMUTH_056}, {application-record-element=DET_AZIMUTH_ERR_053, system-signal=DET_AZIMUTH_ERR_053}, {application-record-element=DET_AZIMUTH_ERR_054, system-signal=DET_AZIMUTH_ERR_054}, {application-record-element=DET_AZIMUTH_ERR_055, system-signal=DET_AZIMUTH_ERR_055}, {application-record-element=DET_AZIMUTH_ERR_056, system-signal=DET_AZIMUTH_ERR_056}, {application-record-element=DET_BELOW_RAIN_THOLD_053, system-signal=DET_BELOW_RAIN_THOLD_053}, {application-record-element=DET_BELOW_RAIN_THOLD_054, system-signal=DET_BELOW_RAIN_THOLD_054}, {application-record-element=DET_BELOW_RAIN_THOLD_055, system-signal=DET_BELOW_RAIN_THOLD_055}, {application-record-element=DET_BELOW_RAIN_THOLD_056, system-signal=DET_BELOW_RAIN_THOLD_056}, {application-record-element=DET_BI_STATIC_FLAG_053, system-signal=DET_BI_STATIC_FLAG_053}, {application-record-element=DET_BI_STATIC_FLAG_054, system-signal=DET_BI_STATIC_FLAG_054}, {application-record-element=DET_BI_STATIC_FLAG_055, system-signal=DET_BI_STATIC_FLAG_055}, {application-record-element=DET_BI_STATIC_FLAG_056, system-signal=DET_BI_STATIC_FLAG_056}, {application-record-element=DET_CONFD_AZIMUTH_053, system-signal=DET_CONFD_AZIMUTH_053}, {application-record-element=DET_CONFD_AZIMUTH_054, system-signal=DET_CONFD_AZIMUTH_054}, {application-record-element=DET_CONFD_AZIMUTH_055, system-signal=DET_CONFD_AZIMUTH_055}, {application-record-element=DET_CONFD_AZIMUTH_056, system-signal=DET_CONFD_AZIMUTH_056}, {application-record-element=DET_CONFD_ELEVATION_053, system-signal=DET_CONFD_ELEVATION_053}, {application-record-element=DET_CONFD_ELEVATION_054, system-signal=DET_CONFD_ELEVATION_054}, {application-record-element=DET_CONFD_ELEVATION_055, system-signal=DET_CONFD_ELEVATION_055}, {application-record-element=DET_CONFD_ELEVATION_056, system-signal=DET_CONFD_ELEVATION_056}, {application-record-element=DET_ELEVATION_053, system-signal=DET_ELEVATION_053}, {application-record-element=DET_ELEVATION_054, system-signal=DET_ELEVATION_054}, {application-record-element=DET_ELEVATION_055, system-signal=DET_ELEVATION_055}, {application-record-element=DET_ELEVATION_056, system-signal=DET_ELEVATION_056}, {application-record-element=DET_ELEVATION_ERR_053, system-signal=DET_ELEVATION_ERR_053}, {application-record-element=DET_ELEVATION_ERR_054, system-signal=DET_ELEVATION_ERR_054}, {application-record-element=DET_ELEVATION_ERR_055, system-signal=DET_ELEVATION_ERR_055}, {application-record-element=DET_ELEVATION_ERR_056, system-signal=DET_ELEVATION_ERR_056}, {application-record-element=DET_EXISTENCE_PROB_053, system-signal=DET_EXISTENCE_PROB_053}, {application-record-element=DET_EXISTENCE_PROB_054, system-signal=DET_EXISTENCE_PROB_054}, {application-record-element=DET_EXISTENCE_PROB_055, system-signal=DET_EXISTENCE_PROB_055}, {application-record-element=DET_EXISTENCE_PROB_056, system-signal=DET_EXISTENCE_PROB_056}, {application-record-element=DET_HVC_FLAG_053, system-signal=DET_HVC_FLAG_053}, {application-record-element=DET_HVC_FLAG_054, system-signal=DET_HVC_FLAG_054}, {application-record-element=DET_HVC_FLAG_055, system-signal=DET_HVC_FLAG_055}, {application-record-element=DET_HVC_FLAG_056, system-signal=DET_HVC_FLAG_056}, {application-record-element=DET_IDM_053, system-signal=DET_IDM_053}, {application-record-element=DET_IDM_054, system-signal=DET_IDM_054}, {application-record-element=DET_IDM_055, system-signal=DET_IDM_055}, {application-record-element=DET_IDM_056, system-signal=DET_IDM_056}, {application-record-element=DET_MH_CRC16_053_056, system-signal=DET_MH_CRC16_053_056}, {application-record-element=DET_MH_CYCLE_COUNTER_053_056, system-signal=DET_MH_CYCLE_COUNTER_053_056}, {application-record-element=DET_MH_SCAN_INDEX_4LSB_053_056, system-signal=DET_MH_SCAN_INDEX_4LSB_053_056}, {application-record-element=DET_MTD_053, system-signal=DET_MTD_053}, {application-record-element=DET_MTD_054, system-signal=DET_MTD_054}, {application-record-element=DET_MTD_055, system-signal=DET_MTD_055}, {application-record-element=DET_MTD_056, system-signal=DET_MTD_056}, {application-record-element=DET_PROB_1STAZHYPO_053, system-signal=DET_PROB_1STAZHYPO_053}, {application-record-element=DET_PROB_1STAZHYPO_054, system-signal=DET_PROB_1STAZHYPO_054}, {application-record-element=DET_PROB_1STAZHYPO_055, system-signal=DET_PROB_1STAZHYPO_055}, {application-record-element=DET_PROB_1STAZHYPO_056, system-signal=DET_PROB_1STAZHYPO_056}, {application-record-element=DET_RANGE_053, system-signal=DET_RANGE_053}, {application-record-element=DET_RANGE_054, system-signal=DET_RANGE_054}, {application-record-element=DET_RANGE_055, system-signal=DET_RANGE_055}, {application-record-element=DET_RANGE_056, system-signal=DET_RANGE_056}, {application-record-element=DET_RANGE_ERR_053, system-signal=DET_RANGE_ERR_053}, {application-record-element=DET_RANGE_ERR_054, system-signal=DET_RANGE_ERR_054}, {application-record-element=DET_RANGE_ERR_055, system-signal=DET_RANGE_ERR_055}, {application-record-element=DET_RANGE_ERR_056, system-signal=DET_RANGE_ERR_056}, {application-record-element=DET_RANGE_VELOCITY_053, system-signal=DET_RANGE_VELOCITY_053}, {application-record-element=DET_RANGE_VELOCITY_054, system-signal=DET_RANGE_VELOCITY_054}, {application-record-element=DET_RANGE_VELOCITY_055, system-signal=DET_RANGE_VELOCITY_055}, {application-record-element=DET_RANGE_VELOCITY_056, system-signal=DET_RANGE_VELOCITY_056}, {application-record-element=DET_RANGE_VELOCITY_ERR_053, system-signal=DET_RANGE_VELOCITY_ERR_053}, {application-record-element=DET_RANGE_VELOCITY_ERR_054, system-signal=DET_RANGE_VELOCITY_ERR_054}, {application-record-element=DET_RANGE_VELOCITY_ERR_055, system-signal=DET_RANGE_VELOCITY_ERR_055}, {application-record-element=DET_RANGE_VELOCITY_ERR_056, system-signal=DET_RANGE_VELOCITY_ERR_056}, {application-record-element=DET_RCS_053, system-signal=DET_RCS_053}, {application-record-element=DET_RCS_054, system-signal=DET_RCS_054}, {application-record-element=DET_RCS_055, system-signal=DET_RCS_055}, {application-record-element=DET_RCS_056, system-signal=DET_RCS_056}, {application-record-element=DET_SNR_053, system-signal=DET_SNR_053}, {application-record-element=DET_SNR_054, system-signal=DET_SNR_054}, {application-record-element=DET_SNR_055, system-signal=DET_SNR_055}, {application-record-element=DET_SNR_056, system-signal=DET_SNR_056}, {application-record-element=DET_SUPER_RES_TARGET_053, system-signal=DET_SUPER_RES_TARGET_053}, {application-record-element=DET_SUPER_RES_TARGET_054, system-signal=DET_SUPER_RES_TARGET_054}, {application-record-element=DET_SUPER_RES_TARGET_055, system-signal=DET_SUPER_RES_TARGET_055}, {application-record-element=DET_SUPER_RES_TARGET_056, system-signal=DET_SUPER_RES_TARGET_056}]}
        sender-receiver-to-signal-group-mapping={data-element=Pp_SG_Detections_057_060_AL.Vdp_SG_Detections_057_060_AL, signal-group=SG_Detections_057_060, type-mapping=sender-rec-record-type-mapping=record-element-mappings=[{application-record-element=DET_AZIMUTH_057, system-signal=DET_AZIMUTH_057}, {application-record-element=DET_AZIMUTH_058, system-signal=DET_AZIMUTH_058}, {application-record-element=DET_AZIMUTH_059, system-signal=DET_AZIMUTH_059}, {application-record-element=DET_AZIMUTH_060, system-signal=DET_AZIMUTH_060}, {application-record-element=DET_AZIMUTH_ERR_057, system-signal=DET_AZIMUTH_ERR_057}, {application-record-element=DET_AZIMUTH_ERR_058, system-signal=DET_AZIMUTH_ERR_058}, {application-record-element=DET_AZIMUTH_ERR_059, system-signal=DET_AZIMUTH_ERR_059}, {application-record-element=DET_AZIMUTH_ERR_060, system-signal=DET_AZIMUTH_ERR_060}, {application-record-element=DET_BELOW_RAIN_THOLD_057, system-signal=DET_BELOW_RAIN_THOLD_057}, {application-record-element=DET_BELOW_RAIN_THOLD_058, system-signal=DET_BELOW_RAIN_THOLD_058}, {application-record-element=DET_BELOW_RAIN_THOLD_059, system-signal=DET_BELOW_RAIN_THOLD_059}, {application-record-element=DET_BELOW_RAIN_THOLD_060, system-signal=DET_BELOW_RAIN_THOLD_060}, {application-record-element=DET_BI_STATIC_FLAG_057, system-signal=DET_BI_STATIC_FLAG_057}, {application-record-element=DET_BI_STATIC_FLAG_058, system-signal=DET_BI_STATIC_FLAG_058}, {application-record-element=DET_BI_STATIC_FLAG_059, system-signal=DET_BI_STATIC_FLAG_059}, {application-record-element=DET_BI_STATIC_FLAG_060, system-signal=DET_BI_STATIC_FLAG_060}, {application-record-element=DET_CONFD_AZIMUTH_057, system-signal=DET_CONFD_AZIMUTH_057}, {application-record-element=DET_CONFD_AZIMUTH_058, system-signal=DET_CONFD_AZIMUTH_058}, {application-record-element=DET_CONFD_AZIMUTH_059, system-signal=DET_CONFD_AZIMUTH_059}, {application-record-element=DET_CONFD_AZIMUTH_060, system-signal=DET_CONFD_AZIMUTH_060}, {application-record-element=DET_CONFD_ELEVATION_057, system-signal=DET_CONFD_ELEVATION_057}, {application-record-element=DET_CONFD_ELEVATION_058, system-signal=DET_CONFD_ELEVATION_058}, {application-record-element=DET_CONFD_ELEVATION_059, system-signal=DET_CONFD_ELEVATION_059}, {application-record-element=DET_CONFD_ELEVATION_060, system-signal=DET_CONFD_ELEVATION_060}, {application-record-element=DET_ELEVATION_057, system-signal=DET_ELEVATION_057}, {application-record-element=DET_ELEVATION_058, system-signal=DET_ELEVATION_058}, {application-record-element=DET_ELEVATION_059, system-signal=DET_ELEVATION_059}, {application-record-element=DET_ELEVATION_060, system-signal=DET_ELEVATION_060}, {application-record-element=DET_ELEVATION_ERR_057, system-signal=DET_ELEVATION_ERR_057}, {application-record-element=DET_ELEVATION_ERR_058, system-signal=DET_ELEVATION_ERR_058}, {application-record-element=DET_ELEVATION_ERR_059, system-signal=DET_ELEVATION_ERR_059}, {application-record-element=DET_ELEVATION_ERR_060, system-signal=DET_ELEVATION_ERR_060}, {application-record-element=DET_EXISTENCE_PROB_057, system-signal=DET_EXISTENCE_PROB_057}, {application-record-element=DET_EXISTENCE_PROB_058, system-signal=DET_EXISTENCE_PROB_058}, {application-record-element=DET_EXISTENCE_PROB_059, system-signal=DET_EXISTENCE_PROB_059}, {application-record-element=DET_EXISTENCE_PROB_060, system-signal=DET_EXISTENCE_PROB_060}, {application-record-element=DET_HVC_FLAG_057, system-signal=DET_HVC_FLAG_057}, {application-record-element=DET_HVC_FLAG_058, system-signal=DET_HVC_FLAG_058}, {application-record-element=DET_HVC_FLAG_059, system-signal=DET_HVC_FLAG_059}, {application-record-element=DET_HVC_FLAG_060, system-signal=DET_HVC_FLAG_060}, {application-record-element=DET_IDM_057, system-signal=DET_IDM_057}, {application-record-element=DET_IDM_058, system-signal=DET_IDM_058}, {application-record-element=DET_IDM_059, system-signal=DET_IDM_059}, {application-record-element=DET_IDM_060, system-signal=DET_IDM_060}, {application-record-element=DET_MH_CRC16_057_060, system-signal=DET_MH_CRC16_057_060}, {application-record-element=DET_MH_CYCLE_COUNTER_057_060, system-signal=DET_MH_CYCLE_COUNTER_057_060}, {application-record-element=DET_MH_SCAN_INDEX_4LSB_057_060, system-signal=DET_MH_SCAN_INDEX_4LSB_057_060}, {application-record-element=DET_MTD_057, system-signal=DET_MTD_057}, {application-record-element=DET_MTD_058, system-signal=DET_MTD_058}, {application-record-element=DET_MTD_059, system-signal=DET_MTD_059}, {application-record-element=DET_MTD_060, system-signal=DET_MTD_060}, {application-record-element=DET_PROB_1STAZHYPO_057, system-signal=DET_PROB_1STAZHYPO_057}, {application-record-element=DET_PROB_1STAZHYPO_058, system-signal=DET_PROB_1STAZHYPO_058}, {application-record-element=DET_PROB_1STAZHYPO_059, system-signal=DET_PROB_1STAZHYPO_059}, {application-record-element=DET_PROB_1STAZHYPO_060, system-signal=DET_PROB_1STAZHYPO_060}, {application-record-element=DET_RANGE_057, system-signal=DET_RANGE_057}, {application-record-element=DET_RANGE_058, system-signal=DET_RANGE_058}, {application-record-element=DET_RANGE_059, system-signal=DET_RANGE_059}, {application-record-element=DET_RANGE_060, system-signal=DET_RANGE_060}, {application-record-element=DET_RANGE_ERR_057, system-signal=DET_RANGE_ERR_057}, {application-record-element=DET_RANGE_ERR_058, system-signal=DET_RANGE_ERR_058}, {application-record-element=DET_RANGE_ERR_059, system-signal=DET_RANGE_ERR_059}, {application-record-element=DET_RANGE_ERR_060, system-signal=DET_RANGE_ERR_060}, {application-record-element=DET_RANGE_VELOCITY_057, system-signal=DET_RANGE_VELOCITY_057}, {application-record-element=DET_RANGE_VELOCITY_058, system-signal=DET_RANGE_VELOCITY_058}, {application-record-element=DET_RANGE_VELOCITY_059, system-signal=DET_RANGE_VELOCITY_059}, {application-record-element=DET_RANGE_VELOCITY_060, system-signal=DET_RANGE_VELOCITY_060}, {application-record-element=DET_RANGE_VELOCITY_ERR_057, system-signal=DET_RANGE_VELOCITY_ERR_057}, {application-record-element=DET_RANGE_VELOCITY_ERR_058, system-signal=DET_RANGE_VELOCITY_ERR_058}, {application-record-element=DET_RANGE_VELOCITY_ERR_059, system-signal=DET_RANGE_VELOCITY_ERR_059}, {application-record-element=DET_RANGE_VELOCITY_ERR_060, system-signal=DET_RANGE_VELOCITY_ERR_060}, {application-record-element=DET_RCS_057, system-signal=DET_RCS_057}, {application-record-element=DET_RCS_058, system-signal=DET_RCS_058}, {application-record-element=DET_RCS_059, system-signal=DET_RCS_059}, {application-record-element=DET_RCS_060, system-signal=DET_RCS_060}, {application-record-element=DET_SNR_057, system-signal=DET_SNR_057}, {application-record-element=DET_SNR_058, system-signal=DET_SNR_058}, {application-record-element=DET_SNR_059, system-signal=DET_SNR_059}, {application-record-element=DET_SNR_060, system-signal=DET_SNR_060}, {application-record-element=DET_SUPER_RES_TARGET_057, system-signal=DET_SUPER_RES_TARGET_057}, {application-record-element=DET_SUPER_RES_TARGET_058, system-signal=DET_SUPER_RES_TARGET_058}, {application-record-element=DET_SUPER_RES_TARGET_059, system-signal=DET_SUPER_RES_TARGET_059}, {application-record-element=DET_SUPER_RES_TARGET_060, system-signal=DET_SUPER_RES_TARGET_060}]}
        sender-receiver-to-signal-group-mapping={data-element=Pp_SG_Detections_061_064_AL.Vdp_SG_Detections_061_064_AL, signal-group=SG_Detections_061_064, type-mapping=sender-rec-record-type-mapping=record-element-mappings=[{application-record-element=DET_AZIMUTH_061, system-signal=DET_AZIMUTH_061}, {application-record-element=DET_AZIMUTH_062, system-signal=DET_AZIMUTH_062}, {application-record-element=DET_AZIMUTH_063, system-signal=DET_AZIMUTH_063}, {application-record-element=DET_AZIMUTH_064, system-signal=DET_AZIMUTH_064}, {application-record-element=DET_AZIMUTH_ERR_061, system-signal=DET_AZIMUTH_ERR_061}, {application-record-element=DET_AZIMUTH_ERR_062, system-signal=DET_AZIMUTH_ERR_062}, {application-record-element=DET_AZIMUTH_ERR_063, system-signal=DET_AZIMUTH_ERR_063}, {application-record-element=DET_AZIMUTH_ERR_064, system-signal=DET_AZIMUTH_ERR_064}, {application-record-element=DET_BELOW_RAIN_THOLD_061, system-signal=DET_BELOW_RAIN_THOLD_061}, {application-record-element=DET_BELOW_RAIN_THOLD_062, system-signal=DET_BELOW_RAIN_THOLD_062}, {application-record-element=DET_BELOW_RAIN_THOLD_063, system-signal=DET_BELOW_RAIN_THOLD_063}, {application-record-element=DET_BELOW_RAIN_THOLD_064, system-signal=DET_BELOW_RAIN_THOLD_064}, {application-record-element=DET_BI_STATIC_FLAG_061, system-signal=DET_BI_STATIC_FLAG_061}, {application-record-element=DET_BI_STATIC_FLAG_062, system-signal=DET_BI_STATIC_FLAG_062}, {application-record-element=DET_BI_STATIC_FLAG_063, system-signal=DET_BI_STATIC_FLAG_063}, {application-record-element=DET_BI_STATIC_FLAG_064, system-signal=DET_BI_STATIC_FLAG_064}, {application-record-element=DET_CONFD_AZIMUTH_061, system-signal=DET_CONFD_AZIMUTH_061}, {application-record-element=DET_CONFD_AZIMUTH_062, system-signal=DET_CONFD_AZIMUTH_062}, {application-record-element=DET_CONFD_AZIMUTH_063, system-signal=DET_CONFD_AZIMUTH_063}, {application-record-element=DET_CONFD_AZIMUTH_064, system-signal=DET_CONFD_AZIMUTH_064}, {application-record-element=DET_CONFD_ELEVATION_061, system-signal=DET_CONFD_ELEVATION_061}, {application-record-element=DET_CONFD_ELEVATION_062, system-signal=DET_CONFD_ELEVATION_062}, {application-record-element=DET_CONFD_ELEVATION_063, system-signal=DET_CONFD_ELEVATION_063}, {application-record-element=DET_CONFD_ELEVATION_064, system-signal=DET_CONFD_ELEVATION_064}, {application-record-element=DET_ELEVATION_061, system-signal=DET_ELEVATION_061}, {application-record-element=DET_ELEVATION_062, system-signal=DET_ELEVATION_062}, {application-record-element=DET_ELEVATION_063, system-signal=DET_ELEVATION_063}, {application-record-element=DET_ELEVATION_064, system-signal=DET_ELEVATION_064}, {application-record-element=DET_ELEVATION_ERR_061, system-signal=DET_ELEVATION_ERR_061}, {application-record-element=DET_ELEVATION_ERR_062, system-signal=DET_ELEVATION_ERR_062}, {application-record-element=DET_ELEVATION_ERR_063, system-signal=DET_ELEVATION_ERR_063}, {application-record-element=DET_ELEVATION_ERR_064, system-signal=DET_ELEVATION_ERR_064}, {application-record-element=DET_EXISTENCE_PROB_061, system-signal=DET_EXISTENCE_PROB_061}, {application-record-element=DET_EXISTENCE_PROB_062, system-signal=DET_EXISTENCE_PROB_062}, {application-record-element=DET_EXISTENCE_PROB_063, system-signal=DET_EXISTENCE_PROB_063}, {application-record-element=DET_EXISTENCE_PROB_064, system-signal=DET_EXISTENCE_PROB_064}, {application-record-element=DET_HVC_FLAG_061, system-signal=DET_HVC_FLAG_061}, {application-record-element=DET_HVC_FLAG_062, system-signal=DET_HVC_FLAG_062}, {application-record-element=DET_HVC_FLAG_063, system-signal=DET_HVC_FLAG_063}, {application-record-element=DET_HVC_FLAG_064, system-signal=DET_HVC_FLAG_064}, {application-record-element=DET_IDM_061, system-signal=DET_IDM_061}, {application-record-element=DET_IDM_062, system-signal=DET_IDM_062}, {application-record-element=DET_IDM_063, system-signal=DET_IDM_063}, {application-record-element=DET_IDM_064, system-signal=DET_IDM_064}, {application-record-element=DET_MH_CRC16_061_064, system-signal=DET_MH_CRC16_061_064}, {application-record-element=DET_MH_CYCLE_COUNTER_061_064, system-signal=DET_MH_CYCLE_COUNTER_061_064}, {application-record-element=DET_MH_SCAN_INDEX_4LSB_061_064, system-signal=DET_MH_SCAN_INDEX_4LSB_061_064}, {application-record-element=DET_MTD_061, system-signal=DET_MTD_061}, {application-record-element=DET_MTD_062, system-signal=DET_MTD_062}, {application-record-element=DET_MTD_063, system-signal=DET_MTD_063}, {application-record-element=DET_MTD_064, system-signal=DET_MTD_064}, {application-record-element=DET_PROB_1STAZHYPO_061, system-signal=DET_PROB_1STAZHYPO_061}, {application-record-element=DET_PROB_1STAZHYPO_062, system-signal=DET_PROB_1STAZHYPO_062}, {application-record-element=DET_PROB_1STAZHYPO_063, system-signal=DET_PROB_1STAZHYPO_063}, {application-record-element=DET_PROB_1STAZHYPO_064, system-signal=DET_PROB_1STAZHYPO_064}, {application-record-element=DET_RANGE_061, system-signal=DET_RANGE_061}, {application-record-element=DET_RANGE_062, system-signal=DET_RANGE_062}, {application-record-element=DET_RANGE_063, system-signal=DET_RANGE_063}, {application-record-element=DET_RANGE_064, system-signal=DET_RANGE_064}, {application-record-element=DET_RANGE_ERR_061, system-signal=DET_RANGE_ERR_061}, {application-record-element=DET_RANGE_ERR_062, system-signal=DET_RANGE_ERR_062}, {application-record-element=DET_RANGE_ERR_063, system-signal=DET_RANGE_ERR_063}, {application-record-element=DET_RANGE_ERR_064, system-signal=DET_RANGE_ERR_064}, {application-record-element=DET_RANGE_VELOCITY_061, system-signal=DET_RANGE_VELOCITY_061}, {application-record-element=DET_RANGE_VELOCITY_062, system-signal=DET_RANGE_VELOCITY_062}, {application-record-element=DET_RANGE_VELOCITY_063, system-signal=DET_RANGE_VELOCITY_063}, {application-record-element=DET_RANGE_VELOCITY_064, system-signal=DET_RANGE_VELOCITY_064}, {application-record-element=DET_RANGE_VELOCITY_ERR_061, system-signal=DET_RANGE_VELOCITY_ERR_061}, {application-record-element=DET_RANGE_VELOCITY_ERR_062, system-signal=DET_RANGE_VELOCITY_ERR_062}, {application-record-element=DET_RANGE_VELOCITY_ERR_063, system-signal=DET_RANGE_VELOCITY_ERR_063}, {application-record-element=DET_RANGE_VELOCITY_ERR_064, system-signal=DET_RANGE_VELOCITY_ERR_064}, {application-record-element=DET_RCS_061, system-signal=DET_RCS_061}, {application-record-element=DET_RCS_062, system-signal=DET_RCS_062}, {application-record-element=DET_RCS_063, system-signal=DET_RCS_063}, {application-record-element=DET_RCS_064, system-signal=DET_RCS_064}, {application-record-element=DET_SNR_061, system-signal=DET_SNR_061}, {application-record-element=DET_SNR_062, system-signal=DET_SNR_062}, {application-record-element=DET_SNR_063, system-signal=DET_SNR_063}, {application-record-element=DET_SNR_064, system-signal=DET_SNR_064}, {application-record-element=DET_SUPER_RES_TARGET_061, system-signal=DET_SUPER_RES_TARGET_061}, {application-record-element=DET_SUPER_RES_TARGET_062, system-signal=DET_SUPER_RES_TARGET_062}, {application-record-element=DET_SUPER_RES_TARGET_063, system-signal=DET_SUPER_RES_TARGET_063}, {application-record-element=DET_SUPER_RES_TARGET_064, system-signal=DET_SUPER_RES_TARGET_064}]}
        sender-receiver-to-signal-group-mapping={data-element=Pp_SG_Detections_065_068_AL.Vdp_SG_Detections_065_068_AL, signal-group=SG_Detections_065_068, type-mapping=sender-rec-record-type-mapping=record-element-mappings=[{application-record-element=DET_AZIMUTH_065, system-signal=DET_AZIMUTH_065}, {application-record-element=DET_AZIMUTH_066, system-signal=DET_AZIMUTH_066}, {application-record-element=DET_AZIMUTH_067, system-signal=DET_AZIMUTH_067}, {application-record-element=DET_AZIMUTH_068, system-signal=DET_AZIMUTH_068}, {application-record-element=DET_AZIMUTH_ERR_065, system-signal=DET_AZIMUTH_ERR_065}, {application-record-element=DET_AZIMUTH_ERR_066, system-signal=DET_AZIMUTH_ERR_066}, {application-record-element=DET_AZIMUTH_ERR_067, system-signal=DET_AZIMUTH_ERR_067}, {application-record-element=DET_AZIMUTH_ERR_068, system-signal=DET_AZIMUTH_ERR_068}, {application-record-element=DET_BELOW_RAIN_THOLD_065, system-signal=DET_BELOW_RAIN_THOLD_065}, {application-record-element=DET_BELOW_RAIN_THOLD_066, system-signal=DET_BELOW_RAIN_THOLD_066}, {application-record-element=DET_BELOW_RAIN_THOLD_067, system-signal=DET_BELOW_RAIN_THOLD_067}, {application-record-element=DET_BELOW_RAIN_THOLD_068, system-signal=DET_BELOW_RAIN_THOLD_068}, {application-record-element=DET_BI_STATIC_FLAG_065, system-signal=DET_BI_STATIC_FLAG_065}, {application-record-element=DET_BI_STATIC_FLAG_066, system-signal=DET_BI_STATIC_FLAG_066}, {application-record-element=DET_BI_STATIC_FLAG_067, system-signal=DET_BI_STATIC_FLAG_067}, {application-record-element=DET_BI_STATIC_FLAG_068, system-signal=DET_BI_STATIC_FLAG_068}, {application-record-element=DET_CONFD_AZIMUTH_065, system-signal=DET_CONFD_AZIMUTH_065}, {application-record-element=DET_CONFD_AZIMUTH_066, system-signal=DET_CONFD_AZIMUTH_066}, {application-record-element=DET_CONFD_AZIMUTH_067, system-signal=DET_CONFD_AZIMUTH_067}, {application-record-element=DET_CONFD_AZIMUTH_068, system-signal=DET_CONFD_AZIMUTH_068}, {application-record-element=DET_CONFD_ELEVATION_065, system-signal=DET_CONFD_ELEVATION_065}, {application-record-element=DET_CONFD_ELEVATION_066, system-signal=DET_CONFD_ELEVATION_066}, {application-record-element=DET_CONFD_ELEVATION_067, system-signal=DET_CONFD_ELEVATION_067}, {application-record-element=DET_CONFD_ELEVATION_068, system-signal=DET_CONFD_ELEVATION_068}, {application-record-element=DET_ELEVATION_065, system-signal=DET_ELEVATION_065}, {application-record-element=DET_ELEVATION_066, system-signal=DET_ELEVATION_066}, {application-record-element=DET_ELEVATION_067, system-signal=DET_ELEVATION_067}, {application-record-element=DET_ELEVATION_068, system-signal=DET_ELEVATION_068}, {application-record-element=DET_ELEVATION_ERR_065, system-signal=DET_ELEVATION_ERR_065}, {application-record-element=DET_ELEVATION_ERR_066, system-signal=DET_ELEVATION_ERR_066}, {application-record-element=DET_ELEVATION_ERR_067, system-signal=DET_ELEVATION_ERR_067}, {application-record-element=DET_ELEVATION_ERR_068, system-signal=DET_ELEVATION_ERR_068}, {application-record-element=DET_EXISTENCE_PROB_065, system-signal=DET_EXISTENCE_PROB_065}, {application-record-element=DET_EXISTENCE_PROB_066, system-signal=DET_EXISTENCE_PROB_066}, {application-record-element=DET_EXISTENCE_PROB_067, system-signal=DET_EXISTENCE_PROB_067}, {application-record-element=DET_EXISTENCE_PROB_068, system-signal=DET_EXISTENCE_PROB_068}, {application-record-element=DET_HVC_FLAG_065, system-signal=DET_HVC_FLAG_065}, {application-record-element=DET_HVC_FLAG_066, system-signal=DET_HVC_FLAG_066}, {application-record-element=DET_HVC_FLAG_067, system-signal=DET_HVC_FLAG_067}, {application-record-element=DET_HVC_FLAG_068, system-signal=DET_HVC_FLAG_068}, {application-record-element=DET_IDM_065, system-signal=DET_IDM_065}, {application-record-element=DET_IDM_066, system-signal=DET_IDM_066}, {application-record-element=DET_IDM_067, system-signal=DET_IDM_067}, {application-record-element=DET_IDM_068, system-signal=DET_IDM_068}, {application-record-element=DET_MH_CRC16_065_068, system-signal=DET_MH_CRC16_065_068}, {application-record-element=DET_MH_CYCLE_COUNTER_065_068, system-signal=DET_MH_CYCLE_COUNTER_065_068}, {application-record-element=DET_MH_SCAN_INDEX_4LSB_065_068, system-signal=DET_MH_SCAN_INDEX_4LSB_065_068}, {application-record-element=DET_MTD_065, system-signal=DET_MTD_065}, {application-record-element=DET_MTD_066, system-signal=DET_MTD_066}, {application-record-element=DET_MTD_067, system-signal=DET_MTD_067}, {application-record-element=DET_MTD_068, system-signal=DET_MTD_068}, {application-record-element=DET_PROB_1STAZHYPO_065, system-signal=DET_PROB_1STAZHYPO_065}, {application-record-element=DET_PROB_1STAZHYPO_066, system-signal=DET_PROB_1STAZHYPO_066}, {application-record-element=DET_PROB_1STAZHYPO_067, system-signal=DET_PROB_1STAZHYPO_067}, {application-record-element=DET_PROB_1STAZHYPO_068, system-signal=DET_PROB_1STAZHYPO_068}, {application-record-element=DET_RANGE_065, system-signal=DET_RANGE_065}, {application-record-element=DET_RANGE_066, system-signal=DET_RANGE_066}, {application-record-element=DET_RANGE_067, system-signal=DET_RANGE_067}, {application-record-element=DET_RANGE_068, system-signal=DET_RANGE_068}, {application-record-element=DET_RANGE_ERR_065, system-signal=DET_RANGE_ERR_065}, {application-record-element=DET_RANGE_ERR_066, system-signal=DET_RANGE_ERR_066}, {application-record-element=DET_RANGE_ERR_067, system-signal=DET_RANGE_ERR_067}, {application-record-element=DET_RANGE_ERR_068, system-signal=DET_RANGE_ERR_068}, {application-record-element=DET_RANGE_VELOCITY_065, system-signal=DET_RANGE_VELOCITY_065}, {application-record-element=DET_RANGE_VELOCITY_066, system-signal=DET_RANGE_VELOCITY_066}, {application-record-element=DET_RANGE_VELOCITY_067, system-signal=DET_RANGE_VELOCITY_067}, {application-record-element=DET_RANGE_VELOCITY_068, system-signal=DET_RANGE_VELOCITY_068}, {application-record-element=DET_RANGE_VELOCITY_ERR_065, system-signal=DET_RANGE_VELOCITY_ERR_065}, {application-record-element=DET_RANGE_VELOCITY_ERR_066, system-signal=DET_RANGE_VELOCITY_ERR_066}, {application-record-element=DET_RANGE_VELOCITY_ERR_067, system-signal=DET_RANGE_VELOCITY_ERR_067}, {application-record-element=DET_RANGE_VELOCITY_ERR_068, system-signal=DET_RANGE_VELOCITY_ERR_068}, {application-record-element=DET_RCS_065, system-signal=DET_RCS_065}, {application-record-element=DET_RCS_066, system-signal=DET_RCS_066}, {application-record-element=DET_RCS_067, system-signal=DET_RCS_067}, {application-record-element=DET_RCS_068, system-signal=DET_RCS_068}, {application-record-element=DET_SNR_065, system-signal=DET_SNR_065}, {application-record-element=DET_SNR_066, system-signal=DET_SNR_066}, {application-record-element=DET_SNR_067, system-signal=DET_SNR_067}, {application-record-element=DET_SNR_068, system-signal=DET_SNR_068}, {application-record-element=DET_SUPER_RES_TARGET_065, system-signal=DET_SUPER_RES_TARGET_065}, {application-record-element=DET_SUPER_RES_TARGET_066, system-signal=DET_SUPER_RES_TARGET_066}, {application-record-element=DET_SUPER_RES_TARGET_067, system-signal=DET_SUPER_RES_TARGET_067}, {application-record-element=DET_SUPER_RES_TARGET_068, system-signal=DET_SUPER_RES_TARGET_068}]}
        sender-receiver-to-signal-group-mapping={data-element=Pp_SG_Detections_069_072_AL.Vdp_SG_Detections_069_072_AL, signal-group=SG_Detections_069_072, type-mapping=sender-rec-record-type-mapping=record-element-mappings=[{application-record-element=DET_AZIMUTH_069, system-signal=DET_AZIMUTH_069}, {application-record-element=DET_AZIMUTH_070, system-signal=DET_AZIMUTH_070}, {application-record-element=DET_AZIMUTH_071, system-signal=DET_AZIMUTH_071}, {application-record-element=DET_AZIMUTH_072, system-signal=DET_AZIMUTH_072}, {application-record-element=DET_AZIMUTH_ERR_069, system-signal=DET_AZIMUTH_ERR_069}, {application-record-element=DET_AZIMUTH_ERR_070, system-signal=DET_AZIMUTH_ERR_070}, {application-record-element=DET_AZIMUTH_ERR_071, system-signal=DET_AZIMUTH_ERR_071}, {application-record-element=DET_AZIMUTH_ERR_072, system-signal=DET_AZIMUTH_ERR_072}, {application-record-element=DET_BELOW_RAIN_THOLD_069, system-signal=DET_BELOW_RAIN_THOLD_069}, {application-record-element=DET_BELOW_RAIN_THOLD_070, system-signal=DET_BELOW_RAIN_THOLD_070}, {application-record-element=DET_BELOW_RAIN_THOLD_071, system-signal=DET_BELOW_RAIN_THOLD_071}, {application-record-element=DET_BELOW_RAIN_THOLD_072, system-signal=DET_BELOW_RAIN_THOLD_072}, {application-record-element=DET_BI_STATIC_FLAG_069, system-signal=DET_BI_STATIC_FLAG_069}, {application-record-element=DET_BI_STATIC_FLAG_070, system-signal=DET_BI_STATIC_FLAG_070}, {application-record-element=DET_BI_STATIC_FLAG_071, system-signal=DET_BI_STATIC_FLAG_071}, {application-record-element=DET_BI_STATIC_FLAG_072, system-signal=DET_BI_STATIC_FLAG_072}, {application-record-element=DET_CONFD_AZIMUTH_069, system-signal=DET_CONFD_AZIMUTH_069}, {application-record-element=DET_CONFD_AZIMUTH_070, system-signal=DET_CONFD_AZIMUTH_070}, {application-record-element=DET_CONFD_AZIMUTH_071, system-signal=DET_CONFD_AZIMUTH_071}, {application-record-element=DET_CONFD_AZIMUTH_072, system-signal=DET_CONFD_AZIMUTH_072}, {application-record-element=DET_CONFD_ELEVATION_069, system-signal=DET_CONFD_ELEVATION_069}, {application-record-element=DET_CONFD_ELEVATION_070, system-signal=DET_CONFD_ELEVATION_070}, {application-record-element=DET_CONFD_ELEVATION_071, system-signal=DET_CONFD_ELEVATION_071}, {application-record-element=DET_CONFD_ELEVATION_072, system-signal=DET_CONFD_ELEVATION_072}, {application-record-element=DET_ELEVATION_069, system-signal=DET_ELEVATION_069}, {application-record-element=DET_ELEVATION_070, system-signal=DET_ELEVATION_070}, {application-record-element=DET_ELEVATION_071, system-signal=DET_ELEVATION_071}, {application-record-element=DET_ELEVATION_072, system-signal=DET_ELEVATION_072}, {application-record-element=DET_ELEVATION_ERR_069, system-signal=DET_ELEVATION_ERR_069}, {application-record-element=DET_ELEVATION_ERR_070, system-signal=DET_ELEVATION_ERR_070}, {application-record-element=DET_ELEVATION_ERR_071, system-signal=DET_ELEVATION_ERR_071}, {application-record-element=DET_ELEVATION_ERR_072, system-signal=DET_ELEVATION_ERR_072}, {application-record-element=DET_EXISTENCE_PROB_069, system-signal=DET_EXISTENCE_PROB_069}, {application-record-element=DET_EXISTENCE_PROB_070, system-signal=DET_EXISTENCE_PROB_070}, {application-record-element=DET_EXISTENCE_PROB_071, system-signal=DET_EXISTENCE_PROB_071}, {application-record-element=DET_EXISTENCE_PROB_072, system-signal=DET_EXISTENCE_PROB_072}, {application-record-element=DET_HVC_FLAG_069, system-signal=DET_HVC_FLAG_069}, {application-record-element=DET_HVC_FLAG_070, system-signal=DET_HVC_FLAG_070}, {application-record-element=DET_HVC_FLAG_071, system-signal=DET_HVC_FLAG_071}, {application-record-element=DET_HVC_FLAG_072, system-signal=DET_HVC_FLAG_072}, {application-record-element=DET_IDM_069, system-signal=DET_IDM_069}, {application-record-element=DET_IDM_070, system-signal=DET_IDM_070}, {application-record-element=DET_IDM_071, system-signal=DET_IDM_071}, {application-record-element=DET_IDM_072, system-signal=DET_IDM_072}, {application-record-element=DET_MH_CRC16_069_072, system-signal=DET_MH_CRC16_069_072}, {application-record-element=DET_MH_CYCLE_COUNTER_069_072, system-signal=DET_MH_CYCLE_COUNTER_069_072}, {application-record-element=DET_MH_SCAN_INDEX_4LSB_069_072, system-signal=DET_MH_SCAN_INDEX_4LSB_069_072}, {application-record-element=DET_MTD_069, system-signal=DET_MTD_069}, {application-record-element=DET_MTD_070, system-signal=DET_MTD_070}, {application-record-element=DET_MTD_071, system-signal=DET_MTD_071}, {application-record-element=DET_MTD_072, system-signal=DET_MTD_072}, {application-record-element=DET_PROB_1STAZHYPO_069, system-signal=DET_PROB_1STAZHYPO_069}, {application-record-element=DET_PROB_1STAZHYPO_070, system-signal=DET_PROB_1STAZHYPO_070}, {application-record-element=DET_PROB_1STAZHYPO_071, system-signal=DET_PROB_1STAZHYPO_071}, {application-record-element=DET_PROB_1STAZHYPO_072, system-signal=DET_PROB_1STAZHYPO_072}, {application-record-element=DET_RANGE_069, system-signal=DET_RANGE_069}, {application-record-element=DET_RANGE_070, system-signal=DET_RANGE_070}, {application-record-element=DET_RANGE_071, system-signal=DET_RANGE_071}, {application-record-element=DET_RANGE_072, system-signal=DET_RANGE_072}, {application-record-element=DET_RANGE_ERR_069, system-signal=DET_RANGE_ERR_069}, {application-record-element=DET_RANGE_ERR_070, system-signal=DET_RANGE_ERR_070}, {application-record-element=DET_RANGE_ERR_071, system-signal=DET_RANGE_ERR_071}, {application-record-element=DET_RANGE_ERR_072, system-signal=DET_RANGE_ERR_072}, {application-record-element=DET_RANGE_VELOCITY_069, system-signal=DET_RANGE_VELOCITY_069}, {application-record-element=DET_RANGE_VELOCITY_070, system-signal=DET_RANGE_VELOCITY_070}, {application-record-element=DET_RANGE_VELOCITY_071, system-signal=DET_RANGE_VELOCITY_071}, {application-record-element=DET_RANGE_VELOCITY_072, system-signal=DET_RANGE_VELOCITY_072}, {application-record-element=DET_RANGE_VELOCITY_ERR_069, system-signal=DET_RANGE_VELOCITY_ERR_069}, {application-record-element=DET_RANGE_VELOCITY_ERR_070, system-signal=DET_RANGE_VELOCITY_ERR_070}, {application-record-element=DET_RANGE_VELOCITY_ERR_071, system-signal=DET_RANGE_VELOCITY_ERR_071}, {application-record-element=DET_RANGE_VELOCITY_ERR_072, system-signal=DET_RANGE_VELOCITY_ERR_072}, {application-record-element=DET_RCS_069, system-signal=DET_RCS_069}, {application-record-element=DET_RCS_070, system-signal=DET_RCS_070}, {application-record-element=DET_RCS_071, system-signal=DET_RCS_071}, {application-record-element=DET_RCS_072, system-signal=DET_RCS_072}, {application-record-element=DET_SNR_069, system-signal=DET_SNR_069}, {application-record-element=DET_SNR_070, system-signal=DET_SNR_070}, {application-record-element=DET_SNR_071, system-signal=DET_SNR_071}, {application-record-element=DET_SNR_072, system-signal=DET_SNR_072}, {application-record-element=DET_SUPER_RES_TARGET_069, system-signal=DET_SUPER_RES_TARGET_069}, {application-record-element=DET_SUPER_RES_TARGET_070, system-signal=DET_SUPER_RES_TARGET_070}, {application-record-element=DET_SUPER_RES_TARGET_071, system-signal=DET_SUPER_RES_TARGET_071}, {application-record-element=DET_SUPER_RES_TARGET_072, system-signal=DET_SUPER_RES_TARGET_072}]}
        sender-receiver-to-signal-group-mapping={data-element=Pp_SG_Detections_073_076_AL.Vdp_SG_Detections_073_076_AL, signal-group=SG_Detections_073_076, type-mapping=sender-rec-record-type-mapping=record-element-mappings=[{application-record-element=DET_AZIMUTH_073, system-signal=DET_AZIMUTH_073}, {application-record-element=DET_AZIMUTH_074, system-signal=DET_AZIMUTH_074}, {application-record-element=DET_AZIMUTH_075, system-signal=DET_AZIMUTH_075}, {application-record-element=DET_AZIMUTH_076, system-signal=DET_AZIMUTH_076}, {application-record-element=DET_AZIMUTH_ERR_073, system-signal=DET_AZIMUTH_ERR_073}, {application-record-element=DET_AZIMUTH_ERR_074, system-signal=DET_AZIMUTH_ERR_074}, {application-record-element=DET_AZIMUTH_ERR_075, system-signal=DET_AZIMUTH_ERR_075}, {application-record-element=DET_AZIMUTH_ERR_076, system-signal=DET_AZIMUTH_ERR_076}, {application-record-element=DET_BELOW_RAIN_THOLD_073, system-signal=DET_BELOW_RAIN_THOLD_073}, {application-record-element=DET_BELOW_RAIN_THOLD_074, system-signal=DET_BELOW_RAIN_THOLD_074}, {application-record-element=DET_BELOW_RAIN_THOLD_075, system-signal=DET_BELOW_RAIN_THOLD_075}, {application-record-element=DET_BELOW_RAIN_THOLD_076, system-signal=DET_BELOW_RAIN_THOLD_076}, {application-record-element=DET_BI_STATIC_FLAG_073, system-signal=DET_BI_STATIC_FLAG_073}, {application-record-element=DET_BI_STATIC_FLAG_074, system-signal=DET_BI_STATIC_FLAG_074}, {application-record-element=DET_BI_STATIC_FLAG_075, system-signal=DET_BI_STATIC_FLAG_075}, {application-record-element=DET_BI_STATIC_FLAG_076, system-signal=DET_BI_STATIC_FLAG_076}, {application-record-element=DET_CONFD_AZIMUTH_073, system-signal=DET_CONFD_AZIMUTH_073}, {application-record-element=DET_CONFD_AZIMUTH_074, system-signal=DET_CONFD_AZIMUTH_074}, {application-record-element=DET_CONFD_AZIMUTH_075, system-signal=DET_CONFD_AZIMUTH_075}, {application-record-element=DET_CONFD_AZIMUTH_076, system-signal=DET_CONFD_AZIMUTH_076}, {application-record-element=DET_CONFD_ELEVATION_073, system-signal=DET_CONFD_ELEVATION_073}, {application-record-element=DET_CONFD_ELEVATION_074, system-signal=DET_CONFD_ELEVATION_074}, {application-record-element=DET_CONFD_ELEVATION_075, system-signal=DET_CONFD_ELEVATION_075}, {application-record-element=DET_CONFD_ELEVATION_076, system-signal=DET_CONFD_ELEVATION_076}, {application-record-element=DET_ELEVATION_073, system-signal=DET_ELEVATION_073}, {application-record-element=DET_ELEVATION_074, system-signal=DET_ELEVATION_074}, {application-record-element=DET_ELEVATION_075, system-signal=DET_ELEVATION_075}, {application-record-element=DET_ELEVATION_076, system-signal=DET_ELEVATION_076}, {application-record-element=DET_ELEVATION_ERR_073, system-signal=DET_ELEVATION_ERR_073}, {application-record-element=DET_ELEVATION_ERR_074, system-signal=DET_ELEVATION_ERR_074}, {application-record-element=DET_ELEVATION_ERR_075, system-signal=DET_ELEVATION_ERR_075}, {application-record-element=DET_ELEVATION_ERR_076, system-signal=DET_ELEVATION_ERR_076}, {application-record-element=DET_EXISTENCE_PROB_073, system-signal=DET_EXISTENCE_PROB_073}, {application-record-element=DET_EXISTENCE_PROB_074, system-signal=DET_EXISTENCE_PROB_074}, {application-record-element=DET_EXISTENCE_PROB_075, system-signal=DET_EXISTENCE_PROB_075}, {application-record-element=DET_EXISTENCE_PROB_076, system-signal=DET_EXISTENCE_PROB_076}, {application-record-element=DET_HVC_FLAG_073, system-signal=DET_HVC_FLAG_073}, {application-record-element=DET_HVC_FLAG_074, system-signal=DET_HVC_FLAG_074}, {application-record-element=DET_HVC_FLAG_075, system-signal=DET_HVC_FLAG_075}, {application-record-element=DET_HVC_FLAG_076, system-signal=DET_HVC_FLAG_076}, {application-record-element=DET_IDM_073, system-signal=DET_IDM_073}, {application-record-element=DET_IDM_074, system-signal=DET_IDM_074}, {application-record-element=DET_IDM_075, system-signal=DET_IDM_075}, {application-record-element=DET_IDM_076, system-signal=DET_IDM_076}, {application-record-element=DET_MH_CRC16_073_076, system-signal=DET_MH_CRC16_073_076}, {application-record-element=DET_MH_CYCLE_COUNTER_073_076, system-signal=DET_MH_CYCLE_COUNTER_073_076}, {application-record-element=DET_MH_SCAN_INDEX_4LSB_073_076, system-signal=DET_MH_SCAN_INDEX_4LSB_073_076}, {application-record-element=DET_MTD_073, system-signal=DET_MTD_073}, {application-record-element=DET_MTD_074, system-signal=DET_MTD_074}, {application-record-element=DET_MTD_075, system-signal=DET_MTD_075}, {application-record-element=DET_MTD_076, system-signal=DET_MTD_076}, {application-record-element=DET_PROB_1STAZHYPO_073, system-signal=DET_PROB_1STAZHYPO_073}, {application-record-element=DET_PROB_1STAZHYPO_074, system-signal=DET_PROB_1STAZHYPO_074}, {application-record-element=DET_PROB_1STAZHYPO_075, system-signal=DET_PROB_1STAZHYPO_075}, {application-record-element=DET_PROB_1STAZHYPO_076, system-signal=DET_PROB_1STAZHYPO_076}, {application-record-element=DET_RANGE_073, system-signal=DET_RANGE_073}, {application-record-element=DET_RANGE_074, system-signal=DET_RANGE_074}, {application-record-element=DET_RANGE_075, system-signal=DET_RANGE_075}, {application-record-element=DET_RANGE_076, system-signal=DET_RANGE_076}, {application-record-element=DET_RANGE_ERR_073, system-signal=DET_RANGE_ERR_073}, {application-record-element=DET_RANGE_ERR_074, system-signal=DET_RANGE_ERR_074}, {application-record-element=DET_RANGE_ERR_075, system-signal=DET_RANGE_ERR_075}, {application-record-element=DET_RANGE_ERR_076, system-signal=DET_RANGE_ERR_076}, {application-record-element=DET_RANGE_VELOCITY_073, system-signal=DET_RANGE_VELOCITY_073}, {application-record-element=DET_RANGE_VELOCITY_074, system-signal=DET_RANGE_VELOCITY_074}, {application-record-element=DET_RANGE_VELOCITY_075, system-signal=DET_RANGE_VELOCITY_075}, {application-record-element=DET_RANGE_VELOCITY_076, system-signal=DET_RANGE_VELOCITY_076}, {application-record-element=DET_RANGE_VELOCITY_ERR_073, system-signal=DET_RANGE_VELOCITY_ERR_073}, {application-record-element=DET_RANGE_VELOCITY_ERR_074, system-signal=DET_RANGE_VELOCITY_ERR_074}, {application-record-element=DET_RANGE_VELOCITY_ERR_075, system-signal=DET_RANGE_VELOCITY_ERR_075}, {application-record-element=DET_RANGE_VELOCITY_ERR_076, system-signal=DET_RANGE_VELOCITY_ERR_076}, {application-record-element=DET_RCS_073, system-signal=DET_RCS_073}, {application-record-element=DET_RCS_074, system-signal=DET_RCS_074}, {application-record-element=DET_RCS_075, system-signal=DET_RCS_075}, {application-record-element=DET_RCS_076, system-signal=DET_RCS_076}, {application-record-element=DET_SNR_073, system-signal=DET_SNR_073}, {application-record-element=DET_SNR_074, system-signal=DET_SNR_074}, {application-record-element=DET_SNR_075, system-signal=DET_SNR_075}, {application-record-element=DET_SNR_076, system-signal=DET_SNR_076}, {application-record-element=DET_SUPER_RES_TARGET_073, system-signal=DET_SUPER_RES_TARGET_073}, {application-record-element=DET_SUPER_RES_TARGET_074, system-signal=DET_SUPER_RES_TARGET_074}, {application-record-element=DET_SUPER_RES_TARGET_075, system-signal=DET_SUPER_RES_TARGET_075}, {application-record-element=DET_SUPER_RES_TARGET_076, system-signal=DET_SUPER_RES_TARGET_076}]}
        sender-receiver-to-signal-group-mapping={data-element=Pp_SG_Detections_077_080_AL.Vdp_SG_Detections_077_080_AL, signal-group=SG_Detections_077_080, type-mapping=sender-rec-record-type-mapping=record-element-mappings=[{application-record-element=DET_AZIMUTH_077, system-signal=DET_AZIMUTH_077}, {application-record-element=DET_AZIMUTH_078, system-signal=DET_AZIMUTH_078}, {application-record-element=DET_AZIMUTH_079, system-signal=DET_AZIMUTH_079}, {application-record-element=DET_AZIMUTH_080, system-signal=DET_AZIMUTH_080}, {application-record-element=DET_AZIMUTH_ERR_077, system-signal=DET_AZIMUTH_ERR_077}, {application-record-element=DET_AZIMUTH_ERR_078, system-signal=DET_AZIMUTH_ERR_078}, {application-record-element=DET_AZIMUTH_ERR_079, system-signal=DET_AZIMUTH_ERR_079}, {application-record-element=DET_AZIMUTH_ERR_080, system-signal=DET_AZIMUTH_ERR_080}, {application-record-element=DET_BELOW_RAIN_THOLD_077, system-signal=DET_BELOW_RAIN_THOLD_077}, {application-record-element=DET_BELOW_RAIN_THOLD_078, system-signal=DET_BELOW_RAIN_THOLD_078}, {application-record-element=DET_BELOW_RAIN_THOLD_079, system-signal=DET_BELOW_RAIN_THOLD_079}, {application-record-element=DET_BELOW_RAIN_THOLD_080, system-signal=DET_BELOW_RAIN_THOLD_080}, {application-record-element=DET_BI_STATIC_FLAG_077, system-signal=DET_BI_STATIC_FLAG_077}, {application-record-element=DET_BI_STATIC_FLAG_078, system-signal=DET_BI_STATIC_FLAG_078}, {application-record-element=DET_BI_STATIC_FLAG_079, system-signal=DET_BI_STATIC_FLAG_079}, {application-record-element=DET_BI_STATIC_FLAG_080, system-signal=DET_BI_STATIC_FLAG_080}, {application-record-element=DET_CONFD_AZIMUTH_077, system-signal=DET_CONFD_AZIMUTH_077}, {application-record-element=DET_CONFD_AZIMUTH_078, system-signal=DET_CONFD_AZIMUTH_078}, {application-record-element=DET_CONFD_AZIMUTH_079, system-signal=DET_CONFD_AZIMUTH_079}, {application-record-element=DET_CONFD_AZIMUTH_080, system-signal=DET_CONFD_AZIMUTH_080}, {application-record-element=DET_CONFD_ELEVATION_077, system-signal=DET_CONFD_ELEVATION_077}, {application-record-element=DET_CONFD_ELEVATION_078, system-signal=DET_CONFD_ELEVATION_078}, {application-record-element=DET_CONFD_ELEVATION_079, system-signal=DET_CONFD_ELEVATION_079}, {application-record-element=DET_CONFD_ELEVATION_080, system-signal=DET_CONFD_ELEVATION_080}, {application-record-element=DET_ELEVATION_077, system-signal=DET_ELEVATION_077}, {application-record-element=DET_ELEVATION_078, system-signal=DET_ELEVATION_078}, {application-record-element=DET_ELEVATION_079, system-signal=DET_ELEVATION_079}, {application-record-element=DET_ELEVATION_080, system-signal=DET_ELEVATION_080}, {application-record-element=DET_ELEVATION_ERR_077, system-signal=DET_ELEVATION_ERR_077}, {application-record-element=DET_ELEVATION_ERR_078, system-signal=DET_ELEVATION_ERR_078}, {application-record-element=DET_ELEVATION_ERR_079, system-signal=DET_ELEVATION_ERR_079}, {application-record-element=DET_ELEVATION_ERR_080, system-signal=DET_ELEVATION_ERR_080}, {application-record-element=DET_EXISTENCE_PROB_077, system-signal=DET_EXISTENCE_PROB_077}, {application-record-element=DET_EXISTENCE_PROB_078, system-signal=DET_EXISTENCE_PROB_078}, {application-record-element=DET_EXISTENCE_PROB_079, system-signal=DET_EXISTENCE_PROB_079}, {application-record-element=DET_EXISTENCE_PROB_080, system-signal=DET_EXISTENCE_PROB_080}, {application-record-element=DET_HVC_FLAG_077, system-signal=DET_HVC_FLAG_077}, {application-record-element=DET_HVC_FLAG_078, system-signal=DET_HVC_FLAG_078}, {application-record-element=DET_HVC_FLAG_079, system-signal=DET_HVC_FLAG_079}, {application-record-element=DET_HVC_FLAG_080, system-signal=DET_HVC_FLAG_080}, {application-record-element=DET_IDM_077, system-signal=DET_IDM_077}, {application-record-element=DET_IDM_078, system-signal=DET_IDM_078}, {application-record-element=DET_IDM_079, system-signal=DET_IDM_079}, {application-record-element=DET_IDM_080, system-signal=DET_IDM_080}, {application-record-element=DET_MH_CRC16_077_080, system-signal=DET_MH_CRC16_077_080}, {application-record-element=DET_MH_CYCLE_COUNTER_077_080, system-signal=DET_MH_CYCLE_COUNTER_077_080}, {application-record-element=DET_MH_SCAN_INDEX_4LSB_077_080, system-signal=DET_MH_SCAN_INDEX_4LSB_077_080}, {application-record-element=DET_MTD_077, system-signal=DET_MTD_077}, {application-record-element=DET_MTD_078, system-signal=DET_MTD_078}, {application-record-element=DET_MTD_079, system-signal=DET_MTD_079}, {application-record-element=DET_MTD_080, system-signal=DET_MTD_080}, {application-record-element=DET_PROB_1STAZHYPO_077, system-signal=DET_PROB_1STAZHYPO_077}, {application-record-element=DET_PROB_1STAZHYPO_078, system-signal=DET_PROB_1STAZHYPO_078}, {application-record-element=DET_PROB_1STAZHYPO_079, system-signal=DET_PROB_1STAZHYPO_079}, {application-record-element=DET_PROB_1STAZHYPO_080, system-signal=DET_PROB_1STAZHYPO_080}, {application-record-element=DET_RANGE_077, system-signal=DET_RANGE_077}, {application-record-element=DET_RANGE_078, system-signal=DET_RANGE_078}, {application-record-element=DET_RANGE_079, system-signal=DET_RANGE_079}, {application-record-element=DET_RANGE_080, system-signal=DET_RANGE_080}, {application-record-element=DET_RANGE_ERR_077, system-signal=DET_RANGE_ERR_077}, {application-record-element=DET_RANGE_ERR_078, system-signal=DET_RANGE_ERR_078}, {application-record-element=DET_RANGE_ERR_079, system-signal=DET_RANGE_ERR_079}, {application-record-element=DET_RANGE_ERR_080, system-signal=DET_RANGE_ERR_080}, {application-record-element=DET_RANGE_VELOCITY_077, system-signal=DET_RANGE_VELOCITY_077}, {application-record-element=DET_RANGE_VELOCITY_078, system-signal=DET_RANGE_VELOCITY_078}, {application-record-element=DET_RANGE_VELOCITY_079, system-signal=DET_RANGE_VELOCITY_079}, {application-record-element=DET_RANGE_VELOCITY_080, system-signal=DET_RANGE_VELOCITY_080}, {application-record-element=DET_RANGE_VELOCITY_ERR_077, system-signal=DET_RANGE_VELOCITY_ERR_077}, {application-record-element=DET_RANGE_VELOCITY_ERR_078, system-signal=DET_RANGE_VELOCITY_ERR_078}, {application-record-element=DET_RANGE_VELOCITY_ERR_079, system-signal=DET_RANGE_VELOCITY_ERR_079}, {application-record-element=DET_RANGE_VELOCITY_ERR_080, system-signal=DET_RANGE_VELOCITY_ERR_080}, {application-record-element=DET_RCS_077, system-signal=DET_RCS_077}, {application-record-element=DET_RCS_078, system-signal=DET_RCS_078}, {application-record-element=DET_RCS_079, system-signal=DET_RCS_079}, {application-record-element=DET_RCS_080, system-signal=DET_RCS_080}, {application-record-element=DET_SNR_077, system-signal=DET_SNR_077}, {application-record-element=DET_SNR_078, system-signal=DET_SNR_078}, {application-record-element=DET_SNR_079, system-signal=DET_SNR_079}, {application-record-element=DET_SNR_080, system-signal=DET_SNR_080}, {application-record-element=DET_SUPER_RES_TARGET_077, system-signal=DET_SUPER_RES_TARGET_077}, {application-record-element=DET_SUPER_RES_TARGET_078, system-signal=DET_SUPER_RES_TARGET_078}, {application-record-element=DET_SUPER_RES_TARGET_079, system-signal=DET_SUPER_RES_TARGET_079}, {application-record-element=DET_SUPER_RES_TARGET_080, system-signal=DET_SUPER_RES_TARGET_080}]}
        sender-receiver-to-signal-group-mapping={data-element=Pp_SG_Detections_081_084_AL.Vdp_SG_Detections_081_084_AL, signal-group=SG_Detections_081_084, type-mapping=sender-rec-record-type-mapping=record-element-mappings=[{application-record-element=DET_AZIMUTH_081, system-signal=DET_AZIMUTH_081}, {application-record-element=DET_AZIMUTH_082, system-signal=DET_AZIMUTH_082}, {application-record-element=DET_AZIMUTH_083, system-signal=DET_AZIMUTH_083}, {application-record-element=DET_AZIMUTH_084, system-signal=DET_AZIMUTH_084}, {application-record-element=DET_AZIMUTH_ERR_081, system-signal=DET_AZIMUTH_ERR_081}, {application-record-element=DET_AZIMUTH_ERR_082, system-signal=DET_AZIMUTH_ERR_082}, {application-record-element=DET_AZIMUTH_ERR_083, system-signal=DET_AZIMUTH_ERR_083}, {application-record-element=DET_AZIMUTH_ERR_084, system-signal=DET_AZIMUTH_ERR_084}, {application-record-element=DET_BELOW_RAIN_THOLD_081, system-signal=DET_BELOW_RAIN_THOLD_081}, {application-record-element=DET_BELOW_RAIN_THOLD_082, system-signal=DET_BELOW_RAIN_THOLD_082}, {application-record-element=DET_BELOW_RAIN_THOLD_083, system-signal=DET_BELOW_RAIN_THOLD_083}, {application-record-element=DET_BELOW_RAIN_THOLD_084, system-signal=DET_BELOW_RAIN_THOLD_084}, {application-record-element=DET_BI_STATIC_FLAG_081, system-signal=DET_BI_STATIC_FLAG_081}, {application-record-element=DET_BI_STATIC_FLAG_082, system-signal=DET_BI_STATIC_FLAG_082}, {application-record-element=DET_BI_STATIC_FLAG_083, system-signal=DET_BI_STATIC_FLAG_083}, {application-record-element=DET_BI_STATIC_FLAG_084, system-signal=DET_BI_STATIC_FLAG_084}, {application-record-element=DET_CONFD_AZIMUTH_081, system-signal=DET_CONFD_AZIMUTH_081}, {application-record-element=DET_CONFD_AZIMUTH_082, system-signal=DET_CONFD_AZIMUTH_082}, {application-record-element=DET_CONFD_AZIMUTH_083, system-signal=DET_CONFD_AZIMUTH_083}, {application-record-element=DET_CONFD_AZIMUTH_084, system-signal=DET_CONFD_AZIMUTH_084}, {application-record-element=DET_CONFD_ELEVATION_081, system-signal=DET_CONFD_ELEVATION_081}, {application-record-element=DET_CONFD_ELEVATION_082, system-signal=DET_CONFD_ELEVATION_082}, {application-record-element=DET_CONFD_ELEVATION_083, system-signal=DET_CONFD_ELEVATION_083}, {application-record-element=DET_CONFD_ELEVATION_084, system-signal=DET_CONFD_ELEVATION_084}, {application-record-element=DET_ELEVATION_081, system-signal=DET_ELEVATION_081}, {application-record-element=DET_ELEVATION_082, system-signal=DET_ELEVATION_082}, {application-record-element=DET_ELEVATION_083, system-signal=DET_ELEVATION_083}, {application-record-element=DET_ELEVATION_084, system-signal=DET_ELEVATION_084}, {application-record-element=DET_ELEVATION_ERR_081, system-signal=DET_ELEVATION_ERR_081}, {application-record-element=DET_ELEVATION_ERR_082, system-signal=DET_ELEVATION_ERR_082}, {application-record-element=DET_ELEVATION_ERR_083, system-signal=DET_ELEVATION_ERR_083}, {application-record-element=DET_ELEVATION_ERR_084, system-signal=DET_ELEVATION_ERR_084}, {application-record-element=DET_EXISTENCE_PROB_081, system-signal=DET_EXISTENCE_PROB_081}, {application-record-element=DET_EXISTENCE_PROB_082, system-signal=DET_EXISTENCE_PROB_082}, {application-record-element=DET_EXISTENCE_PROB_083, system-signal=DET_EXISTENCE_PROB_083}, {application-record-element=DET_EXISTENCE_PROB_084, system-signal=DET_EXISTENCE_PROB_084}, {application-record-element=DET_HVC_FLAG_081, system-signal=DET_HVC_FLAG_081}, {application-record-element=DET_HVC_FLAG_082, system-signal=DET_HVC_FLAG_082}, {application-record-element=DET_HVC_FLAG_083, system-signal=DET_HVC_FLAG_083}, {application-record-element=DET_HVC_FLAG_084, system-signal=DET_HVC_FLAG_084}, {application-record-element=DET_IDM_081, system-signal=DET_IDM_081}, {application-record-element=DET_IDM_082, system-signal=DET_IDM_082}, {application-record-element=DET_IDM_083, system-signal=DET_IDM_083}, {application-record-element=DET_IDM_084, system-signal=DET_IDM_084}, {application-record-element=DET_MH_CRC16_081_084, system-signal=DET_MH_CRC16_081_084}, {application-record-element=DET_MH_CYCLE_COUNTER_081_084, system-signal=DET_MH_CYCLE_COUNTER_081_084}, {application-record-element=DET_MH_SCAN_INDEX_4LSB_081_084, system-signal=DET_MH_SCAN_INDEX_4LSB_081_084}, {application-record-element=DET_MTD_081, system-signal=DET_MTD_081}, {application-record-element=DET_MTD_082, system-signal=DET_MTD_082}, {application-record-element=DET_MTD_083, system-signal=DET_MTD_083}, {application-record-element=DET_MTD_084, system-signal=DET_MTD_084}, {application-record-element=DET_PROB_1STAZHYPO_081, system-signal=DET_PROB_1STAZHYPO_081}, {application-record-element=DET_PROB_1STAZHYPO_082, system-signal=DET_PROB_1STAZHYPO_082}, {application-record-element=DET_PROB_1STAZHYPO_083, system-signal=DET_PROB_1STAZHYPO_083}, {application-record-element=DET_PROB_1STAZHYPO_084, system-signal=DET_PROB_1STAZHYPO_084}, {application-record-element=DET_RANGE_081, system-signal=DET_RANGE_081}, {application-record-element=DET_RANGE_082, system-signal=DET_RANGE_082}, {application-record-element=DET_RANGE_083, system-signal=DET_RANGE_083}, {application-record-element=DET_RANGE_084, system-signal=DET_RANGE_084}, {application-record-element=DET_RANGE_ERR_081, system-signal=DET_RANGE_ERR_081}, {application-record-element=DET_RANGE_ERR_082, system-signal=DET_RANGE_ERR_082}, {application-record-element=DET_RANGE_ERR_083, system-signal=DET_RANGE_ERR_083}, {application-record-element=DET_RANGE_ERR_084, system-signal=DET_RANGE_ERR_084}, {application-record-element=DET_RANGE_VELOCITY_081, system-signal=DET_RANGE_VELOCITY_081}, {application-record-element=DET_RANGE_VELOCITY_082, system-signal=DET_RANGE_VELOCITY_082}, {application-record-element=DET_RANGE_VELOCITY_083, system-signal=DET_RANGE_VELOCITY_083}, {application-record-element=DET_RANGE_VELOCITY_084, system-signal=DET_RANGE_VELOCITY_084}, {application-record-element=DET_RANGE_VELOCITY_ERR_081, system-signal=DET_RANGE_VELOCITY_ERR_081}, {application-record-element=DET_RANGE_VELOCITY_ERR_082, system-signal=DET_RANGE_VELOCITY_ERR_082}, {application-record-element=DET_RANGE_VELOCITY_ERR_083, system-signal=DET_RANGE_VELOCITY_ERR_083}, {application-record-element=DET_RANGE_VELOCITY_ERR_084, system-signal=DET_RANGE_VELOCITY_ERR_084}, {application-record-element=DET_RCS_081, system-signal=DET_RCS_081}, {application-record-element=DET_RCS_082, system-signal=DET_RCS_082}, {application-record-element=DET_RCS_083, system-signal=DET_RCS_083}, {application-record-element=DET_RCS_084, system-signal=DET_RCS_084}, {application-record-element=DET_SNR_081, system-signal=DET_SNR_081}, {application-record-element=DET_SNR_082, system-signal=DET_SNR_082}, {application-record-element=DET_SNR_083, system-signal=DET_SNR_083}, {application-record-element=DET_SNR_084, system-signal=DET_SNR_084}, {application-record-element=DET_SUPER_RES_TARGET_081, system-signal=DET_SUPER_RES_TARGET_081}, {application-record-element=DET_SUPER_RES_TARGET_082, system-signal=DET_SUPER_RES_TARGET_082}, {application-record-element=DET_SUPER_RES_TARGET_083, system-signal=DET_SUPER_RES_TARGET_083}, {application-record-element=DET_SUPER_RES_TARGET_084, system-signal=DET_SUPER_RES_TARGET_084}]}
        sender-receiver-to-signal-group-mapping={data-element=Pp_SG_Detections_085_088_AL.Vdp_SG_Detections_085_088_AL, signal-group=SG_Detections_085_088, type-mapping=sender-rec-record-type-mapping=record-element-mappings=[{application-record-element=DET_AZIMUTH_085, system-signal=DET_AZIMUTH_085}, {application-record-element=DET_AZIMUTH_086, system-signal=DET_AZIMUTH_086}, {application-record-element=DET_AZIMUTH_087, system-signal=DET_AZIMUTH_087}, {application-record-element=DET_AZIMUTH_088, system-signal=DET_AZIMUTH_088}, {application-record-element=DET_AZIMUTH_ERR_085, system-signal=DET_AZIMUTH_ERR_085}, {application-record-element=DET_AZIMUTH_ERR_086, system-signal=DET_AZIMUTH_ERR_086}, {application-record-element=DET_AZIMUTH_ERR_087, system-signal=DET_AZIMUTH_ERR_087}, {application-record-element=DET_AZIMUTH_ERR_088, system-signal=DET_AZIMUTH_ERR_088}, {application-record-element=DET_BELOW_RAIN_THOLD_085, system-signal=DET_BELOW_RAIN_THOLD_085}, {application-record-element=DET_BELOW_RAIN_THOLD_086, system-signal=DET_BELOW_RAIN_THOLD_086}, {application-record-element=DET_BELOW_RAIN_THOLD_087, system-signal=DET_BELOW_RAIN_THOLD_087}, {application-record-element=DET_BELOW_RAIN_THOLD_088, system-signal=DET_BELOW_RAIN_THOLD_088}, {application-record-element=DET_BI_STATIC_FLAG_085, system-signal=DET_BI_STATIC_FLAG_085}, {application-record-element=DET_BI_STATIC_FLAG_086, system-signal=DET_BI_STATIC_FLAG_086}, {application-record-element=DET_BI_STATIC_FLAG_087, system-signal=DET_BI_STATIC_FLAG_087}, {application-record-element=DET_BI_STATIC_FLAG_088, system-signal=DET_BI_STATIC_FLAG_088}, {application-record-element=DET_CONFD_AZIMUTH_085, system-signal=DET_CONFD_AZIMUTH_085}, {application-record-element=DET_CONFD_AZIMUTH_086, system-signal=DET_CONFD_AZIMUTH_086}, {application-record-element=DET_CONFD_AZIMUTH_087, system-signal=DET_CONFD_AZIMUTH_087}, {application-record-element=DET_CONFD_AZIMUTH_088, system-signal=DET_CONFD_AZIMUTH_088}, {application-record-element=DET_CONFD_ELEVATION_085, system-signal=DET_CONFD_ELEVATION_085}, {application-record-element=DET_CONFD_ELEVATION_086, system-signal=DET_CONFD_ELEVATION_086}, {application-record-element=DET_CONFD_ELEVATION_087, system-signal=DET_CONFD_ELEVATION_087}, {application-record-element=DET_CONFD_ELEVATION_088, system-signal=DET_CONFD_ELEVATION_088}, {application-record-element=DET_ELEVATION_085, system-signal=DET_ELEVATION_085}, {application-record-element=DET_ELEVATION_086, system-signal=DET_ELEVATION_086}, {application-record-element=DET_ELEVATION_087, system-signal=DET_ELEVATION_087}, {application-record-element=DET_ELEVATION_088, system-signal=DET_ELEVATION_088}, {application-record-element=DET_ELEVATION_ERR_085, system-signal=DET_ELEVATION_ERR_085}, {application-record-element=DET_ELEVATION_ERR_086, system-signal=DET_ELEVATION_ERR_086}, {application-record-element=DET_ELEVATION_ERR_087, system-signal=DET_ELEVATION_ERR_087}, {application-record-element=DET_ELEVATION_ERR_088, system-signal=DET_ELEVATION_ERR_088}, {application-record-element=DET_EXISTENCE_PROB_085, system-signal=DET_EXISTENCE_PROB_085}, {application-record-element=DET_EXISTENCE_PROB_086, system-signal=DET_EXISTENCE_PROB_086}, {application-record-element=DET_EXISTENCE_PROB_087, system-signal=DET_EXISTENCE_PROB_087}, {application-record-element=DET_EXISTENCE_PROB_088, system-signal=DET_EXISTENCE_PROB_088}, {application-record-element=DET_HVC_FLAG_085, system-signal=DET_HVC_FLAG_085}, {application-record-element=DET_HVC_FLAG_086, system-signal=DET_HVC_FLAG_086}, {application-record-element=DET_HVC_FLAG_087, system-signal=DET_HVC_FLAG_087}, {application-record-element=DET_HVC_FLAG_088, system-signal=DET_HVC_FLAG_088}, {application-record-element=DET_IDM_085, system-signal=DET_IDM_085}, {application-record-element=DET_IDM_086, system-signal=DET_IDM_086}, {application-record-element=DET_IDM_087, system-signal=DET_IDM_087}, {application-record-element=DET_IDM_088, system-signal=DET_IDM_088}, {application-record-element=DET_MH_CRC16_085_088, system-signal=DET_MH_CRC16_085_088}, {application-record-element=DET_MH_CYCLE_COUNTER_085_088, system-signal=DET_MH_CYCLE_COUNTER_085_088}, {application-record-element=DET_MH_SCAN_INDEX_4LSB_085_088, system-signal=DET_MH_SCAN_INDEX_4LSB_085_088}, {application-record-element=DET_MTD_085, system-signal=DET_MTD_085}, {application-record-element=DET_MTD_086, system-signal=DET_MTD_086}, {application-record-element=DET_MTD_087, system-signal=DET_MTD_087}, {application-record-element=DET_MTD_088, system-signal=DET_MTD_088}, {application-record-element=DET_PROB_1STAZHYPO_085, system-signal=DET_PROB_1STAZHYPO_085}, {application-record-element=DET_PROB_1STAZHYPO_086, system-signal=DET_PROB_1STAZHYPO_086}, {application-record-element=DET_PROB_1STAZHYPO_087, system-signal=DET_PROB_1STAZHYPO_087}, {application-record-element=DET_PROB_1STAZHYPO_088, system-signal=DET_PROB_1STAZHYPO_088}, {application-record-element=DET_RANGE_085, system-signal=DET_RANGE_085}, {application-record-element=DET_RANGE_086, system-signal=DET_RANGE_086}, {application-record-element=DET_RANGE_087, system-signal=DET_RANGE_087}, {application-record-element=DET_RANGE_088, system-signal=DET_RANGE_088}, {application-record-element=DET_RANGE_ERR_085, system-signal=DET_RANGE_ERR_085}, {application-record-element=DET_RANGE_ERR_086, system-signal=DET_RANGE_ERR_086}, {application-record-element=DET_RANGE_ERR_087, system-signal=DET_RANGE_ERR_087}, {application-record-element=DET_RANGE_ERR_088, system-signal=DET_RANGE_ERR_088}, {application-record-element=DET_RANGE_VELOCITY_085, system-signal=DET_RANGE_VELOCITY_085}, {application-record-element=DET_RANGE_VELOCITY_086, system-signal=DET_RANGE_VELOCITY_086}, {application-record-element=DET_RANGE_VELOCITY_087, system-signal=DET_RANGE_VELOCITY_087}, {application-record-element=DET_RANGE_VELOCITY_088, system-signal=DET_RANGE_VELOCITY_088}, {application-record-element=DET_RANGE_VELOCITY_ERR_085, system-signal=DET_RANGE_VELOCITY_ERR_085}, {application-record-element=DET_RANGE_VELOCITY_ERR_086, system-signal=DET_RANGE_VELOCITY_ERR_086}, {application-record-element=DET_RANGE_VELOCITY_ERR_087, system-signal=DET_RANGE_VELOCITY_ERR_087}, {application-record-element=DET_RANGE_VELOCITY_ERR_088, system-signal=DET_RANGE_VELOCITY_ERR_088}, {application-record-element=DET_RCS_085, system-signal=DET_RCS_085}, {application-record-element=DET_RCS_086, system-signal=DET_RCS_086}, {application-record-element=DET_RCS_087, system-signal=DET_RCS_087}, {application-record-element=DET_RCS_088, system-signal=DET_RCS_088}, {application-record-element=DET_SNR_085, system-signal=DET_SNR_085}, {application-record-element=DET_SNR_086, system-signal=DET_SNR_086}, {application-record-element=DET_SNR_087, system-signal=DET_SNR_087}, {application-record-element=DET_SNR_088, system-signal=DET_SNR_088}, {application-record-element=DET_SUPER_RES_TARGET_085, system-signal=DET_SUPER_RES_TARGET_085}, {application-record-element=DET_SUPER_RES_TARGET_086, system-signal=DET_SUPER_RES_TARGET_086}, {application-record-element=DET_SUPER_RES_TARGET_087, system-signal=DET_SUPER_RES_TARGET_087}, {application-record-element=DET_SUPER_RES_TARGET_088, system-signal=DET_SUPER_RES_TARGET_088}]}
        sender-receiver-to-signal-group-mapping={data-element=Pp_SG_Detections_089_092_AL.Vdp_SG_Detections_089_092_AL, signal-group=SG_Detections_089_092, type-mapping=sender-rec-record-type-mapping=record-element-mappings=[{application-record-element=DET_AZIMUTH_089, system-signal=DET_AZIMUTH_089}, {application-record-element=DET_AZIMUTH_090, system-signal=DET_AZIMUTH_090}, {application-record-element=DET_AZIMUTH_091, system-signal=DET_AZIMUTH_091}, {application-record-element=DET_AZIMUTH_092, system-signal=DET_AZIMUTH_092}, {application-record-element=DET_AZIMUTH_ERR_089, system-signal=DET_AZIMUTH_ERR_089}, {application-record-element=DET_AZIMUTH_ERR_090, system-signal=DET_AZIMUTH_ERR_090}, {application-record-element=DET_AZIMUTH_ERR_091, system-signal=DET_AZIMUTH_ERR_091}, {application-record-element=DET_AZIMUTH_ERR_092, system-signal=DET_AZIMUTH_ERR_092}, {application-record-element=DET_BELOW_RAIN_THOLD_089, system-signal=DET_BELOW_RAIN_THOLD_089}, {application-record-element=DET_BELOW_RAIN_THOLD_090, system-signal=DET_BELOW_RAIN_THOLD_090}, {application-record-element=DET_BELOW_RAIN_THOLD_091, system-signal=DET_BELOW_RAIN_THOLD_091}, {application-record-element=DET_BELOW_RAIN_THOLD_092, system-signal=DET_BELOW_RAIN_THOLD_092}, {application-record-element=DET_BI_STATIC_FLAG_089, system-signal=DET_BI_STATIC_FLAG_089}, {application-record-element=DET_BI_STATIC_FLAG_090, system-signal=DET_BI_STATIC_FLAG_090}, {application-record-element=DET_BI_STATIC_FLAG_091, system-signal=DET_BI_STATIC_FLAG_091}, {application-record-element=DET_BI_STATIC_FLAG_092, system-signal=DET_BI_STATIC_FLAG_092}, {application-record-element=DET_CONFD_AZIMUTH_089, system-signal=DET_CONFD_AZIMUTH_089}, {application-record-element=DET_CONFD_AZIMUTH_090, system-signal=DET_CONFD_AZIMUTH_090}, {application-record-element=DET_CONFD_AZIMUTH_091, system-signal=DET_CONFD_AZIMUTH_091}, {application-record-element=DET_CONFD_AZIMUTH_092, system-signal=DET_CONFD_AZIMUTH_092}, {application-record-element=DET_CONFD_ELEVATION_089, system-signal=DET_CONFD_ELEVATION_089}, {application-record-element=DET_CONFD_ELEVATION_090, system-signal=DET_CONFD_ELEVATION_090}, {application-record-element=DET_CONFD_ELEVATION_091, system-signal=DET_CONFD_ELEVATION_091}, {application-record-element=DET_CONFD_ELEVATION_092, system-signal=DET_CONFD_ELEVATION_092}, {application-record-element=DET_ELEVATION_089, system-signal=DET_ELEVATION_089}, {application-record-element=DET_ELEVATION_090, system-signal=DET_ELEVATION_090}, {application-record-element=DET_ELEVATION_091, system-signal=DET_ELEVATION_091}, {application-record-element=DET_ELEVATION_092, system-signal=DET_ELEVATION_092}, {application-record-element=DET_ELEVATION_ERR_089, system-signal=DET_ELEVATION_ERR_089}, {application-record-element=DET_ELEVATION_ERR_090, system-signal=DET_ELEVATION_ERR_090}, {application-record-element=DET_ELEVATION_ERR_091, system-signal=DET_ELEVATION_ERR_091}, {application-record-element=DET_ELEVATION_ERR_092, system-signal=DET_ELEVATION_ERR_092}, {application-record-element=DET_EXISTENCE_PROB_089, system-signal=DET_EXISTENCE_PROB_089}, {application-record-element=DET_EXISTENCE_PROB_090, system-signal=DET_EXISTENCE_PROB_090}, {application-record-element=DET_EXISTENCE_PROB_091, system-signal=DET_EXISTENCE_PROB_091}, {application-record-element=DET_EXISTENCE_PROB_092, system-signal=DET_EXISTENCE_PROB_092}, {application-record-element=DET_HVC_FLAG_089, system-signal=DET_HVC_FLAG_089}, {application-record-element=DET_HVC_FLAG_090, system-signal=DET_HVC_FLAG_090}, {application-record-element=DET_HVC_FLAG_091, system-signal=DET_HVC_FLAG_091}, {application-record-element=DET_HVC_FLAG_092, system-signal=DET_HVC_FLAG_092}, {application-record-element=DET_IDM_089, system-signal=DET_IDM_089}, {application-record-element=DET_IDM_090, system-signal=DET_IDM_090}, {application-record-element=DET_IDM_091, system-signal=DET_IDM_091}, {application-record-element=DET_IDM_092, system-signal=DET_IDM_092}, {application-record-element=DET_MH_CRC16_089_092, system-signal=DET_MH_CRC16_089_092}, {application-record-element=DET_MH_CYCLE_COUNTER_089_092, system-signal=DET_MH_CYCLE_COUNTER_089_092}, {application-record-element=DET_MH_SCAN_INDEX_4LSB_089_092, system-signal=DET_MH_SCAN_INDEX_4LSB_089_092}, {application-record-element=DET_MTD_089, system-signal=DET_MTD_089}, {application-record-element=DET_MTD_090, system-signal=DET_MTD_090}, {application-record-element=DET_MTD_091, system-signal=DET_MTD_091}, {application-record-element=DET_MTD_092, system-signal=DET_MTD_092}, {application-record-element=DET_PROB_1STAZHYPO_089, system-signal=DET_PROB_1STAZHYPO_089}, {application-record-element=DET_PROB_1STAZHYPO_090, system-signal=DET_PROB_1STAZHYPO_090}, {application-record-element=DET_PROB_1STAZHYPO_091, system-signal=DET_PROB_1STAZHYPO_091}, {application-record-element=DET_PROB_1STAZHYPO_092, system-signal=DET_PROB_1STAZHYPO_092}, {application-record-element=DET_RANGE_089, system-signal=DET_RANGE_089}, {application-record-element=DET_RANGE_090, system-signal=DET_RANGE_090}, {application-record-element=DET_RANGE_091, system-signal=DET_RANGE_091}, {application-record-element=DET_RANGE_092, system-signal=DET_RANGE_092}, {application-record-element=DET_RANGE_ERR_089, system-signal=DET_RANGE_ERR_089}, {application-record-element=DET_RANGE_ERR_090, system-signal=DET_RANGE_ERR_090}, {application-record-element=DET_RANGE_ERR_091, system-signal=DET_RANGE_ERR_091}, {application-record-element=DET_RANGE_ERR_092, system-signal=DET_RANGE_ERR_092}, {application-record-element=DET_RANGE_VELOCITY_089, system-signal=DET_RANGE_VELOCITY_089}, {application-record-element=DET_RANGE_VELOCITY_090, system-signal=DET_RANGE_VELOCITY_090}, {application-record-element=DET_RANGE_VELOCITY_091, system-signal=DET_RANGE_VELOCITY_091}, {application-record-element=DET_RANGE_VELOCITY_092, system-signal=DET_RANGE_VELOCITY_092}, {application-record-element=DET_RANGE_VELOCITY_ERR_089, system-signal=DET_RANGE_VELOCITY_ERR_089}, {application-record-element=DET_RANGE_VELOCITY_ERR_090, system-signal=DET_RANGE_VELOCITY_ERR_090}, {application-record-element=DET_RANGE_VELOCITY_ERR_091, system-signal=DET_RANGE_VELOCITY_ERR_091}, {application-record-element=DET_RANGE_VELOCITY_ERR_092, system-signal=DET_RANGE_VELOCITY_ERR_092}, {application-record-element=DET_RCS_089, system-signal=DET_RCS_089}, {application-record-element=DET_RCS_090, system-signal=DET_RCS_090}, {application-record-element=DET_RCS_091, system-signal=DET_RCS_091}, {application-record-element=DET_RCS_092, system-signal=DET_RCS_092}, {application-record-element=DET_SNR_089, system-signal=DET_SNR_089}, {application-record-element=DET_SNR_090, system-signal=DET_SNR_090}, {application-record-element=DET_SNR_091, system-signal=DET_SNR_091}, {application-record-element=DET_SNR_092, system-signal=DET_SNR_092}, {application-record-element=DET_SUPER_RES_TARGET_089, system-signal=DET_SUPER_RES_TARGET_089}, {application-record-element=DET_SUPER_RES_TARGET_090, system-signal=DET_SUPER_RES_TARGET_090}, {application-record-element=DET_SUPER_RES_TARGET_091, system-signal=DET_SUPER_RES_TARGET_091}, {application-record-element=DET_SUPER_RES_TARGET_092, system-signal=DET_SUPER_RES_TARGET_092}]}
        sender-receiver-to-signal-group-mapping={data-element=Pp_SG_Detections_093_096_AL.Vdp_SG_Detections_093_096_AL, signal-group=SG_Detections_093_096, type-mapping=sender-rec-record-type-mapping=record-element-mappings=[{application-record-element=DET_AZIMUTH_093, system-signal=DET_AZIMUTH_093}, {application-record-element=DET_AZIMUTH_094, system-signal=DET_AZIMUTH_094}, {application-record-element=DET_AZIMUTH_095, system-signal=DET_AZIMUTH_095}, {application-record-element=DET_AZIMUTH_096, system-signal=DET_AZIMUTH_096}, {application-record-element=DET_AZIMUTH_ERR_093, system-signal=DET_AZIMUTH_ERR_093}, {application-record-element=DET_AZIMUTH_ERR_094, system-signal=DET_AZIMUTH_ERR_094}, {application-record-element=DET_AZIMUTH_ERR_095, system-signal=DET_AZIMUTH_ERR_095}, {application-record-element=DET_AZIMUTH_ERR_096, system-signal=DET_AZIMUTH_ERR_096}, {application-record-element=DET_BELOW_RAIN_THOLD_093, system-signal=DET_BELOW_RAIN_THOLD_093}, {application-record-element=DET_BELOW_RAIN_THOLD_094, system-signal=DET_BELOW_RAIN_THOLD_094}, {application-record-element=DET_BELOW_RAIN_THOLD_095, system-signal=DET_BELOW_RAIN_THOLD_095}, {application-record-element=DET_BELOW_RAIN_THOLD_096, system-signal=DET_BELOW_RAIN_THOLD_096}, {application-record-element=DET_BI_STATIC_FLAG_093, system-signal=DET_BI_STATIC_FLAG_093}, {application-record-element=DET_BI_STATIC_FLAG_094, system-signal=DET_BI_STATIC_FLAG_094}, {application-record-element=DET_BI_STATIC_FLAG_095, system-signal=DET_BI_STATIC_FLAG_095}, {application-record-element=DET_BI_STATIC_FLAG_096, system-signal=DET_BI_STATIC_FLAG_096}, {application-record-element=DET_CONFD_AZIMUTH_093, system-signal=DET_CONFD_AZIMUTH_093}, {application-record-element=DET_CONFD_AZIMUTH_094, system-signal=DET_CONFD_AZIMUTH_094}, {application-record-element=DET_CONFD_AZIMUTH_095, system-signal=DET_CONFD_AZIMUTH_095}, {application-record-element=DET_CONFD_AZIMUTH_096, system-signal=DET_CONFD_AZIMUTH_096}, {application-record-element=DET_CONFD_ELEVATION_093, system-signal=DET_CONFD_ELEVATION_093}, {application-record-element=DET_CONFD_ELEVATION_094, system-signal=DET_CONFD_ELEVATION_094}, {application-record-element=DET_CONFD_ELEVATION_095, system-signal=DET_CONFD_ELEVATION_095}, {application-record-element=DET_CONFD_ELEVATION_096, system-signal=DET_CONFD_ELEVATION_096}, {application-record-element=DET_ELEVATION_093, system-signal=DET_ELEVATION_093}, {application-record-element=DET_ELEVATION_094, system-signal=DET_ELEVATION_094}, {application-record-element=DET_ELEVATION_095, system-signal=DET_ELEVATION_095}, {application-record-element=DET_ELEVATION_096, system-signal=DET_ELEVATION_096}, {application-record-element=DET_ELEVATION_ERR_093, system-signal=DET_ELEVATION_ERR_093}, {application-record-element=DET_ELEVATION_ERR_094, system-signal=DET_ELEVATION_ERR_094}, {application-record-element=DET_ELEVATION_ERR_095, system-signal=DET_ELEVATION_ERR_095}, {application-record-element=DET_ELEVATION_ERR_096, system-signal=DET_ELEVATION_ERR_096}, {application-record-element=DET_EXISTENCE_PROB_093, system-signal=DET_EXISTENCE_PROB_093}, {application-record-element=DET_EXISTENCE_PROB_094, system-signal=DET_EXISTENCE_PROB_094}, {application-record-element=DET_EXISTENCE_PROB_095, system-signal=DET_EXISTENCE_PROB_095}, {application-record-element=DET_EXISTENCE_PROB_096, system-signal=DET_EXISTENCE_PROB_096}, {application-record-element=DET_HVC_FLAG_093, system-signal=DET_HVC_FLAG_093}, {application-record-element=DET_HVC_FLAG_094, system-signal=DET_HVC_FLAG_094}, {application-record-element=DET_HVC_FLAG_095, system-signal=DET_HVC_FLAG_095}, {application-record-element=DET_HVC_FLAG_096, system-signal=DET_HVC_FLAG_096}, {application-record-element=DET_IDM_093, system-signal=DET_IDM_093}, {application-record-element=DET_IDM_094, system-signal=DET_IDM_094}, {application-record-element=DET_IDM_095, system-signal=DET_IDM_095}, {application-record-element=DET_IDM_096, system-signal=DET_IDM_096}, {application-record-element=DET_MH_CRC16_093_096, system-signal=DET_MH_CRC16_093_096}, {application-record-element=DET_MH_CYCLE_COUNTER_093_096, system-signal=DET_MH_CYCLE_COUNTER_093_096}, {application-record-element=DET_MH_SCAN_INDEX_4LSB_093_096, system-signal=DET_MH_SCAN_INDEX_4LSB_093_096}, {application-record-element=DET_MTD_093, system-signal=DET_MTD_093}, {application-record-element=DET_MTD_094, system-signal=DET_MTD_094}, {application-record-element=DET_MTD_095, system-signal=DET_MTD_095}, {application-record-element=DET_MTD_096, system-signal=DET_MTD_096}, {application-record-element=DET_PROB_1STAZHYPO_093, system-signal=DET_PROB_1STAZHYPO_093}, {application-record-element=DET_PROB_1STAZHYPO_094, system-signal=DET_PROB_1STAZHYPO_094}, {application-record-element=DET_PROB_1STAZHYPO_095, system-signal=DET_PROB_1STAZHYPO_095}, {application-record-element=DET_PROB_1STAZHYPO_096, system-signal=DET_PROB_1STAZHYPO_096}, {application-record-element=DET_RANGE_093, system-signal=DET_RANGE_093}, {application-record-element=DET_RANGE_094, system-signal=DET_RANGE_094}, {application-record-element=DET_RANGE_095, system-signal=DET_RANGE_095}, {application-record-element=DET_RANGE_096, system-signal=DET_RANGE_096}, {application-record-element=DET_RANGE_ERR_093, system-signal=DET_RANGE_ERR_093}, {application-record-element=DET_RANGE_ERR_094, system-signal=DET_RANGE_ERR_094}, {application-record-element=DET_RANGE_ERR_095, system-signal=DET_RANGE_ERR_095}, {application-record-element=DET_RANGE_ERR_096, system-signal=DET_RANGE_ERR_096}, {application-record-element=DET_RANGE_VELOCITY_093, system-signal=DET_RANGE_VELOCITY_093}, {application-record-element=DET_RANGE_VELOCITY_094, system-signal=DET_RANGE_VELOCITY_094}, {application-record-element=DET_RANGE_VELOCITY_095, system-signal=DET_RANGE_VELOCITY_095}, {application-record-element=DET_RANGE_VELOCITY_096, system-signal=DET_RANGE_VELOCITY_096}, {application-record-element=DET_RANGE_VELOCITY_ERR_093, system-signal=DET_RANGE_VELOCITY_ERR_093}, {application-record-element=DET_RANGE_VELOCITY_ERR_094, system-signal=DET_RANGE_VELOCITY_ERR_094}, {application-record-element=DET_RANGE_VELOCITY_ERR_095, system-signal=DET_RANGE_VELOCITY_ERR_095}, {application-record-element=DET_RANGE_VELOCITY_ERR_096, system-signal=DET_RANGE_VELOCITY_ERR_096}, {application-record-element=DET_RCS_093, system-signal=DET_RCS_093}, {application-record-element=DET_RCS_094, system-signal=DET_RCS_094}, {application-record-element=DET_RCS_095, system-signal=DET_RCS_095}, {application-record-element=DET_RCS_096, system-signal=DET_RCS_096}, {application-record-element=DET_SNR_093, system-signal=DET_SNR_093}, {application-record-element=DET_SNR_094, system-signal=DET_SNR_094}, {application-record-element=DET_SNR_095, system-signal=DET_SNR_095}, {application-record-element=DET_SNR_096, system-signal=DET_SNR_096}, {application-record-element=DET_SUPER_RES_TARGET_093, system-signal=DET_SUPER_RES_TARGET_093}, {application-record-element=DET_SUPER_RES_TARGET_094, system-signal=DET_SUPER_RES_TARGET_094}, {application-record-element=DET_SUPER_RES_TARGET_095, system-signal=DET_SUPER_RES_TARGET_095}, {application-record-element=DET_SUPER_RES_TARGET_096, system-signal=DET_SUPER_RES_TARGET_096}]}
        sender-receiver-to-signal-group-mapping={data-element=Pp_SG_Detections_101_104_AL.Vdp_SG_Detections_101_104_AL, signal-group=SG_Detections_101_104, type-mapping=sender-rec-record-type-mapping=record-element-mappings=[{application-record-element=DET_AZIMUTH_101, system-signal=DET_AZIMUTH_101}, {application-record-element=DET_AZIMUTH_102, system-signal=DET_AZIMUTH_102}, {application-record-element=DET_AZIMUTH_103, system-signal=DET_AZIMUTH_103}, {application-record-element=DET_AZIMUTH_104, system-signal=DET_AZIMUTH_104}, {application-record-element=DET_AZIMUTH_ERR_101, system-signal=DET_AZIMUTH_ERR_101}, {application-record-element=DET_AZIMUTH_ERR_102, system-signal=DET_AZIMUTH_ERR_102}, {application-record-element=DET_AZIMUTH_ERR_103, system-signal=DET_AZIMUTH_ERR_103}, {application-record-element=DET_AZIMUTH_ERR_104, system-signal=DET_AZIMUTH_ERR_104}, {application-record-element=DET_BELOW_RAIN_THOLD_101, system-signal=DET_BELOW_RAIN_THOLD_101}, {application-record-element=DET_BELOW_RAIN_THOLD_102, system-signal=DET_BELOW_RAIN_THOLD_102}, {application-record-element=DET_BELOW_RAIN_THOLD_103, system-signal=DET_BELOW_RAIN_THOLD_103}, {application-record-element=DET_BELOW_RAIN_THOLD_104, system-signal=DET_BELOW_RAIN_THOLD_104}, {application-record-element=DET_BI_STATIC_FLAG_101, system-signal=DET_BI_STATIC_FLAG_101}, {application-record-element=DET_BI_STATIC_FLAG_102, system-signal=DET_BI_STATIC_FLAG_102}, {application-record-element=DET_BI_STATIC_FLAG_103, system-signal=DET_BI_STATIC_FLAG_103}, {application-record-element=DET_BI_STATIC_FLAG_104, system-signal=DET_BI_STATIC_FLAG_104}, {application-record-element=DET_CONFD_AZIMUTH_101, system-signal=DET_CONFD_AZIMUTH_101}, {application-record-element=DET_CONFD_AZIMUTH_102, system-signal=DET_CONFD_AZIMUTH_102}, {application-record-element=DET_CONFD_AZIMUTH_103, system-signal=DET_CONFD_AZIMUTH_103}, {application-record-element=DET_CONFD_AZIMUTH_104, system-signal=DET_CONFD_AZIMUTH_104}, {application-record-element=DET_CONFD_ELEVATION_101, system-signal=DET_CONFD_ELEVATION_101}, {application-record-element=DET_CONFD_ELEVATION_102, system-signal=DET_CONFD_ELEVATION_102}, {application-record-element=DET_CONFD_ELEVATION_103, system-signal=DET_CONFD_ELEVATION_103}, {application-record-element=DET_CONFD_ELEVATION_104, system-signal=DET_CONFD_ELEVATION_104}, {application-record-element=DET_ELEVATION_101, system-signal=DET_ELEVATION_101}, {application-record-element=DET_ELEVATION_102, system-signal=DET_ELEVATION_102}, {application-record-element=DET_ELEVATION_103, system-signal=DET_ELEVATION_103}, {application-record-element=DET_ELEVATION_104, system-signal=DET_ELEVATION_104}, {application-record-element=DET_ELEVATION_ERR_101, system-signal=DET_ELEVATION_ERR_101}, {application-record-element=DET_ELEVATION_ERR_102, system-signal=DET_ELEVATION_ERR_102}, {application-record-element=DET_ELEVATION_ERR_103, system-signal=DET_ELEVATION_ERR_103}, {application-record-element=DET_ELEVATION_ERR_104, system-signal=DET_ELEVATION_ERR_104}, {application-record-element=DET_EXISTENCE_PROB_101, system-signal=DET_EXISTENCE_PROB_101}, {application-record-element=DET_EXISTENCE_PROB_102, system-signal=DET_EXISTENCE_PROB_102}, {application-record-element=DET_EXISTENCE_PROB_103, system-signal=DET_EXISTENCE_PROB_103}, {application-record-element=DET_EXISTENCE_PROB_104, system-signal=DET_EXISTENCE_PROB_104}, {application-record-element=DET_HVC_FLAG_101, system-signal=DET_HVC_FLAG_101}, {application-record-element=DET_HVC_FLAG_102, system-signal=DET_HVC_FLAG_102}, {application-record-element=DET_HVC_FLAG_103, system-signal=DET_HVC_FLAG_103}, {application-record-element=DET_HVC_FLAG_104, system-signal=DET_HVC_FLAG_104}, {application-record-element=DET_IDM_101, system-signal=DET_IDM_101}, {application-record-element=DET_IDM_102, system-signal=DET_IDM_102}, {application-record-element=DET_IDM_103, system-signal=DET_IDM_103}, {application-record-element=DET_IDM_104, system-signal=DET_IDM_104}, {application-record-element=DET_MH_CRC16_101_104, system-signal=DET_MH_CRC16_101_104}, {application-record-element=DET_MH_CYCLE_COUNTER_101_104, system-signal=DET_MH_CYCLE_COUNTER_101_104}, {application-record-element=DET_MH_SCAN_INDEX_4LSB_101_104, system-signal=DET_MH_SCAN_INDEX_4LSB_101_104}, {application-record-element=DET_MTD_101, system-signal=DET_MTD_101}, {application-record-element=DET_MTD_102, system-signal=DET_MTD_102}, {application-record-element=DET_MTD_103, system-signal=DET_MTD_103}, {application-record-element=DET_MTD_104, system-signal=DET_MTD_104}, {application-record-element=DET_PROB_1STAZHYPO_101, system-signal=DET_PROB_1STAZHYPO_101}, {application-record-element=DET_PROB_1STAZHYPO_102, system-signal=DET_PROB_1STAZHYPO_102}, {application-record-element=DET_PROB_1STAZHYPO_103, system-signal=DET_PROB_1STAZHYPO_103}, {application-record-element=DET_PROB_1STAZHYPO_104, system-signal=DET_PROB_1STAZHYPO_104}, {application-record-element=DET_RANGE_101, system-signal=DET_RANGE_101}, {application-record-element=DET_RANGE_102, system-signal=DET_RANGE_102}, {application-record-element=DET_RANGE_103, system-signal=DET_RANGE_103}, {application-record-element=DET_RANGE_104, system-signal=DET_RANGE_104}, {application-record-element=DET_RANGE_ERR_101, system-signal=DET_RANGE_ERR_101}, {application-record-element=DET_RANGE_ERR_102, system-signal=DET_RANGE_ERR_102}, {application-record-element=DET_RANGE_ERR_103, system-signal=DET_RANGE_ERR_103}, {application-record-element=DET_RANGE_ERR_104, system-signal=DET_RANGE_ERR_104}, {application-record-element=DET_RANGE_VELOCITY_101, system-signal=DET_RANGE_VELOCITY_101}, {application-record-element=DET_RANGE_VELOCITY_102, system-signal=DET_RANGE_VELOCITY_102}, {application-record-element=DET_RANGE_VELOCITY_103, system-signal=DET_RANGE_VELOCITY_103}, {application-record-element=DET_RANGE_VELOCITY_104, system-signal=DET_RANGE_VELOCITY_104}, {application-record-element=DET_RANGE_VELOCITY_ERR_101, system-signal=DET_RANGE_VELOCITY_ERR_101}, {application-record-element=DET_RANGE_VELOCITY_ERR_102, system-signal=DET_RANGE_VELOCITY_ERR_102}, {application-record-element=DET_RANGE_VELOCITY_ERR_103, system-signal=DET_RANGE_VELOCITY_ERR_103}, {application-record-element=DET_RANGE_VELOCITY_ERR_104, system-signal=DET_RANGE_VELOCITY_ERR_104}, {application-record-element=DET_RCS_101, system-signal=DET_RCS_101}, {application-record-element=DET_RCS_102, system-signal=DET_RCS_102}, {application-record-element=DET_RCS_103, system-signal=DET_RCS_103}, {application-record-element=DET_RCS_104, system-signal=DET_RCS_104}, {application-record-element=DET_SNR_101, system-signal=DET_SNR_101}, {application-record-element=DET_SNR_102, system-signal=DET_SNR_102}, {application-record-element=DET_SNR_103, system-signal=DET_SNR_103}, {application-record-element=DET_SNR_104, system-signal=DET_SNR_104}, {application-record-element=DET_SUPER_RES_TARGET_101, system-signal=DET_SUPER_RES_TARGET_101}, {application-record-element=DET_SUPER_RES_TARGET_102, system-signal=DET_SUPER_RES_TARGET_102}, {application-record-element=DET_SUPER_RES_TARGET_103, system-signal=DET_SUPER_RES_TARGET_103}, {application-record-element=DET_SUPER_RES_TARGET_104, system-signal=DET_SUPER_RES_TARGET_104}]}
        sender-receiver-to-signal-group-mapping={data-element=Pp_SG_Detections_105_108_AL.Vdp_SG_Detections_105_108_AL, signal-group=SG_Detections_105_108, type-mapping=sender-rec-record-type-mapping=record-element-mappings=[{application-record-element=DET_AZIMUTH_105, system-signal=DET_AZIMUTH_105}, {application-record-element=DET_AZIMUTH_106, system-signal=DET_AZIMUTH_106}, {application-record-element=DET_AZIMUTH_107, system-signal=DET_AZIMUTH_107}, {application-record-element=DET_AZIMUTH_108, system-signal=DET_AZIMUTH_108}, {application-record-element=DET_AZIMUTH_ERR_105, system-signal=DET_AZIMUTH_ERR_105}, {application-record-element=DET_AZIMUTH_ERR_106, system-signal=DET_AZIMUTH_ERR_106}, {application-record-element=DET_AZIMUTH_ERR_107, system-signal=DET_AZIMUTH_ERR_107}, {application-record-element=DET_AZIMUTH_ERR_108, system-signal=DET_AZIMUTH_ERR_108}, {application-record-element=DET_BELOW_RAIN_THOLD_105, system-signal=DET_BELOW_RAIN_THOLD_105}, {application-record-element=DET_BELOW_RAIN_THOLD_106, system-signal=DET_BELOW_RAIN_THOLD_106}, {application-record-element=DET_BELOW_RAIN_THOLD_107, system-signal=DET_BELOW_RAIN_THOLD_107}, {application-record-element=DET_BELOW_RAIN_THOLD_108, system-signal=DET_BELOW_RAIN_THOLD_108}, {application-record-element=DET_BI_STATIC_FLAG_105, system-signal=DET_BI_STATIC_FLAG_105}, {application-record-element=DET_BI_STATIC_FLAG_106, system-signal=DET_BI_STATIC_FLAG_106}, {application-record-element=DET_BI_STATIC_FLAG_107, system-signal=DET_BI_STATIC_FLAG_107}, {application-record-element=DET_BI_STATIC_FLAG_108, system-signal=DET_BI_STATIC_FLAG_108}, {application-record-element=DET_CONFD_AZIMUTH_105, system-signal=DET_CONFD_AZIMUTH_105}, {application-record-element=DET_CONFD_AZIMUTH_106, system-signal=DET_CONFD_AZIMUTH_106}, {application-record-element=DET_CONFD_AZIMUTH_107, system-signal=DET_CONFD_AZIMUTH_107}, {application-record-element=DET_CONFD_AZIMUTH_108, system-signal=DET_CONFD_AZIMUTH_108}, {application-record-element=DET_CONFD_ELEVATION_105, system-signal=DET_CONFD_ELEVATION_105}, {application-record-element=DET_CONFD_ELEVATION_106, system-signal=DET_CONFD_ELEVATION_106}, {application-record-element=DET_CONFD_ELEVATION_107, system-signal=DET_CONFD_ELEVATION_107}, {application-record-element=DET_CONFD_ELEVATION_108, system-signal=DET_CONFD_ELEVATION_108}, {application-record-element=DET_ELEVATION_105, system-signal=DET_ELEVATION_105}, {application-record-element=DET_ELEVATION_106, system-signal=DET_ELEVATION_106}, {application-record-element=DET_ELEVATION_107, system-signal=DET_ELEVATION_107}, {application-record-element=DET_ELEVATION_108, system-signal=DET_ELEVATION_108}, {application-record-element=DET_ELEVATION_ERR_105, system-signal=DET_ELEVATION_ERR_105}, {application-record-element=DET_ELEVATION_ERR_106, system-signal=DET_ELEVATION_ERR_106}, {application-record-element=DET_ELEVATION_ERR_107, system-signal=DET_ELEVATION_ERR_107}, {application-record-element=DET_ELEVATION_ERR_108, system-signal=DET_ELEVATION_ERR_108}, {application-record-element=DET_EXISTENCE_PROB_105, system-signal=DET_EXISTENCE_PROB_105}, {application-record-element=DET_EXISTENCE_PROB_106, system-signal=DET_EXISTENCE_PROB_106}, {application-record-element=DET_EXISTENCE_PROB_107, system-signal=DET_EXISTENCE_PROB_107}, {application-record-element=DET_EXISTENCE_PROB_108, system-signal=DET_EXISTENCE_PROB_108}, {application-record-element=DET_HVC_FLAG_105, system-signal=DET_HVC_FLAG_105}, {application-record-element=DET_HVC_FLAG_106, system-signal=DET_HVC_FLAG_106}, {application-record-element=DET_HVC_FLAG_107, system-signal=DET_HVC_FLAG_107}, {application-record-element=DET_HVC_FLAG_108, system-signal=DET_HVC_FLAG_108}, {application-record-element=DET_IDM_105, system-signal=DET_IDM_105}, {application-record-element=DET_IDM_106, system-signal=DET_IDM_106}, {application-record-element=DET_IDM_107, system-signal=DET_IDM_107}, {application-record-element=DET_IDM_108, system-signal=DET_IDM_108}, {application-record-element=DET_MH_CRC16_105_108, system-signal=DET_MH_CRC16_105_108}, {application-record-element=DET_MH_CYCLE_COUNTER_105_108, system-signal=DET_MH_CYCLE_COUNTER_105_108}, {application-record-element=DET_MH_SCAN_INDEX_4LSB_105_108, system-signal=DET_MH_SCAN_INDEX_4LSB_105_108}, {application-record-element=DET_MTD_105, system-signal=DET_MTD_105}, {application-record-element=DET_MTD_106, system-signal=DET_MTD_106}, {application-record-element=DET_MTD_107, system-signal=DET_MTD_107}, {application-record-element=DET_MTD_108, system-signal=DET_MTD_108}, {application-record-element=DET_PROB_1STAZHYPO_105, system-signal=DET_PROB_1STAZHYPO_105}, {application-record-element=DET_PROB_1STAZHYPO_106, system-signal=DET_PROB_1STAZHYPO_106}, {application-record-element=DET_PROB_1STAZHYPO_107, system-signal=DET_PROB_1STAZHYPO_107}, {application-record-element=DET_PROB_1STAZHYPO_108, system-signal=DET_PROB_1STAZHYPO_108}, {application-record-element=DET_RANGE_105, system-signal=DET_RANGE_105}, {application-record-element=DET_RANGE_106, system-signal=DET_RANGE_106}, {application-record-element=DET_RANGE_107, system-signal=DET_RANGE_107}, {application-record-element=DET_RANGE_108, system-signal=DET_RANGE_108}, {application-record-element=DET_RANGE_ERR_105, system-signal=DET_RANGE_ERR_105}, {application-record-element=DET_RANGE_ERR_106, system-signal=DET_RANGE_ERR_106}, {application-record-element=DET_RANGE_ERR_107, system-signal=DET_RANGE_ERR_107}, {application-record-element=DET_RANGE_ERR_108, system-signal=DET_RANGE_ERR_108}, {application-record-element=DET_RANGE_VELOCITY_105, system-signal=DET_RANGE_VELOCITY_105}, {application-record-element=DET_RANGE_VELOCITY_106, system-signal=DET_RANGE_VELOCITY_106}, {application-record-element=DET_RANGE_VELOCITY_107, system-signal=DET_RANGE_VELOCITY_107}, {application-record-element=DET_RANGE_VELOCITY_108, system-signal=DET_RANGE_VELOCITY_108}, {application-record-element=DET_RANGE_VELOCITY_ERR_105, system-signal=DET_RANGE_VELOCITY_ERR_105}, {application-record-element=DET_RANGE_VELOCITY_ERR_106, system-signal=DET_RANGE_VELOCITY_ERR_106}, {application-record-element=DET_RANGE_VELOCITY_ERR_107, system-signal=DET_RANGE_VELOCITY_ERR_107}, {application-record-element=DET_RANGE_VELOCITY_ERR_108, system-signal=DET_RANGE_VELOCITY_ERR_108}, {application-record-element=DET_RCS_105, system-signal=DET_RCS_105}, {application-record-element=DET_RCS_106, system-signal=DET_RCS_106}, {application-record-element=DET_RCS_107, system-signal=DET_RCS_107}, {application-record-element=DET_RCS_108, system-signal=DET_RCS_108}, {application-record-element=DET_SNR_105, system-signal=DET_SNR_105}, {application-record-element=DET_SNR_106, system-signal=DET_SNR_106}, {application-record-element=DET_SNR_107, system-signal=DET_SNR_107}, {application-record-element=DET_SNR_108, system-signal=DET_SNR_108}, {application-record-element=DET_SUPER_RES_TARGET_105, system-signal=DET_SUPER_RES_TARGET_105}, {application-record-element=DET_SUPER_RES_TARGET_106, system-signal=DET_SUPER_RES_TARGET_106}, {application-record-element=DET_SUPER_RES_TARGET_107, system-signal=DET_SUPER_RES_TARGET_107}, {application-record-element=DET_SUPER_RES_TARGET_108, system-signal=DET_SUPER_RES_TARGET_108}]}
        sender-receiver-to-signal-group-mapping={data-element=Pp_SG_Detections_109_112_AL.Vdp_SG_Detections_109_112_AL, signal-group=SG_Detections_109_112, type-mapping=sender-rec-record-type-mapping=record-element-mappings=[{application-record-element=DET_AZIMUTH_109, system-signal=DET_AZIMUTH_109}, {application-record-element=DET_AZIMUTH_110, system-signal=DET_AZIMUTH_110}, {application-record-element=DET_AZIMUTH_111, system-signal=DET_AZIMUTH_111}, {application-record-element=DET_AZIMUTH_112, system-signal=DET_AZIMUTH_112}, {application-record-element=DET_AZIMUTH_ERR_109, system-signal=DET_AZIMUTH_ERR_109}, {application-record-element=DET_AZIMUTH_ERR_110, system-signal=DET_AZIMUTH_ERR_110}, {application-record-element=DET_AZIMUTH_ERR_111, system-signal=DET_AZIMUTH_ERR_111}, {application-record-element=DET_AZIMUTH_ERR_112, system-signal=DET_AZIMUTH_ERR_112}, {application-record-element=DET_BELOW_RAIN_THOLD_109, system-signal=DET_BELOW_RAIN_THOLD_109}, {application-record-element=DET_BELOW_RAIN_THOLD_110, system-signal=DET_BELOW_RAIN_THOLD_110}, {application-record-element=DET_BELOW_RAIN_THOLD_111, system-signal=DET_BELOW_RAIN_THOLD_111}, {application-record-element=DET_BELOW_RAIN_THOLD_112, system-signal=DET_BELOW_RAIN_THOLD_112}, {application-record-element=DET_BI_STATIC_FLAG_109, system-signal=DET_BI_STATIC_FLAG_109}, {application-record-element=DET_BI_STATIC_FLAG_110, system-signal=DET_BI_STATIC_FLAG_110}, {application-record-element=DET_BI_STATIC_FLAG_111, system-signal=DET_BI_STATIC_FLAG_111}, {application-record-element=DET_BI_STATIC_FLAG_112, system-signal=DET_BI_STATIC_FLAG_112}, {application-record-element=DET_CONFD_AZIMUTH_109, system-signal=DET_CONFD_AZIMUTH_109}, {application-record-element=DET_CONFD_AZIMUTH_110, system-signal=DET_CONFD_AZIMUTH_110}, {application-record-element=DET_CONFD_AZIMUTH_111, system-signal=DET_CONFD_AZIMUTH_111}, {application-record-element=DET_CONFD_AZIMUTH_112, system-signal=DET_CONFD_AZIMUTH_112}, {application-record-element=DET_CONFD_ELEVATION_109, system-signal=DET_CONFD_ELEVATION_109}, {application-record-element=DET_CONFD_ELEVATION_110, system-signal=DET_CONFD_ELEVATION_110}, {application-record-element=DET_CONFD_ELEVATION_111, system-signal=DET_CONFD_ELEVATION_111}, {application-record-element=DET_CONFD_ELEVATION_112, system-signal=DET_CONFD_ELEVATION_112}, {application-record-element=DET_ELEVATION_109, system-signal=DET_ELEVATION_109}, {application-record-element=DET_ELEVATION_110, system-signal=DET_ELEVATION_110}, {application-record-element=DET_ELEVATION_111, system-signal=DET_ELEVATION_111}, {application-record-element=DET_ELEVATION_112, system-signal=DET_ELEVATION_112}, {application-record-element=DET_ELEVATION_ERR_109, system-signal=DET_ELEVATION_ERR_109}, {application-record-element=DET_ELEVATION_ERR_110, system-signal=DET_ELEVATION_ERR_110}, {application-record-element=DET_ELEVATION_ERR_111, system-signal=DET_ELEVATION_ERR_111}, {application-record-element=DET_ELEVATION_ERR_112, system-signal=DET_ELEVATION_ERR_112}, {application-record-element=DET_EXISTENCE_PROB_109, system-signal=DET_EXISTENCE_PROB_109}, {application-record-element=DET_EXISTENCE_PROB_110, system-signal=DET_EXISTENCE_PROB_110}, {application-record-element=DET_EXISTENCE_PROB_111, system-signal=DET_EXISTENCE_PROB_111}, {application-record-element=DET_EXISTENCE_PROB_112, system-signal=DET_EXISTENCE_PROB_112}, {application-record-element=DET_HVC_FLAG_109, system-signal=DET_HVC_FLAG_109}, {application-record-element=DET_HVC_FLAG_110, system-signal=DET_HVC_FLAG_110}, {application-record-element=DET_HVC_FLAG_111, system-signal=DET_HVC_FLAG_111}, {application-record-element=DET_HVC_FLAG_112, system-signal=DET_HVC_FLAG_112}, {application-record-element=DET_IDM_109, system-signal=DET_IDM_109}, {application-record-element=DET_IDM_110, system-signal=DET_IDM_110}, {application-record-element=DET_IDM_111, system-signal=DET_IDM_111}, {application-record-element=DET_IDM_112, system-signal=DET_IDM_112}, {application-record-element=DET_MH_CRC16_109_112, system-signal=DET_MH_CRC16_109_112}, {application-record-element=DET_MH_CYCLE_COUNTER_109_112, system-signal=DET_MH_CYCLE_COUNTER_109_112}, {application-record-element=DET_MH_SCAN_INDEX_4LSB_109_112, system-signal=DET_MH_SCAN_INDEX_4LSB_109_112}, {application-record-element=DET_MTD_109, system-signal=DET_MTD_109}, {application-record-element=DET_MTD_110, system-signal=DET_MTD_110}, {application-record-element=DET_MTD_111, system-signal=DET_MTD_111}, {application-record-element=DET_MTD_112, system-signal=DET_MTD_112}, {application-record-element=DET_PROB_1STAZHYPO_109, system-signal=DET_PROB_1STAZHYPO_109}, {application-record-element=DET_PROB_1STAZHYPO_110, system-signal=DET_PROB_1STAZHYPO_110}, {application-record-element=DET_PROB_1STAZHYPO_111, system-signal=DET_PROB_1STAZHYPO_111}, {application-record-element=DET_PROB_1STAZHYPO_112, system-signal=DET_PROB_1STAZHYPO_112}, {application-record-element=DET_RANGE_109, system-signal=DET_RANGE_109}, {application-record-element=DET_RANGE_110, system-signal=DET_RANGE_110}, {application-record-element=DET_RANGE_111, system-signal=DET_RANGE_111}, {application-record-element=DET_RANGE_112, system-signal=DET_RANGE_112}, {application-record-element=DET_RANGE_ERR_109, system-signal=DET_RANGE_ERR_109}, {application-record-element=DET_RANGE_ERR_110, system-signal=DET_RANGE_ERR_110}, {application-record-element=DET_RANGE_ERR_111, system-signal=DET_RANGE_ERR_111}, {application-record-element=DET_RANGE_ERR_112, system-signal=DET_RANGE_ERR_112}, {application-record-element=DET_RANGE_VELOCITY_109, system-signal=DET_RANGE_VELOCITY_109}, {application-record-element=DET_RANGE_VELOCITY_110, system-signal=DET_RANGE_VELOCITY_110}, {application-record-element=DET_RANGE_VELOCITY_111, system-signal=DET_RANGE_VELOCITY_111}, {application-record-element=DET_RANGE_VELOCITY_112, system-signal=DET_RANGE_VELOCITY_112}, {application-record-element=DET_RANGE_VELOCITY_ERR_109, system-signal=DET_RANGE_VELOCITY_ERR_109}, {application-record-element=DET_RANGE_VELOCITY_ERR_110, system-signal=DET_RANGE_VELOCITY_ERR_110}, {application-record-element=DET_RANGE_VELOCITY_ERR_111, system-signal=DET_RANGE_VELOCITY_ERR_111}, {application-record-element=DET_RANGE_VELOCITY_ERR_112, system-signal=DET_RANGE_VELOCITY_ERR_112}, {application-record-element=DET_RCS_109, system-signal=DET_RCS_109}, {application-record-element=DET_RCS_110, system-signal=DET_RCS_110}, {application-record-element=DET_RCS_111, system-signal=DET_RCS_111}, {application-record-element=DET_RCS_112, system-signal=DET_RCS_112}, {application-record-element=DET_SNR_109, system-signal=DET_SNR_109}, {application-record-element=DET_SNR_110, system-signal=DET_SNR_110}, {application-record-element=DET_SNR_111, system-signal=DET_SNR_111}, {application-record-element=DET_SNR_112, system-signal=DET_SNR_112}, {application-record-element=DET_SUPER_RES_TARGET_109, system-signal=DET_SUPER_RES_TARGET_109}, {application-record-element=DET_SUPER_RES_TARGET_110, system-signal=DET_SUPER_RES_TARGET_110}, {application-record-element=DET_SUPER_RES_TARGET_111, system-signal=DET_SUPER_RES_TARGET_111}, {application-record-element=DET_SUPER_RES_TARGET_112, system-signal=DET_SUPER_RES_TARGET_112}]}
        sender-receiver-to-signal-group-mapping={data-element=Pp_SG_Detections_113_116_AL.Vdp_SG_Detections_113_116_AL, signal-group=SG_Detections_113_116, type-mapping=sender-rec-record-type-mapping=record-element-mappings=[{application-record-element=DET_AZIMUTH_113, system-signal=DET_AZIMUTH_113}, {application-record-element=DET_AZIMUTH_114, system-signal=DET_AZIMUTH_114}, {application-record-element=DET_AZIMUTH_115, system-signal=DET_AZIMUTH_115}, {application-record-element=DET_AZIMUTH_116, system-signal=DET_AZIMUTH_116}, {application-record-element=DET_AZIMUTH_ERR_113, system-signal=DET_AZIMUTH_ERR_113}, {application-record-element=DET_AZIMUTH_ERR_114, system-signal=DET_AZIMUTH_ERR_114}, {application-record-element=DET_AZIMUTH_ERR_115, system-signal=DET_AZIMUTH_ERR_115}, {application-record-element=DET_AZIMUTH_ERR_116, system-signal=DET_AZIMUTH_ERR_116}, {application-record-element=DET_BELOW_RAIN_THOLD_113, system-signal=DET_BELOW_RAIN_THOLD_113}, {application-record-element=DET_BELOW_RAIN_THOLD_114, system-signal=DET_BELOW_RAIN_THOLD_114}, {application-record-element=DET_BELOW_RAIN_THOLD_115, system-signal=DET_BELOW_RAIN_THOLD_115}, {application-record-element=DET_BELOW_RAIN_THOLD_116, system-signal=DET_BELOW_RAIN_THOLD_116}, {application-record-element=DET_BI_STATIC_FLAG_113, system-signal=DET_BI_STATIC_FLAG_113}, {application-record-element=DET_BI_STATIC_FLAG_114, system-signal=DET_BI_STATIC_FLAG_114}, {application-record-element=DET_BI_STATIC_FLAG_115, system-signal=DET_BI_STATIC_FLAG_115}, {application-record-element=DET_BI_STATIC_FLAG_116, system-signal=DET_BI_STATIC_FLAG_116}, {application-record-element=DET_CONFD_AZIMUTH_113, system-signal=DET_CONFD_AZIMUTH_113}, {application-record-element=DET_CONFD_AZIMUTH_114, system-signal=DET_CONFD_AZIMUTH_114}, {application-record-element=DET_CONFD_AZIMUTH_115, system-signal=DET_CONFD_AZIMUTH_115}, {application-record-element=DET_CONFD_AZIMUTH_116, system-signal=DET_CONFD_AZIMUTH_116}, {application-record-element=DET_CONFD_ELEVATION_113, system-signal=DET_CONFD_ELEVATION_113}, {application-record-element=DET_CONFD_ELEVATION_114, system-signal=DET_CONFD_ELEVATION_114}, {application-record-element=DET_CONFD_ELEVATION_115, system-signal=DET_CONFD_ELEVATION_115}, {application-record-element=DET_CONFD_ELEVATION_116, system-signal=DET_CONFD_ELEVATION_116}, {application-record-element=DET_ELEVATION_113, system-signal=DET_ELEVATION_113}, {application-record-element=DET_ELEVATION_114, system-signal=DET_ELEVATION_114}, {application-record-element=DET_ELEVATION_115, system-signal=DET_ELEVATION_115}, {application-record-element=DET_ELEVATION_116, system-signal=DET_ELEVATION_116}, {application-record-element=DET_ELEVATION_ERR_113, system-signal=DET_ELEVATION_ERR_113}, {application-record-element=DET_ELEVATION_ERR_114, system-signal=DET_ELEVATION_ERR_114}, {application-record-element=DET_ELEVATION_ERR_115, system-signal=DET_ELEVATION_ERR_115}, {application-record-element=DET_ELEVATION_ERR_116, system-signal=DET_ELEVATION_ERR_116}, {application-record-element=DET_EXISTENCE_PROB_113, system-signal=DET_EXISTENCE_PROB_113}, {application-record-element=DET_EXISTENCE_PROB_114, system-signal=DET_EXISTENCE_PROB_114}, {application-record-element=DET_EXISTENCE_PROB_115, system-signal=DET_EXISTENCE_PROB_115}, {application-record-element=DET_EXISTENCE_PROB_116, system-signal=DET_EXISTENCE_PROB_116}, {application-record-element=DET_HVC_FLAG_113, system-signal=DET_HVC_FLAG_113}, {application-record-element=DET_HVC_FLAG_114, system-signal=DET_HVC_FLAG_114}, {application-record-element=DET_HVC_FLAG_115, system-signal=DET_HVC_FLAG_115}, {application-record-element=DET_HVC_FLAG_116, system-signal=DET_HVC_FLAG_116}, {application-record-element=DET_IDM_113, system-signal=DET_IDM_113}, {application-record-element=DET_IDM_114, system-signal=DET_IDM_114}, {application-record-element=DET_IDM_115, system-signal=DET_IDM_115}, {application-record-element=DET_IDM_116, system-signal=DET_IDM_116}, {application-record-element=DET_MH_CRC16_113_116, system-signal=DET_MH_CRC16_113_116}, {application-record-element=DET_MH_CYCLE_COUNTER_113_116, system-signal=DET_MH_CYCLE_COUNTER_113_116}, {application-record-element=DET_MH_SCAN_INDEX_4LSB_113_116, system-signal=DET_MH_SCAN_INDEX_4LSB_113_116}, {application-record-element=DET_MTD_113, system-signal=DET_MTD_113}, {application-record-element=DET_MTD_114, system-signal=DET_MTD_114}, {application-record-element=DET_MTD_115, system-signal=DET_MTD_115}, {application-record-element=DET_MTD_116, system-signal=DET_MTD_116}, {application-record-element=DET_PROB_1STAZHYPO_113, system-signal=DET_PROB_1STAZHYPO_113}, {application-record-element=DET_PROB_1STAZHYPO_114, system-signal=DET_PROB_1STAZHYPO_114}, {application-record-element=DET_PROB_1STAZHYPO_115, system-signal=DET_PROB_1STAZHYPO_115}, {application-record-element=DET_PROB_1STAZHYPO_116, system-signal=DET_PROB_1STAZHYPO_116}, {application-record-element=DET_RANGE_113, system-signal=DET_RANGE_113}, {application-record-element=DET_RANGE_114, system-signal=DET_RANGE_114}, {application-record-element=DET_RANGE_115, system-signal=DET_RANGE_115}, {application-record-element=DET_RANGE_116, system-signal=DET_RANGE_116}, {application-record-element=DET_RANGE_ERR_113, system-signal=DET_RANGE_ERR_113}, {application-record-element=DET_RANGE_ERR_114, system-signal=DET_RANGE_ERR_114}, {application-record-element=DET_RANGE_ERR_115, system-signal=DET_RANGE_ERR_115}, {application-record-element=DET_RANGE_ERR_116, system-signal=DET_RANGE_ERR_116}, {application-record-element=DET_RANGE_VELOCITY_113, system-signal=DET_RANGE_VELOCITY_113}, {application-record-element=DET_RANGE_VELOCITY_114, system-signal=DET_RANGE_VELOCITY_114}, {application-record-element=DET_RANGE_VELOCITY_115, system-signal=DET_RANGE_VELOCITY_115}, {application-record-element=DET_RANGE_VELOCITY_116, system-signal=DET_RANGE_VELOCITY_116}, {application-record-element=DET_RANGE_VELOCITY_ERR_113, system-signal=DET_RANGE_VELOCITY_ERR_113}, {application-record-element=DET_RANGE_VELOCITY_ERR_114, system-signal=DET_RANGE_VELOCITY_ERR_114}, {application-record-element=DET_RANGE_VELOCITY_ERR_115, system-signal=DET_RANGE_VELOCITY_ERR_115}, {application-record-element=DET_RANGE_VELOCITY_ERR_116, system-signal=DET_RANGE_VELOCITY_ERR_116}, {application-record-element=DET_RCS_113, system-signal=DET_RCS_113}, {application-record-element=DET_RCS_114, system-signal=DET_RCS_114}, {application-record-element=DET_RCS_115, system-signal=DET_RCS_115}, {application-record-element=DET_RCS_116, system-signal=DET_RCS_116}, {application-record-element=DET_SNR_113, system-signal=DET_SNR_113}, {application-record-element=DET_SNR_114, system-signal=DET_SNR_114}, {application-record-element=DET_SNR_115, system-signal=DET_SNR_115}, {application-record-element=DET_SNR_116, system-signal=DET_SNR_116}, {application-record-element=DET_SUPER_RES_TARGET_113, system-signal=DET_SUPER_RES_TARGET_113}, {application-record-element=DET_SUPER_RES_TARGET_114, system-signal=DET_SUPER_RES_TARGET_114}, {application-record-element=DET_SUPER_RES_TARGET_115, system-signal=DET_SUPER_RES_TARGET_115}, {application-record-element=DET_SUPER_RES_TARGET_116, system-signal=DET_SUPER_RES_TARGET_116}]}
        sender-receiver-to-signal-group-mapping={data-element=Pp_SG_Detections_117_120_AL.Vdp_SG_Detections_117_120_AL, signal-group=SG_Detections_117_120, type-mapping=sender-rec-record-type-mapping=record-element-mappings=[{application-record-element=DET_AZIMUTH_117, system-signal=DET_AZIMUTH_117}, {application-record-element=DET_AZIMUTH_118, system-signal=DET_AZIMUTH_118}, {application-record-element=DET_AZIMUTH_119, system-signal=DET_AZIMUTH_119}, {application-record-element=DET_AZIMUTH_120, system-signal=DET_AZIMUTH_120}, {application-record-element=DET_AZIMUTH_ERR_117, system-signal=DET_AZIMUTH_ERR_117}, {application-record-element=DET_AZIMUTH_ERR_118, system-signal=DET_AZIMUTH_ERR_118}, {application-record-element=DET_AZIMUTH_ERR_119, system-signal=DET_AZIMUTH_ERR_119}, {application-record-element=DET_AZIMUTH_ERR_120, system-signal=DET_AZIMUTH_ERR_120}, {application-record-element=DET_BELOW_RAIN_THOLD_117, system-signal=DET_BELOW_RAIN_THOLD_117}, {application-record-element=DET_BELOW_RAIN_THOLD_118, system-signal=DET_BELOW_RAIN_THOLD_118}, {application-record-element=DET_BELOW_RAIN_THOLD_119, system-signal=DET_BELOW_RAIN_THOLD_119}, {application-record-element=DET_BELOW_RAIN_THOLD_120, system-signal=DET_BELOW_RAIN_THOLD_120}, {application-record-element=DET_BI_STATIC_FLAG_117, system-signal=DET_BI_STATIC_FLAG_117}, {application-record-element=DET_BI_STATIC_FLAG_118, system-signal=DET_BI_STATIC_FLAG_118}, {application-record-element=DET_BI_STATIC_FLAG_119, system-signal=DET_BI_STATIC_FLAG_119}, {application-record-element=DET_BI_STATIC_FLAG_120, system-signal=DET_BI_STATIC_FLAG_120}, {application-record-element=DET_CONFD_AZIMUTH_117, system-signal=DET_CONFD_AZIMUTH_117}, {application-record-element=DET_CONFD_AZIMUTH_118, system-signal=DET_CONFD_AZIMUTH_118}, {application-record-element=DET_CONFD_AZIMUTH_119, system-signal=DET_CONFD_AZIMUTH_119}, {application-record-element=DET_CONFD_AZIMUTH_120, system-signal=DET_CONFD_AZIMUTH_120}, {application-record-element=DET_CONFD_ELEVATION_117, system-signal=DET_CONFD_ELEVATION_117}, {application-record-element=DET_CONFD_ELEVATION_118, system-signal=DET_CONFD_ELEVATION_118}, {application-record-element=DET_CONFD_ELEVATION_119, system-signal=DET_CONFD_ELEVATION_119}, {application-record-element=DET_CONFD_ELEVATION_120, system-signal=DET_CONFD_ELEVATION_120}, {application-record-element=DET_ELEVATION_117, system-signal=DET_ELEVATION_117}, {application-record-element=DET_ELEVATION_118, system-signal=DET_ELEVATION_118}, {application-record-element=DET_ELEVATION_119, system-signal=DET_ELEVATION_119}, {application-record-element=DET_ELEVATION_120, system-signal=DET_ELEVATION_120}, {application-record-element=DET_ELEVATION_ERR_117, system-signal=DET_ELEVATION_ERR_117}, {application-record-element=DET_ELEVATION_ERR_118, system-signal=DET_ELEVATION_ERR_118}, {application-record-element=DET_ELEVATION_ERR_119, system-signal=DET_ELEVATION_ERR_119}, {application-record-element=DET_ELEVATION_ERR_120, system-signal=DET_ELEVATION_ERR_120}, {application-record-element=DET_EXISTENCE_PROB_117, system-signal=DET_EXISTENCE_PROB_117}, {application-record-element=DET_EXISTENCE_PROB_118, system-signal=DET_EXISTENCE_PROB_118}, {application-record-element=DET_EXISTENCE_PROB_119, system-signal=DET_EXISTENCE_PROB_119}, {application-record-element=DET_EXISTENCE_PROB_120, system-signal=DET_EXISTENCE_PROB_120}, {application-record-element=DET_HVC_FLAG_117, system-signal=DET_HVC_FLAG_117}, {application-record-element=DET_HVC_FLAG_118, system-signal=DET_HVC_FLAG_118}, {application-record-element=DET_HVC_FLAG_119, system-signal=DET_HVC_FLAG_119}, {application-record-element=DET_HVC_FLAG_120, system-signal=DET_HVC_FLAG_120}, {application-record-element=DET_IDM_117, system-signal=DET_IDM_117}, {application-record-element=DET_IDM_118, system-signal=DET_IDM_118}, {application-record-element=DET_IDM_119, system-signal=DET_IDM_119}, {application-record-element=DET_IDM_120, system-signal=DET_IDM_120}, {application-record-element=DET_MH_CRC16_117_120, system-signal=DET_MH_CRC16_117_120}, {application-record-element=DET_MH_CYCLE_COUNTER_117_120, system-signal=DET_MH_CYCLE_COUNTER_117_120}, {application-record-element=DET_MH_SCAN_INDEX_4LSB_117_120, system-signal=DET_MH_SCAN_INDEX_4LSB_117_120}, {application-record-element=DET_MTD_117, system-signal=DET_MTD_117}, {application-record-element=DET_MTD_118, system-signal=DET_MTD_118}, {application-record-element=DET_MTD_119, system-signal=DET_MTD_119}, {application-record-element=DET_MTD_120, system-signal=DET_MTD_120}, {application-record-element=DET_PROB_1STAZHYPO_117, system-signal=DET_PROB_1STAZHYPO_117}, {application-record-element=DET_PROB_1STAZHYPO_118, system-signal=DET_PROB_1STAZHYPO_118}, {application-record-element=DET_PROB_1STAZHYPO_119, system-signal=DET_PROB_1STAZHYPO_119}, {application-record-element=DET_PROB_1STAZHYPO_120, system-signal=DET_PROB_1STAZHYPO_120}, {application-record-element=DET_RANGE_117, system-signal=DET_RANGE_117}, {application-record-element=DET_RANGE_118, system-signal=DET_RANGE_118}, {application-record-element=DET_RANGE_119, system-signal=DET_RANGE_119}, {application-record-element=DET_RANGE_120, system-signal=DET_RANGE_120}, {application-record-element=DET_RANGE_ERR_117, system-signal=DET_RANGE_ERR_117}, {application-record-element=DET_RANGE_ERR_118, system-signal=DET_RANGE_ERR_118}, {application-record-element=DET_RANGE_ERR_119, system-signal=DET_RANGE_ERR_119}, {application-record-element=DET_RANGE_ERR_120, system-signal=DET_RANGE_ERR_120}, {application-record-element=DET_RANGE_VELOCITY_117, system-signal=DET_RANGE_VELOCITY_117}, {application-record-element=DET_RANGE_VELOCITY_118, system-signal=DET_RANGE_VELOCITY_118}, {application-record-element=DET_RANGE_VELOCITY_119, system-signal=DET_RANGE_VELOCITY_119}, {application-record-element=DET_RANGE_VELOCITY_120, system-signal=DET_RANGE_VELOCITY_120}, {application-record-element=DET_RANGE_VELOCITY_ERR_117, system-signal=DET_RANGE_VELOCITY_ERR_117}, {application-record-element=DET_RANGE_VELOCITY_ERR_118, system-signal=DET_RANGE_VELOCITY_ERR_118}, {application-record-element=DET_RANGE_VELOCITY_ERR_119, system-signal=DET_RANGE_VELOCITY_ERR_119}, {application-record-element=DET_RANGE_VELOCITY_ERR_120, system-signal=DET_RANGE_VELOCITY_ERR_120}, {application-record-element=DET_RCS_117, system-signal=DET_RCS_117}, {application-record-element=DET_RCS_118, system-signal=DET_RCS_118}, {application-record-element=DET_RCS_119, system-signal=DET_RCS_119}, {application-record-element=DET_RCS_120, system-signal=DET_RCS_120}, {application-record-element=DET_SNR_117, system-signal=DET_SNR_117}, {application-record-element=DET_SNR_118, system-signal=DET_SNR_118}, {application-record-element=DET_SNR_119, system-signal=DET_SNR_119}, {application-record-element=DET_SNR_120, system-signal=DET_SNR_120}, {application-record-element=DET_SUPER_RES_TARGET_117, system-signal=DET_SUPER_RES_TARGET_117}, {application-record-element=DET_SUPER_RES_TARGET_118, system-signal=DET_SUPER_RES_TARGET_118}, {application-record-element=DET_SUPER_RES_TARGET_119, system-signal=DET_SUPER_RES_TARGET_119}, {application-record-element=DET_SUPER_RES_TARGET_120, system-signal=DET_SUPER_RES_TARGET_120}]}
        sender-receiver-to-signal-group-mapping={data-element=Pp_SG_Detections_121_124_AL.Vdp_SG_Detections_121_124_AL, signal-group=SG_Detections_121_124, type-mapping=sender-rec-record-type-mapping=record-element-mappings=[{application-record-element=DET_AZIMUTH_121, system-signal=DET_AZIMUTH_121}, {application-record-element=DET_AZIMUTH_122, system-signal=DET_AZIMUTH_122}, {application-record-element=DET_AZIMUTH_123, system-signal=DET_AZIMUTH_123}, {application-record-element=DET_AZIMUTH_124, system-signal=DET_AZIMUTH_124}, {application-record-element=DET_AZIMUTH_ERR_121, system-signal=DET_AZIMUTH_ERR_121}, {application-record-element=DET_AZIMUTH_ERR_122, system-signal=DET_AZIMUTH_ERR_122}, {application-record-element=DET_AZIMUTH_ERR_123, system-signal=DET_AZIMUTH_ERR_123}, {application-record-element=DET_AZIMUTH_ERR_124, system-signal=DET_AZIMUTH_ERR_124}, {application-record-element=DET_BELOW_RAIN_THOLD_121, system-signal=DET_BELOW_RAIN_THOLD_121}, {application-record-element=DET_BELOW_RAIN_THOLD_122, system-signal=DET_BELOW_RAIN_THOLD_122}, {application-record-element=DET_BELOW_RAIN_THOLD_123, system-signal=DET_BELOW_RAIN_THOLD_123}, {application-record-element=DET_BELOW_RAIN_THOLD_124, system-signal=DET_BELOW_RAIN_THOLD_124}, {application-record-element=DET_BI_STATIC_FLAG_121, system-signal=DET_BI_STATIC_FLAG_121}, {application-record-element=DET_BI_STATIC_FLAG_122, system-signal=DET_BI_STATIC_FLAG_122}, {application-record-element=DET_BI_STATIC_FLAG_123, system-signal=DET_BI_STATIC_FLAG_123}, {application-record-element=DET_BI_STATIC_FLAG_124, system-signal=DET_BI_STATIC_FLAG_124}, {application-record-element=DET_CONFD_AZIMUTH_121, system-signal=DET_CONFD_AZIMUTH_121}, {application-record-element=DET_CONFD_AZIMUTH_122, system-signal=DET_CONFD_AZIMUTH_122}, {application-record-element=DET_CONFD_AZIMUTH_123, system-signal=DET_CONFD_AZIMUTH_123}, {application-record-element=DET_CONFD_AZIMUTH_124, system-signal=DET_CONFD_AZIMUTH_124}, {application-record-element=DET_CONFD_ELEVATION_121, system-signal=DET_CONFD_ELEVATION_121}, {application-record-element=DET_CONFD_ELEVATION_122, system-signal=DET_CONFD_ELEVATION_122}, {application-record-element=DET_CONFD_ELEVATION_123, system-signal=DET_CONFD_ELEVATION_123}, {application-record-element=DET_CONFD_ELEVATION_124, system-signal=DET_CONFD_ELEVATION_124}, {application-record-element=DET_ELEVATION_121, system-signal=DET_ELEVATION_121}, {application-record-element=DET_ELEVATION_122, system-signal=DET_ELEVATION_122}, {application-record-element=DET_ELEVATION_123, system-signal=DET_ELEVATION_123}, {application-record-element=DET_ELEVATION_124, system-signal=DET_ELEVATION_124}, {application-record-element=DET_ELEVATION_ERR_121, system-signal=DET_ELEVATION_ERR_121}, {application-record-element=DET_ELEVATION_ERR_122, system-signal=DET_ELEVATION_ERR_122}, {application-record-element=DET_ELEVATION_ERR_123, system-signal=DET_ELEVATION_ERR_123}, {application-record-element=DET_ELEVATION_ERR_124, system-signal=DET_ELEVATION_ERR_124}, {application-record-element=DET_EXISTENCE_PROB_121, system-signal=DET_EXISTENCE_PROB_121}, {application-record-element=DET_EXISTENCE_PROB_122, system-signal=DET_EXISTENCE_PROB_122}, {application-record-element=DET_EXISTENCE_PROB_123, system-signal=DET_EXISTENCE_PROB_123}, {application-record-element=DET_EXISTENCE_PROB_124, system-signal=DET_EXISTENCE_PROB_124}, {application-record-element=DET_HVC_FLAG_121, system-signal=DET_HVC_FLAG_121}, {application-record-element=DET_HVC_FLAG_122, system-signal=DET_HVC_FLAG_122}, {application-record-element=DET_HVC_FLAG_123, system-signal=DET_HVC_FLAG_123}, {application-record-element=DET_HVC_FLAG_124, system-signal=DET_HVC_FLAG_124}, {application-record-element=DET_IDM_121, system-signal=DET_IDM_121}, {application-record-element=DET_IDM_122, system-signal=DET_IDM_122}, {application-record-element=DET_IDM_123, system-signal=DET_IDM_123}, {application-record-element=DET_IDM_124, system-signal=DET_IDM_124}, {application-record-element=DET_MH_CRC16_121_124, system-signal=DET_MH_CRC16_121_124}, {application-record-element=DET_MH_CYCLE_COUNTER_121_124, system-signal=DET_MH_CYCLE_COUNTER_121_124}, {application-record-element=DET_MH_SCAN_INDEX_4LSB_121_124, system-signal=DET_MH_SCAN_INDEX_4LSB_121_124}, {application-record-element=DET_MTD_121, system-signal=DET_MTD_121}, {application-record-element=DET_MTD_122, system-signal=DET_MTD_122}, {application-record-element=DET_MTD_123, system-signal=DET_MTD_123}, {application-record-element=DET_MTD_124, system-signal=DET_MTD_124}, {application-record-element=DET_PROB_1STAZHYPO_121, system-signal=DET_PROB_1STAZHYPO_121}, {application-record-element=DET_PROB_1STAZHYPO_122, system-signal=DET_PROB_1STAZHYPO_122}, {application-record-element=DET_PROB_1STAZHYPO_123, system-signal=DET_PROB_1STAZHYPO_123}, {application-record-element=DET_PROB_1STAZHYPO_124, system-signal=DET_PROB_1STAZHYPO_124}, {application-record-element=DET_RANGE_121, system-signal=DET_RANGE_121}, {application-record-element=DET_RANGE_122, system-signal=DET_RANGE_122}, {application-record-element=DET_RANGE_123, system-signal=DET_RANGE_123}, {application-record-element=DET_RANGE_124, system-signal=DET_RANGE_124}, {application-record-element=DET_RANGE_ERR_121, system-signal=DET_RANGE_ERR_121}, {application-record-element=DET_RANGE_ERR_122, system-signal=DET_RANGE_ERR_122}, {application-record-element=DET_RANGE_ERR_123, system-signal=DET_RANGE_ERR_123}, {application-record-element=DET_RANGE_ERR_124, system-signal=DET_RANGE_ERR_124}, {application-record-element=DET_RANGE_VELOCITY_121, system-signal=DET_RANGE_VELOCITY_121}, {application-record-element=DET_RANGE_VELOCITY_122, system-signal=DET_RANGE_VELOCITY_122}, {application-record-element=DET_RANGE_VELOCITY_123, system-signal=DET_RANGE_VELOCITY_123}, {application-record-element=DET_RANGE_VELOCITY_124, system-signal=DET_RANGE_VELOCITY_124}, {application-record-element=DET_RANGE_VELOCITY_ERR_121, system-signal=DET_RANGE_VELOCITY_ERR_121}, {application-record-element=DET_RANGE_VELOCITY_ERR_122, system-signal=DET_RANGE_VELOCITY_ERR_122}, {application-record-element=DET_RANGE_VELOCITY_ERR_123, system-signal=DET_RANGE_VELOCITY_ERR_123}, {application-record-element=DET_RANGE_VELOCITY_ERR_124, system-signal=DET_RANGE_VELOCITY_ERR_124}, {application-record-element=DET_RCS_121, system-signal=DET_RCS_121}, {application-record-element=DET_RCS_122, system-signal=DET_RCS_122}, {application-record-element=DET_RCS_123, system-signal=DET_RCS_123}, {application-record-element=DET_RCS_124, system-signal=DET_RCS_124}, {application-record-element=DET_SNR_121, system-signal=DET_SNR_121}, {application-record-element=DET_SNR_122, system-signal=DET_SNR_122}, {application-record-element=DET_SNR_123, system-signal=DET_SNR_123}, {application-record-element=DET_SNR_124, system-signal=DET_SNR_124}, {application-record-element=DET_SUPER_RES_TARGET_121, system-signal=DET_SUPER_RES_TARGET_121}, {application-record-element=DET_SUPER_RES_TARGET_122, system-signal=DET_SUPER_RES_TARGET_122}, {application-record-element=DET_SUPER_RES_TARGET_123, system-signal=DET_SUPER_RES_TARGET_123}, {application-record-element=DET_SUPER_RES_TARGET_124, system-signal=DET_SUPER_RES_TARGET_124}]}
        sender-receiver-to-signal-group-mapping={data-element=Pp_SG_Detections_125_128_AL.Vdp_SG_Detections_125_128_AL, signal-group=SG_Detections_125_128, type-mapping=sender-rec-record-type-mapping=record-element-mappings=[{application-record-element=DET_AZIMUTH_125, system-signal=DET_AZIMUTH_125}, {application-record-element=DET_AZIMUTH_126, system-signal=DET_AZIMUTH_126}, {application-record-element=DET_AZIMUTH_127, system-signal=DET_AZIMUTH_127}, {application-record-element=DET_AZIMUTH_128, system-signal=DET_AZIMUTH_128}, {application-record-element=DET_AZIMUTH_ERR_125, system-signal=DET_AZIMUTH_ERR_125}, {application-record-element=DET_AZIMUTH_ERR_126, system-signal=DET_AZIMUTH_ERR_126}, {application-record-element=DET_AZIMUTH_ERR_127, system-signal=DET_AZIMUTH_ERR_127}, {application-record-element=DET_AZIMUTH_ERR_128, system-signal=DET_AZIMUTH_ERR_128}, {application-record-element=DET_BELOW_RAIN_THOLD_125, system-signal=DET_BELOW_RAIN_THOLD_125}, {application-record-element=DET_BELOW_RAIN_THOLD_126, system-signal=DET_BELOW_RAIN_THOLD_126}, {application-record-element=DET_BELOW_RAIN_THOLD_127, system-signal=DET_BELOW_RAIN_THOLD_127}, {application-record-element=DET_BELOW_RAIN_THOLD_128, system-signal=DET_BELOW_RAIN_THOLD_128}, {application-record-element=DET_BI_STATIC_FLAG_125, system-signal=DET_BI_STATIC_FLAG_125}, {application-record-element=DET_BI_STATIC_FLAG_126, system-signal=DET_BI_STATIC_FLAG_126}, {application-record-element=DET_BI_STATIC_FLAG_127, system-signal=DET_BI_STATIC_FLAG_127}, {application-record-element=DET_BI_STATIC_FLAG_128, system-signal=DET_BI_STATIC_FLAG_128}, {application-record-element=DET_CONFD_AZIMUTH_125, system-signal=DET_CONFD_AZIMUTH_125}, {application-record-element=DET_CONFD_AZIMUTH_126, system-signal=DET_CONFD_AZIMUTH_126}, {application-record-element=DET_CONFD_AZIMUTH_127, system-signal=DET_CONFD_AZIMUTH_127}, {application-record-element=DET_CONFD_AZIMUTH_128, system-signal=DET_CONFD_AZIMUTH_128}, {application-record-element=DET_CONFD_ELEVATION_125, system-signal=DET_CONFD_ELEVATION_125}, {application-record-element=DET_CONFD_ELEVATION_126, system-signal=DET_CONFD_ELEVATION_126}, {application-record-element=DET_CONFD_ELEVATION_127, system-signal=DET_CONFD_ELEVATION_127}, {application-record-element=DET_CONFD_ELEVATION_128, system-signal=DET_CONFD_ELEVATION_128}, {application-record-element=DET_ELEVATION_125, system-signal=DET_ELEVATION_125}, {application-record-element=DET_ELEVATION_126, system-signal=DET_ELEVATION_126}, {application-record-element=DET_ELEVATION_127, system-signal=DET_ELEVATION_127}, {application-record-element=DET_ELEVATION_128, system-signal=DET_ELEVATION_128}, {application-record-element=DET_ELEVATION_ERR_125, system-signal=DET_ELEVATION_ERR_125}, {application-record-element=DET_ELEVATION_ERR_126, system-signal=DET_ELEVATION_ERR_126}, {application-record-element=DET_ELEVATION_ERR_127, system-signal=DET_ELEVATION_ERR_127}, {application-record-element=DET_ELEVATION_ERR_128, system-signal=DET_ELEVATION_ERR_128}, {application-record-element=DET_EXISTENCE_PROB_125, system-signal=DET_EXISTENCE_PROB_125}, {application-record-element=DET_EXISTENCE_PROB_126, system-signal=DET_EXISTENCE_PROB_126}, {application-record-element=DET_EXISTENCE_PROB_127, system-signal=DET_EXISTENCE_PROB_127}, {application-record-element=DET_EXISTENCE_PROB_128, system-signal=DET_EXISTENCE_PROB_128}, {application-record-element=DET_HVC_FLAG_125, system-signal=DET_HVC_FLAG_125}, {application-record-element=DET_HVC_FLAG_126, system-signal=DET_HVC_FLAG_126}, {application-record-element=DET_HVC_FLAG_127, system-signal=DET_HVC_FLAG_127}, {application-record-element=DET_HVC_FLAG_128, system-signal=DET_HVC_FLAG_128}, {application-record-element=DET_IDM_125, system-signal=DET_IDM_125}, {application-record-element=DET_IDM_126, system-signal=DET_IDM_126}, {application-record-element=DET_IDM_127, system-signal=DET_IDM_127}, {application-record-element=DET_IDM_128, system-signal=DET_IDM_128}, {application-record-element=DET_MH_CRC16_125_128, system-signal=DET_MH_CRC16_125_128}, {application-record-element=DET_MH_CYCLE_COUNTER_125_128, system-signal=DET_MH_CYCLE_COUNTER_125_128}, {application-record-element=DET_MH_SCAN_INDEX_4LSB_125_128, system-signal=DET_MH_SCAN_INDEX_4LSB_125_128}, {application-record-element=DET_MTD_125, system-signal=DET_MTD_125}, {application-record-element=DET_MTD_126, system-signal=DET_MTD_126}, {application-record-element=DET_MTD_127, system-signal=DET_MTD_127}, {application-record-element=DET_MTD_128, system-signal=DET_MTD_128}, {application-record-element=DET_PROB_1STAZHYPO_125, system-signal=DET_PROB_1STAZHYPO_125}, {application-record-element=DET_PROB_1STAZHYPO_126, system-signal=DET_PROB_1STAZHYPO_126}, {application-record-element=DET_PROB_1STAZHYPO_127, system-signal=DET_PROB_1STAZHYPO_127}, {application-record-element=DET_PROB_1STAZHYPO_128, system-signal=DET_PROB_1STAZHYPO_128}, {application-record-element=DET_RANGE_125, system-signal=DET_RANGE_125}, {application-record-element=DET_RANGE_126, system-signal=DET_RANGE_126}, {application-record-element=DET_RANGE_127, system-signal=DET_RANGE_127}, {application-record-element=DET_RANGE_128, system-signal=DET_RANGE_128}, {application-record-element=DET_RANGE_ERR_125, system-signal=DET_RANGE_ERR_125}, {application-record-element=DET_RANGE_ERR_126, system-signal=DET_RANGE_ERR_126}, {application-record-element=DET_RANGE_ERR_127, system-signal=DET_RANGE_ERR_127}, {application-record-element=DET_RANGE_ERR_128, system-signal=DET_RANGE_ERR_128}, {application-record-element=DET_RANGE_VELOCITY_125, system-signal=DET_RANGE_VELOCITY_125}, {application-record-element=DET_RANGE_VELOCITY_126, system-signal=DET_RANGE_VELOCITY_126}, {application-record-element=DET_RANGE_VELOCITY_127, system-signal=DET_RANGE_VELOCITY_127}, {application-record-element=DET_RANGE_VELOCITY_128, system-signal=DET_RANGE_VELOCITY_128}, {application-record-element=DET_RANGE_VELOCITY_ERR_125, system-signal=DET_RANGE_VELOCITY_ERR_125}, {application-record-element=DET_RANGE_VELOCITY_ERR_126, system-signal=DET_RANGE_VELOCITY_ERR_126}, {application-record-element=DET_RANGE_VELOCITY_ERR_127, system-signal=DET_RANGE_VELOCITY_ERR_127}, {application-record-element=DET_RANGE_VELOCITY_ERR_128, system-signal=DET_RANGE_VELOCITY_ERR_128}, {application-record-element=DET_RCS_125, system-signal=DET_RCS_125}, {application-record-element=DET_RCS_126, system-signal=DET_RCS_126}, {application-record-element=DET_RCS_127, system-signal=DET_RCS_127}, {application-record-element=DET_RCS_128, system-signal=DET_RCS_128}, {application-record-element=DET_SNR_125, system-signal=DET_SNR_125}, {application-record-element=DET_SNR_126, system-signal=DET_SNR_126}, {application-record-element=DET_SNR_127, system-signal=DET_SNR_127}, {application-record-element=DET_SNR_128, system-signal=DET_SNR_128}, {application-record-element=DET_SUPER_RES_TARGET_125, system-signal=DET_SUPER_RES_TARGET_125}, {application-record-element=DET_SUPER_RES_TARGET_126, system-signal=DET_SUPER_RES_TARGET_126}, {application-record-element=DET_SUPER_RES_TARGET_127, system-signal=DET_SUPER_RES_TARGET_127}, {application-record-element=DET_SUPER_RES_TARGET_128, system-signal=DET_SUPER_RES_TARGET_128}]}
        sender-receiver-to-signal-group-mapping={data-element=Pp_SG_Detections_129_132_AL.Vdp_SG_Detections_129_132_AL, signal-group=SG_Detections_129_132, type-mapping=sender-rec-record-type-mapping=record-element-mappings=[{application-record-element=DET_AZIMUTH_129, system-signal=DET_AZIMUTH_129}, {application-record-element=DET_AZIMUTH_130, system-signal=DET_AZIMUTH_130}, {application-record-element=DET_AZIMUTH_131, system-signal=DET_AZIMUTH_131}, {application-record-element=DET_AZIMUTH_132, system-signal=DET_AZIMUTH_132}, {application-record-element=DET_AZIMUTH_ERR_129, system-signal=DET_AZIMUTH_ERR_129}, {application-record-element=DET_AZIMUTH_ERR_130, system-signal=DET_AZIMUTH_ERR_130}, {application-record-element=DET_AZIMUTH_ERR_131, system-signal=DET_AZIMUTH_ERR_131}, {application-record-element=DET_AZIMUTH_ERR_132, system-signal=DET_AZIMUTH_ERR_132}, {application-record-element=DET_BELOW_RAIN_THOLD_129, system-signal=DET_BELOW_RAIN_THOLD_129}, {application-record-element=DET_BELOW_RAIN_THOLD_130, system-signal=DET_BELOW_RAIN_THOLD_130}, {application-record-element=DET_BELOW_RAIN_THOLD_131, system-signal=DET_BELOW_RAIN_THOLD_131}, {application-record-element=DET_BELOW_RAIN_THOLD_132, system-signal=DET_BELOW_RAIN_THOLD_132}, {application-record-element=DET_BI_STATIC_FLAG_129, system-signal=DET_BI_STATIC_FLAG_129}, {application-record-element=DET_BI_STATIC_FLAG_130, system-signal=DET_BI_STATIC_FLAG_130}, {application-record-element=DET_BI_STATIC_FLAG_131, system-signal=DET_BI_STATIC_FLAG_131}, {application-record-element=DET_BI_STATIC_FLAG_132, system-signal=DET_BI_STATIC_FLAG_132}, {application-record-element=DET_CONFD_AZIMUTH_129, system-signal=DET_CONFD_AZIMUTH_129}, {application-record-element=DET_CONFD_AZIMUTH_130, system-signal=DET_CONFD_AZIMUTH_130}, {application-record-element=DET_CONFD_AZIMUTH_131, system-signal=DET_CONFD_AZIMUTH_131}, {application-record-element=DET_CONFD_AZIMUTH_132, system-signal=DET_CONFD_AZIMUTH_132}, {application-record-element=DET_CONFD_ELEVATION_129, system-signal=DET_CONFD_ELEVATION_129}, {application-record-element=DET_CONFD_ELEVATION_130, system-signal=DET_CONFD_ELEVATION_130}, {application-record-element=DET_CONFD_ELEVATION_131, system-signal=DET_CONFD_ELEVATION_131}, {application-record-element=DET_CONFD_ELEVATION_132, system-signal=DET_CONFD_ELEVATION_132}, {application-record-element=DET_ELEVATION_129, system-signal=DET_ELEVATION_129}, {application-record-element=DET_ELEVATION_130, system-signal=DET_ELEVATION_130}, {application-record-element=DET_ELEVATION_131, system-signal=DET_ELEVATION_131}, {application-record-element=DET_ELEVATION_132, system-signal=DET_ELEVATION_132}, {application-record-element=DET_ELEVATION_ERR_129, system-signal=DET_ELEVATION_ERR_129}, {application-record-element=DET_ELEVATION_ERR_130, system-signal=DET_ELEVATION_ERR_130}, {application-record-element=DET_ELEVATION_ERR_131, system-signal=DET_ELEVATION_ERR_131}, {application-record-element=DET_ELEVATION_ERR_132, system-signal=DET_ELEVATION_ERR_132}, {application-record-element=DET_EXISTENCE_PROB_129, system-signal=DET_EXISTENCE_PROB_129}, {application-record-element=DET_EXISTENCE_PROB_130, system-signal=DET_EXISTENCE_PROB_130}, {application-record-element=DET_EXISTENCE_PROB_131, system-signal=DET_EXISTENCE_PROB_131}, {application-record-element=DET_EXISTENCE_PROB_132, system-signal=DET_EXISTENCE_PROB_132}, {application-record-element=DET_HVC_FLAG_129, system-signal=DET_HVC_FLAG_129}, {application-record-element=DET_HVC_FLAG_130, system-signal=DET_HVC_FLAG_130}, {application-record-element=DET_HVC_FLAG_131, system-signal=DET_HVC_FLAG_131}, {application-record-element=DET_HVC_FLAG_132, system-signal=DET_HVC_FLAG_132}, {application-record-element=DET_IDM_129, system-signal=DET_IDM_129}, {application-record-element=DET_IDM_130, system-signal=DET_IDM_130}, {application-record-element=DET_IDM_131, system-signal=DET_IDM_131}, {application-record-element=DET_IDM_132, system-signal=DET_IDM_132}, {application-record-element=DET_MH_CRC16_129_132, system-signal=DET_MH_CRC16_129_132}, {application-record-element=DET_MH_CYCLE_COUNTER_129_132, system-signal=DET_MH_CYCLE_COUNTER_129_132}, {application-record-element=DET_MH_SCAN_INDEX_4LSB_129_132, system-signal=DET_MH_SCAN_INDEX_4LSB_129_132}, {application-record-element=DET_MTD_129, system-signal=DET_MTD_129}, {application-record-element=DET_MTD_130, system-signal=DET_MTD_130}, {application-record-element=DET_MTD_131, system-signal=DET_MTD_131}, {application-record-element=DET_MTD_132, system-signal=DET_MTD_132}, {application-record-element=DET_PROB_1STAZHYPO_129, system-signal=DET_PROB_1STAZHYPO_129}, {application-record-element=DET_PROB_1STAZHYPO_130, system-signal=DET_PROB_1STAZHYPO_130}, {application-record-element=DET_PROB_1STAZHYPO_131, system-signal=DET_PROB_1STAZHYPO_131}, {application-record-element=DET_PROB_1STAZHYPO_132, system-signal=DET_PROB_1STAZHYPO_132}, {application-record-element=DET_RANGE_129, system-signal=DET_RANGE_129}, {application-record-element=DET_RANGE_130, system-signal=DET_RANGE_130}, {application-record-element=DET_RANGE_131, system-signal=DET_RANGE_131}, {application-record-element=DET_RANGE_132, system-signal=DET_RANGE_132}, {application-record-element=DET_RANGE_ERR_129, system-signal=DET_RANGE_ERR_129}, {application-record-element=DET_RANGE_ERR_130, system-signal=DET_RANGE_ERR_130}, {application-record-element=DET_RANGE_ERR_131, system-signal=DET_RANGE_ERR_131}, {application-record-element=DET_RANGE_ERR_132, system-signal=DET_RANGE_ERR_132}, {application-record-element=DET_RANGE_VELOCITY_129, system-signal=DET_RANGE_VELOCITY_129}, {application-record-element=DET_RANGE_VELOCITY_130, system-signal=DET_RANGE_VELOCITY_130}, {application-record-element=DET_RANGE_VELOCITY_131, system-signal=DET_RANGE_VELOCITY_131}, {application-record-element=DET_RANGE_VELOCITY_132, system-signal=DET_RANGE_VELOCITY_132}, {application-record-element=DET_RANGE_VELOCITY_ERR_129, system-signal=DET_RANGE_VELOCITY_ERR_129}, {application-record-element=DET_RANGE_VELOCITY_ERR_130, system-signal=DET_RANGE_VELOCITY_ERR_130}, {application-record-element=DET_RANGE_VELOCITY_ERR_131, system-signal=DET_RANGE_VELOCITY_ERR_131}, {application-record-element=DET_RANGE_VELOCITY_ERR_132, system-signal=DET_RANGE_VELOCITY_ERR_132}, {application-record-element=DET_RCS_129, system-signal=DET_RCS_129}, {application-record-element=DET_RCS_130, system-signal=DET_RCS_130}, {application-record-element=DET_RCS_131, system-signal=DET_RCS_131}, {application-record-element=DET_RCS_132, system-signal=DET_RCS_132}, {application-record-element=DET_SNR_129, system-signal=DET_SNR_129}, {application-record-element=DET_SNR_130, system-signal=DET_SNR_130}, {application-record-element=DET_SNR_131, system-signal=DET_SNR_131}, {application-record-element=DET_SNR_132, system-signal=DET_SNR_132}, {application-record-element=DET_SUPER_RES_TARGET_129, system-signal=DET_SUPER_RES_TARGET_129}, {application-record-element=DET_SUPER_RES_TARGET_130, system-signal=DET_SUPER_RES_TARGET_130}, {application-record-element=DET_SUPER_RES_TARGET_131, system-signal=DET_SUPER_RES_TARGET_131}, {application-record-element=DET_SUPER_RES_TARGET_132, system-signal=DET_SUPER_RES_TARGET_132}]}
        sender-receiver-to-signal-group-mapping={data-element=Pp_SG_Detections_133_136_AL.Vdp_SG_Detections_133_136_AL, signal-group=SG_Detections_133_136, type-mapping=sender-rec-record-type-mapping=record-element-mappings=[{application-record-element=DET_AZIMUTH_133, system-signal=DET_AZIMUTH_133}, {application-record-element=DET_AZIMUTH_134, system-signal=DET_AZIMUTH_134}, {application-record-element=DET_AZIMUTH_135, system-signal=DET_AZIMUTH_135}, {application-record-element=DET_AZIMUTH_136, system-signal=DET_AZIMUTH_136}, {application-record-element=DET_AZIMUTH_ERR_133, system-signal=DET_AZIMUTH_ERR_133}, {application-record-element=DET_AZIMUTH_ERR_134, system-signal=DET_AZIMUTH_ERR_134}, {application-record-element=DET_AZIMUTH_ERR_135, system-signal=DET_AZIMUTH_ERR_135}, {application-record-element=DET_AZIMUTH_ERR_136, system-signal=DET_AZIMUTH_ERR_136}, {application-record-element=DET_BELOW_RAIN_THOLD_133, system-signal=DET_BELOW_RAIN_THOLD_133}, {application-record-element=DET_BELOW_RAIN_THOLD_134, system-signal=DET_BELOW_RAIN_THOLD_134}, {application-record-element=DET_BELOW_RAIN_THOLD_135, system-signal=DET_BELOW_RAIN_THOLD_135}, {application-record-element=DET_BELOW_RAIN_THOLD_136, system-signal=DET_BELOW_RAIN_THOLD_136}, {application-record-element=DET_BI_STATIC_FLAG_133, system-signal=DET_BI_STATIC_FLAG_133}, {application-record-element=DET_BI_STATIC_FLAG_134, system-signal=DET_BI_STATIC_FLAG_134}, {application-record-element=DET_BI_STATIC_FLAG_135, system-signal=DET_BI_STATIC_FLAG_135}, {application-record-element=DET_BI_STATIC_FLAG_136, system-signal=DET_BI_STATIC_FLAG_136}, {application-record-element=DET_CONFD_AZIMUTH_133, system-signal=DET_CONFD_AZIMUTH_133}, {application-record-element=DET_CONFD_AZIMUTH_134, system-signal=DET_CONFD_AZIMUTH_134}, {application-record-element=DET_CONFD_AZIMUTH_135, system-signal=DET_CONFD_AZIMUTH_135}, {application-record-element=DET_CONFD_AZIMUTH_136, system-signal=DET_CONFD_AZIMUTH_136}, {application-record-element=DET_CONFD_ELEVATION_133, system-signal=DET_CONFD_ELEVATION_133}, {application-record-element=DET_CONFD_ELEVATION_134, system-signal=DET_CONFD_ELEVATION_134}, {application-record-element=DET_CONFD_ELEVATION_135, system-signal=DET_CONFD_ELEVATION_135}, {application-record-element=DET_CONFD_ELEVATION_136, system-signal=DET_CONFD_ELEVATION_136}, {application-record-element=DET_ELEVATION_133, system-signal=DET_ELEVATION_133}, {application-record-element=DET_ELEVATION_134, system-signal=DET_ELEVATION_134}, {application-record-element=DET_ELEVATION_135, system-signal=DET_ELEVATION_135}, {application-record-element=DET_ELEVATION_136, system-signal=DET_ELEVATION_136}, {application-record-element=DET_ELEVATION_ERR_133, system-signal=DET_ELEVATION_ERR_133}, {application-record-element=DET_ELEVATION_ERR_134, system-signal=DET_ELEVATION_ERR_134}, {application-record-element=DET_ELEVATION_ERR_135, system-signal=DET_ELEVATION_ERR_135}, {application-record-element=DET_ELEVATION_ERR_136, system-signal=DET_ELEVATION_ERR_136}, {application-record-element=DET_EXISTENCE_PROB_133, system-signal=DET_EXISTENCE_PROB_133}, {application-record-element=DET_EXISTENCE_PROB_134, system-signal=DET_EXISTENCE_PROB_134}, {application-record-element=DET_EXISTENCE_PROB_135, system-signal=DET_EXISTENCE_PROB_135}, {application-record-element=DET_EXISTENCE_PROB_136, system-signal=DET_EXISTENCE_PROB_136}, {application-record-element=DET_HVC_FLAG_133, system-signal=DET_HVC_FLAG_133}, {application-record-element=DET_HVC_FLAG_134, system-signal=DET_HVC_FLAG_134}, {application-record-element=DET_HVC_FLAG_135, system-signal=DET_HVC_FLAG_135}, {application-record-element=DET_HVC_FLAG_136, system-signal=DET_HVC_FLAG_136}, {application-record-element=DET_IDM_133, system-signal=DET_IDM_133}, {application-record-element=DET_IDM_134, system-signal=DET_IDM_134}, {application-record-element=DET_IDM_135, system-signal=DET_IDM_135}, {application-record-element=DET_IDM_136, system-signal=DET_IDM_136}, {application-record-element=DET_MH_CRC16_133_136, system-signal=DET_MH_CRC16_133_136}, {application-record-element=DET_MH_CYCLE_COUNTER_133_136, system-signal=DET_MH_CYCLE_COUNTER_133_136}, {application-record-element=DET_MH_SCAN_INDEX_4LSB_133_136, system-signal=DET_MH_SCAN_INDEX_4LSB_133_136}, {application-record-element=DET_MTD_133, system-signal=DET_MTD_133}, {application-record-element=DET_MTD_134, system-signal=DET_MTD_134}, {application-record-element=DET_MTD_135, system-signal=DET_MTD_135}, {application-record-element=DET_MTD_136, system-signal=DET_MTD_136}, {application-record-element=DET_PROB_1STAZHYPO_133, system-signal=DET_PROB_1STAZHYPO_133}, {application-record-element=DET_PROB_1STAZHYPO_134, system-signal=DET_PROB_1STAZHYPO_134}, {application-record-element=DET_PROB_1STAZHYPO_135, system-signal=DET_PROB_1STAZHYPO_135}, {application-record-element=DET_PROB_1STAZHYPO_136, system-signal=DET_PROB_1STAZHYPO_136}, {application-record-element=DET_RANGE_133, system-signal=DET_RANGE_133}, {application-record-element=DET_RANGE_134, system-signal=DET_RANGE_134}, {application-record-element=DET_RANGE_135, system-signal=DET_RANGE_135}, {application-record-element=DET_RANGE_136, system-signal=DET_RANGE_136}, {application-record-element=DET_RANGE_ERR_133, system-signal=DET_RANGE_ERR_133}, {application-record-element=DET_RANGE_ERR_134, system-signal=DET_RANGE_ERR_134}, {application-record-element=DET_RANGE_ERR_135, system-signal=DET_RANGE_ERR_135}, {application-record-element=DET_RANGE_ERR_136, system-signal=DET_RANGE_ERR_136}, {application-record-element=DET_RANGE_VELOCITY_133, system-signal=DET_RANGE_VELOCITY_133}, {application-record-element=DET_RANGE_VELOCITY_134, system-signal=DET_RANGE_VELOCITY_134}, {application-record-element=DET_RANGE_VELOCITY_135, system-signal=DET_RANGE_VELOCITY_135}, {application-record-element=DET_RANGE_VELOCITY_136, system-signal=DET_RANGE_VELOCITY_136}, {application-record-element=DET_RANGE_VELOCITY_ERR_133, system-signal=DET_RANGE_VELOCITY_ERR_133}, {application-record-element=DET_RANGE_VELOCITY_ERR_134, system-signal=DET_RANGE_VELOCITY_ERR_134}, {application-record-element=DET_RANGE_VELOCITY_ERR_135, system-signal=DET_RANGE_VELOCITY_ERR_135}, {application-record-element=DET_RANGE_VELOCITY_ERR_136, system-signal=DET_RANGE_VELOCITY_ERR_136}, {application-record-element=DET_RCS_133, system-signal=DET_RCS_133}, {application-record-element=DET_RCS_134, system-signal=DET_RCS_134}, {application-record-element=DET_RCS_135, system-signal=DET_RCS_135}, {application-record-element=DET_RCS_136, system-signal=DET_RCS_136}, {application-record-element=DET_SNR_133, system-signal=DET_SNR_133}, {application-record-element=DET_SNR_134, system-signal=DET_SNR_134}, {application-record-element=DET_SNR_135, system-signal=DET_SNR_135}, {application-record-element=DET_SNR_136, system-signal=DET_SNR_136}, {application-record-element=DET_SUPER_RES_TARGET_133, system-signal=DET_SUPER_RES_TARGET_133}, {application-record-element=DET_SUPER_RES_TARGET_134, system-signal=DET_SUPER_RES_TARGET_134}, {application-record-element=DET_SUPER_RES_TARGET_135, system-signal=DET_SUPER_RES_TARGET_135}, {application-record-element=DET_SUPER_RES_TARGET_136, system-signal=DET_SUPER_RES_TARGET_136}]}
        sender-receiver-to-signal-group-mapping={data-element=Pp_SG_Detections_137_140_AL.Vdp_SG_Detections_137_140_AL, signal-group=SG_Detections_137_140, type-mapping=sender-rec-record-type-mapping=record-element-mappings=[{application-record-element=DET_AZIMUTH_137, system-signal=DET_AZIMUTH_137}, {application-record-element=DET_AZIMUTH_138, system-signal=DET_AZIMUTH_138}, {application-record-element=DET_AZIMUTH_139, system-signal=DET_AZIMUTH_139}, {application-record-element=DET_AZIMUTH_140, system-signal=DET_AZIMUTH_140}, {application-record-element=DET_AZIMUTH_ERR_137, system-signal=DET_AZIMUTH_ERR_137}, {application-record-element=DET_AZIMUTH_ERR_138, system-signal=DET_AZIMUTH_ERR_138}, {application-record-element=DET_AZIMUTH_ERR_139, system-signal=DET_AZIMUTH_ERR_139}, {application-record-element=DET_AZIMUTH_ERR_140, system-signal=DET_AZIMUTH_ERR_140}, {application-record-element=DET_BELOW_RAIN_THOLD_137, system-signal=DET_BELOW_RAIN_THOLD_137}, {application-record-element=DET_BELOW_RAIN_THOLD_138, system-signal=DET_BELOW_RAIN_THOLD_138}, {application-record-element=DET_BELOW_RAIN_THOLD_139, system-signal=DET_BELOW_RAIN_THOLD_139}, {application-record-element=DET_BELOW_RAIN_THOLD_140, system-signal=DET_BELOW_RAIN_THOLD_140}, {application-record-element=DET_BI_STATIC_FLAG_137, system-signal=DET_BI_STATIC_FLAG_137}, {application-record-element=DET_BI_STATIC_FLAG_138, system-signal=DET_BI_STATIC_FLAG_138}, {application-record-element=DET_BI_STATIC_FLAG_139, system-signal=DET_BI_STATIC_FLAG_139}, {application-record-element=DET_BI_STATIC_FLAG_140, system-signal=DET_BI_STATIC_FLAG_140}, {application-record-element=DET_CONFD_AZIMUTH_137, system-signal=DET_CONFD_AZIMUTH_137}, {application-record-element=DET_CONFD_AZIMUTH_138, system-signal=DET_CONFD_AZIMUTH_138}, {application-record-element=DET_CONFD_AZIMUTH_139, system-signal=DET_CONFD_AZIMUTH_139}, {application-record-element=DET_CONFD_AZIMUTH_140, system-signal=DET_CONFD_AZIMUTH_140}, {application-record-element=DET_CONFD_ELEVATION_137, system-signal=DET_CONFD_ELEVATION_137}, {application-record-element=DET_CONFD_ELEVATION_138, system-signal=DET_CONFD_ELEVATION_138}, {application-record-element=DET_CONFD_ELEVATION_139, system-signal=DET_CONFD_ELEVATION_139}, {application-record-element=DET_CONFD_ELEVATION_140, system-signal=DET_CONFD_ELEVATION_140}, {application-record-element=DET_ELEVATION_137, system-signal=DET_ELEVATION_137}, {application-record-element=DET_ELEVATION_138, system-signal=DET_ELEVATION_138}, {application-record-element=DET_ELEVATION_139, system-signal=DET_ELEVATION_139}, {application-record-element=DET_ELEVATION_140, system-signal=DET_ELEVATION_140}, {application-record-element=DET_ELEVATION_ERR_137, system-signal=DET_ELEVATION_ERR_137}, {application-record-element=DET_ELEVATION_ERR_138, system-signal=DET_ELEVATION_ERR_138}, {application-record-element=DET_ELEVATION_ERR_139, system-signal=DET_ELEVATION_ERR_139}, {application-record-element=DET_ELEVATION_ERR_140, system-signal=DET_ELEVATION_ERR_140}, {application-record-element=DET_EXISTENCE_PROB_137, system-signal=DET_EXISTENCE_PROB_137}, {application-record-element=DET_EXISTENCE_PROB_138, system-signal=DET_EXISTENCE_PROB_138}, {application-record-element=DET_EXISTENCE_PROB_139, system-signal=DET_EXISTENCE_PROB_139}, {application-record-element=DET_EXISTENCE_PROB_140, system-signal=DET_EXISTENCE_PROB_140}, {application-record-element=DET_HVC_FLAG_137, system-signal=DET_HVC_FLAG_137}, {application-record-element=DET_HVC_FLAG_138, system-signal=DET_HVC_FLAG_138}, {application-record-element=DET_HVC_FLAG_139, system-signal=DET_HVC_FLAG_139}, {application-record-element=DET_HVC_FLAG_140, system-signal=DET_HVC_FLAG_140}, {application-record-element=DET_IDM_137, system-signal=DET_IDM_137}, {application-record-element=DET_IDM_138, system-signal=DET_IDM_138}, {application-record-element=DET_IDM_139, system-signal=DET_IDM_139}, {application-record-element=DET_IDM_140, system-signal=DET_IDM_140}, {application-record-element=DET_MH_CRC16_137_140, system-signal=DET_MH_CRC16_137_140}, {application-record-element=DET_MH_CYCLE_COUNTER_137_140, system-signal=DET_MH_CYCLE_COUNTER_137_140}, {application-record-element=DET_MH_SCAN_INDEX_4LSB_137_140, system-signal=DET_MH_SCAN_INDEX_4LSB_137_140}, {application-record-element=DET_MTD_137, system-signal=DET_MTD_137}, {application-record-element=DET_MTD_138, system-signal=DET_MTD_138}, {application-record-element=DET_MTD_139, system-signal=DET_MTD_139}, {application-record-element=DET_MTD_140, system-signal=DET_MTD_140}, {application-record-element=DET_PROB_1STAZHYPO_137, system-signal=DET_PROB_1STAZHYPO_137}, {application-record-element=DET_PROB_1STAZHYPO_138, system-signal=DET_PROB_1STAZHYPO_138}, {application-record-element=DET_PROB_1STAZHYPO_139, system-signal=DET_PROB_1STAZHYPO_139}, {application-record-element=DET_PROB_1STAZHYPO_140, system-signal=DET_PROB_1STAZHYPO_140}, {application-record-element=DET_RANGE_137, system-signal=DET_RANGE_137}, {application-record-element=DET_RANGE_138, system-signal=DET_RANGE_138}, {application-record-element=DET_RANGE_139, system-signal=DET_RANGE_139}, {application-record-element=DET_RANGE_140, system-signal=DET_RANGE_140}, {application-record-element=DET_RANGE_ERR_137, system-signal=DET_RANGE_ERR_137}, {application-record-element=DET_RANGE_ERR_138, system-signal=DET_RANGE_ERR_138}, {application-record-element=DET_RANGE_ERR_139, system-signal=DET_RANGE_ERR_139}, {application-record-element=DET_RANGE_ERR_140, system-signal=DET_RANGE_ERR_140}, {application-record-element=DET_RANGE_VELOCITY_137, system-signal=DET_RANGE_VELOCITY_137}, {application-record-element=DET_RANGE_VELOCITY_138, system-signal=DET_RANGE_VELOCITY_138}, {application-record-element=DET_RANGE_VELOCITY_139, system-signal=DET_RANGE_VELOCITY_139}, {application-record-element=DET_RANGE_VELOCITY_140, system-signal=DET_RANGE_VELOCITY_140}, {application-record-element=DET_RANGE_VELOCITY_ERR_137, system-signal=DET_RANGE_VELOCITY_ERR_137}, {application-record-element=DET_RANGE_VELOCITY_ERR_138, system-signal=DET_RANGE_VELOCITY_ERR_138}, {application-record-element=DET_RANGE_VELOCITY_ERR_139, system-signal=DET_RANGE_VELOCITY_ERR_139}, {application-record-element=DET_RANGE_VELOCITY_ERR_140, system-signal=DET_RANGE_VELOCITY_ERR_140}, {application-record-element=DET_RCS_137, system-signal=DET_RCS_137}, {application-record-element=DET_RCS_138, system-signal=DET_RCS_138}, {application-record-element=DET_RCS_139, system-signal=DET_RCS_139}, {application-record-element=DET_RCS_140, system-signal=DET_RCS_140}, {application-record-element=DET_SNR_137, system-signal=DET_SNR_137}, {application-record-element=DET_SNR_138, system-signal=DET_SNR_138}, {application-record-element=DET_SNR_139, system-signal=DET_SNR_139}, {application-record-element=DET_SNR_140, system-signal=DET_SNR_140}, {application-record-element=DET_SUPER_RES_TARGET_137, system-signal=DET_SUPER_RES_TARGET_137}, {application-record-element=DET_SUPER_RES_TARGET_138, system-signal=DET_SUPER_RES_TARGET_138}, {application-record-element=DET_SUPER_RES_TARGET_139, system-signal=DET_SUPER_RES_TARGET_139}, {application-record-element=DET_SUPER_RES_TARGET_140, system-signal=DET_SUPER_RES_TARGET_140}]}
        sender-receiver-to-signal-group-mapping={data-element=Pp_SG_Detections_141_144_AL.Vdp_SG_Detections_141_144_AL, signal-group=SG_Detections_141_144, type-mapping=sender-rec-record-type-mapping=record-element-mappings=[{application-record-element=DET_AZIMUTH_141, system-signal=DET_AZIMUTH_141}, {application-record-element=DET_AZIMUTH_142, system-signal=DET_AZIMUTH_142}, {application-record-element=DET_AZIMUTH_143, system-signal=DET_AZIMUTH_143}, {application-record-element=DET_AZIMUTH_144, system-signal=DET_AZIMUTH_144}, {application-record-element=DET_AZIMUTH_ERR_141, system-signal=DET_AZIMUTH_ERR_141}, {application-record-element=DET_AZIMUTH_ERR_142, system-signal=DET_AZIMUTH_ERR_142}, {application-record-element=DET_AZIMUTH_ERR_143, system-signal=DET_AZIMUTH_ERR_143}, {application-record-element=DET_AZIMUTH_ERR_144, system-signal=DET_AZIMUTH_ERR_144}, {application-record-element=DET_BELOW_RAIN_THOLD_141, system-signal=DET_BELOW_RAIN_THOLD_141}, {application-record-element=DET_BELOW_RAIN_THOLD_142, system-signal=DET_BELOW_RAIN_THOLD_142}, {application-record-element=DET_BELOW_RAIN_THOLD_143, system-signal=DET_BELOW_RAIN_THOLD_143}, {application-record-element=DET_BELOW_RAIN_THOLD_144, system-signal=DET_BELOW_RAIN_THOLD_144}, {application-record-element=DET_BI_STATIC_FLAG_141, system-signal=DET_BI_STATIC_FLAG_141}, {application-record-element=DET_BI_STATIC_FLAG_142, system-signal=DET_BI_STATIC_FLAG_142}, {application-record-element=DET_BI_STATIC_FLAG_143, system-signal=DET_BI_STATIC_FLAG_143}, {application-record-element=DET_BI_STATIC_FLAG_144, system-signal=DET_BI_STATIC_FLAG_144}, {application-record-element=DET_CONFD_AZIMUTH_141, system-signal=DET_CONFD_AZIMUTH_141}, {application-record-element=DET_CONFD_AZIMUTH_142, system-signal=DET_CONFD_AZIMUTH_142}, {application-record-element=DET_CONFD_AZIMUTH_143, system-signal=DET_CONFD_AZIMUTH_143}, {application-record-element=DET_CONFD_AZIMUTH_144, system-signal=DET_CONFD_AZIMUTH_144}, {application-record-element=DET_CONFD_ELEVATION_141, system-signal=DET_CONFD_ELEVATION_141}, {application-record-element=DET_CONFD_ELEVATION_142, system-signal=DET_CONFD_ELEVATION_142}, {application-record-element=DET_CONFD_ELEVATION_143, system-signal=DET_CONFD_ELEVATION_143}, {application-record-element=DET_CONFD_ELEVATION_144, system-signal=DET_CONFD_ELEVATION_144}, {application-record-element=DET_ELEVATION_141, system-signal=DET_ELEVATION_141}, {application-record-element=DET_ELEVATION_142, system-signal=DET_ELEVATION_142}, {application-record-element=DET_ELEVATION_143, system-signal=DET_ELEVATION_143}, {application-record-element=DET_ELEVATION_144, system-signal=DET_ELEVATION_144}, {application-record-element=DET_ELEVATION_ERR_141, system-signal=DET_ELEVATION_ERR_141}, {application-record-element=DET_ELEVATION_ERR_142, system-signal=DET_ELEVATION_ERR_142}, {application-record-element=DET_ELEVATION_ERR_143, system-signal=DET_ELEVATION_ERR_143}, {application-record-element=DET_ELEVATION_ERR_144, system-signal=DET_ELEVATION_ERR_144}, {application-record-element=DET_EXISTENCE_PROB_141, system-signal=DET_EXISTENCE_PROB_141}, {application-record-element=DET_EXISTENCE_PROB_142, system-signal=DET_EXISTENCE_PROB_142}, {application-record-element=DET_EXISTENCE_PROB_143, system-signal=DET_EXISTENCE_PROB_143}, {application-record-element=DET_EXISTENCE_PROB_144, system-signal=DET_EXISTENCE_PROB_144}, {application-record-element=DET_HVC_FLAG_141, system-signal=DET_HVC_FLAG_141}, {application-record-element=DET_HVC_FLAG_142, system-signal=DET_HVC_FLAG_142}, {application-record-element=DET_HVC_FLAG_143, system-signal=DET_HVC_FLAG_143}, {application-record-element=DET_HVC_FLAG_144, system-signal=DET_HVC_FLAG_144}, {application-record-element=DET_IDM_141, system-signal=DET_IDM_141}, {application-record-element=DET_IDM_142, system-signal=DET_IDM_142}, {application-record-element=DET_IDM_143, system-signal=DET_IDM_143}, {application-record-element=DET_IDM_144, system-signal=DET_IDM_144}, {application-record-element=DET_MH_CRC16_141_144, system-signal=DET_MH_CRC16_141_144}, {application-record-element=DET_MH_CYCLE_COUNTER_141_144, system-signal=DET_MH_CYCLE_COUNTER_141_144}, {application-record-element=DET_MH_SCAN_INDEX_4LSB_141_144, system-signal=DET_MH_SCAN_INDEX_4LSB_141_144}, {application-record-element=DET_MTD_141, system-signal=DET_MTD_141}, {application-record-element=DET_MTD_142, system-signal=DET_MTD_142}, {application-record-element=DET_MTD_143, system-signal=DET_MTD_143}, {application-record-element=DET_MTD_144, system-signal=DET_MTD_144}, {application-record-element=DET_PROB_1STAZHYPO_141, system-signal=DET_PROB_1STAZHYPO_141}, {application-record-element=DET_PROB_1STAZHYPO_142, system-signal=DET_PROB_1STAZHYPO_142}, {application-record-element=DET_PROB_1STAZHYPO_143, system-signal=DET_PROB_1STAZHYPO_143}, {application-record-element=DET_PROB_1STAZHYPO_144, system-signal=DET_PROB_1STAZHYPO_144}, {application-record-element=DET_RANGE_141, system-signal=DET_RANGE_141}, {application-record-element=DET_RANGE_142, system-signal=DET_RANGE_142}, {application-record-element=DET_RANGE_143, system-signal=DET_RANGE_143}, {application-record-element=DET_RANGE_144, system-signal=DET_RANGE_144}, {application-record-element=DET_RANGE_ERR_141, system-signal=DET_RANGE_ERR_141}, {application-record-element=DET_RANGE_ERR_142, system-signal=DET_RANGE_ERR_142}, {application-record-element=DET_RANGE_ERR_143, system-signal=DET_RANGE_ERR_143}, {application-record-element=DET_RANGE_ERR_144, system-signal=DET_RANGE_ERR_144}, {application-record-element=DET_RANGE_VELOCITY_141, system-signal=DET_RANGE_VELOCITY_141}, {application-record-element=DET_RANGE_VELOCITY_142, system-signal=DET_RANGE_VELOCITY_142}, {application-record-element=DET_RANGE_VELOCITY_143, system-signal=DET_RANGE_VELOCITY_143}, {application-record-element=DET_RANGE_VELOCITY_144, system-signal=DET_RANGE_VELOCITY_144}, {application-record-element=DET_RANGE_VELOCITY_ERR_141, system-signal=DET_RANGE_VELOCITY_ERR_141}, {application-record-element=DET_RANGE_VELOCITY_ERR_142, system-signal=DET_RANGE_VELOCITY_ERR_142}, {application-record-element=DET_RANGE_VELOCITY_ERR_143, system-signal=DET_RANGE_VELOCITY_ERR_143}, {application-record-element=DET_RANGE_VELOCITY_ERR_144, system-signal=DET_RANGE_VELOCITY_ERR_144}, {application-record-element=DET_RCS_141, system-signal=DET_RCS_141}, {application-record-element=DET_RCS_142, system-signal=DET_RCS_142}, {application-record-element=DET_RCS_143, system-signal=DET_RCS_143}, {application-record-element=DET_RCS_144, system-signal=DET_RCS_144}, {application-record-element=DET_SNR_141, system-signal=DET_SNR_141}, {application-record-element=DET_SNR_142, system-signal=DET_SNR_142}, {application-record-element=DET_SNR_143, system-signal=DET_SNR_143}, {application-record-element=DET_SNR_144, system-signal=DET_SNR_144}, {application-record-element=DET_SUPER_RES_TARGET_141, system-signal=DET_SUPER_RES_TARGET_141}, {application-record-element=DET_SUPER_RES_TARGET_142, system-signal=DET_SUPER_RES_TARGET_142}, {application-record-element=DET_SUPER_RES_TARGET_143, system-signal=DET_SUPER_RES_TARGET_143}, {application-record-element=DET_SUPER_RES_TARGET_144, system-signal=DET_SUPER_RES_TARGET_144}]}
        sender-receiver-to-signal-group-mapping={data-element=Pp_SG_Detections_145_148_AL.Vdp_SG_Detections_145_148_AL, signal-group=SG_Detections_145_148, type-mapping=sender-rec-record-type-mapping=record-element-mappings=[{application-record-element=DET_AZIMUTH_145, system-signal=DET_AZIMUTH_145}, {application-record-element=DET_AZIMUTH_146, system-signal=DET_AZIMUTH_146}, {application-record-element=DET_AZIMUTH_147, system-signal=DET_AZIMUTH_147}, {application-record-element=DET_AZIMUTH_148, system-signal=DET_AZIMUTH_148}, {application-record-element=DET_AZIMUTH_ERR_145, system-signal=DET_AZIMUTH_ERR_145}, {application-record-element=DET_AZIMUTH_ERR_146, system-signal=DET_AZIMUTH_ERR_146}, {application-record-element=DET_AZIMUTH_ERR_147, system-signal=DET_AZIMUTH_ERR_147}, {application-record-element=DET_AZIMUTH_ERR_148, system-signal=DET_AZIMUTH_ERR_148}, {application-record-element=DET_BELOW_RAIN_THOLD_145, system-signal=DET_BELOW_RAIN_THOLD_145}, {application-record-element=DET_BELOW_RAIN_THOLD_146, system-signal=DET_BELOW_RAIN_THOLD_146}, {application-record-element=DET_BELOW_RAIN_THOLD_147, system-signal=DET_BELOW_RAIN_THOLD_147}, {application-record-element=DET_BELOW_RAIN_THOLD_148, system-signal=DET_BELOW_RAIN_THOLD_148}, {application-record-element=DET_BI_STATIC_FLAG_145, system-signal=DET_BI_STATIC_FLAG_145}, {application-record-element=DET_BI_STATIC_FLAG_146, system-signal=DET_BI_STATIC_FLAG_146}, {application-record-element=DET_BI_STATIC_FLAG_147, system-signal=DET_BI_STATIC_FLAG_147}, {application-record-element=DET_BI_STATIC_FLAG_148, system-signal=DET_BI_STATIC_FLAG_148}, {application-record-element=DET_CONFD_AZIMUTH_145, system-signal=DET_CONFD_AZIMUTH_145}, {application-record-element=DET_CONFD_AZIMUTH_146, system-signal=DET_CONFD_AZIMUTH_146}, {application-record-element=DET_CONFD_AZIMUTH_147, system-signal=DET_CONFD_AZIMUTH_147}, {application-record-element=DET_CONFD_AZIMUTH_148, system-signal=DET_CONFD_AZIMUTH_148}, {application-record-element=DET_CONFD_ELEVATION_145, system-signal=DET_CONFD_ELEVATION_145}, {application-record-element=DET_CONFD_ELEVATION_146, system-signal=DET_CONFD_ELEVATION_146}, {application-record-element=DET_CONFD_ELEVATION_147, system-signal=DET_CONFD_ELEVATION_147}, {application-record-element=DET_CONFD_ELEVATION_148, system-signal=DET_CONFD_ELEVATION_148}, {application-record-element=DET_ELEVATION_145, system-signal=DET_ELEVATION_145}, {application-record-element=DET_ELEVATION_146, system-signal=DET_ELEVATION_146}, {application-record-element=DET_ELEVATION_147, system-signal=DET_ELEVATION_147}, {application-record-element=DET_ELEVATION_148, system-signal=DET_ELEVATION_148}, {application-record-element=DET_ELEVATION_ERR_145, system-signal=DET_ELEVATION_ERR_145}, {application-record-element=DET_ELEVATION_ERR_146, system-signal=DET_ELEVATION_ERR_146}, {application-record-element=DET_ELEVATION_ERR_147, system-signal=DET_ELEVATION_ERR_147}, {application-record-element=DET_ELEVATION_ERR_148, system-signal=DET_ELEVATION_ERR_148}, {application-record-element=DET_EXISTENCE_PROB_145, system-signal=DET_EXISTENCE_PROB_145}, {application-record-element=DET_EXISTENCE_PROB_146, system-signal=DET_EXISTENCE_PROB_146}, {application-record-element=DET_EXISTENCE_PROB_147, system-signal=DET_EXISTENCE_PROB_147}, {application-record-element=DET_EXISTENCE_PROB_148, system-signal=DET_EXISTENCE_PROB_148}, {application-record-element=DET_HVC_FLAG_145, system-signal=DET_HVC_FLAG_145}, {application-record-element=DET_HVC_FLAG_146, system-signal=DET_HVC_FLAG_146}, {application-record-element=DET_HVC_FLAG_147, system-signal=DET_HVC_FLAG_147}, {application-record-element=DET_HVC_FLAG_148, system-signal=DET_HVC_FLAG_148}, {application-record-element=DET_IDM_145, system-signal=DET_IDM_145}, {application-record-element=DET_IDM_146, system-signal=DET_IDM_146}, {application-record-element=DET_IDM_147, system-signal=DET_IDM_147}, {application-record-element=DET_IDM_148, system-signal=DET_IDM_148}, {application-record-element=DET_MH_CRC16_145_148, system-signal=DET_MH_CRC16_145_148}, {application-record-element=DET_MH_CYCLE_COUNTER_145_148, system-signal=DET_MH_CYCLE_COUNTER_145_148}, {application-record-element=DET_MH_SCAN_INDEX_4LSB_145_148, system-signal=DET_MH_SCAN_INDEX_4LSB_145_148}, {application-record-element=DET_MTD_145, system-signal=DET_MTD_145}, {application-record-element=DET_MTD_146, system-signal=DET_MTD_146}, {application-record-element=DET_MTD_147, system-signal=DET_MTD_147}, {application-record-element=DET_MTD_148, system-signal=DET_MTD_148}, {application-record-element=DET_PROB_1STAZHYPO_145, system-signal=DET_PROB_1STAZHYPO_145}, {application-record-element=DET_PROB_1STAZHYPO_146, system-signal=DET_PROB_1STAZHYPO_146}, {application-record-element=DET_PROB_1STAZHYPO_147, system-signal=DET_PROB_1STAZHYPO_147}, {application-record-element=DET_PROB_1STAZHYPO_148, system-signal=DET_PROB_1STAZHYPO_148}, {application-record-element=DET_RANGE_145, system-signal=DET_RANGE_145}, {application-record-element=DET_RANGE_146, system-signal=DET_RANGE_146}, {application-record-element=DET_RANGE_147, system-signal=DET_RANGE_147}, {application-record-element=DET_RANGE_148, system-signal=DET_RANGE_148}, {application-record-element=DET_RANGE_ERR_145, system-signal=DET_RANGE_ERR_145}, {application-record-element=DET_RANGE_ERR_146, system-signal=DET_RANGE_ERR_146}, {application-record-element=DET_RANGE_ERR_147, system-signal=DET_RANGE_ERR_147}, {application-record-element=DET_RANGE_ERR_148, system-signal=DET_RANGE_ERR_148}, {application-record-element=DET_RANGE_VELOCITY_145, system-signal=DET_RANGE_VELOCITY_145}, {application-record-element=DET_RANGE_VELOCITY_146, system-signal=DET_RANGE_VELOCITY_146}, {application-record-element=DET_RANGE_VELOCITY_147, system-signal=DET_RANGE_VELOCITY_147}, {application-record-element=DET_RANGE_VELOCITY_148, system-signal=DET_RANGE_VELOCITY_148}, {application-record-element=DET_RANGE_VELOCITY_ERR_145, system-signal=DET_RANGE_VELOCITY_ERR_145}, {application-record-element=DET_RANGE_VELOCITY_ERR_146, system-signal=DET_RANGE_VELOCITY_ERR_146}, {application-record-element=DET_RANGE_VELOCITY_ERR_147, system-signal=DET_RANGE_VELOCITY_ERR_147}, {application-record-element=DET_RANGE_VELOCITY_ERR_148, system-signal=DET_RANGE_VELOCITY_ERR_148}, {application-record-element=DET_RCS_145, system-signal=DET_RCS_145}, {application-record-element=DET_RCS_146, system-signal=DET_RCS_146}, {application-record-element=DET_RCS_147, system-signal=DET_RCS_147}, {application-record-element=DET_RCS_148, system-signal=DET_RCS_148}, {application-record-element=DET_SNR_145, system-signal=DET_SNR_145}, {application-record-element=DET_SNR_146, system-signal=DET_SNR_146}, {application-record-element=DET_SNR_147, system-signal=DET_SNR_147}, {application-record-element=DET_SNR_148, system-signal=DET_SNR_148}, {application-record-element=DET_SUPER_RES_TARGET_145, system-signal=DET_SUPER_RES_TARGET_145}, {application-record-element=DET_SUPER_RES_TARGET_146, system-signal=DET_SUPER_RES_TARGET_146}, {application-record-element=DET_SUPER_RES_TARGET_147, system-signal=DET_SUPER_RES_TARGET_147}, {application-record-element=DET_SUPER_RES_TARGET_148, system-signal=DET_SUPER_RES_TARGET_148}]}
