AUTOSAR XML (schema 00053)
standard types defined: boolean, float32, uint16, uint32, uint8
package /MICROSAR
  bsw implementation Rte_Impl: programming-language=C, sw-version=4.40.00, used-code-generator=DaVinci Configurator, vendor-id=30, ar-release-version=4.03.01
    mc-parameter-instances:
      72 x mc data instance, all with category=STRUCTURE:
        SWC_PLT_Appl_IoHwAb_ECU_Position_ROMDefault: flat-map-entry=SWC_PLT_Appl_IoHwAb_ECU_Position_ROMDefault, symbol=Rte_SWC_PLT_Appl_IoHwAb_ECU_Position_ROMDefault, variation-point=post-build-variant-condition{matching-criterion=RDR_POS, value=0}
          mc data instance ECUPosition_Value: category=VALUE, resulting-properties={base-type=uint8, sw-calibration-access=READ-WRITE, data-constr=uint8_DataConstr}
          mc data instance Reserved: category=VALUE, resulting-properties={base-type=uint8, sw-calibration-access=READ-WRITE, data-constr=uint8_DataConstr}
          mc data instance CRC_Value: category=VALUE, resulting-properties={base-type=uint16, sw-calibration-access=READ-WRITE, data-constr=uint16_DataConstr}
        SWC_PLT_Appl_NvMHandler_Alignment_NvMBlock_DefaultValue: flat-map-entry=SWC_PLT_Appl_NvMHandler_Alignment_NvMBlock_DefaultValue, symbol=Rte_SWC_PLT_Appl_NvMHandler_Alignment_NvMBlock_DefaultValue, variation-point=post-build-variant-condition{matching-criterion=RDR_POS, value=0}
          19 x mc data instance, all with category=VALUE:
            AACurrentAzimuth: resulting-properties={base-type=float32, sw-calibration-access=READ-WRITE, data-constr=float32_DataConstr}
            AACurrentElevation: resulting-properties={base-type=float32, sw-calibration-access=READ-WRITE, data-constr=float32_DataConstr}
            AACurrentRoll: resulting-properties={base-type=float32, sw-calibration-access=READ-WRITE, data-constr=float32_DataConstr}
            InitialAlignmentResultAzimuth: resulting-properties={base-type=float32, sw-calibration-access=READ-WRITE, data-constr=float32_DataConstr}
            InitialAlignmentResultElevation: resulting-properties={base-type=float32, sw-calibration-access=READ-WRITE, data-constr=float32_DataConstr}
            InitialAlignmentResultRoll: resulting-properties={base-type=float32, sw-calibration-access=READ-WRITE, data-constr=float32_DataConstr}
            InitialLastSuccessfulAlignmentMode: resulting-properties={base-type=float32, sw-calibration-access=READ-WRITE, data-constr=float32_DataConstr}
            ElevationUpdates: resulting-properties={base-type=float32, sw-calibration-access=READ-WRITE, data-constr=float32_DataConstr}
            AzimuthUpdates: resulting-properties={base-type=float32, sw-calibration-access=READ-WRITE, data-constr=float32_DataConstr}
            RollUpdates: resulting-properties={base-type=float32, sw-calibration-access=READ-WRITE, data-constr=float32_DataConstr}
            InitialAlignmentResultElevationUpdates: resulting-properties={base-type=float32, sw-calibration-access=READ-WRITE, data-constr=float32_DataConstr}
            InitialAlignmentResultHostSpeedCompensationFactor: resulting-properties={base-type=float32, sw-calibration-access=READ-WRITE, data-constr=float32_DataConstr}
            HostSpeedCompensationFactor: resulting-properties={base-type=float32, sw-calibration-access=READ-WRITE, data-constr=float32_DataConstr}
            InitialAlignmentResultAzimuthUpdates: resulting-properties={base-type=float32, sw-calibration-access=READ-WRITE, data-constr=float32_DataConstr}
            InitialAlignmentResultRollUpdates: resulting-properties={base-type=float32, sw-calibration-access=READ-WRITE, data-constr=float32_DataConstr}
            AlignmentModeOut: resulting-properties={base-type=uint8, sw-calibration-access=READ-WRITE, data-constr=uint8_DataConstr}
            azimuth_estimation_qf: resulting-properties={base-type=uint8, sw-calibration-access=READ-WRITE, data-constr=uint8_DataConstr}
            elevation_estimation_qf: resulting-properties={base-type=uint8, sw-calibration-access=READ-WRITE, data-constr=uint8_DataConstr}
            scf_estimation_qf: resulting-properties={base-type=uint8, sw-calibration-access=READ-WRITE, data-constr=uint8_DataConstr}
        SWC_PLT_Appl_NvMHandler_Correctable_Fault_NvM_DefaultValue: flat-map-entry=SWC_PLT_Appl_NvMHandler_Correctable_Fault_NvM_DefaultValue, symbol=Rte_SWC_PLT_Appl_NvMHandler_Correctable_Fault_NvM_DefaultValue, variation-point=post-build-variant-condition{matching-criterion=RDR_POS, value=0}
          21 x mc data instance, all with category=VALUE:
            aa_mem_sec: resulting-properties={base-type=uint8, sw-calibration-access=READ-WRITE, data-constr=uint8_DataConstr}
            artie_mem_sec: resulting-properties={base-type=uint8, sw-calibration-access=READ-WRITE, data-constr=uint8_DataConstr}
            csi2_sec: resulting-properties={base-type=uint8, sw-calibration-access=READ-WRITE, data-constr=uint8_DataConstr}
            dsp_opif_sec: resulting-properties={base-type=uint8, sw-calibration-access=READ-WRITE, data-constr=uint8_DataConstr}
            dsp_idma_sec: resulting-properties={base-type=uint8, sw-calibration-access=READ-WRITE, data-constr=uint8_DataConstr}
            dsp_iram_sec_axis: resulting-properties={base-type=uint8, sw-calibration-access=READ-WRITE, data-constr=uint8_DataConstr}
            dsp_dcache_sec: resulting-properties={base-type=uint8, sw-calibration-access=READ-WRITE, data-constr=uint8_DataConstr}
            dsp_dram_sec: resulting-properties={base-type=uint8, sw-calibration-access=READ-WRITE, data-constr=uint8_DataConstr}
            dsp_icache_sec: resulting-properties={base-type=uint8, sw-calibration-access=READ-WRITE, data-constr=uint8_DataConstr}
            dsp_iram_sec: resulting-properties={base-type=uint8, sw-calibration-access=READ-WRITE, data-constr=uint8_DataConstr}
            ra_cqmem_sec: resulting-properties={base-type=uint8, sw-calibration-access=READ-WRITE, data-constr=uint8_DataConstr}
            ra_dpmem_sec: resulting-properties={base-type=uint8, sw-calibration-access=READ-WRITE, data-constr=uint8_DataConstr}
            ra_estmem_sec: resulting-properties={base-type=uint8, sw-calibration-access=READ-WRITE, data-constr=uint8_DataConstr}
            ra_idxmem_sec: resulting-properties={base-type=uint8, sw-calibration-access=READ-WRITE, data-constr=uint8_DataConstr}
            ra_phmem_sec: resulting-properties={base-type=uint8, sw-calibration-access=READ-WRITE, data-constr=uint8_DataConstr}
            ra_wcmem_sec: resulting-properties={base-type=uint8, sw-calibration-access=READ-WRITE, data-constr=uint8_DataConstr}
            sp_axi_m_corr: resulting-properties={base-type=uint16, sw-calibration-access=READ-WRITE, data-constr=uint16_DataConstr}
            sp_axi_s_corr: resulting-properties={base-type=uint16, sw-calibration-access=READ-WRITE, data-constr=uint16_DataConstr}
            sysmem0_sec: resulting-properties={base-type=uint8, sw-calibration-access=READ-WRITE, data-constr=uint8_DataConstr}
            sysmem1_sec: resulting-properties={base-type=uint8, sw-calibration-access=READ-WRITE, data-constr=uint8_DataConstr}
            not_recorded: resulting-properties={base-type=uint8, sw-calibration-access=READ-WRITE, data-constr=uint8_DataConstr}
        SWC_PLT_Appl_NvMHandler_NvMBringUp_DefaultValue: flat-map-entry=SWC_PLT_Appl_NvMHandler_NvMBringUp_DefaultValue, symbol=Rte_SWC_PLT_Appl_NvMHandler_NvMBringUp_DefaultValue, variation-point=post-build-variant-condition{matching-criterion=RDR_POS, value=0}
          19 x mc data instance, all with category=VALUE:
            AACurrentAzimuth: resulting-properties={base-type=float32, sw-calibration-access=READ-WRITE, data-constr=float32_DataConstr}
            AACurrentElevation: resulting-properties={base-type=float32, sw-calibration-access=READ-WRITE, data-constr=float32_DataConstr}
            AACurrentRoll: resulting-properties={base-type=float32, sw-calibration-access=READ-WRITE, data-constr=float32_DataConstr}
            InitialAlignmentResultAzimuth: resulting-properties={base-type=float32, sw-calibration-access=READ-WRITE, data-constr=float32_DataConstr}
            InitialAlignmentResultElevation: resulting-properties={base-type=float32, sw-calibration-access=READ-WRITE, data-constr=float32_DataConstr}
            InitialAlignmentResultRoll: resulting-properties={base-type=float32, sw-calibration-access=READ-WRITE, data-constr=float32_DataConstr}
            InitialLastSuccessfulAlignmentMode: resulting-properties={base-type=float32, sw-calibration-access=READ-WRITE, data-constr=float32_DataConstr}
            ElevationUpdates: resulting-properties={base-type=float32, sw-calibration-access=READ-WRITE, data-constr=float32_DataConstr}
            AzimuthUpdates: resulting-properties={base-type=float32, sw-calibration-access=READ-WRITE, data-constr=float32_DataConstr}
            RollUpdates: resulting-properties={base-type=float32, sw-calibration-access=READ-WRITE, data-constr=float32_DataConstr}
            InitialAlignmentResultElevationUpdates: resulting-properties={base-type=float32, sw-calibration-access=READ-WRITE, data-constr=float32_DataConstr}
            InitialAlignmentResultHostSpeedCompensationFactor: resulting-properties={base-type=float32, sw-calibration-access=READ-WRITE, data-constr=float32_DataConstr}
            HostSpeedCompensationFactor: resulting-properties={base-type=float32, sw-calibration-access=READ-WRITE, data-constr=float32_DataConstr}
            InitialAlignmentResultAzimuthUpdates: resulting-properties={base-type=float32, sw-calibration-access=READ-WRITE, data-constr=float32_DataConstr}
            InitialAlignmentResultRollUpdates: resulting-properties={base-type=float32, sw-calibration-access=READ-WRITE, data-constr=float32_DataConstr}
            AlignmentModeOut: resulting-properties={base-type=uint8, sw-calibration-access=READ-WRITE, data-constr=uint8_DataConstr}
            azimuth_estimation_qf: resulting-properties={base-type=uint8, sw-calibration-access=READ-WRITE, data-constr=uint8_DataConstr}
            elevation_estimation_qf: resulting-properties={base-type=uint8, sw-calibration-access=READ-WRITE, data-constr=uint8_DataConstr}
            scf_estimation_qf: resulting-properties={base-type=uint8, sw-calibration-access=READ-WRITE, data-constr=uint8_DataConstr}
        SWC_PLT_Appl_NvMHandler_RFE_R1R2_Fault_NvM_DefaultValue: flat-map-entry=SWC_PLT_Appl_NvMHandler_RFE_R1R2_Fault_NvM_DefaultValue, symbol=Rte_SWC_PLT_Appl_NvMHandler_RFE_R1R2_Fault_NvM_DefaultValue, variation-point=post-build-variant-condition{matching-criterion=RDR_POS, value=0}
          18 x mc data instance, all with category=VALUE:
            CORE_BANK_SFT_ERR_MON: resulting-properties={base-type=uint32, sw-calibration-access=READ-WRITE, data-constr=uint32_DataConstr}
            CORE_BANK_SFT_ERR_STATUS: resulting-properties={base-type=uint32, sw-calibration-access=READ-WRITE, data-constr=uint32_DataConstr}
            CORE_BANK_MCU_STS_MCU_MSSG: resulting-properties={base-type=uint32, sw-calibration-access=READ-WRITE, data-constr=uint32_DataConstr}
            FUSA_IRQ{0..2}_FLAG_R: resulting-properties={base-type=uint32, sw-calibration-access=READ-WRITE, data-constr=uint32_DataConstr}
            Api_ret_val: resulting-properties={base-type=uint32, sw-calibration-access=READ-WRITE, data-constr=uint32_DataConstr}
            LOGEN_BANK_CHRP_GEN_ERROR: resulting-properties={base-type=uint32, sw-calibration-access=READ-WRITE, data-constr=uint32_DataConstr}
            LOGEN_BANK_LOGEN_ERROR: resulting-properties={base-type=uint32, sw-calibration-access=READ-WRITE, data-constr=uint32_DataConstr}
            CPU_SYS_MCU_ERR_{0..3}: resulting-properties={base-type=uint32, sw-calibration-access=READ-WRITE, data-constr=uint32_DataConstr}
            ASYNC_BANK_ASYNC_ERR1: resulting-properties={base-type=uint32, sw-calibration-access=READ-WRITE, data-constr=uint32_DataConstr}
            PROF_BANK_PRF_ERR1: resulting-properties={base-type=uint32, sw-calibration-access=READ-WRITE, data-constr=uint32_DataConstr}
            PROF_BANK_PRF_ERR2: resulting-properties={base-type=uint32, sw-calibration-access=READ-WRITE, data-constr=uint32_DataConstr}
            RXADC_FUSAMON: resulting-properties={base-type=uint32, sw-calibration-access=READ-WRITE, data-constr=uint32_DataConstr}
            maf_status: resulting-properties={base-type=uint8, sw-calibration-access=READ-WRITE, data-constr=uint8_DataConstr}
        SWC_PLT_Appl_NvMHandler_SWC_PLT_CDD_FailSafe_DefaultValue: flat-map-entry=SWC_PLT_Appl_NvMHandler_SWC_PLT_CDD_FailSafe_DefaultValue, symbol=Rte_SWC_PLT_Appl_NvMHandler_SWC_PLT_CDD_FailSafe_DefaultValue, variation-point=post-build-variant-condition{matching-criterion=RDR_POS, value=0}
          11 x mc data instance:
            reset_reason: category=ARRAY, array-size=5, resulting-properties={base-type=uint8, sw-calibration-access=READ-WRITE, range raw 0..255}
            reset_counter: category=VALUE, resulting-properties={base-type=uint8, sw-calibration-access=READ-WRITE, data-constr=uint8_DataConstr}
            last_cycle_reset: category=VALUE, resulting-properties={base-type=uint8, sw-calibration-access=READ-WRITE, data-constr=uint8_DataConstr}
            reset_reason_crnt_indx: category=VALUE, resulting-properties={base-type=uint8, sw-calibration-access=READ-WRITE, data-constr=uint8_DataConstr}
            repetitive_reset_counter: category=VALUE, resulting-properties={base-type=uint8, sw-calibration-access=READ-WRITE, data-constr=uint8_DataConstr}
            RFE_Repetitive_Reset_Counter: category=VALUE, resulting-properties={base-type=uint8, sw-calibration-access=READ-WRITE, data-constr=uint8_DataConstr}
            mem_exception_reason: category=STRUCTURE
              6 x mc data instance, all with category=VALUE:
                ExceptionType: resulting-properties={base-type=uint32, sw-calibration-access=READ-WRITE, range raw 0..4294967295}
                ExceptionCausingAddress: resulting-properties={base-type=uint32, sw-calibration-access=READ-WRITE, range raw 0..4294967295}
                ExceptionStatusRegister: resulting-properties={base-type=uint32, sw-calibration-access=READ-WRITE, range raw 0..4294967295}
                IsMemException_Occured: resulting-properties={base-type=boolean, sw-calibration-access=READ-WRITE, compu {1=TRUE, 0=FALSE}, range raw 0..1}
                MemoryExceptionAddress: resulting-properties={base-type=uint32, sw-calibration-access=READ-WRITE, range raw 0..4294967295}
                StackPointer: resulting-properties={base-type=uint32, sw-calibration-access=READ-WRITE, range raw 0..4294967295}
            wdg_failed_SE_info: category=ARRAY, array-size=5, resulting-properties={base-type=uint16, sw-calibration-access=READ-WRITE, data-constr=uint16_DataConstr}
            FCCU_Faults: category=ARRAY, array-size=10, resulting-properties={base-type=uint16, sw-calibration-access=READ-WRITE, data-constr=uint16_DataConstr}
            StaticRegCheckFailureInfo: category=ARRAY, array-size=35, resulting-properties={base-type=uint8, sw-calibration-access=READ-WRITE, range raw 0..255}
            NOC_LatentIntFault_Info: category=STRUCTURE
              5 x mc data instance, all with category=VALUE:
                LatentFault{0..3}: resulting-properties={base-type=uint32, sw-calibration-access=READ-WRITE, data-constr=uint32_DataConstr}
                Resnum: resulting-properties={base-type=uint16, sw-calibration-access=READ-WRITE, data-constr=uint16_DataConstr}
        SWC_PLT_CDD_FailSafe_ExceptionReason_DefaultValue: flat-map-entry=SWC_PLT_CDD_FailSafe_ExceptionReason_DefaultValue, symbol=Rte_SWC_PLT_CDD_FailSafe_ExceptionReason_DefaultValue, variation-point=post-build-variant-condition{matching-criterion=RDR_POS, value=0}
          mc data instance exception_reason_info: category=ARRAY, array-size=3
            mc data instance Element_0: category=STRUCTURE, symbol=[0]
              4 x mc data instance:
                exception_type: category=VALUE, resulting-properties={base-type=uint8, sw-calibration-access=READ-WRITE, range raw 0..255}
                coreid: category=VALUE, resulting-properties={base-type=uint8, sw-calibration-access=READ-WRITE, range raw 0..255}
                reserved: category=VALUE, resulting-properties={base-type=uint16, sw-calibration-access=READ-WRITE, range raw 0..65535}
                spf_regs: category=ARRAY, array-size=5, resulting-properties={base-type=uint32, sw-calibration-access=READ-WRITE, range raw 0..4294967295}
            mc data instance Element_1: category=STRUCTURE, symbol=[1]
              4 x mc data instance:
                exception_type: category=VALUE, resulting-properties={base-type=uint8, sw-calibration-access=READ-WRITE, range raw 0..255}
                coreid: category=VALUE, resulting-properties={base-type=uint8, sw-calibration-access=READ-WRITE, range raw 0..255}
                reserved: category=VALUE, resulting-properties={base-type=uint16, sw-calibration-access=READ-WRITE, range raw 0..65535}
                spf_regs: category=ARRAY, array-size=5, resulting-properties={base-type=uint32, sw-calibration-access=READ-WRITE, range raw 0..4294967295}
            mc data instance Element_2: category=STRUCTURE, symbol=[2]
              4 x mc data instance:
                exception_type: category=VALUE, resulting-properties={base-type=uint8, sw-calibration-access=READ-WRITE, range raw 0..255}
                coreid: category=VALUE, resulting-properties={base-type=uint8, sw-calibration-access=READ-WRITE, range raw 0..255}
                reserved: category=VALUE, resulting-properties={base-type=uint16, sw-calibration-access=READ-WRITE, range raw 0..65535}
                spf_regs: category=ARRAY, array-size=5, resulting-properties={base-type=uint32, sw-calibration-access=READ-WRITE, range raw 0..4294967295}
          mc data instance exception_reason_crnt_indx: category=VALUE, resulting-properties={base-type=uint8, sw-calibration-access=READ-WRITE, data-constr=uint8_DataConstr}
        SWC_PLT_CDD_FailSafe_ResetReason_DefaultValue: flat-map-entry=SWC_PLT_CDD_FailSafe_ResetReason_DefaultValue, symbol=Rte_SWC_PLT_CDD_FailSafe_ResetReason_DefaultValue, variation-point=post-build-variant-condition{matching-criterion=RDR_POS, value=0}
          11 x mc data instance:
            reset_reason: category=ARRAY, array-size=5, resulting-properties={base-type=uint8, sw-calibration-access=READ-WRITE, range raw 0..255}
            reset_counter: category=VALUE, resulting-properties={base-type=uint8, sw-calibration-access=READ-WRITE, data-constr=uint8_DataConstr}
            last_cycle_reset: category=VALUE, resulting-properties={base-type=uint8, sw-calibration-access=READ-WRITE, data-constr=uint8_DataConstr}
            reset_reason_crnt_indx: category=VALUE, resulting-properties={base-type=uint8, sw-calibration-access=READ-WRITE, data-constr=uint8_DataConstr}
            repetitive_reset_counter: category=VALUE, resulting-properties={base-type=uint8, sw-calibration-access=READ-WRITE, data-constr=uint8_DataConstr}
            RFE_Repetitive_Reset_Counter: category=VALUE, resulting-properties={base-type=uint8, sw-calibration-access=READ-WRITE, data-constr=uint8_DataConstr}
            mem_exception_reason: category=STRUCTURE
              6 x mc data instance, all with category=VALUE:
                ExceptionType: resulting-properties={base-type=uint32, sw-calibration-access=READ-WRITE, range raw 0..4294967295}
                ExceptionCausingAddress: resulting-properties={base-type=uint32, sw-calibration-access=READ-WRITE, range raw 0..4294967295}
                ExceptionStatusRegister: resulting-properties={base-type=uint32, sw-calibration-access=READ-WRITE, range raw 0..4294967295}
                IsMemException_Occured: resulting-properties={base-type=boolean, sw-calibration-access=READ-WRITE, compu {1=TRUE, 0=FALSE}, range raw 0..1}
                MemoryExceptionAddress: resulting-properties={base-type=uint32, sw-calibration-access=READ-WRITE, range raw 0..4294967295}
                StackPointer: resulting-properties={base-type=uint32, sw-calibration-access=READ-WRITE, range raw 0..4294967295}
            wdg_failed_SE_info: category=ARRAY, array-size=5, resulting-properties={base-type=uint16, sw-calibration-access=READ-WRITE, data-constr=uint16_DataConstr}
            FCCU_Faults: category=ARRAY, array-size=10, resulting-properties={base-type=uint16, sw-calibration-access=READ-WRITE, data-constr=uint16_DataConstr}
            StaticRegCheckFailureInfo: category=ARRAY, array-size=35, resulting-properties={base-type=uint8, sw-calibration-access=READ-WRITE, range raw 0..255}
            NOC_LatentIntFault_Info: category=STRUCTURE
              5 x mc data instance, all with category=VALUE:
                LatentFault{0..3}: resulting-properties={base-type=uint32, sw-calibration-access=READ-WRITE, data-constr=uint32_DataConstr}
                Resnum: resulting-properties={base-type=uint16, sw-calibration-access=READ-WRITE, data-constr=uint16_DataConstr}
        SWC_PLT_Radar_Alignment_Handler_Appl_AutoAlignment_DefaultValue: flat-map-entry=SWC_PLT_Radar_Alignment_Handler_Appl_AutoAlignment_DefaultValue, symbol=Rte_SWC_PLT_Radar_Alignment_Handler_Appl_AutoAlignment_DefaultValue, variation-point=post-build-variant-condition{matching-criterion=RDR_POS, value=0}
          5 x mc data instance:
            Alignment_Initial_NVM_Data: category=STRUCTURE
              mc data instance InitialAlignmentResultAzimuth: category=VALUE, resulting-properties={base-type=float32, sw-calibration-access=READ-WRITE, data-constr=float32_DataConstr}
              mc data instance InitialAlignmentResultElevation: category=VALUE, resulting-properties={base-type=float32, sw-calibration-access=READ-WRITE, data-constr=float32_DataConstr}
              mc data instance InitialLastSuccessfulAlignmentMode: category=VALUE, resulting-properties={base-type=uint8, sw-calibration-access=READ-WRITE, compu-method=CM_AlignMode, range raw 0..255}
            AlignmentDyn_Initial_NVM_Data: category=STRUCTURE
              mc data instance InitialAlignmentResultAzimuthUpdates: category=VALUE, resulting-properties={base-type=uint32, sw-calibration-access=READ-WRITE, data-constr=uint32_DataConstr}
              mc data instance InitialAlignmentResultElevationUpdates: category=VALUE, resulting-properties={base-type=uint32, sw-calibration-access=READ-WRITE, data-constr=uint32_DataConstr}
              mc data instance InitialAlignmentResultHostSCF: category=VALUE, resulting-properties={base-type=float32, sw-calibration-access=READ-WRITE, data-constr=float32_DataConstr}
            Alignment_AutoCyclic_NVM_Data: category=STRUCTURE
              mc data instance AACurrentAzimuth: category=VALUE, resulting-properties={base-type=float32, sw-calibration-access=READ-WRITE, data-constr=float32_DataConstr}
              mc data instance AACurrentElevation: category=VALUE, resulting-properties={base-type=float32, sw-calibration-access=READ-WRITE, data-constr=float32_DataConstr}
            Alignment_Auto_NVM_data: category=STRUCTURE
              mc data instance AzimuthUpdates: category=VALUE, resulting-properties={base-type=uint32, sw-calibration-access=READ-WRITE, data-constr=uint32_DataConstr}
              mc data instance ElevationUpdates: category=VALUE, resulting-properties={base-type=uint32, sw-calibration-access=READ-WRITE, data-constr=uint32_DataConstr}
              mc data instance HostScf: category=VALUE, resulting-properties={base-type=float32, sw-calibration-access=READ-WRITE, data-constr=float32_DataConstr}
            AlignmentModeOut: category=VALUE, resulting-properties={base-type=uint8, sw-calibration-access=READ-WRITE, compu-method=CM_AlignMode, range raw 0..255}
        SWC_PLT_Appl_IoHwAb_ECU_Position_ROMDefault: flat-map-entry=SWC_PLT_Appl_IoHwAb_ECU_Position_ROMDefault, symbol=Rte_SWC_PLT_Appl_IoHwAb_ECU_Position_ROMDefault, variation-point=post-build-variant-condition{matching-criterion=RDR_POS, value=1}
          mc data instance ECUPosition_Value: category=VALUE, resulting-properties={base-type=uint8, sw-calibration-access=READ-WRITE, data-constr=uint8_DataConstr}
          mc data instance Reserved: category=VALUE, resulting-properties={base-type=uint8, sw-calibration-access=READ-WRITE, data-constr=uint8_DataConstr}
          mc data instance CRC_Value: category=VALUE, resulting-properties={base-type=uint16, sw-calibration-access=READ-WRITE, data-constr=uint16_DataConstr}
        SWC_PLT_Appl_NvMHandler_Alignment_NvMBlock_DefaultValue: flat-map-entry=SWC_PLT_Appl_NvMHandler_Alignment_NvMBlock_DefaultValue, symbol=Rte_SWC_PLT_Appl_NvMHandler_Alignment_NvMBlock_DefaultValue, variation-point=post-build-variant-condition{matching-criterion=RDR_POS, value=1}
          19 x mc data instance, all with category=VALUE:
            AACurrentAzimuth: resulting-properties={base-type=float32, sw-calibration-access=READ-WRITE, data-constr=float32_DataConstr}
            AACurrentElevation: resulting-properties={base-type=float32, sw-calibration-access=READ-WRITE, data-constr=float32_DataConstr}
            AACurrentRoll: resulting-properties={base-type=float32, sw-calibration-access=READ-WRITE, data-constr=float32_DataConstr}
            InitialAlignmentResultAzimuth: resulting-properties={base-type=float32, sw-calibration-access=READ-WRITE, data-constr=float32_DataConstr}
            InitialAlignmentResultElevation: resulting-properties={base-type=float32, sw-calibration-access=READ-WRITE, data-constr=float32_DataConstr}
            InitialAlignmentResultRoll: resulting-properties={base-type=float32, sw-calibration-access=READ-WRITE, data-constr=float32_DataConstr}
            InitialLastSuccessfulAlignmentMode: resulting-properties={base-type=float32, sw-calibration-access=READ-WRITE, data-constr=float32_DataConstr}
            ElevationUpdates: resulting-properties={base-type=float32, sw-calibration-access=READ-WRITE, data-constr=float32_DataConstr}
            AzimuthUpdates: resulting-properties={base-type=float32, sw-calibration-access=READ-WRITE, data-constr=float32_DataConstr}
            RollUpdates: resulting-properties={base-type=float32, sw-calibration-access=READ-WRITE, data-constr=float32_DataConstr}
            InitialAlignmentResultElevationUpdates: resulting-properties={base-type=float32, sw-calibration-access=READ-WRITE, data-constr=float32_DataConstr}
            InitialAlignmentResultHostSpeedCompensationFactor: resulting-properties={base-type=float32, sw-calibration-access=READ-WRITE, data-constr=float32_DataConstr}
            HostSpeedCompensationFactor: resulting-properties={base-type=float32, sw-calibration-access=READ-WRITE, data-constr=float32_DataConstr}
            InitialAlignmentResultAzimuthUpdates: resulting-properties={base-type=float32, sw-calibration-access=READ-WRITE, data-constr=float32_DataConstr}
            InitialAlignmentResultRollUpdates: resulting-properties={base-type=float32, sw-calibration-access=READ-WRITE, data-constr=float32_DataConstr}
            AlignmentModeOut: resulting-properties={base-type=uint8, sw-calibration-access=READ-WRITE, data-constr=uint8_DataConstr}
            azimuth_estimation_qf: resulting-properties={base-type=uint8, sw-calibration-access=READ-WRITE, data-constr=uint8_DataConstr}
            elevation_estimation_qf: resulting-properties={base-type=uint8, sw-calibration-access=READ-WRITE, data-constr=uint8_DataConstr}
            scf_estimation_qf: resulting-properties={base-type=uint8, sw-calibration-access=READ-WRITE, data-constr=uint8_DataConstr}
        SWC_PLT_Appl_NvMHandler_Correctable_Fault_NvM_DefaultValue: flat-map-entry=SWC_PLT_Appl_NvMHandler_Correctable_Fault_NvM_DefaultValue, symbol=Rte_SWC_PLT_Appl_NvMHandler_Correctable_Fault_NvM_DefaultValue, variation-point=post-build-variant-condition{matching-criterion=RDR_POS, value=1}
          21 x mc data instance, all with category=VALUE:
            aa_mem_sec: resulting-properties={base-type=uint8, sw-calibration-access=READ-WRITE, data-constr=uint8_DataConstr}
            artie_mem_sec: resulting-properties={base-type=uint8, sw-calibration-access=READ-WRITE, data-constr=uint8_DataConstr}
            csi2_sec: resulting-properties={base-type=uint8, sw-calibration-access=READ-WRITE, data-constr=uint8_DataConstr}
            dsp_opif_sec: resulting-properties={base-type=uint8, sw-calibration-access=READ-WRITE, data-constr=uint8_DataConstr}
            dsp_idma_sec: resulting-properties={base-type=uint8, sw-calibration-access=READ-WRITE, data-constr=uint8_DataConstr}
            dsp_iram_sec_axis: resulting-properties={base-type=uint8, sw-calibration-access=READ-WRITE, data-constr=uint8_DataConstr}
            dsp_dcache_sec: resulting-properties={base-type=uint8, sw-calibration-access=READ-WRITE, data-constr=uint8_DataConstr}
            dsp_dram_sec: resulting-properties={base-type=uint8, sw-calibration-access=READ-WRITE, data-constr=uint8_DataConstr}
            dsp_icache_sec: resulting-properties={base-type=uint8, sw-calibration-access=READ-WRITE, data-constr=uint8_DataConstr}
            dsp_iram_sec: resulting-properties={base-type=uint8, sw-calibration-access=READ-WRITE, data-constr=uint8_DataConstr}
            ra_cqmem_sec: resulting-properties={base-type=uint8, sw-calibration-access=READ-WRITE, data-constr=uint8_DataConstr}
            ra_dpmem_sec: resulting-properties={base-type=uint8, sw-calibration-access=READ-WRITE, data-constr=uint8_DataConstr}
            ra_estmem_sec: resulting-properties={base-type=uint8, sw-calibration-access=READ-WRITE, data-constr=uint8_DataConstr}
            ra_idxmem_sec: resulting-properties={base-type=uint8, sw-calibration-access=READ-WRITE, data-constr=uint8_DataConstr}
            ra_phmem_sec: resulting-properties={base-type=uint8, sw-calibration-access=READ-WRITE, data-constr=uint8_DataConstr}
            ra_wcmem_sec: resulting-properties={base-type=uint8, sw-calibration-access=READ-WRITE, data-constr=uint8_DataConstr}
            sp_axi_m_corr: resulting-properties={base-type=uint16, sw-calibration-access=READ-WRITE, data-constr=uint16_DataConstr}
            sp_axi_s_corr: resulting-properties={base-type=uint16, sw-calibration-access=READ-WRITE, data-constr=uint16_DataConstr}
            sysmem0_sec: resulting-properties={base-type=uint8, sw-calibration-access=READ-WRITE, data-constr=uint8_DataConstr}
            sysmem1_sec: resulting-properties={base-type=uint8, sw-calibration-access=READ-WRITE, data-constr=uint8_DataConstr}
            not_recorded: resulting-properties={base-type=uint8, sw-calibration-access=READ-WRITE, data-constr=uint8_DataConstr}
        SWC_PLT_Appl_NvMHandler_NvMBringUp_DefaultValue: flat-map-entry=SWC_PLT_Appl_NvMHandler_NvMBringUp_DefaultValue, symbol=Rte_SWC_PLT_Appl_NvMHandler_NvMBringUp_DefaultValue, variation-point=post-build-variant-condition{matching-criterion=RDR_POS, value=1}
          19 x mc data instance, all with category=VALUE:
            AACurrentAzimuth: resulting-properties={base-type=float32, sw-calibration-access=READ-WRITE, data-constr=float32_DataConstr}
            AACurrentElevation: resulting-properties={base-type=float32, sw-calibration-access=READ-WRITE, data-constr=float32_DataConstr}
            AACurrentRoll: resulting-properties={base-type=float32, sw-calibration-access=READ-WRITE, data-constr=float32_DataConstr}
            InitialAlignmentResultAzimuth: resulting-properties={base-type=float32, sw-calibration-access=READ-WRITE, data-constr=float32_DataConstr}
            InitialAlignmentResultElevation: resulting-properties={base-type=float32, sw-calibration-access=READ-WRITE, data-constr=float32_DataConstr}
            InitialAlignmentResultRoll: resulting-properties={base-type=float32, sw-calibration-access=READ-WRITE, data-constr=float32_DataConstr}
            InitialLastSuccessfulAlignmentMode: resulting-properties={base-type=float32, sw-calibration-access=READ-WRITE, data-constr=float32_DataConstr}
            ElevationUpdates: resulting-properties={base-type=float32, sw-calibration-access=READ-WRITE, data-constr=float32_DataConstr}
            AzimuthUpdates: resulting-properties={base-type=float32, sw-calibration-access=READ-WRITE, data-constr=float32_DataConstr}
            RollUpdates: resulting-properties={base-type=float32, sw-calibration-access=READ-WRITE, data-constr=float32_DataConstr}
            InitialAlignmentResultElevationUpdates: resulting-properties={base-type=float32, sw-calibration-access=READ-WRITE, data-constr=float32_DataConstr}
            InitialAlignmentResultHostSpeedCompensationFactor: resulting-properties={base-type=float32, sw-calibration-access=READ-WRITE, data-constr=float32_DataConstr}
            HostSpeedCompensationFactor: resulting-properties={base-type=float32, sw-calibration-access=READ-WRITE, data-constr=float32_DataConstr}
            InitialAlignmentResultAzimuthUpdates: resulting-properties={base-type=float32, sw-calibration-access=READ-WRITE, data-constr=float32_DataConstr}
            InitialAlignmentResultRollUpdates: resulting-properties={base-type=float32, sw-calibration-access=READ-WRITE, data-constr=float32_DataConstr}
            AlignmentModeOut: resulting-properties={base-type=uint8, sw-calibration-access=READ-WRITE, data-constr=uint8_DataConstr}
            azimuth_estimation_qf: resulting-properties={base-type=uint8, sw-calibration-access=READ-WRITE, data-constr=uint8_DataConstr}
            elevation_estimation_qf: resulting-properties={base-type=uint8, sw-calibration-access=READ-WRITE, data-constr=uint8_DataConstr}
            scf_estimation_qf: resulting-properties={base-type=uint8, sw-calibration-access=READ-WRITE, data-constr=uint8_DataConstr}
        SWC_PLT_Appl_NvMHandler_RFE_R1R2_Fault_NvM_DefaultValue: flat-map-entry=SWC_PLT_Appl_NvMHandler_RFE_R1R2_Fault_NvM_DefaultValue, symbol=Rte_SWC_PLT_Appl_NvMHandler_RFE_R1R2_Fault_NvM_DefaultValue, variation-point=post-build-variant-condition{matching-criterion=RDR_POS, value=1}
          18 x mc data instance, all with category=VALUE:
            CORE_BANK_SFT_ERR_MON: resulting-properties={base-type=uint32, sw-calibration-access=READ-WRITE, data-constr=uint32_DataConstr}
            CORE_BANK_SFT_ERR_STATUS: resulting-properties={base-type=uint32, sw-calibration-access=READ-WRITE, data-constr=uint32_DataConstr}
            CORE_BANK_MCU_STS_MCU_MSSG: resulting-properties={base-type=uint32, sw-calibration-access=READ-WRITE, data-constr=uint32_DataConstr}
            FUSA_IRQ{0..2}_FLAG_R: resulting-properties={base-type=uint32, sw-calibration-access=READ-WRITE, data-constr=uint32_DataConstr}
            Api_ret_val: resulting-properties={base-type=uint32, sw-calibration-access=READ-WRITE, data-constr=uint32_DataConstr}
            LOGEN_BANK_CHRP_GEN_ERROR: resulting-properties={base-type=uint32, sw-calibration-access=READ-WRITE, data-constr=uint32_DataConstr}
            LOGEN_BANK_LOGEN_ERROR: resulting-properties={base-type=uint32, sw-calibration-access=READ-WRITE, data-constr=uint32_DataConstr}
            CPU_SYS_MCU_ERR_{0..3}: resulting-properties={base-type=uint32, sw-calibration-access=READ-WRITE, data-constr=uint32_DataConstr}
            ASYNC_BANK_ASYNC_ERR1: resulting-properties={base-type=uint32, sw-calibration-access=READ-WRITE, data-constr=uint32_DataConstr}
            PROF_BANK_PRF_ERR1: resulting-properties={base-type=uint32, sw-calibration-access=READ-WRITE, data-constr=uint32_DataConstr}
            PROF_BANK_PRF_ERR2: resulting-properties={base-type=uint32, sw-calibration-access=READ-WRITE, data-constr=uint32_DataConstr}
            RXADC_FUSAMON: resulting-properties={base-type=uint32, sw-calibration-access=READ-WRITE, data-constr=uint32_DataConstr}
            maf_status: resulting-properties={base-type=uint8, sw-calibration-access=READ-WRITE, data-constr=uint8_DataConstr}
        SWC_PLT_Appl_NvMHandler_SWC_PLT_CDD_FailSafe_DefaultValue: flat-map-entry=SWC_PLT_Appl_NvMHandler_SWC_PLT_CDD_FailSafe_DefaultValue, symbol=Rte_SWC_PLT_Appl_NvMHandler_SWC_PLT_CDD_FailSafe_DefaultValue, variation-point=post-build-variant-condition{matching-criterion=RDR_POS, value=1}
          11 x mc data instance:
            reset_reason: category=ARRAY, array-size=5, resulting-properties={base-type=uint8, sw-calibration-access=READ-WRITE, range raw 0..255}
            reset_counter: category=VALUE, resulting-properties={base-type=uint8, sw-calibration-access=READ-WRITE, data-constr=uint8_DataConstr}
            last_cycle_reset: category=VALUE, resulting-properties={base-type=uint8, sw-calibration-access=READ-WRITE, data-constr=uint8_DataConstr}
            reset_reason_crnt_indx: category=VALUE, resulting-properties={base-type=uint8, sw-calibration-access=READ-WRITE, data-constr=uint8_DataConstr}
            repetitive_reset_counter: category=VALUE, resulting-properties={base-type=uint8, sw-calibration-access=READ-WRITE, data-constr=uint8_DataConstr}
            RFE_Repetitive_Reset_Counter: category=VALUE, resulting-properties={base-type=uint8, sw-calibration-access=READ-WRITE, data-constr=uint8_DataConstr}
            mem_exception_reason: category=STRUCTURE
              6 x mc data instance, all with category=VALUE:
                ExceptionType: resulting-properties={base-type=uint32, sw-calibration-access=READ-WRITE, range raw 0..4294967295}
                ExceptionCausingAddress: resulting-properties={base-type=uint32, sw-calibration-access=READ-WRITE, range raw 0..4294967295}
                ExceptionStatusRegister: resulting-properties={base-type=uint32, sw-calibration-access=READ-WRITE, range raw 0..4294967295}
                IsMemException_Occured: resulting-properties={base-type=boolean, sw-calibration-access=READ-WRITE, compu {1=TRUE, 0=FALSE}, range raw 0..1}
                MemoryExceptionAddress: resulting-properties={base-type=uint32, sw-calibration-access=READ-WRITE, range raw 0..4294967295}
                StackPointer: resulting-properties={base-type=uint32, sw-calibration-access=READ-WRITE, range raw 0..4294967295}
            wdg_failed_SE_info: category=ARRAY, array-size=5, resulting-properties={base-type=uint16, sw-calibration-access=READ-WRITE, data-constr=uint16_DataConstr}
            FCCU_Faults: category=ARRAY, array-size=10, resulting-properties={base-type=uint16, sw-calibration-access=READ-WRITE, data-constr=uint16_DataConstr}
            StaticRegCheckFailureInfo: category=ARRAY, array-size=35, resulting-properties={base-type=uint8, sw-calibration-access=READ-WRITE, range raw 0..255}
            NOC_LatentIntFault_Info: category=STRUCTURE
              5 x mc data instance, all with category=VALUE:
                LatentFault{0..3}: resulting-properties={base-type=uint32, sw-calibration-access=READ-WRITE, data-constr=uint32_DataConstr}
                Resnum: resulting-properties={base-type=uint16, sw-calibration-access=READ-WRITE, data-constr=uint16_DataConstr}
        SWC_PLT_CDD_FailSafe_ExceptionReason_DefaultValue: flat-map-entry=SWC_PLT_CDD_FailSafe_ExceptionReason_DefaultValue, symbol=Rte_SWC_PLT_CDD_FailSafe_ExceptionReason_DefaultValue, variation-point=post-build-variant-condition{matching-criterion=RDR_POS, value=1}
          mc data instance exception_reason_info: category=ARRAY, array-size=3
            mc data instance Element_0: category=STRUCTURE, symbol=[0]
              4 x mc data instance:
                exception_type: category=VALUE, resulting-properties={base-type=uint8, sw-calibration-access=READ-WRITE, range raw 0..255}
                coreid: category=VALUE, resulting-properties={base-type=uint8, sw-calibration-access=READ-WRITE, range raw 0..255}
                reserved: category=VALUE, resulting-properties={base-type=uint16, sw-calibration-access=READ-WRITE, range raw 0..65535}
                spf_regs: category=ARRAY, array-size=5, resulting-properties={base-type=uint32, sw-calibration-access=READ-WRITE, range raw 0..4294967295}
            mc data instance Element_1: category=STRUCTURE, symbol=[1]
              4 x mc data instance:
                exception_type: category=VALUE, resulting-properties={base-type=uint8, sw-calibration-access=READ-WRITE, range raw 0..255}
                coreid: category=VALUE, resulting-properties={base-type=uint8, sw-calibration-access=READ-WRITE, range raw 0..255}
                reserved: category=VALUE, resulting-properties={base-type=uint16, sw-calibration-access=READ-WRITE, range raw 0..65535}
                spf_regs: category=ARRAY, array-size=5, resulting-properties={base-type=uint32, sw-calibration-access=READ-WRITE, range raw 0..4294967295}
            mc data instance Element_2: category=STRUCTURE, symbol=[2]
              4 x mc data instance:
                exception_type: category=VALUE, resulting-properties={base-type=uint8, sw-calibration-access=READ-WRITE, range raw 0..255}
                coreid: category=VALUE, resulting-properties={base-type=uint8, sw-calibration-access=READ-WRITE, range raw 0..255}
                reserved: category=VALUE, resulting-properties={base-type=uint16, sw-calibration-access=READ-WRITE, range raw 0..65535}
                spf_regs: category=ARRAY, array-size=5, resulting-properties={base-type=uint32, sw-calibration-access=READ-WRITE, range raw 0..4294967295}
          mc data instance exception_reason_crnt_indx: category=VALUE, resulting-properties={base-type=uint8, sw-calibration-access=READ-WRITE, data-constr=uint8_DataConstr}
        SWC_PLT_CDD_FailSafe_ResetReason_DefaultValue: flat-map-entry=SWC_PLT_CDD_FailSafe_ResetReason_DefaultValue, symbol=Rte_SWC_PLT_CDD_FailSafe_ResetReason_DefaultValue, variation-point=post-build-variant-condition{matching-criterion=RDR_POS, value=1}
          11 x mc data instance:
            reset_reason: category=ARRAY, array-size=5, resulting-properties={base-type=uint8, sw-calibration-access=READ-WRITE, range raw 0..255}
            reset_counter: category=VALUE, resulting-properties={base-type=uint8, sw-calibration-access=READ-WRITE, data-constr=uint8_DataConstr}
            last_cycle_reset: category=VALUE, resulting-properties={base-type=uint8, sw-calibration-access=READ-WRITE, data-constr=uint8_DataConstr}
            reset_reason_crnt_indx: category=VALUE, resulting-properties={base-type=uint8, sw-calibration-access=READ-WRITE, data-constr=uint8_DataConstr}
            repetitive_reset_counter: category=VALUE, resulting-properties={base-type=uint8, sw-calibration-access=READ-WRITE, data-constr=uint8_DataConstr}
            RFE_Repetitive_Reset_Counter: category=VALUE, resulting-properties={base-type=uint8, sw-calibration-access=READ-WRITE, data-constr=uint8_DataConstr}
            mem_exception_reason: category=STRUCTURE
              6 x mc data instance, all with category=VALUE:
                ExceptionType: resulting-properties={base-type=uint32, sw-calibration-access=READ-WRITE, range raw 0..4294967295}
                ExceptionCausingAddress: resulting-properties={base-type=uint32, sw-calibration-access=READ-WRITE, range raw 0..4294967295}
                ExceptionStatusRegister: resulting-properties={base-type=uint32, sw-calibration-access=READ-WRITE, range raw 0..4294967295}
                IsMemException_Occured: resulting-properties={base-type=boolean, sw-calibration-access=READ-WRITE, compu {1=TRUE, 0=FALSE}, range raw 0..1}
                MemoryExceptionAddress: resulting-properties={base-type=uint32, sw-calibration-access=READ-WRITE, range raw 0..4294967295}
                StackPointer: resulting-properties={base-type=uint32, sw-calibration-access=READ-WRITE, range raw 0..4294967295}
            wdg_failed_SE_info: category=ARRAY, array-size=5, resulting-properties={base-type=uint16, sw-calibration-access=READ-WRITE, data-constr=uint16_DataConstr}
            FCCU_Faults: category=ARRAY, array-size=10, resulting-properties={base-type=uint16, sw-calibration-access=READ-WRITE, data-constr=uint16_DataConstr}
            StaticRegCheckFailureInfo: category=ARRAY, array-size=35, resulting-properties={base-type=uint8, sw-calibration-access=READ-WRITE, range raw 0..255}
            NOC_LatentIntFault_Info: category=STRUCTURE
              5 x mc data instance, all with category=VALUE:
                LatentFault{0..3}: resulting-properties={base-type=uint32, sw-calibration-access=READ-WRITE, data-constr=uint32_DataConstr}
                Resnum: resulting-properties={base-type=uint16, sw-calibration-access=READ-WRITE, data-constr=uint16_DataConstr}
        SWC_PLT_Radar_Alignment_Handler_Appl_AutoAlignment_DefaultValue: flat-map-entry=SWC_PLT_Radar_Alignment_Handler_Appl_AutoAlignment_DefaultValue, symbol=Rte_SWC_PLT_Radar_Alignment_Handler_Appl_AutoAlignment_DefaultValue, variation-point=post-build-variant-condition{matching-criterion=RDR_POS, value=1}
          5 x mc data instance:
            Alignment_Initial_NVM_Data: category=STRUCTURE
              mc data instance InitialAlignmentResultAzimuth: category=VALUE, resulting-properties={base-type=float32, sw-calibration-access=READ-WRITE, data-constr=float32_DataConstr}
              mc data instance InitialAlignmentResultElevation: category=VALUE, resulting-properties={base-type=float32, sw-calibration-access=READ-WRITE, data-constr=float32_DataConstr}
              mc data instance InitialLastSuccessfulAlignmentMode: category=VALUE, resulting-properties={base-type=uint8, sw-calibration-access=READ-WRITE, compu-method=CM_AlignMode, range raw 0..255}
            AlignmentDyn_Initial_NVM_Data: category=STRUCTURE
              mc data instance InitialAlignmentResultAzimuthUpdates: category=VALUE, resulting-properties={base-type=uint32, sw-calibration-access=READ-WRITE, data-constr=uint32_DataConstr}
              mc data instance InitialAlignmentResultElevationUpdates: category=VALUE, resulting-properties={base-type=uint32, sw-calibration-access=READ-WRITE, data-constr=uint32_DataConstr}
              mc data instance InitialAlignmentResultHostSCF: category=VALUE, resulting-properties={base-type=float32, sw-calibration-access=READ-WRITE, data-constr=float32_DataConstr}
            Alignment_AutoCyclic_NVM_Data: category=STRUCTURE
              mc data instance AACurrentAzimuth: category=VALUE, resulting-properties={base-type=float32, sw-calibration-access=READ-WRITE, data-constr=float32_DataConstr}
              mc data instance AACurrentElevation: category=VALUE, resulting-properties={base-type=float32, sw-calibration-access=READ-WRITE, data-constr=float32_DataConstr}
            Alignment_Auto_NVM_data: category=STRUCTURE
              mc data instance AzimuthUpdates: category=VALUE, resulting-properties={base-type=uint32, sw-calibration-access=READ-WRITE, data-constr=uint32_DataConstr}
              mc data instance ElevationUpdates: category=VALUE, resulting-properties={base-type=uint32, sw-calibration-access=READ-WRITE, data-constr=uint32_DataConstr}
              mc data instance HostScf: category=VALUE, resulting-properties={base-type=float32, sw-calibration-access=READ-WRITE, data-constr=float32_DataConstr}
            AlignmentModeOut: category=VALUE, resulting-properties={base-type=uint8, sw-calibration-access=READ-WRITE, compu-method=CM_AlignMode, range raw 0..255}
        SWC_PLT_Appl_IoHwAb_ECU_Position_ROMDefault: flat-map-entry=SWC_PLT_Appl_IoHwAb_ECU_Position_ROMDefault, symbol=Rte_SWC_PLT_Appl_IoHwAb_ECU_Position_ROMDefault, variation-point=post-build-variant-condition{matching-criterion=RDR_POS, value=2}
          mc data instance ECUPosition_Value: category=VALUE, resulting-properties={base-type=uint8, sw-calibration-access=READ-WRITE, data-constr=uint8_DataConstr}
          mc data instance Reserved: category=VALUE, resulting-properties={base-type=uint8, sw-calibration-access=READ-WRITE, data-constr=uint8_DataConstr}
          mc data instance CRC_Value: category=VALUE, resulting-properties={base-type=uint16, sw-calibration-access=READ-WRITE, data-constr=uint16_DataConstr}
        SWC_PLT_Appl_NvMHandler_Alignment_NvMBlock_DefaultValue: flat-map-entry=SWC_PLT_Appl_NvMHandler_Alignment_NvMBlock_DefaultValue, symbol=Rte_SWC_PLT_Appl_NvMHandler_Alignment_NvMBlock_DefaultValue, variation-point=post-build-variant-condition{matching-criterion=RDR_POS, value=2}
          19 x mc data instance, all with category=VALUE:
            AACurrentAzimuth: resulting-properties={base-type=float32, sw-calibration-access=READ-WRITE, data-constr=float32_DataConstr}
            AACurrentElevation: resulting-properties={base-type=float32, sw-calibration-access=READ-WRITE, data-constr=float32_DataConstr}
            AACurrentRoll: resulting-properties={base-type=float32, sw-calibration-access=READ-WRITE, data-constr=float32_DataConstr}
            InitialAlignmentResultAzimuth: resulting-properties={base-type=float32, sw-calibration-access=READ-WRITE, data-constr=float32_DataConstr}
            InitialAlignmentResultElevation: resulting-properties={base-type=float32, sw-calibration-access=READ-WRITE, data-constr=float32_DataConstr}
            InitialAlignmentResultRoll: resulting-properties={base-type=float32, sw-calibration-access=READ-WRITE, data-constr=float32_DataConstr}
            InitialLastSuccessfulAlignmentMode: resulting-properties={base-type=float32, sw-calibration-access=READ-WRITE, data-constr=float32_DataConstr}
            ElevationUpdates: resulting-properties={base-type=float32, sw-calibration-access=READ-WRITE, data-constr=float32_DataConstr}
            AzimuthUpdates: resulting-properties={base-type=float32, sw-calibration-access=READ-WRITE, data-constr=float32_DataConstr}
            RollUpdates: resulting-properties={base-type=float32, sw-calibration-access=READ-WRITE, data-constr=float32_DataConstr}
            InitialAlignmentResultElevationUpdates: resulting-properties={base-type=float32, sw-calibration-access=READ-WRITE, data-constr=float32_DataConstr}
            InitialAlignmentResultHostSpeedCompensationFactor: resulting-properties={base-type=float32, sw-calibration-access=READ-WRITE, data-constr=float32_DataConstr}
            HostSpeedCompensationFactor: resulting-properties={base-type=float32, sw-calibration-access=READ-WRITE, data-constr=float32_DataConstr}
            InitialAlignmentResultAzimuthUpdates: resulting-properties={base-type=float32, sw-calibration-access=READ-WRITE, data-constr=float32_DataConstr}
            InitialAlignmentResultRollUpdates: resulting-properties={base-type=float32, sw-calibration-access=READ-WRITE, data-constr=float32_DataConstr}
            AlignmentModeOut: resulting-properties={base-type=uint8, sw-calibration-access=READ-WRITE, data-constr=uint8_DataConstr}
            azimuth_estimation_qf: resulting-properties={base-type=uint8, sw-calibration-access=READ-WRITE, data-constr=uint8_DataConstr}
            elevation_estimation_qf: resulting-properties={base-type=uint8, sw-calibration-access=READ-WRITE, data-constr=uint8_DataConstr}
            scf_estimation_qf: resulting-properties={base-type=uint8, sw-calibration-access=READ-WRITE, data-constr=uint8_DataConstr}
        SWC_PLT_Appl_NvMHandler_Correctable_Fault_NvM_DefaultValue: flat-map-entry=SWC_PLT_Appl_NvMHandler_Correctable_Fault_NvM_DefaultValue, symbol=Rte_SWC_PLT_Appl_NvMHandler_Correctable_Fault_NvM_DefaultValue, variation-point=post-build-variant-condition{matching-criterion=RDR_POS, value=2}
          21 x mc data instance, all with category=VALUE:
            aa_mem_sec: resulting-properties={base-type=uint8, sw-calibration-access=READ-WRITE, data-constr=uint8_DataConstr}
            artie_mem_sec: resulting-properties={base-type=uint8, sw-calibration-access=READ-WRITE, data-constr=uint8_DataConstr}
            csi2_sec: resulting-properties={base-type=uint8, sw-calibration-access=READ-WRITE, data-constr=uint8_DataConstr}
            dsp_opif_sec: resulting-properties={base-type=uint8, sw-calibration-access=READ-WRITE, data-constr=uint8_DataConstr}
            dsp_idma_sec: resulting-properties={base-type=uint8, sw-calibration-access=READ-WRITE, data-constr=uint8_DataConstr}
            dsp_iram_sec_axis: resulting-properties={base-type=uint8, sw-calibration-access=READ-WRITE, data-constr=uint8_DataConstr}
            dsp_dcache_sec: resulting-properties={base-type=uint8, sw-calibration-access=READ-WRITE, data-constr=uint8_DataConstr}
            dsp_dram_sec: resulting-properties={base-type=uint8, sw-calibration-access=READ-WRITE, data-constr=uint8_DataConstr}
            dsp_icache_sec: resulting-properties={base-type=uint8, sw-calibration-access=READ-WRITE, data-constr=uint8_DataConstr}
            dsp_iram_sec: resulting-properties={base-type=uint8, sw-calibration-access=READ-WRITE, data-constr=uint8_DataConstr}
            ra_cqmem_sec: resulting-properties={base-type=uint8, sw-calibration-access=READ-WRITE, data-constr=uint8_DataConstr}
            ra_dpmem_sec: resulting-properties={base-type=uint8, sw-calibration-access=READ-WRITE, data-constr=uint8_DataConstr}
            ra_estmem_sec: resulting-properties={base-type=uint8, sw-calibration-access=READ-WRITE, data-constr=uint8_DataConstr}
            ra_idxmem_sec: resulting-properties={base-type=uint8, sw-calibration-access=READ-WRITE, data-constr=uint8_DataConstr}
            ra_phmem_sec: resulting-properties={base-type=uint8, sw-calibration-access=READ-WRITE, data-constr=uint8_DataConstr}
            ra_wcmem_sec: resulting-properties={base-type=uint8, sw-calibration-access=READ-WRITE, data-constr=uint8_DataConstr}
            sp_axi_m_corr: resulting-properties={base-type=uint16, sw-calibration-access=READ-WRITE, data-constr=uint16_DataConstr}
            sp_axi_s_corr: resulting-properties={base-type=uint16, sw-calibration-access=READ-WRITE, data-constr=uint16_DataConstr}
            sysmem0_sec: resulting-properties={base-type=uint8, sw-calibration-access=READ-WRITE, data-constr=uint8_DataConstr}
            sysmem1_sec: resulting-properties={base-type=uint8, sw-calibration-access=READ-WRITE, data-constr=uint8_DataConstr}
            not_recorded: resulting-properties={base-type=uint8, sw-calibration-access=READ-WRITE, data-constr=uint8_DataConstr}
        SWC_PLT_Appl_NvMHandler_NvMBringUp_DefaultValue: flat-map-entry=SWC_PLT_Appl_NvMHandler_NvMBringUp_DefaultValue, symbol=Rte_SWC_PLT_Appl_NvMHandler_NvMBringUp_DefaultValue, variation-point=post-build-variant-condition{matching-criterion=RDR_POS, value=2}
          19 x mc data instance, all with category=VALUE:
            AACurrentAzimuth: resulting-properties={base-type=float32, sw-calibration-access=READ-WRITE, data-constr=float32_DataConstr}
            AACurrentElevation: resulting-properties={base-type=float32, sw-calibration-access=READ-WRITE, data-constr=float32_DataConstr}
            AACurrentRoll: resulting-properties={base-type=float32, sw-calibration-access=READ-WRITE, data-constr=float32_DataConstr}
            InitialAlignmentResultAzimuth: resulting-properties={base-type=float32, sw-calibration-access=READ-WRITE, data-constr=float32_DataConstr}
            InitialAlignmentResultElevation: resulting-properties={base-type=float32, sw-calibration-access=READ-WRITE, data-constr=float32_DataConstr}
            InitialAlignmentResultRoll: resulting-properties={base-type=float32, sw-calibration-access=READ-WRITE, data-constr=float32_DataConstr}
            InitialLastSuccessfulAlignmentMode: resulting-properties={base-type=float32, sw-calibration-access=READ-WRITE, data-constr=float32_DataConstr}
            ElevationUpdates: resulting-properties={base-type=float32, sw-calibration-access=READ-WRITE, data-constr=float32_DataConstr}
            AzimuthUpdates: resulting-properties={base-type=float32, sw-calibration-access=READ-WRITE, data-constr=float32_DataConstr}
            RollUpdates: resulting-properties={base-type=float32, sw-calibration-access=READ-WRITE, data-constr=float32_DataConstr}
            InitialAlignmentResultElevationUpdates: resulting-properties={base-type=float32, sw-calibration-access=READ-WRITE, data-constr=float32_DataConstr}
            InitialAlignmentResultHostSpeedCompensationFactor: resulting-properties={base-type=float32, sw-calibration-access=READ-WRITE, data-constr=float32_DataConstr}
            HostSpeedCompensationFactor: resulting-properties={base-type=float32, sw-calibration-access=READ-WRITE, data-constr=float32_DataConstr}
            InitialAlignmentResultAzimuthUpdates: resulting-properties={base-type=float32, sw-calibration-access=READ-WRITE, data-constr=float32_DataConstr}
            InitialAlignmentResultRollUpdates: resulting-properties={base-type=float32, sw-calibration-access=READ-WRITE, data-constr=float32_DataConstr}
            AlignmentModeOut: resulting-properties={base-type=uint8, sw-calibration-access=READ-WRITE, data-constr=uint8_DataConstr}
            azimuth_estimation_qf: resulting-properties={base-type=uint8, sw-calibration-access=READ-WRITE, data-constr=uint8_DataConstr}
            elevation_estimation_qf: resulting-properties={base-type=uint8, sw-calibration-access=READ-WRITE, data-constr=uint8_DataConstr}
            scf_estimation_qf: resulting-properties={base-type=uint8, sw-calibration-access=READ-WRITE, data-constr=uint8_DataConstr}
        SWC_PLT_Appl_NvMHandler_RFE_R1R2_Fault_NvM_DefaultValue: flat-map-entry=SWC_PLT_Appl_NvMHandler_RFE_R1R2_Fault_NvM_DefaultValue, symbol=Rte_SWC_PLT_Appl_NvMHandler_RFE_R1R2_Fault_NvM_DefaultValue, variation-point=post-build-variant-condition{matching-criterion=RDR_POS, value=2}
          18 x mc data instance, all with category=VALUE:
            CORE_BANK_SFT_ERR_MON: resulting-properties={base-type=uint32, sw-calibration-access=READ-WRITE, data-constr=uint32_DataConstr}
            CORE_BANK_SFT_ERR_STATUS: resulting-properties={base-type=uint32, sw-calibration-access=READ-WRITE, data-constr=uint32_DataConstr}
            CORE_BANK_MCU_STS_MCU_MSSG: resulting-properties={base-type=uint32, sw-calibration-access=READ-WRITE, data-constr=uint32_DataConstr}
            FUSA_IRQ{0..2}_FLAG_R: resulting-properties={base-type=uint32, sw-calibration-access=READ-WRITE, data-constr=uint32_DataConstr}
            Api_ret_val: resulting-properties={base-type=uint32, sw-calibration-access=READ-WRITE, data-constr=uint32_DataConstr}
            LOGEN_BANK_CHRP_GEN_ERROR: resulting-properties={base-type=uint32, sw-calibration-access=READ-WRITE, data-constr=uint32_DataConstr}
            LOGEN_BANK_LOGEN_ERROR: resulting-properties={base-type=uint32, sw-calibration-access=READ-WRITE, data-constr=uint32_DataConstr}
            CPU_SYS_MCU_ERR_{0..3}: resulting-properties={base-type=uint32, sw-calibration-access=READ-WRITE, data-constr=uint32_DataConstr}
            ASYNC_BANK_ASYNC_ERR1: resulting-properties={base-type=uint32, sw-calibration-access=READ-WRITE, data-constr=uint32_DataConstr}
            PROF_BANK_PRF_ERR1: resulting-properties={base-type=uint32, sw-calibration-access=READ-WRITE, data-constr=uint32_DataConstr}
            PROF_BANK_PRF_ERR2: resulting-properties={base-type=uint32, sw-calibration-access=READ-WRITE, data-constr=uint32_DataConstr}
            RXADC_FUSAMON: resulting-properties={base-type=uint32, sw-calibration-access=READ-WRITE, data-constr=uint32_DataConstr}
            maf_status: resulting-properties={base-type=uint8, sw-calibration-access=READ-WRITE, data-constr=uint8_DataConstr}
        SWC_PLT_Appl_NvMHandler_SWC_PLT_CDD_FailSafe_DefaultValue: flat-map-entry=SWC_PLT_Appl_NvMHandler_SWC_PLT_CDD_FailSafe_DefaultValue, symbol=Rte_SWC_PLT_Appl_NvMHandler_SWC_PLT_CDD_FailSafe_DefaultValue, variation-point=post-build-variant-condition{matching-criterion=RDR_POS, value=2}
          11 x mc data instance:
            reset_reason: category=ARRAY, array-size=5, resulting-properties={base-type=uint8, sw-calibration-access=READ-WRITE, range raw 0..255}
            reset_counter: category=VALUE, resulting-properties={base-type=uint8, sw-calibration-access=READ-WRITE, data-constr=uint8_DataConstr}
            last_cycle_reset: category=VALUE, resulting-properties={base-type=uint8, sw-calibration-access=READ-WRITE, data-constr=uint8_DataConstr}
            reset_reason_crnt_indx: category=VALUE, resulting-properties={base-type=uint8, sw-calibration-access=READ-WRITE, data-constr=uint8_DataConstr}
            repetitive_reset_counter: category=VALUE, resulting-properties={base-type=uint8, sw-calibration-access=READ-WRITE, data-constr=uint8_DataConstr}
            RFE_Repetitive_Reset_Counter: category=VALUE, resulting-properties={base-type=uint8, sw-calibration-access=READ-WRITE, data-constr=uint8_DataConstr}
            mem_exception_reason: category=STRUCTURE
              6 x mc data instance, all with category=VALUE:
                ExceptionType: resulting-properties={base-type=uint32, sw-calibration-access=READ-WRITE, range raw 0..4294967295}
                ExceptionCausingAddress: resulting-properties={base-type=uint32, sw-calibration-access=READ-WRITE, range raw 0..4294967295}
                ExceptionStatusRegister: resulting-properties={base-type=uint32, sw-calibration-access=READ-WRITE, range raw 0..4294967295}
                IsMemException_Occured: resulting-properties={base-type=boolean, sw-calibration-access=READ-WRITE, compu {1=TRUE, 0=FALSE}, range raw 0..1}
                MemoryExceptionAddress: resulting-properties={base-type=uint32, sw-calibration-access=READ-WRITE, range raw 0..4294967295}
                StackPointer: resulting-properties={base-type=uint32, sw-calibration-access=READ-WRITE, range raw 0..4294967295}
            wdg_failed_SE_info: category=ARRAY, array-size=5, resulting-properties={base-type=uint16, sw-calibration-access=READ-WRITE, data-constr=uint16_DataConstr}
            FCCU_Faults: category=ARRAY, array-size=10, resulting-properties={base-type=uint16, sw-calibration-access=READ-WRITE, data-constr=uint16_DataConstr}
            StaticRegCheckFailureInfo: category=ARRAY, array-size=35, resulting-properties={base-type=uint8, sw-calibration-access=READ-WRITE, range raw 0..255}
            NOC_LatentIntFault_Info: category=STRUCTURE
              5 x mc data instance, all with category=VALUE:
                LatentFault{0..3}: resulting-properties={base-type=uint32, sw-calibration-access=READ-WRITE, data-constr=uint32_DataConstr}
                Resnum: resulting-properties={base-type=uint16, sw-calibration-access=READ-WRITE, data-constr=uint16_DataConstr}
        SWC_PLT_CDD_FailSafe_ExceptionReason_DefaultValue: flat-map-entry=SWC_PLT_CDD_FailSafe_ExceptionReason_DefaultValue, symbol=Rte_SWC_PLT_CDD_FailSafe_ExceptionReason_DefaultValue, variation-point=post-build-variant-condition{matching-criterion=RDR_POS, value=2}
          mc data instance exception_reason_info: category=ARRAY, array-size=3
            mc data instance Element_0: category=STRUCTURE, symbol=[0]
              4 x mc data instance:
                exception_type: category=VALUE, resulting-properties={base-type=uint8, sw-calibration-access=READ-WRITE, range raw 0..255}
                coreid: category=VALUE, resulting-properties={base-type=uint8, sw-calibration-access=READ-WRITE, range raw 0..255}
                reserved: category=VALUE, resulting-properties={base-type=uint16, sw-calibration-access=READ-WRITE, range raw 0..65535}
                spf_regs: category=ARRAY, array-size=5, resulting-properties={base-type=uint32, sw-calibration-access=READ-WRITE, range raw 0..4294967295}
            mc data instance Element_1: category=STRUCTURE, symbol=[1]
              4 x mc data instance:
                exception_type: category=VALUE, resulting-properties={base-type=uint8, sw-calibration-access=READ-WRITE, range raw 0..255}
                coreid: category=VALUE, resulting-properties={base-type=uint8, sw-calibration-access=READ-WRITE, range raw 0..255}
                reserved: category=VALUE, resulting-properties={base-type=uint16, sw-calibration-access=READ-WRITE, range raw 0..65535}
                spf_regs: category=ARRAY, array-size=5, resulting-properties={base-type=uint32, sw-calibration-access=READ-WRITE, range raw 0..4294967295}
            mc data instance Element_2: category=STRUCTURE, symbol=[2]
              4 x mc data instance:
                exception_type: category=VALUE, resulting-properties={base-type=uint8, sw-calibration-access=READ-WRITE, range raw 0..255}
                coreid: category=VALUE, resulting-properties={base-type=uint8, sw-calibration-access=READ-WRITE, range raw 0..255}
                reserved: category=VALUE, resulting-properties={base-type=uint16, sw-calibration-access=READ-WRITE, range raw 0..65535}
                spf_regs: category=ARRAY, array-size=5, resulting-properties={base-type=uint32, sw-calibration-access=READ-WRITE, range raw 0..4294967295}
          mc data instance exception_reason_crnt_indx: category=VALUE, resulting-properties={base-type=uint8, sw-calibration-access=READ-WRITE, data-constr=uint8_DataConstr}
        SWC_PLT_CDD_FailSafe_ResetReason_DefaultValue: flat-map-entry=SWC_PLT_CDD_FailSafe_ResetReason_DefaultValue, symbol=Rte_SWC_PLT_CDD_FailSafe_ResetReason_DefaultValue, variation-point=post-build-variant-condition{matching-criterion=RDR_POS, value=2}
          11 x mc data instance:
            reset_reason: category=ARRAY, array-size=5, resulting-properties={base-type=uint8, sw-calibration-access=READ-WRITE, range raw 0..255}
            reset_counter: category=VALUE, resulting-properties={base-type=uint8, sw-calibration-access=READ-WRITE, data-constr=uint8_DataConstr}
            last_cycle_reset: category=VALUE, resulting-properties={base-type=uint8, sw-calibration-access=READ-WRITE, data-constr=uint8_DataConstr}
            reset_reason_crnt_indx: category=VALUE, resulting-properties={base-type=uint8, sw-calibration-access=READ-WRITE, data-constr=uint8_DataConstr}
            repetitive_reset_counter: category=VALUE, resulting-properties={base-type=uint8, sw-calibration-access=READ-WRITE, data-constr=uint8_DataConstr}
            RFE_Repetitive_Reset_Counter: category=VALUE, resulting-properties={base-type=uint8, sw-calibration-access=READ-WRITE, data-constr=uint8_DataConstr}
            mem_exception_reason: category=STRUCTURE
              6 x mc data instance, all with category=VALUE:
                ExceptionType: resulting-properties={base-type=uint32, sw-calibration-access=READ-WRITE, range raw 0..4294967295}
                ExceptionCausingAddress: resulting-properties={base-type=uint32, sw-calibration-access=READ-WRITE, range raw 0..4294967295}
                ExceptionStatusRegister: resulting-properties={base-type=uint32, sw-calibration-access=READ-WRITE, range raw 0..4294967295}
                IsMemException_Occured: resulting-properties={base-type=boolean, sw-calibration-access=READ-WRITE, compu {1=TRUE, 0=FALSE}, range raw 0..1}
                MemoryExceptionAddress: resulting-properties={base-type=uint32, sw-calibration-access=READ-WRITE, range raw 0..4294967295}
                StackPointer: resulting-properties={base-type=uint32, sw-calibration-access=READ-WRITE, range raw 0..4294967295}
            wdg_failed_SE_info: category=ARRAY, array-size=5, resulting-properties={base-type=uint16, sw-calibration-access=READ-WRITE, data-constr=uint16_DataConstr}
            FCCU_Faults: category=ARRAY, array-size=10, resulting-properties={base-type=uint16, sw-calibration-access=READ-WRITE, data-constr=uint16_DataConstr}
            StaticRegCheckFailureInfo: category=ARRAY, array-size=35, resulting-properties={base-type=uint8, sw-calibration-access=READ-WRITE, range raw 0..255}
            NOC_LatentIntFault_Info: category=STRUCTURE
              5 x mc data instance, all with category=VALUE:
                LatentFault{0..3}: resulting-properties={base-type=uint32, sw-calibration-access=READ-WRITE, data-constr=uint32_DataConstr}
                Resnum: resulting-properties={base-type=uint16, sw-calibration-access=READ-WRITE, data-constr=uint16_DataConstr}
        SWC_PLT_Radar_Alignment_Handler_Appl_AutoAlignment_DefaultValue: flat-map-entry=SWC_PLT_Radar_Alignment_Handler_Appl_AutoAlignment_DefaultValue, symbol=Rte_SWC_PLT_Radar_Alignment_Handler_Appl_AutoAlignment_DefaultValue, variation-point=post-build-variant-condition{matching-criterion=RDR_POS, value=2}
          5 x mc data instance:
            Alignment_Initial_NVM_Data: category=STRUCTURE
              mc data instance InitialAlignmentResultAzimuth: category=VALUE, resulting-properties={base-type=float32, sw-calibration-access=READ-WRITE, data-constr=float32_DataConstr}
              mc data instance InitialAlignmentResultElevation: category=VALUE, resulting-properties={base-type=float32, sw-calibration-access=READ-WRITE, data-constr=float32_DataConstr}
              mc data instance InitialLastSuccessfulAlignmentMode: category=VALUE, resulting-properties={base-type=uint8, sw-calibration-access=READ-WRITE, compu-method=CM_AlignMode, range raw 0..255}
            AlignmentDyn_Initial_NVM_Data: category=STRUCTURE
              mc data instance InitialAlignmentResultAzimuthUpdates: category=VALUE, resulting-properties={base-type=uint32, sw-calibration-access=READ-WRITE, data-constr=uint32_DataConstr}
              mc data instance InitialAlignmentResultElevationUpdates: category=VALUE, resulting-properties={base-type=uint32, sw-calibration-access=READ-WRITE, data-constr=uint32_DataConstr}
              mc data instance InitialAlignmentResultHostSCF: category=VALUE, resulting-properties={base-type=float32, sw-calibration-access=READ-WRITE, data-constr=float32_DataConstr}
            Alignment_AutoCyclic_NVM_Data: category=STRUCTURE
              mc data instance AACurrentAzimuth: category=VALUE, resulting-properties={base-type=float32, sw-calibration-access=READ-WRITE, data-constr=float32_DataConstr}
              mc data instance AACurrentElevation: category=VALUE, resulting-properties={base-type=float32, sw-calibration-access=READ-WRITE, data-constr=float32_DataConstr}
            Alignment_Auto_NVM_data: category=STRUCTURE
              mc data instance AzimuthUpdates: category=VALUE, resulting-properties={base-type=uint32, sw-calibration-access=READ-WRITE, data-constr=uint32_DataConstr}
              mc data instance ElevationUpdates: category=VALUE, resulting-properties={base-type=uint32, sw-calibration-access=READ-WRITE, data-constr=uint32_DataConstr}
              mc data instance HostScf: category=VALUE, resulting-properties={base-type=float32, sw-calibration-access=READ-WRITE, data-constr=float32_DataConstr}
            AlignmentModeOut: category=VALUE, resulting-properties={base-type=uint8, sw-calibration-access=READ-WRITE, compu-method=CM_AlignMode, range raw 0..255}
        SWC_PLT_Appl_IoHwAb_ECU_Position_ROMDefault: flat-map-entry=SWC_PLT_Appl_IoHwAb_ECU_Position_ROMDefault, symbol=Rte_SWC_PLT_Appl_IoHwAb_ECU_Position_ROMDefault, variation-point=post-build-variant-condition{matching-criterion=RDR_POS, value=3}
          mc data instance ECUPosition_Value: category=VALUE, resulting-properties={base-type=uint8, sw-calibration-access=READ-WRITE, data-constr=uint8_DataConstr}
          mc data instance Reserved: category=VALUE, resulting-properties={base-type=uint8, sw-calibration-access=READ-WRITE, data-constr=uint8_DataConstr}
          mc data instance CRC_Value: category=VALUE, resulting-properties={base-type=uint16, sw-calibration-access=READ-WRITE, data-constr=uint16_DataConstr}
        SWC_PLT_Appl_NvMHandler_Alignment_NvMBlock_DefaultValue: flat-map-entry=SWC_PLT_Appl_NvMHandler_Alignment_NvMBlock_DefaultValue, symbol=Rte_SWC_PLT_Appl_NvMHandler_Alignment_NvMBlock_DefaultValue, variation-point=post-build-variant-condition{matching-criterion=RDR_POS, value=3}
          19 x mc data instance, all with category=VALUE:
            AACurrentAzimuth: resulting-properties={base-type=float32, sw-calibration-access=READ-WRITE, data-constr=float32_DataConstr}
            AACurrentElevation: resulting-properties={base-type=float32, sw-calibration-access=READ-WRITE, data-constr=float32_DataConstr}
            AACurrentRoll: resulting-properties={base-type=float32, sw-calibration-access=READ-WRITE, data-constr=float32_DataConstr}
            InitialAlignmentResultAzimuth: resulting-properties={base-type=float32, sw-calibration-access=READ-WRITE, data-constr=float32_DataConstr}
            InitialAlignmentResultElevation: resulting-properties={base-type=float32, sw-calibration-access=READ-WRITE, data-constr=float32_DataConstr}
            InitialAlignmentResultRoll: resulting-properties={base-type=float32, sw-calibration-access=READ-WRITE, data-constr=float32_DataConstr}
            InitialLastSuccessfulAlignmentMode: resulting-properties={base-type=float32, sw-calibration-access=READ-WRITE, data-constr=float32_DataConstr}
            ElevationUpdates: resulting-properties={base-type=float32, sw-calibration-access=READ-WRITE, data-constr=float32_DataConstr}
            AzimuthUpdates: resulting-properties={base-type=float32, sw-calibration-access=READ-WRITE, data-constr=float32_DataConstr}
            RollUpdates: resulting-properties={base-type=float32, sw-calibration-access=READ-WRITE, data-constr=float32_DataConstr}
            InitialAlignmentResultElevationUpdates: resulting-properties={base-type=float32, sw-calibration-access=READ-WRITE, data-constr=float32_DataConstr}
            InitialAlignmentResultHostSpeedCompensationFactor: resulting-properties={base-type=float32, sw-calibration-access=READ-WRITE, data-constr=float32_DataConstr}
            HostSpeedCompensationFactor: resulting-properties={base-type=float32, sw-calibration-access=READ-WRITE, data-constr=float32_DataConstr}
            InitialAlignmentResultAzimuthUpdates: resulting-properties={base-type=float32, sw-calibration-access=READ-WRITE, data-constr=float32_DataConstr}
            InitialAlignmentResultRollUpdates: resulting-properties={base-type=float32, sw-calibration-access=READ-WRITE, data-constr=float32_DataConstr}
            AlignmentModeOut: resulting-properties={base-type=uint8, sw-calibration-access=READ-WRITE, data-constr=uint8_DataConstr}
            azimuth_estimation_qf: resulting-properties={base-type=uint8, sw-calibration-access=READ-WRITE, data-constr=uint8_DataConstr}
            elevation_estimation_qf: resulting-properties={base-type=uint8, sw-calibration-access=READ-WRITE, data-constr=uint8_DataConstr}
            scf_estimation_qf: resulting-properties={base-type=uint8, sw-calibration-access=READ-WRITE, data-constr=uint8_DataConstr}
        SWC_PLT_Appl_NvMHandler_Correctable_Fault_NvM_DefaultValue: flat-map-entry=SWC_PLT_Appl_NvMHandler_Correctable_Fault_NvM_DefaultValue, symbol=Rte_SWC_PLT_Appl_NvMHandler_Correctable_Fault_NvM_DefaultValue, variation-point=post-build-variant-condition{matching-criterion=RDR_POS, value=3}
          21 x mc data instance, all with category=VALUE:
            aa_mem_sec: resulting-properties={base-type=uint8, sw-calibration-access=READ-WRITE, data-constr=uint8_DataConstr}
            artie_mem_sec: resulting-properties={base-type=uint8, sw-calibration-access=READ-WRITE, data-constr=uint8_DataConstr}
            csi2_sec: resulting-properties={base-type=uint8, sw-calibration-access=READ-WRITE, data-constr=uint8_DataConstr}
            dsp_opif_sec: resulting-properties={base-type=uint8, sw-calibration-access=READ-WRITE, data-constr=uint8_DataConstr}
            dsp_idma_sec: resulting-properties={base-type=uint8, sw-calibration-access=READ-WRITE, data-constr=uint8_DataConstr}
            dsp_iram_sec_axis: resulting-properties={base-type=uint8, sw-calibration-access=READ-WRITE, data-constr=uint8_DataConstr}
            dsp_dcache_sec: resulting-properties={base-type=uint8, sw-calibration-access=READ-WRITE, data-constr=uint8_DataConstr}
            dsp_dram_sec: resulting-properties={base-type=uint8, sw-calibration-access=READ-WRITE, data-constr=uint8_DataConstr}
            dsp_icache_sec: resulting-properties={base-type=uint8, sw-calibration-access=READ-WRITE, data-constr=uint8_DataConstr}
            dsp_iram_sec: resulting-properties={base-type=uint8, sw-calibration-access=READ-WRITE, data-constr=uint8_DataConstr}
            ra_cqmem_sec: resulting-properties={base-type=uint8, sw-calibration-access=READ-WRITE, data-constr=uint8_DataConstr}
            ra_dpmem_sec: resulting-properties={base-type=uint8, sw-calibration-access=READ-WRITE, data-constr=uint8_DataConstr}
            ra_estmem_sec: resulting-properties={base-type=uint8, sw-calibration-access=READ-WRITE, data-constr=uint8_DataConstr}
            ra_idxmem_sec: resulting-properties={base-type=uint8, sw-calibration-access=READ-WRITE, data-constr=uint8_DataConstr}
            ra_phmem_sec: resulting-properties={base-type=uint8, sw-calibration-access=READ-WRITE, data-constr=uint8_DataConstr}
            ra_wcmem_sec: resulting-properties={base-type=uint8, sw-calibration-access=READ-WRITE, data-constr=uint8_DataConstr}
            sp_axi_m_corr: resulting-properties={base-type=uint16, sw-calibration-access=READ-WRITE, data-constr=uint16_DataConstr}
            sp_axi_s_corr: resulting-properties={base-type=uint16, sw-calibration-access=READ-WRITE, data-constr=uint16_DataConstr}
            sysmem0_sec: resulting-properties={base-type=uint8, sw-calibration-access=READ-WRITE, data-constr=uint8_DataConstr}
            sysmem1_sec: resulting-properties={base-type=uint8, sw-calibration-access=READ-WRITE, data-constr=uint8_DataConstr}
            not_recorded: resulting-properties={base-type=uint8, sw-calibration-access=READ-WRITE, data-constr=uint8_DataConstr}
        SWC_PLT_Appl_NvMHandler_NvMBringUp_DefaultValue: flat-map-entry=SWC_PLT_Appl_NvMHandler_NvMBringUp_DefaultValue, symbol=Rte_SWC_PLT_Appl_NvMHandler_NvMBringUp_DefaultValue, variation-point=post-build-variant-condition{matching-criterion=RDR_POS, value=3}
          19 x mc data instance, all with category=VALUE:
            AACurrentAzimuth: resulting-properties={base-type=float32, sw-calibration-access=READ-WRITE, data-constr=float32_DataConstr}
            AACurrentElevation: resulting-properties={base-type=float32, sw-calibration-access=READ-WRITE, data-constr=float32_DataConstr}
            AACurrentRoll: resulting-properties={base-type=float32, sw-calibration-access=READ-WRITE, data-constr=float32_DataConstr}
            InitialAlignmentResultAzimuth: resulting-properties={base-type=float32, sw-calibration-access=READ-WRITE, data-constr=float32_DataConstr}
            InitialAlignmentResultElevation: resulting-properties={base-type=float32, sw-calibration-access=READ-WRITE, data-constr=float32_DataConstr}
            InitialAlignmentResultRoll: resulting-properties={base-type=float32, sw-calibration-access=READ-WRITE, data-constr=float32_DataConstr}
            InitialLastSuccessfulAlignmentMode: resulting-properties={base-type=float32, sw-calibration-access=READ-WRITE, data-constr=float32_DataConstr}
            ElevationUpdates: resulting-properties={base-type=float32, sw-calibration-access=READ-WRITE, data-constr=float32_DataConstr}
            AzimuthUpdates: resulting-properties={base-type=float32, sw-calibration-access=READ-WRITE, data-constr=float32_DataConstr}
            RollUpdates: resulting-properties={base-type=float32, sw-calibration-access=READ-WRITE, data-constr=float32_DataConstr}
            InitialAlignmentResultElevationUpdates: resulting-properties={base-type=float32, sw-calibration-access=READ-WRITE, data-constr=float32_DataConstr}
            InitialAlignmentResultHostSpeedCompensationFactor: resulting-properties={base-type=float32, sw-calibration-access=READ-WRITE, data-constr=float32_DataConstr}
            HostSpeedCompensationFactor: resulting-properties={base-type=float32, sw-calibration-access=READ-WRITE, data-constr=float32_DataConstr}
            InitialAlignmentResultAzimuthUpdates: resulting-properties={base-type=float32, sw-calibration-access=READ-WRITE, data-constr=float32_DataConstr}
            InitialAlignmentResultRollUpdates: resulting-properties={base-type=float32, sw-calibration-access=READ-WRITE, data-constr=float32_DataConstr}
            AlignmentModeOut: resulting-properties={base-type=uint8, sw-calibration-access=READ-WRITE, data-constr=uint8_DataConstr}
            azimuth_estimation_qf: resulting-properties={base-type=uint8, sw-calibration-access=READ-WRITE, data-constr=uint8_DataConstr}
            elevation_estimation_qf: resulting-properties={base-type=uint8, sw-calibration-access=READ-WRITE, data-constr=uint8_DataConstr}
            scf_estimation_qf: resulting-properties={base-type=uint8, sw-calibration-access=READ-WRITE, data-constr=uint8_DataConstr}
        SWC_PLT_Appl_NvMHandler_RFE_R1R2_Fault_NvM_DefaultValue: flat-map-entry=SWC_PLT_Appl_NvMHandler_RFE_R1R2_Fault_NvM_DefaultValue, symbol=Rte_SWC_PLT_Appl_NvMHandler_RFE_R1R2_Fault_NvM_DefaultValue, variation-point=post-build-variant-condition{matching-criterion=RDR_POS, value=3}
          18 x mc data instance, all with category=VALUE:
            CORE_BANK_SFT_ERR_MON: resulting-properties={base-type=uint32, sw-calibration-access=READ-WRITE, data-constr=uint32_DataConstr}
            CORE_BANK_SFT_ERR_STATUS: resulting-properties={base-type=uint32, sw-calibration-access=READ-WRITE, data-constr=uint32_DataConstr}
            CORE_BANK_MCU_STS_MCU_MSSG: resulting-properties={base-type=uint32, sw-calibration-access=READ-WRITE, data-constr=uint32_DataConstr}
            FUSA_IRQ{0..2}_FLAG_R: resulting-properties={base-type=uint32, sw-calibration-access=READ-WRITE, data-constr=uint32_DataConstr}
            Api_ret_val: resulting-properties={base-type=uint32, sw-calibration-access=READ-WRITE, data-constr=uint32_DataConstr}
            LOGEN_BANK_CHRP_GEN_ERROR: resulting-properties={base-type=uint32, sw-calibration-access=READ-WRITE, data-constr=uint32_DataConstr}
            LOGEN_BANK_LOGEN_ERROR: resulting-properties={base-type=uint32, sw-calibration-access=READ-WRITE, data-constr=uint32_DataConstr}
            CPU_SYS_MCU_ERR_{0..3}: resulting-properties={base-type=uint32, sw-calibration-access=READ-WRITE, data-constr=uint32_DataConstr}
            ASYNC_BANK_ASYNC_ERR1: resulting-properties={base-type=uint32, sw-calibration-access=READ-WRITE, data-constr=uint32_DataConstr}
            PROF_BANK_PRF_ERR1: resulting-properties={base-type=uint32, sw-calibration-access=READ-WRITE, data-constr=uint32_DataConstr}
            PROF_BANK_PRF_ERR2: resulting-properties={base-type=uint32, sw-calibration-access=READ-WRITE, data-constr=uint32_DataConstr}
            RXADC_FUSAMON: resulting-properties={base-type=uint32, sw-calibration-access=READ-WRITE, data-constr=uint32_DataConstr}
            maf_status: resulting-properties={base-type=uint8, sw-calibration-access=READ-WRITE, data-constr=uint8_DataConstr}
        SWC_PLT_Appl_NvMHandler_SWC_PLT_CDD_FailSafe_DefaultValue: flat-map-entry=SWC_PLT_Appl_NvMHandler_SWC_PLT_CDD_FailSafe_DefaultValue, symbol=Rte_SWC_PLT_Appl_NvMHandler_SWC_PLT_CDD_FailSafe_DefaultValue, variation-point=post-build-variant-condition{matching-criterion=RDR_POS, value=3}
          11 x mc data instance:
            reset_reason: category=ARRAY, array-size=5, resulting-properties={base-type=uint8, sw-calibration-access=READ-WRITE, range raw 0..255}
            reset_counter: category=VALUE, resulting-properties={base-type=uint8, sw-calibration-access=READ-WRITE, data-constr=uint8_DataConstr}
            last_cycle_reset: category=VALUE, resulting-properties={base-type=uint8, sw-calibration-access=READ-WRITE, data-constr=uint8_DataConstr}
            reset_reason_crnt_indx: category=VALUE, resulting-properties={base-type=uint8, sw-calibration-access=READ-WRITE, data-constr=uint8_DataConstr}
            repetitive_reset_counter: category=VALUE, resulting-properties={base-type=uint8, sw-calibration-access=READ-WRITE, data-constr=uint8_DataConstr}
            RFE_Repetitive_Reset_Counter: category=VALUE, resulting-properties={base-type=uint8, sw-calibration-access=READ-WRITE, data-constr=uint8_DataConstr}
            mem_exception_reason: category=STRUCTURE
              6 x mc data instance, all with category=VALUE:
                ExceptionType: resulting-properties={base-type=uint32, sw-calibration-access=READ-WRITE, range raw 0..4294967295}
                ExceptionCausingAddress: resulting-properties={base-type=uint32, sw-calibration-access=READ-WRITE, range raw 0..4294967295}
                ExceptionStatusRegister: resulting-properties={base-type=uint32, sw-calibration-access=READ-WRITE, range raw 0..4294967295}
                IsMemException_Occured: resulting-properties={base-type=boolean, sw-calibration-access=READ-WRITE, compu {1=TRUE, 0=FALSE}, range raw 0..1}
                MemoryExceptionAddress: resulting-properties={base-type=uint32, sw-calibration-access=READ-WRITE, range raw 0..4294967295}
                StackPointer: resulting-properties={base-type=uint32, sw-calibration-access=READ-WRITE, range raw 0..4294967295}
            wdg_failed_SE_info: category=ARRAY, array-size=5, resulting-properties={base-type=uint16, sw-calibration-access=READ-WRITE, data-constr=uint16_DataConstr}
            FCCU_Faults: category=ARRAY, array-size=10, resulting-properties={base-type=uint16, sw-calibration-access=READ-WRITE, data-constr=uint16_DataConstr}
            StaticRegCheckFailureInfo: category=ARRAY, array-size=35, resulting-properties={base-type=uint8, sw-calibration-access=READ-WRITE, range raw 0..255}
            NOC_LatentIntFault_Info: category=STRUCTURE
              5 x mc data instance, all with category=VALUE:
                LatentFault{0..3}: resulting-properties={base-type=uint32, sw-calibration-access=READ-WRITE, data-constr=uint32_DataConstr}
                Resnum: resulting-properties={base-type=uint16, sw-calibration-access=READ-WRITE, data-constr=uint16_DataConstr}
        SWC_PLT_CDD_FailSafe_ExceptionReason_DefaultValue: flat-map-entry=SWC_PLT_CDD_FailSafe_ExceptionReason_DefaultValue, symbol=Rte_SWC_PLT_CDD_FailSafe_ExceptionReason_DefaultValue, variation-point=post-build-variant-condition{matching-criterion=RDR_POS, value=3}
          mc data instance exception_reason_info: category=ARRAY, array-size=3
            mc data instance Element_0: category=STRUCTURE, symbol=[0]
              4 x mc data instance:
                exception_type: category=VALUE, resulting-properties={base-type=uint8, sw-calibration-access=READ-WRITE, range raw 0..255}
                coreid: category=VALUE, resulting-properties={base-type=uint8, sw-calibration-access=READ-WRITE, range raw 0..255}
                reserved: category=VALUE, resulting-properties={base-type=uint16, sw-calibration-access=READ-WRITE, range raw 0..65535}
                spf_regs: category=ARRAY, array-size=5, resulting-properties={base-type=uint32, sw-calibration-access=READ-WRITE, range raw 0..4294967295}
            mc data instance Element_1: category=STRUCTURE, symbol=[1]
              4 x mc data instance:
                exception_type: category=VALUE, resulting-properties={base-type=uint8, sw-calibration-access=READ-WRITE, range raw 0..255}
                coreid: category=VALUE, resulting-properties={base-type=uint8, sw-calibration-access=READ-WRITE, range raw 0..255}
                reserved: category=VALUE, resulting-properties={base-type=uint16, sw-calibration-access=READ-WRITE, range raw 0..65535}
                spf_regs: category=ARRAY, array-size=5, resulting-properties={base-type=uint32, sw-calibration-access=READ-WRITE, range raw 0..4294967295}
            mc data instance Element_2: category=STRUCTURE, symbol=[2]
              4 x mc data instance:
                exception_type: category=VALUE, resulting-properties={base-type=uint8, sw-calibration-access=READ-WRITE, range raw 0..255}
                coreid: category=VALUE, resulting-properties={base-type=uint8, sw-calibration-access=READ-WRITE, range raw 0..255}
                reserved: category=VALUE, resulting-properties={base-type=uint16, sw-calibration-access=READ-WRITE, range raw 0..65535}
                spf_regs: category=ARRAY, array-size=5, resulting-properties={base-type=uint32, sw-calibration-access=READ-WRITE, range raw 0..4294967295}
          mc data instance exception_reason_crnt_indx: category=VALUE, resulting-properties={base-type=uint8, sw-calibration-access=READ-WRITE, data-constr=uint8_DataConstr}
        SWC_PLT_CDD_FailSafe_ResetReason_DefaultValue: flat-map-entry=SWC_PLT_CDD_FailSafe_ResetReason_DefaultValue, symbol=Rte_SWC_PLT_CDD_FailSafe_ResetReason_DefaultValue, variation-point=post-build-variant-condition{matching-criterion=RDR_POS, value=3}
          11 x mc data instance:
            reset_reason: category=ARRAY, array-size=5, resulting-properties={base-type=uint8, sw-calibration-access=READ-WRITE, range raw 0..255}
            reset_counter: category=VALUE, resulting-properties={base-type=uint8, sw-calibration-access=READ-WRITE, data-constr=uint8_DataConstr}
            last_cycle_reset: category=VALUE, resulting-properties={base-type=uint8, sw-calibration-access=READ-WRITE, data-constr=uint8_DataConstr}
            reset_reason_crnt_indx: category=VALUE, resulting-properties={base-type=uint8, sw-calibration-access=READ-WRITE, data-constr=uint8_DataConstr}
            repetitive_reset_counter: category=VALUE, resulting-properties={base-type=uint8, sw-calibration-access=READ-WRITE, data-constr=uint8_DataConstr}
            RFE_Repetitive_Reset_Counter: category=VALUE, resulting-properties={base-type=uint8, sw-calibration-access=READ-WRITE, data-constr=uint8_DataConstr}
            mem_exception_reason: category=STRUCTURE
              6 x mc data instance, all with category=VALUE:
                ExceptionType: resulting-properties={base-type=uint32, sw-calibration-access=READ-WRITE, range raw 0..4294967295}
                ExceptionCausingAddress: resulting-properties={base-type=uint32, sw-calibration-access=READ-WRITE, range raw 0..4294967295}
                ExceptionStatusRegister: resulting-properties={base-type=uint32, sw-calibration-access=READ-WRITE, range raw 0..4294967295}
                IsMemException_Occured: resulting-properties={base-type=boolean, sw-calibration-access=READ-WRITE, compu {1=TRUE, 0=FALSE}, range raw 0..1}
                MemoryExceptionAddress: resulting-properties={base-type=uint32, sw-calibration-access=READ-WRITE, range raw 0..4294967295}
                StackPointer: resulting-properties={base-type=uint32, sw-calibration-access=READ-WRITE, range raw 0..4294967295}
            wdg_failed_SE_info: category=ARRAY, array-size=5, resulting-properties={base-type=uint16, sw-calibration-access=READ-WRITE, data-constr=uint16_DataConstr}
            FCCU_Faults: category=ARRAY, array-size=10, resulting-properties={base-type=uint16, sw-calibration-access=READ-WRITE, data-constr=uint16_DataConstr}
            StaticRegCheckFailureInfo: category=ARRAY, array-size=35, resulting-properties={base-type=uint8, sw-calibration-access=READ-WRITE, range raw 0..255}
            NOC_LatentIntFault_Info: category=STRUCTURE
              5 x mc data instance, all with category=VALUE:
                LatentFault{0..3}: resulting-properties={base-type=uint32, sw-calibration-access=READ-WRITE, data-constr=uint32_DataConstr}
                Resnum: resulting-properties={base-type=uint16, sw-calibration-access=READ-WRITE, data-constr=uint16_DataConstr}
        SWC_PLT_Radar_Alignment_Handler_Appl_AutoAlignment_DefaultValue: flat-map-entry=SWC_PLT_Radar_Alignment_Handler_Appl_AutoAlignment_DefaultValue, symbol=Rte_SWC_PLT_Radar_Alignment_Handler_Appl_AutoAlignment_DefaultValue, variation-point=post-build-variant-condition{matching-criterion=RDR_POS, value=3}
          5 x mc data instance:
            Alignment_Initial_NVM_Data: category=STRUCTURE
              mc data instance InitialAlignmentResultAzimuth: category=VALUE, resulting-properties={base-type=float32, sw-calibration-access=READ-WRITE, data-constr=float32_DataConstr}
              mc data instance InitialAlignmentResultElevation: category=VALUE, resulting-properties={base-type=float32, sw-calibration-access=READ-WRITE, data-constr=float32_DataConstr}
              mc data instance InitialLastSuccessfulAlignmentMode: category=VALUE, resulting-properties={base-type=uint8, sw-calibration-access=READ-WRITE, compu-method=CM_AlignMode, range raw 0..255}
            AlignmentDyn_Initial_NVM_Data: category=STRUCTURE
              mc data instance InitialAlignmentResultAzimuthUpdates: category=VALUE, resulting-properties={base-type=uint32, sw-calibration-access=READ-WRITE, data-constr=uint32_DataConstr}
              mc data instance InitialAlignmentResultElevationUpdates: category=VALUE, resulting-properties={base-type=uint32, sw-calibration-access=READ-WRITE, data-constr=uint32_DataConstr}
              mc data instance InitialAlignmentResultHostSCF: category=VALUE, resulting-properties={base-type=float32, sw-calibration-access=READ-WRITE, data-constr=float32_DataConstr}
            Alignment_AutoCyclic_NVM_Data: category=STRUCTURE
              mc data instance AACurrentAzimuth: category=VALUE, resulting-properties={base-type=float32, sw-calibration-access=READ-WRITE, data-constr=float32_DataConstr}
              mc data instance AACurrentElevation: category=VALUE, resulting-properties={base-type=float32, sw-calibration-access=READ-WRITE, data-constr=float32_DataConstr}
            Alignment_Auto_NVM_data: category=STRUCTURE
              mc data instance AzimuthUpdates: category=VALUE, resulting-properties={base-type=uint32, sw-calibration-access=READ-WRITE, data-constr=uint32_DataConstr}
              mc data instance ElevationUpdates: category=VALUE, resulting-properties={base-type=uint32, sw-calibration-access=READ-WRITE, data-constr=uint32_DataConstr}
              mc data instance HostScf: category=VALUE, resulting-properties={base-type=float32, sw-calibration-access=READ-WRITE, data-constr=float32_DataConstr}
            AlignmentModeOut: category=VALUE, resulting-properties={base-type=uint8, sw-calibration-access=READ-WRITE, compu-method=CM_AlignMode, range raw 0..255}
        SWC_PLT_Appl_IoHwAb_ECU_Position_ROMDefault: flat-map-entry=SWC_PLT_Appl_IoHwAb_ECU_Position_ROMDefault, symbol=Rte_SWC_PLT_Appl_IoHwAb_ECU_Position_ROMDefault, variation-point=post-build-variant-condition{matching-criterion=RDR_POS, value=4}
          mc data instance ECUPosition_Value: category=VALUE, resulting-properties={base-type=uint8, sw-calibration-access=READ-WRITE, data-constr=uint8_DataConstr}
          mc data instance Reserved: category=VALUE, resulting-properties={base-type=uint8, sw-calibration-access=READ-WRITE, data-constr=uint8_DataConstr}
          mc data instance CRC_Value: category=VALUE, resulting-properties={base-type=uint16, sw-calibration-access=READ-WRITE, data-constr=uint16_DataConstr}
        SWC_PLT_Appl_NvMHandler_Alignment_NvMBlock_DefaultValue: flat-map-entry=SWC_PLT_Appl_NvMHandler_Alignment_NvMBlock_DefaultValue, symbol=Rte_SWC_PLT_Appl_NvMHandler_Alignment_NvMBlock_DefaultValue, variation-point=post-build-variant-condition{matching-criterion=RDR_POS, value=4}
          19 x mc data instance, all with category=VALUE:
            AACurrentAzimuth: resulting-properties={base-type=float32, sw-calibration-access=READ-WRITE, data-constr=float32_DataConstr}
            AACurrentElevation: resulting-properties={base-type=float32, sw-calibration-access=READ-WRITE, data-constr=float32_DataConstr}
            AACurrentRoll: resulting-properties={base-type=float32, sw-calibration-access=READ-WRITE, data-constr=float32_DataConstr}
            InitialAlignmentResultAzimuth: resulting-properties={base-type=float32, sw-calibration-access=READ-WRITE, data-constr=float32_DataConstr}
            InitialAlignmentResultElevation: resulting-properties={base-type=float32, sw-calibration-access=READ-WRITE, data-constr=float32_DataConstr}
            InitialAlignmentResultRoll: resulting-properties={base-type=float32, sw-calibration-access=READ-WRITE, data-constr=float32_DataConstr}
            InitialLastSuccessfulAlignmentMode: resulting-properties={base-type=float32, sw-calibration-access=READ-WRITE, data-constr=float32_DataConstr}
            ElevationUpdates: resulting-properties={base-type=float32, sw-calibration-access=READ-WRITE, data-constr=float32_DataConstr}
            AzimuthUpdates: resulting-properties={base-type=float32, sw-calibration-access=READ-WRITE, data-constr=float32_DataConstr}
            RollUpdates: resulting-properties={base-type=float32, sw-calibration-access=READ-WRITE, data-constr=float32_DataConstr}
            InitialAlignmentResultElevationUpdates: resulting-properties={base-type=float32, sw-calibration-access=READ-WRITE, data-constr=float32_DataConstr}
            InitialAlignmentResultHostSpeedCompensationFactor: resulting-properties={base-type=float32, sw-calibration-access=READ-WRITE, data-constr=float32_DataConstr}
            HostSpeedCompensationFactor: resulting-properties={base-type=float32, sw-calibration-access=READ-WRITE, data-constr=float32_DataConstr}
            InitialAlignmentResultAzimuthUpdates: resulting-properties={base-type=float32, sw-calibration-access=READ-WRITE, data-constr=float32_DataConstr}
            InitialAlignmentResultRollUpdates: resulting-properties={base-type=float32, sw-calibration-access=READ-WRITE, data-constr=float32_DataConstr}
            AlignmentModeOut: resulting-properties={base-type=uint8, sw-calibration-access=READ-WRITE, data-constr=uint8_DataConstr}
            azimuth_estimation_qf: resulting-properties={base-type=uint8, sw-calibration-access=READ-WRITE, data-constr=uint8_DataConstr}
            elevation_estimation_qf: resulting-properties={base-type=uint8, sw-calibration-access=READ-WRITE, data-constr=uint8_DataConstr}
            scf_estimation_qf: resulting-properties={base-type=uint8, sw-calibration-access=READ-WRITE, data-constr=uint8_DataConstr}
        SWC_PLT_Appl_NvMHandler_Correctable_Fault_NvM_DefaultValue: flat-map-entry=SWC_PLT_Appl_NvMHandler_Correctable_Fault_NvM_DefaultValue, symbol=Rte_SWC_PLT_Appl_NvMHandler_Correctable_Fault_NvM_DefaultValue, variation-point=post-build-variant-condition{matching-criterion=RDR_POS, value=4}
          21 x mc data instance, all with category=VALUE:
            aa_mem_sec: resulting-properties={base-type=uint8, sw-calibration-access=READ-WRITE, data-constr=uint8_DataConstr}
            artie_mem_sec: resulting-properties={base-type=uint8, sw-calibration-access=READ-WRITE, data-constr=uint8_DataConstr}
            csi2_sec: resulting-properties={base-type=uint8, sw-calibration-access=READ-WRITE, data-constr=uint8_DataConstr}
            dsp_opif_sec: resulting-properties={base-type=uint8, sw-calibration-access=READ-WRITE, data-constr=uint8_DataConstr}
            dsp_idma_sec: resulting-properties={base-type=uint8, sw-calibration-access=READ-WRITE, data-constr=uint8_DataConstr}
            dsp_iram_sec_axis: resulting-properties={base-type=uint8, sw-calibration-access=READ-WRITE, data-constr=uint8_DataConstr}
            dsp_dcache_sec: resulting-properties={base-type=uint8, sw-calibration-access=READ-WRITE, data-constr=uint8_DataConstr}
            dsp_dram_sec: resulting-properties={base-type=uint8, sw-calibration-access=READ-WRITE, data-constr=uint8_DataConstr}
            dsp_icache_sec: resulting-properties={base-type=uint8, sw-calibration-access=READ-WRITE, data-constr=uint8_DataConstr}
            dsp_iram_sec: resulting-properties={base-type=uint8, sw-calibration-access=READ-WRITE, data-constr=uint8_DataConstr}
            ra_cqmem_sec: resulting-properties={base-type=uint8, sw-calibration-access=READ-WRITE, data-constr=uint8_DataConstr}
            ra_dpmem_sec: resulting-properties={base-type=uint8, sw-calibration-access=READ-WRITE, data-constr=uint8_DataConstr}
            ra_estmem_sec: resulting-properties={base-type=uint8, sw-calibration-access=READ-WRITE, data-constr=uint8_DataConstr}
            ra_idxmem_sec: resulting-properties={base-type=uint8, sw-calibration-access=READ-WRITE, data-constr=uint8_DataConstr}
            ra_phmem_sec: resulting-properties={base-type=uint8, sw-calibration-access=READ-WRITE, data-constr=uint8_DataConstr}
            ra_wcmem_sec: resulting-properties={base-type=uint8, sw-calibration-access=READ-WRITE, data-constr=uint8_DataConstr}
            sp_axi_m_corr: resulting-properties={base-type=uint16, sw-calibration-access=READ-WRITE, data-constr=uint16_DataConstr}
            sp_axi_s_corr: resulting-properties={base-type=uint16, sw-calibration-access=READ-WRITE, data-constr=uint16_DataConstr}
            sysmem0_sec: resulting-properties={base-type=uint8, sw-calibration-access=READ-WRITE, data-constr=uint8_DataConstr}
            sysmem1_sec: resulting-properties={base-type=uint8, sw-calibration-access=READ-WRITE, data-constr=uint8_DataConstr}
            not_recorded: resulting-properties={base-type=uint8, sw-calibration-access=READ-WRITE, data-constr=uint8_DataConstr}
        SWC_PLT_Appl_NvMHandler_NvMBringUp_DefaultValue: flat-map-entry=SWC_PLT_Appl_NvMHandler_NvMBringUp_DefaultValue, symbol=Rte_SWC_PLT_Appl_NvMHandler_NvMBringUp_DefaultValue, variation-point=post-build-variant-condition{matching-criterion=RDR_POS, value=4}
          19 x mc data instance, all with category=VALUE:
            AACurrentAzimuth: resulting-properties={base-type=float32, sw-calibration-access=READ-WRITE, data-constr=float32_DataConstr}
            AACurrentElevation: resulting-properties={base-type=float32, sw-calibration-access=READ-WRITE, data-constr=float32_DataConstr}
            AACurrentRoll: resulting-properties={base-type=float32, sw-calibration-access=READ-WRITE, data-constr=float32_DataConstr}
            InitialAlignmentResultAzimuth: resulting-properties={base-type=float32, sw-calibration-access=READ-WRITE, data-constr=float32_DataConstr}
            InitialAlignmentResultElevation: resulting-properties={base-type=float32, sw-calibration-access=READ-WRITE, data-constr=float32_DataConstr}
            InitialAlignmentResultRoll: resulting-properties={base-type=float32, sw-calibration-access=READ-WRITE, data-constr=float32_DataConstr}
            InitialLastSuccessfulAlignmentMode: resulting-properties={base-type=float32, sw-calibration-access=READ-WRITE, data-constr=float32_DataConstr}
            ElevationUpdates: resulting-properties={base-type=float32, sw-calibration-access=READ-WRITE, data-constr=float32_DataConstr}
            AzimuthUpdates: resulting-properties={base-type=float32, sw-calibration-access=READ-WRITE, data-constr=float32_DataConstr}
            RollUpdates: resulting-properties={base-type=float32, sw-calibration-access=READ-WRITE, data-constr=float32_DataConstr}
            InitialAlignmentResultElevationUpdates: resulting-properties={base-type=float32, sw-calibration-access=READ-WRITE, data-constr=float32_DataConstr}
            InitialAlignmentResultHostSpeedCompensationFactor: resulting-properties={base-type=float32, sw-calibration-access=READ-WRITE, data-constr=float32_DataConstr}
            HostSpeedCompensationFactor: resulting-properties={base-type=float32, sw-calibration-access=READ-WRITE, data-constr=float32_DataConstr}
            InitialAlignmentResultAzimuthUpdates: resulting-properties={base-type=float32, sw-calibration-access=READ-WRITE, data-constr=float32_DataConstr}
            InitialAlignmentResultRollUpdates: resulting-properties={base-type=float32, sw-calibration-access=READ-WRITE, data-constr=float32_DataConstr}
            AlignmentModeOut: resulting-properties={base-type=uint8, sw-calibration-access=READ-WRITE, data-constr=uint8_DataConstr}
            azimuth_estimation_qf: resulting-properties={base-type=uint8, sw-calibration-access=READ-WRITE, data-constr=uint8_DataConstr}
            elevation_estimation_qf: resulting-properties={base-type=uint8, sw-calibration-access=READ-WRITE, data-constr=uint8_DataConstr}
            scf_estimation_qf: resulting-properties={base-type=uint8, sw-calibration-access=READ-WRITE, data-constr=uint8_DataConstr}
        SWC_PLT_Appl_NvMHandler_RFE_R1R2_Fault_NvM_DefaultValue: flat-map-entry=SWC_PLT_Appl_NvMHandler_RFE_R1R2_Fault_NvM_DefaultValue, symbol=Rte_SWC_PLT_Appl_NvMHandler_RFE_R1R2_Fault_NvM_DefaultValue, variation-point=post-build-variant-condition{matching-criterion=RDR_POS, value=4}
          18 x mc data instance, all with category=VALUE:
            CORE_BANK_SFT_ERR_MON: resulting-properties={base-type=uint32, sw-calibration-access=READ-WRITE, data-constr=uint32_DataConstr}
            CORE_BANK_SFT_ERR_STATUS: resulting-properties={base-type=uint32, sw-calibration-access=READ-WRITE, data-constr=uint32_DataConstr}
            CORE_BANK_MCU_STS_MCU_MSSG: resulting-properties={base-type=uint32, sw-calibration-access=READ-WRITE, data-constr=uint32_DataConstr}
            FUSA_IRQ{0..2}_FLAG_R: resulting-properties={base-type=uint32, sw-calibration-access=READ-WRITE, data-constr=uint32_DataConstr}
            Api_ret_val: resulting-properties={base-type=uint32, sw-calibration-access=READ-WRITE, data-constr=uint32_DataConstr}
            LOGEN_BANK_CHRP_GEN_ERROR: resulting-properties={base-type=uint32, sw-calibration-access=READ-WRITE, data-constr=uint32_DataConstr}
            LOGEN_BANK_LOGEN_ERROR: resulting-properties={base-type=uint32, sw-calibration-access=READ-WRITE, data-constr=uint32_DataConstr}
            CPU_SYS_MCU_ERR_{0..3}: resulting-properties={base-type=uint32, sw-calibration-access=READ-WRITE, data-constr=uint32_DataConstr}
            ASYNC_BANK_ASYNC_ERR1: resulting-properties={base-type=uint32, sw-calibration-access=READ-WRITE, data-constr=uint32_DataConstr}
            PROF_BANK_PRF_ERR1: resulting-properties={base-type=uint32, sw-calibration-access=READ-WRITE, data-constr=uint32_DataConstr}
            PROF_BANK_PRF_ERR2: resulting-properties={base-type=uint32, sw-calibration-access=READ-WRITE, data-constr=uint32_DataConstr}
            RXADC_FUSAMON: resulting-properties={base-type=uint32, sw-calibration-access=READ-WRITE, data-constr=uint32_DataConstr}
            maf_status: resulting-properties={base-type=uint8, sw-calibration-access=READ-WRITE, data-constr=uint8_DataConstr}
        SWC_PLT_Appl_NvMHandler_SWC_PLT_CDD_FailSafe_DefaultValue: flat-map-entry=SWC_PLT_Appl_NvMHandler_SWC_PLT_CDD_FailSafe_DefaultValue, symbol=Rte_SWC_PLT_Appl_NvMHandler_SWC_PLT_CDD_FailSafe_DefaultValue, variation-point=post-build-variant-condition{matching-criterion=RDR_POS, value=4}
          11 x mc data instance:
            reset_reason: category=ARRAY, array-size=5, resulting-properties={base-type=uint8, sw-calibration-access=READ-WRITE, range raw 0..255}
            reset_counter: category=VALUE, resulting-properties={base-type=uint8, sw-calibration-access=READ-WRITE, data-constr=uint8_DataConstr}
            last_cycle_reset: category=VALUE, resulting-properties={base-type=uint8, sw-calibration-access=READ-WRITE, data-constr=uint8_DataConstr}
            reset_reason_crnt_indx: category=VALUE, resulting-properties={base-type=uint8, sw-calibration-access=READ-WRITE, data-constr=uint8_DataConstr}
            repetitive_reset_counter: category=VALUE, resulting-properties={base-type=uint8, sw-calibration-access=READ-WRITE, data-constr=uint8_DataConstr}
            RFE_Repetitive_Reset_Counter: category=VALUE, resulting-properties={base-type=uint8, sw-calibration-access=READ-WRITE, data-constr=uint8_DataConstr}
            mem_exception_reason: category=STRUCTURE
              6 x mc data instance, all with category=VALUE:
                ExceptionType: resulting-properties={base-type=uint32, sw-calibration-access=READ-WRITE, range raw 0..4294967295}
                ExceptionCausingAddress: resulting-properties={base-type=uint32, sw-calibration-access=READ-WRITE, range raw 0..4294967295}
                ExceptionStatusRegister: resulting-properties={base-type=uint32, sw-calibration-access=READ-WRITE, range raw 0..4294967295}
                IsMemException_Occured: resulting-properties={base-type=boolean, sw-calibration-access=READ-WRITE, compu {1=TRUE, 0=FALSE}, range raw 0..1}
                MemoryExceptionAddress: resulting-properties={base-type=uint32, sw-calibration-access=READ-WRITE, range raw 0..4294967295}
                StackPointer: resulting-properties={base-type=uint32, sw-calibration-access=READ-WRITE, range raw 0..4294967295}
            wdg_failed_SE_info: category=ARRAY, array-size=5, resulting-properties={base-type=uint16, sw-calibration-access=READ-WRITE, data-constr=uint16_DataConstr}
            FCCU_Faults: category=ARRAY, array-size=10, resulting-properties={base-type=uint16, sw-calibration-access=READ-WRITE, data-constr=uint16_DataConstr}
            StaticRegCheckFailureInfo: category=ARRAY, array-size=35, resulting-properties={base-type=uint8, sw-calibration-access=READ-WRITE, range raw 0..255}
            NOC_LatentIntFault_Info: category=STRUCTURE
              5 x mc data instance, all with category=VALUE:
                LatentFault{0..3}: resulting-properties={base-type=uint32, sw-calibration-access=READ-WRITE, data-constr=uint32_DataConstr}
                Resnum: resulting-properties={base-type=uint16, sw-calibration-access=READ-WRITE, data-constr=uint16_DataConstr}
        SWC_PLT_CDD_FailSafe_ExceptionReason_DefaultValue: flat-map-entry=SWC_PLT_CDD_FailSafe_ExceptionReason_DefaultValue, symbol=Rte_SWC_PLT_CDD_FailSafe_ExceptionReason_DefaultValue, variation-point=post-build-variant-condition{matching-criterion=RDR_POS, value=4}
          mc data instance exception_reason_info: category=ARRAY, array-size=3
            mc data instance Element_0: category=STRUCTURE, symbol=[0]
              4 x mc data instance:
                exception_type: category=VALUE, resulting-properties={base-type=uint8, sw-calibration-access=READ-WRITE, range raw 0..255}
                coreid: category=VALUE, resulting-properties={base-type=uint8, sw-calibration-access=READ-WRITE, range raw 0..255}
                reserved: category=VALUE, resulting-properties={base-type=uint16, sw-calibration-access=READ-WRITE, range raw 0..65535}
                spf_regs: category=ARRAY, array-size=5, resulting-properties={base-type=uint32, sw-calibration-access=READ-WRITE, range raw 0..4294967295}
            mc data instance Element_1: category=STRUCTURE, symbol=[1]
              4 x mc data instance:
                exception_type: category=VALUE, resulting-properties={base-type=uint8, sw-calibration-access=READ-WRITE, range raw 0..255}
                coreid: category=VALUE, resulting-properties={base-type=uint8, sw-calibration-access=READ-WRITE, range raw 0..255}
                reserved: category=VALUE, resulting-properties={base-type=uint16, sw-calibration-access=READ-WRITE, range raw 0..65535}
                spf_regs: category=ARRAY, array-size=5, resulting-properties={base-type=uint32, sw-calibration-access=READ-WRITE, range raw 0..4294967295}
            mc data instance Element_2: category=STRUCTURE, symbol=[2]
              4 x mc data instance:
                exception_type: category=VALUE, resulting-properties={base-type=uint8, sw-calibration-access=READ-WRITE, range raw 0..255}
                coreid: category=VALUE, resulting-properties={base-type=uint8, sw-calibration-access=READ-WRITE, range raw 0..255}
                reserved: category=VALUE, resulting-properties={base-type=uint16, sw-calibration-access=READ-WRITE, range raw 0..65535}
                spf_regs: category=ARRAY, array-size=5, resulting-properties={base-type=uint32, sw-calibration-access=READ-WRITE, range raw 0..4294967295}
          mc data instance exception_reason_crnt_indx: category=VALUE, resulting-properties={base-type=uint8, sw-calibration-access=READ-WRITE, data-constr=uint8_DataConstr}
        SWC_PLT_CDD_FailSafe_ResetReason_DefaultValue: flat-map-entry=SWC_PLT_CDD_FailSafe_ResetReason_DefaultValue, symbol=Rte_SWC_PLT_CDD_FailSafe_ResetReason_DefaultValue, variation-point=post-build-variant-condition{matching-criterion=RDR_POS, value=4}
          11 x mc data instance:
            reset_reason: category=ARRAY, array-size=5, resulting-properties={base-type=uint8, sw-calibration-access=READ-WRITE, range raw 0..255}
            reset_counter: category=VALUE, resulting-properties={base-type=uint8, sw-calibration-access=READ-WRITE, data-constr=uint8_DataConstr}
            last_cycle_reset: category=VALUE, resulting-properties={base-type=uint8, sw-calibration-access=READ-WRITE, data-constr=uint8_DataConstr}
            reset_reason_crnt_indx: category=VALUE, resulting-properties={base-type=uint8, sw-calibration-access=READ-WRITE, data-constr=uint8_DataConstr}
            repetitive_reset_counter: category=VALUE, resulting-properties={base-type=uint8, sw-calibration-access=READ-WRITE, data-constr=uint8_DataConstr}
            RFE_Repetitive_Reset_Counter: category=VALUE, resulting-properties={base-type=uint8, sw-calibration-access=READ-WRITE, data-constr=uint8_DataConstr}
            mem_exception_reason: category=STRUCTURE
              6 x mc data instance, all with category=VALUE:
                ExceptionType: resulting-properties={base-type=uint32, sw-calibration-access=READ-WRITE, range raw 0..4294967295}
                ExceptionCausingAddress: resulting-properties={base-type=uint32, sw-calibration-access=READ-WRITE, range raw 0..4294967295}
                ExceptionStatusRegister: resulting-properties={base-type=uint32, sw-calibration-access=READ-WRITE, range raw 0..4294967295}
                IsMemException_Occured: resulting-properties={base-type=boolean, sw-calibration-access=READ-WRITE, compu {1=TRUE, 0=FALSE}, range raw 0..1}
                MemoryExceptionAddress: resulting-properties={base-type=uint32, sw-calibration-access=READ-WRITE, range raw 0..4294967295}
                StackPointer: resulting-properties={base-type=uint32, sw-calibration-access=READ-WRITE, range raw 0..4294967295}
            wdg_failed_SE_info: category=ARRAY, array-size=5, resulting-properties={base-type=uint16, sw-calibration-access=READ-WRITE, data-constr=uint16_DataConstr}
            FCCU_Faults: category=ARRAY, array-size=10, resulting-properties={base-type=uint16, sw-calibration-access=READ-WRITE, data-constr=uint16_DataConstr}
            StaticRegCheckFailureInfo: category=ARRAY, array-size=35, resulting-properties={base-type=uint8, sw-calibration-access=READ-WRITE, range raw 0..255}
            NOC_LatentIntFault_Info: category=STRUCTURE
              5 x mc data instance, all with category=VALUE:
                LatentFault{0..3}: resulting-properties={base-type=uint32, sw-calibration-access=READ-WRITE, data-constr=uint32_DataConstr}
                Resnum: resulting-properties={base-type=uint16, sw-calibration-access=READ-WRITE, data-constr=uint16_DataConstr}
        SWC_PLT_Radar_Alignment_Handler_Appl_AutoAlignment_DefaultValue: flat-map-entry=SWC_PLT_Radar_Alignment_Handler_Appl_AutoAlignment_DefaultValue, symbol=Rte_SWC_PLT_Radar_Alignment_Handler_Appl_AutoAlignment_DefaultValue, variation-point=post-build-variant-condition{matching-criterion=RDR_POS, value=4}
          5 x mc data instance:
            Alignment_Initial_NVM_Data: category=STRUCTURE
              mc data instance InitialAlignmentResultAzimuth: category=VALUE, resulting-properties={base-type=float32, sw-calibration-access=READ-WRITE, data-constr=float32_DataConstr}
              mc data instance InitialAlignmentResultElevation: category=VALUE, resulting-properties={base-type=float32, sw-calibration-access=READ-WRITE, data-constr=float32_DataConstr}
              mc data instance InitialLastSuccessfulAlignmentMode: category=VALUE, resulting-properties={base-type=uint8, sw-calibration-access=READ-WRITE, compu-method=CM_AlignMode, range raw 0..255}
            AlignmentDyn_Initial_NVM_Data: category=STRUCTURE
              mc data instance InitialAlignmentResultAzimuthUpdates: category=VALUE, resulting-properties={base-type=uint32, sw-calibration-access=READ-WRITE, data-constr=uint32_DataConstr}
              mc data instance InitialAlignmentResultElevationUpdates: category=VALUE, resulting-properties={base-type=uint32, sw-calibration-access=READ-WRITE, data-constr=uint32_DataConstr}
              mc data instance InitialAlignmentResultHostSCF: category=VALUE, resulting-properties={base-type=float32, sw-calibration-access=READ-WRITE, data-constr=float32_DataConstr}
            Alignment_AutoCyclic_NVM_Data: category=STRUCTURE
              mc data instance AACurrentAzimuth: category=VALUE, resulting-properties={base-type=float32, sw-calibration-access=READ-WRITE, data-constr=float32_DataConstr}
              mc data instance AACurrentElevation: category=VALUE, resulting-properties={base-type=float32, sw-calibration-access=READ-WRITE, data-constr=float32_DataConstr}
            Alignment_Auto_NVM_data: category=STRUCTURE
              mc data instance AzimuthUpdates: category=VALUE, resulting-properties={base-type=uint32, sw-calibration-access=READ-WRITE, data-constr=uint32_DataConstr}
              mc data instance ElevationUpdates: category=VALUE, resulting-properties={base-type=uint32, sw-calibration-access=READ-WRITE, data-constr=uint32_DataConstr}
              mc data instance HostScf: category=VALUE, resulting-properties={base-type=float32, sw-calibration-access=READ-WRITE, data-constr=float32_DataConstr}
            AlignmentModeOut: category=VALUE, resulting-properties={base-type=uint8, sw-calibration-access=READ-WRITE, compu-method=CM_AlignMode, range raw 0..255}
        SWC_PLT_Appl_IoHwAb_ECU_Position_ROMDefault: flat-map-entry=SWC_PLT_Appl_IoHwAb_ECU_Position_ROMDefault, symbol=Rte_SWC_PLT_Appl_IoHwAb_ECU_Position_ROMDefault, variation-point=post-build-variant-condition{matching-criterion=RDR_POS, value=5}
          mc data instance ECUPosition_Value: category=VALUE, resulting-properties={base-type=uint8, sw-calibration-access=READ-WRITE, data-constr=uint8_DataConstr}
          mc data instance Reserved: category=VALUE, resulting-properties={base-type=uint8, sw-calibration-access=READ-WRITE, data-constr=uint8_DataConstr}
          mc data instance CRC_Value: category=VALUE, resulting-properties={base-type=uint16, sw-calibration-access=READ-WRITE, data-constr=uint16_DataConstr}
        SWC_PLT_Appl_NvMHandler_Alignment_NvMBlock_DefaultValue: flat-map-entry=SWC_PLT_Appl_NvMHandler_Alignment_NvMBlock_DefaultValue, symbol=Rte_SWC_PLT_Appl_NvMHandler_Alignment_NvMBlock_DefaultValue, variation-point=post-build-variant-condition{matching-criterion=RDR_POS, value=5}
          19 x mc data instance, all with category=VALUE:
            AACurrentAzimuth: resulting-properties={base-type=float32, sw-calibration-access=READ-WRITE, data-constr=float32_DataConstr}
            AACurrentElevation: resulting-properties={base-type=float32, sw-calibration-access=READ-WRITE, data-constr=float32_DataConstr}
            AACurrentRoll: resulting-properties={base-type=float32, sw-calibration-access=READ-WRITE, data-constr=float32_DataConstr}
            InitialAlignmentResultAzimuth: resulting-properties={base-type=float32, sw-calibration-access=READ-WRITE, data-constr=float32_DataConstr}
            InitialAlignmentResultElevation: resulting-properties={base-type=float32, sw-calibration-access=READ-WRITE, data-constr=float32_DataConstr}
            InitialAlignmentResultRoll: resulting-properties={base-type=float32, sw-calibration-access=READ-WRITE, data-constr=float32_DataConstr}
            InitialLastSuccessfulAlignmentMode: resulting-properties={base-type=float32, sw-calibration-access=READ-WRITE, data-constr=float32_DataConstr}
            ElevationUpdates: resulting-properties={base-type=float32, sw-calibration-access=READ-WRITE, data-constr=float32_DataConstr}
            AzimuthUpdates: resulting-properties={base-type=float32, sw-calibration-access=READ-WRITE, data-constr=float32_DataConstr}
            RollUpdates: resulting-properties={base-type=float32, sw-calibration-access=READ-WRITE, data-constr=float32_DataConstr}
            InitialAlignmentResultElevationUpdates: resulting-properties={base-type=float32, sw-calibration-access=READ-WRITE, data-constr=float32_DataConstr}
            InitialAlignmentResultHostSpeedCompensationFactor: resulting-properties={base-type=float32, sw-calibration-access=READ-WRITE, data-constr=float32_DataConstr}
            HostSpeedCompensationFactor: resulting-properties={base-type=float32, sw-calibration-access=READ-WRITE, data-constr=float32_DataConstr}
            InitialAlignmentResultAzimuthUpdates: resulting-properties={base-type=float32, sw-calibration-access=READ-WRITE, data-constr=float32_DataConstr}
            InitialAlignmentResultRollUpdates: resulting-properties={base-type=float32, sw-calibration-access=READ-WRITE, data-constr=float32_DataConstr}
            AlignmentModeOut: resulting-properties={base-type=uint8, sw-calibration-access=READ-WRITE, data-constr=uint8_DataConstr}
            azimuth_estimation_qf: resulting-properties={base-type=uint8, sw-calibration-access=READ-WRITE, data-constr=uint8_DataConstr}
            elevation_estimation_qf: resulting-properties={base-type=uint8, sw-calibration-access=READ-WRITE, data-constr=uint8_DataConstr}
            scf_estimation_qf: resulting-properties={base-type=uint8, sw-calibration-access=READ-WRITE, data-constr=uint8_DataConstr}
        SWC_PLT_Appl_NvMHandler_Correctable_Fault_NvM_DefaultValue: flat-map-entry=SWC_PLT_Appl_NvMHandler_Correctable_Fault_NvM_DefaultValue, symbol=Rte_SWC_PLT_Appl_NvMHandler_Correctable_Fault_NvM_DefaultValue, variation-point=post-build-variant-condition{matching-criterion=RDR_POS, value=5}
          21 x mc data instance, all with category=VALUE:
            aa_mem_sec: resulting-properties={base-type=uint8, sw-calibration-access=READ-WRITE, data-constr=uint8_DataConstr}
            artie_mem_sec: resulting-properties={base-type=uint8, sw-calibration-access=READ-WRITE, data-constr=uint8_DataConstr}
            csi2_sec: resulting-properties={base-type=uint8, sw-calibration-access=READ-WRITE, data-constr=uint8_DataConstr}
            dsp_opif_sec: resulting-properties={base-type=uint8, sw-calibration-access=READ-WRITE, data-constr=uint8_DataConstr}
            dsp_idma_sec: resulting-properties={base-type=uint8, sw-calibration-access=READ-WRITE, data-constr=uint8_DataConstr}
            dsp_iram_sec_axis: resulting-properties={base-type=uint8, sw-calibration-access=READ-WRITE, data-constr=uint8_DataConstr}
            dsp_dcache_sec: resulting-properties={base-type=uint8, sw-calibration-access=READ-WRITE, data-constr=uint8_DataConstr}
            dsp_dram_sec: resulting-properties={base-type=uint8, sw-calibration-access=READ-WRITE, data-constr=uint8_DataConstr}
            dsp_icache_sec: resulting-properties={base-type=uint8, sw-calibration-access=READ-WRITE, data-constr=uint8_DataConstr}
            dsp_iram_sec: resulting-properties={base-type=uint8, sw-calibration-access=READ-WRITE, data-constr=uint8_DataConstr}
            ra_cqmem_sec: resulting-properties={base-type=uint8, sw-calibration-access=READ-WRITE, data-constr=uint8_DataConstr}
            ra_dpmem_sec: resulting-properties={base-type=uint8, sw-calibration-access=READ-WRITE, data-constr=uint8_DataConstr}
            ra_estmem_sec: resulting-properties={base-type=uint8, sw-calibration-access=READ-WRITE, data-constr=uint8_DataConstr}
            ra_idxmem_sec: resulting-properties={base-type=uint8, sw-calibration-access=READ-WRITE, data-constr=uint8_DataConstr}
            ra_phmem_sec: resulting-properties={base-type=uint8, sw-calibration-access=READ-WRITE, data-constr=uint8_DataConstr}
            ra_wcmem_sec: resulting-properties={base-type=uint8, sw-calibration-access=READ-WRITE, data-constr=uint8_DataConstr}
            sp_axi_m_corr: resulting-properties={base-type=uint16, sw-calibration-access=READ-WRITE, data-constr=uint16_DataConstr}
            sp_axi_s_corr: resulting-properties={base-type=uint16, sw-calibration-access=READ-WRITE, data-constr=uint16_DataConstr}
            sysmem0_sec: resulting-properties={base-type=uint8, sw-calibration-access=READ-WRITE, data-constr=uint8_DataConstr}
            sysmem1_sec: resulting-properties={base-type=uint8, sw-calibration-access=READ-WRITE, data-constr=uint8_DataConstr}
            not_recorded: resulting-properties={base-type=uint8, sw-calibration-access=READ-WRITE, data-constr=uint8_DataConstr}
        SWC_PLT_Appl_NvMHandler_NvMBringUp_DefaultValue: flat-map-entry=SWC_PLT_Appl_NvMHandler_NvMBringUp_DefaultValue, symbol=Rte_SWC_PLT_Appl_NvMHandler_NvMBringUp_DefaultValue, variation-point=post-build-variant-condition{matching-criterion=RDR_POS, value=5}
          19 x mc data instance, all with category=VALUE:
            AACurrentAzimuth: resulting-properties={base-type=float32, sw-calibration-access=READ-WRITE, data-constr=float32_DataConstr}
            AACurrentElevation: resulting-properties={base-type=float32, sw-calibration-access=READ-WRITE, data-constr=float32_DataConstr}
            AACurrentRoll: resulting-properties={base-type=float32, sw-calibration-access=READ-WRITE, data-constr=float32_DataConstr}
            InitialAlignmentResultAzimuth: resulting-properties={base-type=float32, sw-calibration-access=READ-WRITE, data-constr=float32_DataConstr}
            InitialAlignmentResultElevation: resulting-properties={base-type=float32, sw-calibration-access=READ-WRITE, data-constr=float32_DataConstr}
            InitialAlignmentResultRoll: resulting-properties={base-type=float32, sw-calibration-access=READ-WRITE, data-constr=float32_DataConstr}
            InitialLastSuccessfulAlignmentMode: resulting-properties={base-type=float32, sw-calibration-access=READ-WRITE, data-constr=float32_DataConstr}
            ElevationUpdates: resulting-properties={base-type=float32, sw-calibration-access=READ-WRITE, data-constr=float32_DataConstr}
            AzimuthUpdates: resulting-properties={base-type=float32, sw-calibration-access=READ-WRITE, data-constr=float32_DataConstr}
            RollUpdates: resulting-properties={base-type=float32, sw-calibration-access=READ-WRITE, data-constr=float32_DataConstr}
            InitialAlignmentResultElevationUpdates: resulting-properties={base-type=float32, sw-calibration-access=READ-WRITE, data-constr=float32_DataConstr}
            InitialAlignmentResultHostSpeedCompensationFactor: resulting-properties={base-type=float32, sw-calibration-access=READ-WRITE, data-constr=float32_DataConstr}
            HostSpeedCompensationFactor: resulting-properties={base-type=float32, sw-calibration-access=READ-WRITE, data-constr=float32_DataConstr}
            InitialAlignmentResultAzimuthUpdates: resulting-properties={base-type=float32, sw-calibration-access=READ-WRITE, data-constr=float32_DataConstr}
            InitialAlignmentResultRollUpdates: resulting-properties={base-type=float32, sw-calibration-access=READ-WRITE, data-constr=float32_DataConstr}
            AlignmentModeOut: resulting-properties={base-type=uint8, sw-calibration-access=READ-WRITE, data-constr=uint8_DataConstr}
            azimuth_estimation_qf: resulting-properties={base-type=uint8, sw-calibration-access=READ-WRITE, data-constr=uint8_DataConstr}
            elevation_estimation_qf: resulting-properties={base-type=uint8, sw-calibration-access=READ-WRITE, data-constr=uint8_DataConstr}
            scf_estimation_qf: resulting-properties={base-type=uint8, sw-calibration-access=READ-WRITE, data-constr=uint8_DataConstr}
        SWC_PLT_Appl_NvMHandler_RFE_R1R2_Fault_NvM_DefaultValue: flat-map-entry=SWC_PLT_Appl_NvMHandler_RFE_R1R2_Fault_NvM_DefaultValue, symbol=Rte_SWC_PLT_Appl_NvMHandler_RFE_R1R2_Fault_NvM_DefaultValue, variation-point=post-build-variant-condition{matching-criterion=RDR_POS, value=5}
          18 x mc data instance, all with category=VALUE:
            CORE_BANK_SFT_ERR_MON: resulting-properties={base-type=uint32, sw-calibration-access=READ-WRITE, data-constr=uint32_DataConstr}
            CORE_BANK_SFT_ERR_STATUS: resulting-properties={base-type=uint32, sw-calibration-access=READ-WRITE, data-constr=uint32_DataConstr}
            CORE_BANK_MCU_STS_MCU_MSSG: resulting-properties={base-type=uint32, sw-calibration-access=READ-WRITE, data-constr=uint32_DataConstr}
            FUSA_IRQ{0..2}_FLAG_R: resulting-properties={base-type=uint32, sw-calibration-access=READ-WRITE, data-constr=uint32_DataConstr}
            Api_ret_val: resulting-properties={base-type=uint32, sw-calibration-access=READ-WRITE, data-constr=uint32_DataConstr}
            LOGEN_BANK_CHRP_GEN_ERROR: resulting-properties={base-type=uint32, sw-calibration-access=READ-WRITE, data-constr=uint32_DataConstr}
            LOGEN_BANK_LOGEN_ERROR: resulting-properties={base-type=uint32, sw-calibration-access=READ-WRITE, data-constr=uint32_DataConstr}
            CPU_SYS_MCU_ERR_{0..3}: resulting-properties={base-type=uint32, sw-calibration-access=READ-WRITE, data-constr=uint32_DataConstr}
            ASYNC_BANK_ASYNC_ERR1: resulting-properties={base-type=uint32, sw-calibration-access=READ-WRITE, data-constr=uint32_DataConstr}
            PROF_BANK_PRF_ERR1: resulting-properties={base-type=uint32, sw-calibration-access=READ-WRITE, data-constr=uint32_DataConstr}
            PROF_BANK_PRF_ERR2: resulting-properties={base-type=uint32, sw-calibration-access=READ-WRITE, data-constr=uint32_DataConstr}
            RXADC_FUSAMON: resulting-properties={base-type=uint32, sw-calibration-access=READ-WRITE, data-constr=uint32_DataConstr}
            maf_status: resulting-properties={base-type=uint8, sw-calibration-access=READ-WRITE, data-constr=uint8_DataConstr}
        SWC_PLT_Appl_NvMHandler_SWC_PLT_CDD_FailSafe_DefaultValue: flat-map-entry=SWC_PLT_Appl_NvMHandler_SWC_PLT_CDD_FailSafe_DefaultValue, symbol=Rte_SWC_PLT_Appl_NvMHandler_SWC_PLT_CDD_FailSafe_DefaultValue, variation-point=post-build-variant-condition{matching-criterion=RDR_POS, value=5}
          11 x mc data instance:
            reset_reason: category=ARRAY, array-size=5, resulting-properties={base-type=uint8, sw-calibration-access=READ-WRITE, range raw 0..255}
            reset_counter: category=VALUE, resulting-properties={base-type=uint8, sw-calibration-access=READ-WRITE, data-constr=uint8_DataConstr}
            last_cycle_reset: category=VALUE, resulting-properties={base-type=uint8, sw-calibration-access=READ-WRITE, data-constr=uint8_DataConstr}
            reset_reason_crnt_indx: category=VALUE, resulting-properties={base-type=uint8, sw-calibration-access=READ-WRITE, data-constr=uint8_DataConstr}
            repetitive_reset_counter: category=VALUE, resulting-properties={base-type=uint8, sw-calibration-access=READ-WRITE, data-constr=uint8_DataConstr}
            RFE_Repetitive_Reset_Counter: category=VALUE, resulting-properties={base-type=uint8, sw-calibration-access=READ-WRITE, data-constr=uint8_DataConstr}
            mem_exception_reason: category=STRUCTURE
              6 x mc data instance, all with category=VALUE:
                ExceptionType: resulting-properties={base-type=uint32, sw-calibration-access=READ-WRITE, range raw 0..4294967295}
                ExceptionCausingAddress: resulting-properties={base-type=uint32, sw-calibration-access=READ-WRITE, range raw 0..4294967295}
                ExceptionStatusRegister: resulting-properties={base-type=uint32, sw-calibration-access=READ-WRITE, range raw 0..4294967295}
                IsMemException_Occured: resulting-properties={base-type=boolean, sw-calibration-access=READ-WRITE, compu {1=TRUE, 0=FALSE}, range raw 0..1}
                MemoryExceptionAddress: resulting-properties={base-type=uint32, sw-calibration-access=READ-WRITE, range raw 0..4294967295}
                StackPointer: resulting-properties={base-type=uint32, sw-calibration-access=READ-WRITE, range raw 0..4294967295}
            wdg_failed_SE_info: category=ARRAY, array-size=5, resulting-properties={base-type=uint16, sw-calibration-access=READ-WRITE, data-constr=uint16_DataConstr}
            FCCU_Faults: category=ARRAY, array-size=10, resulting-properties={base-type=uint16, sw-calibration-access=READ-WRITE, data-constr=uint16_DataConstr}
            StaticRegCheckFailureInfo: category=ARRAY, array-size=35, resulting-properties={base-type=uint8, sw-calibration-access=READ-WRITE, range raw 0..255}
            NOC_LatentIntFault_Info: category=STRUCTURE
              5 x mc data instance, all with category=VALUE:
                LatentFault{0..3}: resulting-properties={base-type=uint32, sw-calibration-access=READ-WRITE, data-constr=uint32_DataConstr}
                Resnum: resulting-properties={base-type=uint16, sw-calibration-access=READ-WRITE, data-constr=uint16_DataConstr}
        SWC_PLT_CDD_FailSafe_ExceptionReason_DefaultValue: flat-map-entry=SWC_PLT_CDD_FailSafe_ExceptionReason_DefaultValue, symbol=Rte_SWC_PLT_CDD_FailSafe_ExceptionReason_DefaultValue, variation-point=post-build-variant-condition{matching-criterion=RDR_POS, value=5}
          mc data instance exception_reason_info: category=ARRAY, array-size=3
            mc data instance Element_0: category=STRUCTURE, symbol=[0]
              4 x mc data instance:
                exception_type: category=VALUE, resulting-properties={base-type=uint8, sw-calibration-access=READ-WRITE, range raw 0..255}
                coreid: category=VALUE, resulting-properties={base-type=uint8, sw-calibration-access=READ-WRITE, range raw 0..255}
                reserved: category=VALUE, resulting-properties={base-type=uint16, sw-calibration-access=READ-WRITE, range raw 0..65535}
                spf_regs: category=ARRAY, array-size=5, resulting-properties={base-type=uint32, sw-calibration-access=READ-WRITE, range raw 0..4294967295}
            mc data instance Element_1: category=STRUCTURE, symbol=[1]
              4 x mc data instance:
                exception_type: category=VALUE, resulting-properties={base-type=uint8, sw-calibration-access=READ-WRITE, range raw 0..255}
                coreid: category=VALUE, resulting-properties={base-type=uint8, sw-calibration-access=READ-WRITE, range raw 0..255}
                reserved: category=VALUE, resulting-properties={base-type=uint16, sw-calibration-access=READ-WRITE, range raw 0..65535}
                spf_regs: category=ARRAY, array-size=5, resulting-properties={base-type=uint32, sw-calibration-access=READ-WRITE, range raw 0..4294967295}
            mc data instance Element_2: category=STRUCTURE, symbol=[2]
              4 x mc data instance:
                exception_type: category=VALUE, resulting-properties={base-type=uint8, sw-calibration-access=READ-WRITE, range raw 0..255}
                coreid: category=VALUE, resulting-properties={base-type=uint8, sw-calibration-access=READ-WRITE, range raw 0..255}
                reserved: category=VALUE, resulting-properties={base-type=uint16, sw-calibration-access=READ-WRITE, range raw 0..65535}
                spf_regs: category=ARRAY, array-size=5, resulting-properties={base-type=uint32, sw-calibration-access=READ-WRITE, range raw 0..4294967295}
          mc data instance exception_reason_crnt_indx: category=VALUE, resulting-properties={base-type=uint8, sw-calibration-access=READ-WRITE, data-constr=uint8_DataConstr}
        SWC_PLT_CDD_FailSafe_ResetReason_DefaultValue: flat-map-entry=SWC_PLT_CDD_FailSafe_ResetReason_DefaultValue, symbol=Rte_SWC_PLT_CDD_FailSafe_ResetReason_DefaultValue, variation-point=post-build-variant-condition{matching-criterion=RDR_POS, value=5}
          11 x mc data instance:
            reset_reason: category=ARRAY, array-size=5, resulting-properties={base-type=uint8, sw-calibration-access=READ-WRITE, range raw 0..255}
            reset_counter: category=VALUE, resulting-properties={base-type=uint8, sw-calibration-access=READ-WRITE, data-constr=uint8_DataConstr}
            last_cycle_reset: category=VALUE, resulting-properties={base-type=uint8, sw-calibration-access=READ-WRITE, data-constr=uint8_DataConstr}
            reset_reason_crnt_indx: category=VALUE, resulting-properties={base-type=uint8, sw-calibration-access=READ-WRITE, data-constr=uint8_DataConstr}
            repetitive_reset_counter: category=VALUE, resulting-properties={base-type=uint8, sw-calibration-access=READ-WRITE, data-constr=uint8_DataConstr}
            RFE_Repetitive_Reset_Counter: category=VALUE, resulting-properties={base-type=uint8, sw-calibration-access=READ-WRITE, data-constr=uint8_DataConstr}
            mem_exception_reason: category=STRUCTURE
              6 x mc data instance, all with category=VALUE:
                ExceptionType: resulting-properties={base-type=uint32, sw-calibration-access=READ-WRITE, range raw 0..4294967295}
                ExceptionCausingAddress: resulting-properties={base-type=uint32, sw-calibration-access=READ-WRITE, range raw 0..4294967295}
                ExceptionStatusRegister: resulting-properties={base-type=uint32, sw-calibration-access=READ-WRITE, range raw 0..4294967295}
                IsMemException_Occured: resulting-properties={base-type=boolean, sw-calibration-access=READ-WRITE, compu {1=TRUE, 0=FALSE}, range raw 0..1}
                MemoryExceptionAddress: resulting-properties={base-type=uint32, sw-calibration-access=READ-WRITE, range raw 0..4294967295}
                StackPointer: resulting-properties={base-type=uint32, sw-calibration-access=READ-WRITE, range raw 0..4294967295}
            wdg_failed_SE_info: category=ARRAY, array-size=5, resulting-properties={base-type=uint16, sw-calibration-access=READ-WRITE, data-constr=uint16_DataConstr}
            FCCU_Faults: category=ARRAY, array-size=10, resulting-properties={base-type=uint16, sw-calibration-access=READ-WRITE, data-constr=uint16_DataConstr}
            StaticRegCheckFailureInfo: category=ARRAY, array-size=35, resulting-properties={base-type=uint8, sw-calibration-access=READ-WRITE, range raw 0..255}
            NOC_LatentIntFault_Info: category=STRUCTURE
              5 x mc data instance, all with category=VALUE:
                LatentFault{0..3}: resulting-properties={base-type=uint32, sw-calibration-access=READ-WRITE, data-constr=uint32_DataConstr}
                Resnum: resulting-properties={base-type=uint16, sw-calibration-access=READ-WRITE, data-constr=uint16_DataConstr}
        SWC_PLT_Radar_Alignment_Handler_Appl_AutoAlignment_DefaultValue: flat-map-entry=SWC_PLT_Radar_Alignment_Handler_Appl_AutoAlignment_DefaultValue, symbol=Rte_SWC_PLT_Radar_Alignment_Handler_Appl_AutoAlignment_DefaultValue, variation-point=post-build-variant-condition{matching-criterion=RDR_POS, value=5}
          5 x mc data instance:
            Alignment_Initial_NVM_Data: category=STRUCTURE
              mc data instance InitialAlignmentResultAzimuth: category=VALUE, resulting-properties={base-type=float32, sw-calibration-access=READ-WRITE, data-constr=float32_DataConstr}
              mc data instance InitialAlignmentResultElevation: category=VALUE, resulting-properties={base-type=float32, sw-calibration-access=READ-WRITE, data-constr=float32_DataConstr}
              mc data instance InitialLastSuccessfulAlignmentMode: category=VALUE, resulting-properties={base-type=uint8, sw-calibration-access=READ-WRITE, compu-method=CM_AlignMode, range raw 0..255}
            AlignmentDyn_Initial_NVM_Data: category=STRUCTURE
              mc data instance InitialAlignmentResultAzimuthUpdates: category=VALUE, resulting-properties={base-type=uint32, sw-calibration-access=READ-WRITE, data-constr=uint32_DataConstr}
              mc data instance InitialAlignmentResultElevationUpdates: category=VALUE, resulting-properties={base-type=uint32, sw-calibration-access=READ-WRITE, data-constr=uint32_DataConstr}
              mc data instance InitialAlignmentResultHostSCF: category=VALUE, resulting-properties={base-type=float32, sw-calibration-access=READ-WRITE, data-constr=float32_DataConstr}
            Alignment_AutoCyclic_NVM_Data: category=STRUCTURE
              mc data instance AACurrentAzimuth: category=VALUE, resulting-properties={base-type=float32, sw-calibration-access=READ-WRITE, data-constr=float32_DataConstr}
              mc data instance AACurrentElevation: category=VALUE, resulting-properties={base-type=float32, sw-calibration-access=READ-WRITE, data-constr=float32_DataConstr}
            Alignment_Auto_NVM_data: category=STRUCTURE
              mc data instance AzimuthUpdates: category=VALUE, resulting-properties={base-type=uint32, sw-calibration-access=READ-WRITE, data-constr=uint32_DataConstr}
              mc data instance ElevationUpdates: category=VALUE, resulting-properties={base-type=uint32, sw-calibration-access=READ-WRITE, data-constr=uint32_DataConstr}
              mc data instance HostScf: category=VALUE, resulting-properties={base-type=float32, sw-calibration-access=READ-WRITE, data-constr=float32_DataConstr}
            AlignmentModeOut: category=VALUE, resulting-properties={base-type=uint8, sw-calibration-access=READ-WRITE, compu-method=CM_AlignMode, range raw 0..255}
        SWC_PLT_Appl_IoHwAb_ECU_Position_ROMDefault: flat-map-entry=SWC_PLT_Appl_IoHwAb_ECU_Position_ROMDefault, symbol=Rte_SWC_PLT_Appl_IoHwAb_ECU_Position_ROMDefault, variation-point=post-build-variant-condition{matching-criterion=RDR_POS, value=6}
          mc data instance ECUPosition_Value: category=VALUE, resulting-properties={base-type=uint8, sw-calibration-access=READ-WRITE, data-constr=uint8_DataConstr}
          mc data instance Reserved: category=VALUE, resulting-properties={base-type=uint8, sw-calibration-access=READ-WRITE, data-constr=uint8_DataConstr}
          mc data instance CRC_Value: category=VALUE, resulting-properties={base-type=uint16, sw-calibration-access=READ-WRITE, data-constr=uint16_DataConstr}
        SWC_PLT_Appl_NvMHandler_Alignment_NvMBlock_DefaultValue: flat-map-entry=SWC_PLT_Appl_NvMHandler_Alignment_NvMBlock_DefaultValue, symbol=Rte_SWC_PLT_Appl_NvMHandler_Alignment_NvMBlock_DefaultValue, variation-point=post-build-variant-condition{matching-criterion=RDR_POS, value=6}
          19 x mc data instance, all with category=VALUE:
            AACurrentAzimuth: resulting-properties={base-type=float32, sw-calibration-access=READ-WRITE, data-constr=float32_DataConstr}
            AACurrentElevation: resulting-properties={base-type=float32, sw-calibration-access=READ-WRITE, data-constr=float32_DataConstr}
            AACurrentRoll: resulting-properties={base-type=float32, sw-calibration-access=READ-WRITE, data-constr=float32_DataConstr}
            InitialAlignmentResultAzimuth: resulting-properties={base-type=float32, sw-calibration-access=READ-WRITE, data-constr=float32_DataConstr}
            InitialAlignmentResultElevation: resulting-properties={base-type=float32, sw-calibration-access=READ-WRITE, data-constr=float32_DataConstr}
            InitialAlignmentResultRoll: resulting-properties={base-type=float32, sw-calibration-access=READ-WRITE, data-constr=float32_DataConstr}
            InitialLastSuccessfulAlignmentMode: resulting-properties={base-type=float32, sw-calibration-access=READ-WRITE, data-constr=float32_DataConstr}
            ElevationUpdates: resulting-properties={base-type=float32, sw-calibration-access=READ-WRITE, data-constr=float32_DataConstr}
            AzimuthUpdates: resulting-properties={base-type=float32, sw-calibration-access=READ-WRITE, data-constr=float32_DataConstr}
            RollUpdates: resulting-properties={base-type=float32, sw-calibration-access=READ-WRITE, data-constr=float32_DataConstr}
            InitialAlignmentResultElevationUpdates: resulting-properties={base-type=float32, sw-calibration-access=READ-WRITE, data-constr=float32_DataConstr}
            InitialAlignmentResultHostSpeedCompensationFactor: resulting-properties={base-type=float32, sw-calibration-access=READ-WRITE, data-constr=float32_DataConstr}
            HostSpeedCompensationFactor: resulting-properties={base-type=float32, sw-calibration-access=READ-WRITE, data-constr=float32_DataConstr}
            InitialAlignmentResultAzimuthUpdates: resulting-properties={base-type=float32, sw-calibration-access=READ-WRITE, data-constr=float32_DataConstr}
            InitialAlignmentResultRollUpdates: resulting-properties={base-type=float32, sw-calibration-access=READ-WRITE, data-constr=float32_DataConstr}
            AlignmentModeOut: resulting-properties={base-type=uint8, sw-calibration-access=READ-WRITE, data-constr=uint8_DataConstr}
            azimuth_estimation_qf: resulting-properties={base-type=uint8, sw-calibration-access=READ-WRITE, data-constr=uint8_DataConstr}
            elevation_estimation_qf: resulting-properties={base-type=uint8, sw-calibration-access=READ-WRITE, data-constr=uint8_DataConstr}
            scf_estimation_qf: resulting-properties={base-type=uint8, sw-calibration-access=READ-WRITE, data-constr=uint8_DataConstr}
        SWC_PLT_Appl_NvMHandler_Correctable_Fault_NvM_DefaultValue: flat-map-entry=SWC_PLT_Appl_NvMHandler_Correctable_Fault_NvM_DefaultValue, symbol=Rte_SWC_PLT_Appl_NvMHandler_Correctable_Fault_NvM_DefaultValue, variation-point=post-build-variant-condition{matching-criterion=RDR_POS, value=6}
          21 x mc data instance, all with category=VALUE:
            aa_mem_sec: resulting-properties={base-type=uint8, sw-calibration-access=READ-WRITE, data-constr=uint8_DataConstr}
            artie_mem_sec: resulting-properties={base-type=uint8, sw-calibration-access=READ-WRITE, data-constr=uint8_DataConstr}
            csi2_sec: resulting-properties={base-type=uint8, sw-calibration-access=READ-WRITE, data-constr=uint8_DataConstr}
            dsp_opif_sec: resulting-properties={base-type=uint8, sw-calibration-access=READ-WRITE, data-constr=uint8_DataConstr}
            dsp_idma_sec: resulting-properties={base-type=uint8, sw-calibration-access=READ-WRITE, data-constr=uint8_DataConstr}
            dsp_iram_sec_axis: resulting-properties={base-type=uint8, sw-calibration-access=READ-WRITE, data-constr=uint8_DataConstr}
            dsp_dcache_sec: resulting-properties={base-type=uint8, sw-calibration-access=READ-WRITE, data-constr=uint8_DataConstr}
            dsp_dram_sec: resulting-properties={base-type=uint8, sw-calibration-access=READ-WRITE, data-constr=uint8_DataConstr}
            dsp_icache_sec: resulting-properties={base-type=uint8, sw-calibration-access=READ-WRITE, data-constr=uint8_DataConstr}
            dsp_iram_sec: resulting-properties={base-type=uint8, sw-calibration-access=READ-WRITE, data-constr=uint8_DataConstr}
            ra_cqmem_sec: resulting-properties={base-type=uint8, sw-calibration-access=READ-WRITE, data-constr=uint8_DataConstr}
            ra_dpmem_sec: resulting-properties={base-type=uint8, sw-calibration-access=READ-WRITE, data-constr=uint8_DataConstr}
            ra_estmem_sec: resulting-properties={base-type=uint8, sw-calibration-access=READ-WRITE, data-constr=uint8_DataConstr}
            ra_idxmem_sec: resulting-properties={base-type=uint8, sw-calibration-access=READ-WRITE, data-constr=uint8_DataConstr}
            ra_phmem_sec: resulting-properties={base-type=uint8, sw-calibration-access=READ-WRITE, data-constr=uint8_DataConstr}
            ra_wcmem_sec: resulting-properties={base-type=uint8, sw-calibration-access=READ-WRITE, data-constr=uint8_DataConstr}
            sp_axi_m_corr: resulting-properties={base-type=uint16, sw-calibration-access=READ-WRITE, data-constr=uint16_DataConstr}
            sp_axi_s_corr: resulting-properties={base-type=uint16, sw-calibration-access=READ-WRITE, data-constr=uint16_DataConstr}
            sysmem0_sec: resulting-properties={base-type=uint8, sw-calibration-access=READ-WRITE, data-constr=uint8_DataConstr}
            sysmem1_sec: resulting-properties={base-type=uint8, sw-calibration-access=READ-WRITE, data-constr=uint8_DataConstr}
            not_recorded: resulting-properties={base-type=uint8, sw-calibration-access=READ-WRITE, data-constr=uint8_DataConstr}
        SWC_PLT_Appl_NvMHandler_NvMBringUp_DefaultValue: flat-map-entry=SWC_PLT_Appl_NvMHandler_NvMBringUp_DefaultValue, symbol=Rte_SWC_PLT_Appl_NvMHandler_NvMBringUp_DefaultValue, variation-point=post-build-variant-condition{matching-criterion=RDR_POS, value=6}
          19 x mc data instance, all with category=VALUE:
            AACurrentAzimuth: resulting-properties={base-type=float32, sw-calibration-access=READ-WRITE, data-constr=float32_DataConstr}
            AACurrentElevation: resulting-properties={base-type=float32, sw-calibration-access=READ-WRITE, data-constr=float32_DataConstr}
            AACurrentRoll: resulting-properties={base-type=float32, sw-calibration-access=READ-WRITE, data-constr=float32_DataConstr}
            InitialAlignmentResultAzimuth: resulting-properties={base-type=float32, sw-calibration-access=READ-WRITE, data-constr=float32_DataConstr}
            InitialAlignmentResultElevation: resulting-properties={base-type=float32, sw-calibration-access=READ-WRITE, data-constr=float32_DataConstr}
            InitialAlignmentResultRoll: resulting-properties={base-type=float32, sw-calibration-access=READ-WRITE, data-constr=float32_DataConstr}
            InitialLastSuccessfulAlignmentMode: resulting-properties={base-type=float32, sw-calibration-access=READ-WRITE, data-constr=float32_DataConstr}
            ElevationUpdates: resulting-properties={base-type=float32, sw-calibration-access=READ-WRITE, data-constr=float32_DataConstr}
            AzimuthUpdates: resulting-properties={base-type=float32, sw-calibration-access=READ-WRITE, data-constr=float32_DataConstr}
            RollUpdates: resulting-properties={base-type=float32, sw-calibration-access=READ-WRITE, data-constr=float32_DataConstr}
            InitialAlignmentResultElevationUpdates: resulting-properties={base-type=float32, sw-calibration-access=READ-WRITE, data-constr=float32_DataConstr}
            InitialAlignmentResultHostSpeedCompensationFactor: resulting-properties={base-type=float32, sw-calibration-access=READ-WRITE, data-constr=float32_DataConstr}
            HostSpeedCompensationFactor: resulting-properties={base-type=float32, sw-calibration-access=READ-WRITE, data-constr=float32_DataConstr}
            InitialAlignmentResultAzimuthUpdates: resulting-properties={base-type=float32, sw-calibration-access=READ-WRITE, data-constr=float32_DataConstr}
            InitialAlignmentResultRollUpdates: resulting-properties={base-type=float32, sw-calibration-access=READ-WRITE, data-constr=float32_DataConstr}
            AlignmentModeOut: resulting-properties={base-type=uint8, sw-calibration-access=READ-WRITE, data-constr=uint8_DataConstr}
            azimuth_estimation_qf: resulting-properties={base-type=uint8, sw-calibration-access=READ-WRITE, data-constr=uint8_DataConstr}
            elevation_estimation_qf: resulting-properties={base-type=uint8, sw-calibration-access=READ-WRITE, data-constr=uint8_DataConstr}
            scf_estimation_qf: resulting-properties={base-type=uint8, sw-calibration-access=READ-WRITE, data-constr=uint8_DataConstr}
        SWC_PLT_Appl_NvMHandler_RFE_R1R2_Fault_NvM_DefaultValue: flat-map-entry=SWC_PLT_Appl_NvMHandler_RFE_R1R2_Fault_NvM_DefaultValue, symbol=Rte_SWC_PLT_Appl_NvMHandler_RFE_R1R2_Fault_NvM_DefaultValue, variation-point=post-build-variant-condition{matching-criterion=RDR_POS, value=6}
          18 x mc data instance, all with category=VALUE:
            CORE_BANK_SFT_ERR_MON: resulting-properties={base-type=uint32, sw-calibration-access=READ-WRITE, data-constr=uint32_DataConstr}
            CORE_BANK_SFT_ERR_STATUS: resulting-properties={base-type=uint32, sw-calibration-access=READ-WRITE, data-constr=uint32_DataConstr}
            CORE_BANK_MCU_STS_MCU_MSSG: resulting-properties={base-type=uint32, sw-calibration-access=READ-WRITE, data-constr=uint32_DataConstr}
            FUSA_IRQ{0..2}_FLAG_R: resulting-properties={base-type=uint32, sw-calibration-access=READ-WRITE, data-constr=uint32_DataConstr}
            Api_ret_val: resulting-properties={base-type=uint32, sw-calibration-access=READ-WRITE, data-constr=uint32_DataConstr}
            LOGEN_BANK_CHRP_GEN_ERROR: resulting-properties={base-type=uint32, sw-calibration-access=READ-WRITE, data-constr=uint32_DataConstr}
            LOGEN_BANK_LOGEN_ERROR: resulting-properties={base-type=uint32, sw-calibration-access=READ-WRITE, data-constr=uint32_DataConstr}
            CPU_SYS_MCU_ERR_{0..3}: resulting-properties={base-type=uint32, sw-calibration-access=READ-WRITE, data-constr=uint32_DataConstr}
            ASYNC_BANK_ASYNC_ERR1: resulting-properties={base-type=uint32, sw-calibration-access=READ-WRITE, data-constr=uint32_DataConstr}
            PROF_BANK_PRF_ERR1: resulting-properties={base-type=uint32, sw-calibration-access=READ-WRITE, data-constr=uint32_DataConstr}
            PROF_BANK_PRF_ERR2: resulting-properties={base-type=uint32, sw-calibration-access=READ-WRITE, data-constr=uint32_DataConstr}
            RXADC_FUSAMON: resulting-properties={base-type=uint32, sw-calibration-access=READ-WRITE, data-constr=uint32_DataConstr}
            maf_status: resulting-properties={base-type=uint8, sw-calibration-access=READ-WRITE, data-constr=uint8_DataConstr}
        SWC_PLT_Appl_NvMHandler_SWC_PLT_CDD_FailSafe_DefaultValue: flat-map-entry=SWC_PLT_Appl_NvMHandler_SWC_PLT_CDD_FailSafe_DefaultValue, symbol=Rte_SWC_PLT_Appl_NvMHandler_SWC_PLT_CDD_FailSafe_DefaultValue, variation-point=post-build-variant-condition{matching-criterion=RDR_POS, value=6}
          11 x mc data instance:
            reset_reason: category=ARRAY, array-size=5, resulting-properties={base-type=uint8, sw-calibration-access=READ-WRITE, range raw 0..255}
            reset_counter: category=VALUE, resulting-properties={base-type=uint8, sw-calibration-access=READ-WRITE, data-constr=uint8_DataConstr}
            last_cycle_reset: category=VALUE, resulting-properties={base-type=uint8, sw-calibration-access=READ-WRITE, data-constr=uint8_DataConstr}
            reset_reason_crnt_indx: category=VALUE, resulting-properties={base-type=uint8, sw-calibration-access=READ-WRITE, data-constr=uint8_DataConstr}
            repetitive_reset_counter: category=VALUE, resulting-properties={base-type=uint8, sw-calibration-access=READ-WRITE, data-constr=uint8_DataConstr}
            RFE_Repetitive_Reset_Counter: category=VALUE, resulting-properties={base-type=uint8, sw-calibration-access=READ-WRITE, data-constr=uint8_DataConstr}
            mem_exception_reason: category=STRUCTURE
              6 x mc data instance, all with category=VALUE:
                ExceptionType: resulting-properties={base-type=uint32, sw-calibration-access=READ-WRITE, range raw 0..4294967295}
                ExceptionCausingAddress: resulting-properties={base-type=uint32, sw-calibration-access=READ-WRITE, range raw 0..4294967295}
                ExceptionStatusRegister: resulting-properties={base-type=uint32, sw-calibration-access=READ-WRITE, range raw 0..4294967295}
                IsMemException_Occured: resulting-properties={base-type=boolean, sw-calibration-access=READ-WRITE, compu {1=TRUE, 0=FALSE}, range raw 0..1}
                MemoryExceptionAddress: resulting-properties={base-type=uint32, sw-calibration-access=READ-WRITE, range raw 0..4294967295}
                StackPointer: resulting-properties={base-type=uint32, sw-calibration-access=READ-WRITE, range raw 0..4294967295}
            wdg_failed_SE_info: category=ARRAY, array-size=5, resulting-properties={base-type=uint16, sw-calibration-access=READ-WRITE, data-constr=uint16_DataConstr}
            FCCU_Faults: category=ARRAY, array-size=10, resulting-properties={base-type=uint16, sw-calibration-access=READ-WRITE, data-constr=uint16_DataConstr}
            StaticRegCheckFailureInfo: category=ARRAY, array-size=35, resulting-properties={base-type=uint8, sw-calibration-access=READ-WRITE, range raw 0..255}
            NOC_LatentIntFault_Info: category=STRUCTURE
              5 x mc data instance, all with category=VALUE:
                LatentFault{0..3}: resulting-properties={base-type=uint32, sw-calibration-access=READ-WRITE, data-constr=uint32_DataConstr}
                Resnum: resulting-properties={base-type=uint16, sw-calibration-access=READ-WRITE, data-constr=uint16_DataConstr}
        SWC_PLT_CDD_FailSafe_ExceptionReason_DefaultValue: flat-map-entry=SWC_PLT_CDD_FailSafe_ExceptionReason_DefaultValue, symbol=Rte_SWC_PLT_CDD_FailSafe_ExceptionReason_DefaultValue, variation-point=post-build-variant-condition{matching-criterion=RDR_POS, value=6}
          mc data instance exception_reason_info: category=ARRAY, array-size=3
            mc data instance Element_0: category=STRUCTURE, symbol=[0]
              4 x mc data instance:
                exception_type: category=VALUE, resulting-properties={base-type=uint8, sw-calibration-access=READ-WRITE, range raw 0..255}
                coreid: category=VALUE, resulting-properties={base-type=uint8, sw-calibration-access=READ-WRITE, range raw 0..255}
                reserved: category=VALUE, resulting-properties={base-type=uint16, sw-calibration-access=READ-WRITE, range raw 0..65535}
                spf_regs: category=ARRAY, array-size=5, resulting-properties={base-type=uint32, sw-calibration-access=READ-WRITE, range raw 0..4294967295}
            mc data instance Element_1: category=STRUCTURE, symbol=[1]
              4 x mc data instance:
                exception_type: category=VALUE, resulting-properties={base-type=uint8, sw-calibration-access=READ-WRITE, range raw 0..255}
                coreid: category=VALUE, resulting-properties={base-type=uint8, sw-calibration-access=READ-WRITE, range raw 0..255}
                reserved: category=VALUE, resulting-properties={base-type=uint16, sw-calibration-access=READ-WRITE, range raw 0..65535}
                spf_regs: category=ARRAY, array-size=5, resulting-properties={base-type=uint32, sw-calibration-access=READ-WRITE, range raw 0..4294967295}
            mc data instance Element_2: category=STRUCTURE, symbol=[2]
              4 x mc data instance:
                exception_type: category=VALUE, resulting-properties={base-type=uint8, sw-calibration-access=READ-WRITE, range raw 0..255}
                coreid: category=VALUE, resulting-properties={base-type=uint8, sw-calibration-access=READ-WRITE, range raw 0..255}
                reserved: category=VALUE, resulting-properties={base-type=uint16, sw-calibration-access=READ-WRITE, range raw 0..65535}
                spf_regs: category=ARRAY, array-size=5, resulting-properties={base-type=uint32, sw-calibration-access=READ-WRITE, range raw 0..4294967295}
          mc data instance exception_reason_crnt_indx: category=VALUE, resulting-properties={base-type=uint8, sw-calibration-access=READ-WRITE, data-constr=uint8_DataConstr}
        SWC_PLT_CDD_FailSafe_ResetReason_DefaultValue: flat-map-entry=SWC_PLT_CDD_FailSafe_ResetReason_DefaultValue, symbol=Rte_SWC_PLT_CDD_FailSafe_ResetReason_DefaultValue, variation-point=post-build-variant-condition{matching-criterion=RDR_POS, value=6}
          11 x mc data instance:
            reset_reason: category=ARRAY, array-size=5, resulting-properties={base-type=uint8, sw-calibration-access=READ-WRITE, range raw 0..255}
            reset_counter: category=VALUE, resulting-properties={base-type=uint8, sw-calibration-access=READ-WRITE, data-constr=uint8_DataConstr}
            last_cycle_reset: category=VALUE, resulting-properties={base-type=uint8, sw-calibration-access=READ-WRITE, data-constr=uint8_DataConstr}
            reset_reason_crnt_indx: category=VALUE, resulting-properties={base-type=uint8, sw-calibration-access=READ-WRITE, data-constr=uint8_DataConstr}
            repetitive_reset_counter: category=VALUE, resulting-properties={base-type=uint8, sw-calibration-access=READ-WRITE, data-constr=uint8_DataConstr}
            RFE_Repetitive_Reset_Counter: category=VALUE, resulting-properties={base-type=uint8, sw-calibration-access=READ-WRITE, data-constr=uint8_DataConstr}
            mem_exception_reason: category=STRUCTURE
              6 x mc data instance, all with category=VALUE:
                ExceptionType: resulting-properties={base-type=uint32, sw-calibration-access=READ-WRITE, range raw 0..4294967295}
                ExceptionCausingAddress: resulting-properties={base-type=uint32, sw-calibration-access=READ-WRITE, range raw 0..4294967295}
                ExceptionStatusRegister: resulting-properties={base-type=uint32, sw-calibration-access=READ-WRITE, range raw 0..4294967295}
                IsMemException_Occured: resulting-properties={base-type=boolean, sw-calibration-access=READ-WRITE, compu {1=TRUE, 0=FALSE}, range raw 0..1}
                MemoryExceptionAddress: resulting-properties={base-type=uint32, sw-calibration-access=READ-WRITE, range raw 0..4294967295}
                StackPointer: resulting-properties={base-type=uint32, sw-calibration-access=READ-WRITE, range raw 0..4294967295}
            wdg_failed_SE_info: category=ARRAY, array-size=5, resulting-properties={base-type=uint16, sw-calibration-access=READ-WRITE, data-constr=uint16_DataConstr}
            FCCU_Faults: category=ARRAY, array-size=10, resulting-properties={base-type=uint16, sw-calibration-access=READ-WRITE, data-constr=uint16_DataConstr}
            StaticRegCheckFailureInfo: category=ARRAY, array-size=35, resulting-properties={base-type=uint8, sw-calibration-access=READ-WRITE, range raw 0..255}
            NOC_LatentIntFault_Info: category=STRUCTURE
              5 x mc data instance, all with category=VALUE:
                LatentFault{0..3}: resulting-properties={base-type=uint32, sw-calibration-access=READ-WRITE, data-constr=uint32_DataConstr}
                Resnum: resulting-properties={base-type=uint16, sw-calibration-access=READ-WRITE, data-constr=uint16_DataConstr}
        SWC_PLT_Radar_Alignment_Handler_Appl_AutoAlignment_DefaultValue: flat-map-entry=SWC_PLT_Radar_Alignment_Handler_Appl_AutoAlignment_DefaultValue, symbol=Rte_SWC_PLT_Radar_Alignment_Handler_Appl_AutoAlignment_DefaultValue, variation-point=post-build-variant-condition{matching-criterion=RDR_POS, value=6}
          5 x mc data instance:
            Alignment_Initial_NVM_Data: category=STRUCTURE
              mc data instance InitialAlignmentResultAzimuth: category=VALUE, resulting-properties={base-type=float32, sw-calibration-access=READ-WRITE, data-constr=float32_DataConstr}
              mc data instance InitialAlignmentResultElevation: category=VALUE, resulting-properties={base-type=float32, sw-calibration-access=READ-WRITE, data-constr=float32_DataConstr}
              mc data instance InitialLastSuccessfulAlignmentMode: category=VALUE, resulting-properties={base-type=uint8, sw-calibration-access=READ-WRITE, compu-method=CM_AlignMode, range raw 0..255}
            AlignmentDyn_Initial_NVM_Data: category=STRUCTURE
              mc data instance InitialAlignmentResultAzimuthUpdates: category=VALUE, resulting-properties={base-type=uint32, sw-calibration-access=READ-WRITE, data-constr=uint32_DataConstr}
              mc data instance InitialAlignmentResultElevationUpdates: category=VALUE, resulting-properties={base-type=uint32, sw-calibration-access=READ-WRITE, data-constr=uint32_DataConstr}
              mc data instance InitialAlignmentResultHostSCF: category=VALUE, resulting-properties={base-type=float32, sw-calibration-access=READ-WRITE, data-constr=float32_DataConstr}
            Alignment_AutoCyclic_NVM_Data: category=STRUCTURE
              mc data instance AACurrentAzimuth: category=VALUE, resulting-properties={base-type=float32, sw-calibration-access=READ-WRITE, data-constr=float32_DataConstr}
              mc data instance AACurrentElevation: category=VALUE, resulting-properties={base-type=float32, sw-calibration-access=READ-WRITE, data-constr=float32_DataConstr}
            Alignment_Auto_NVM_data: category=STRUCTURE
              mc data instance AzimuthUpdates: category=VALUE, resulting-properties={base-type=uint32, sw-calibration-access=READ-WRITE, data-constr=uint32_DataConstr}
              mc data instance ElevationUpdates: category=VALUE, resulting-properties={base-type=uint32, sw-calibration-access=READ-WRITE, data-constr=uint32_DataConstr}
              mc data instance HostScf: category=VALUE, resulting-properties={base-type=float32, sw-calibration-access=READ-WRITE, data-constr=float32_DataConstr}
            AlignmentModeOut: category=VALUE, resulting-properties={base-type=uint8, sw-calibration-access=READ-WRITE, compu-method=CM_AlignMode, range raw 0..255}
        SWC_PLT_Appl_IoHwAb_ECU_Position_ROMDefault: flat-map-entry=SWC_PLT_Appl_IoHwAb_ECU_Position_ROMDefault, symbol=Rte_SWC_PLT_Appl_IoHwAb_ECU_Position_ROMDefault, variation-point=post-build-variant-condition{matching-criterion=RDR_POS, value=7}
          mc data instance ECUPosition_Value: category=VALUE, resulting-properties={base-type=uint8, sw-calibration-access=READ-WRITE, data-constr=uint8_DataConstr}
          mc data instance Reserved: category=VALUE, resulting-properties={base-type=uint8, sw-calibration-access=READ-WRITE, data-constr=uint8_DataConstr}
          mc data instance CRC_Value: category=VALUE, resulting-properties={base-type=uint16, sw-calibration-access=READ-WRITE, data-constr=uint16_DataConstr}
        SWC_PLT_Appl_NvMHandler_Alignment_NvMBlock_DefaultValue: flat-map-entry=SWC_PLT_Appl_NvMHandler_Alignment_NvMBlock_DefaultValue, symbol=Rte_SWC_PLT_Appl_NvMHandler_Alignment_NvMBlock_DefaultValue, variation-point=post-build-variant-condition{matching-criterion=RDR_POS, value=7}
          19 x mc data instance, all with category=VALUE:
            AACurrentAzimuth: resulting-properties={base-type=float32, sw-calibration-access=READ-WRITE, data-constr=float32_DataConstr}
            AACurrentElevation: resulting-properties={base-type=float32, sw-calibration-access=READ-WRITE, data-constr=float32_DataConstr}
            AACurrentRoll: resulting-properties={base-type=float32, sw-calibration-access=READ-WRITE, data-constr=float32_DataConstr}
            InitialAlignmentResultAzimuth: resulting-properties={base-type=float32, sw-calibration-access=READ-WRITE, data-constr=float32_DataConstr}
            InitialAlignmentResultElevation: resulting-properties={base-type=float32, sw-calibration-access=READ-WRITE, data-constr=float32_DataConstr}
            InitialAlignmentResultRoll: resulting-properties={base-type=float32, sw-calibration-access=READ-WRITE, data-constr=float32_DataConstr}
            InitialLastSuccessfulAlignmentMode: resulting-properties={base-type=float32, sw-calibration-access=READ-WRITE, data-constr=float32_DataConstr}
            ElevationUpdates: resulting-properties={base-type=float32, sw-calibration-access=READ-WRITE, data-constr=float32_DataConstr}
            AzimuthUpdates: resulting-properties={base-type=float32, sw-calibration-access=READ-WRITE, data-constr=float32_DataConstr}
            RollUpdates: resulting-properties={base-type=float32, sw-calibration-access=READ-WRITE, data-constr=float32_DataConstr}
            InitialAlignmentResultElevationUpdates: resulting-properties={base-type=float32, sw-calibration-access=READ-WRITE, data-constr=float32_DataConstr}
            InitialAlignmentResultHostSpeedCompensationFactor: resulting-properties={base-type=float32, sw-calibration-access=READ-WRITE, data-constr=float32_DataConstr}
            HostSpeedCompensationFactor: resulting-properties={base-type=float32, sw-calibration-access=READ-WRITE, data-constr=float32_DataConstr}
            InitialAlignmentResultAzimuthUpdates: resulting-properties={base-type=float32, sw-calibration-access=READ-WRITE, data-constr=float32_DataConstr}
            InitialAlignmentResultRollUpdates: resulting-properties={base-type=float32, sw-calibration-access=READ-WRITE, data-constr=float32_DataConstr}
            AlignmentModeOut: resulting-properties={base-type=uint8, sw-calibration-access=READ-WRITE, data-constr=uint8_DataConstr}
            azimuth_estimation_qf: resulting-properties={base-type=uint8, sw-calibration-access=READ-WRITE, data-constr=uint8_DataConstr}
            elevation_estimation_qf: resulting-properties={base-type=uint8, sw-calibration-access=READ-WRITE, data-constr=uint8_DataConstr}
            scf_estimation_qf: resulting-properties={base-type=uint8, sw-calibration-access=READ-WRITE, data-constr=uint8_DataConstr}
        SWC_PLT_Appl_NvMHandler_Correctable_Fault_NvM_DefaultValue: flat-map-entry=SWC_PLT_Appl_NvMHandler_Correctable_Fault_NvM_DefaultValue, symbol=Rte_SWC_PLT_Appl_NvMHandler_Correctable_Fault_NvM_DefaultValue, variation-point=post-build-variant-condition{matching-criterion=RDR_POS, value=7}
          21 x mc data instance, all with category=VALUE:
            aa_mem_sec: resulting-properties={base-type=uint8, sw-calibration-access=READ-WRITE, data-constr=uint8_DataConstr}
            artie_mem_sec: resulting-properties={base-type=uint8, sw-calibration-access=READ-WRITE, data-constr=uint8_DataConstr}
            csi2_sec: resulting-properties={base-type=uint8, sw-calibration-access=READ-WRITE, data-constr=uint8_DataConstr}
            dsp_opif_sec: resulting-properties={base-type=uint8, sw-calibration-access=READ-WRITE, data-constr=uint8_DataConstr}
            dsp_idma_sec: resulting-properties={base-type=uint8, sw-calibration-access=READ-WRITE, data-constr=uint8_DataConstr}
            dsp_iram_sec_axis: resulting-properties={base-type=uint8, sw-calibration-access=READ-WRITE, data-constr=uint8_DataConstr}
            dsp_dcache_sec: resulting-properties={base-type=uint8, sw-calibration-access=READ-WRITE, data-constr=uint8_DataConstr}
            dsp_dram_sec: resulting-properties={base-type=uint8, sw-calibration-access=READ-WRITE, data-constr=uint8_DataConstr}
            dsp_icache_sec: resulting-properties={base-type=uint8, sw-calibration-access=READ-WRITE, data-constr=uint8_DataConstr}
            dsp_iram_sec: resulting-properties={base-type=uint8, sw-calibration-access=READ-WRITE, data-constr=uint8_DataConstr}
            ra_cqmem_sec: resulting-properties={base-type=uint8, sw-calibration-access=READ-WRITE, data-constr=uint8_DataConstr}
            ra_dpmem_sec: resulting-properties={base-type=uint8, sw-calibration-access=READ-WRITE, data-constr=uint8_DataConstr}
            ra_estmem_sec: resulting-properties={base-type=uint8, sw-calibration-access=READ-WRITE, data-constr=uint8_DataConstr}
            ra_idxmem_sec: resulting-properties={base-type=uint8, sw-calibration-access=READ-WRITE, data-constr=uint8_DataConstr}
            ra_phmem_sec: resulting-properties={base-type=uint8, sw-calibration-access=READ-WRITE, data-constr=uint8_DataConstr}
            ra_wcmem_sec: resulting-properties={base-type=uint8, sw-calibration-access=READ-WRITE, data-constr=uint8_DataConstr}
            sp_axi_m_corr: resulting-properties={base-type=uint16, sw-calibration-access=READ-WRITE, data-constr=uint16_DataConstr}
            sp_axi_s_corr: resulting-properties={base-type=uint16, sw-calibration-access=READ-WRITE, data-constr=uint16_DataConstr}
            sysmem0_sec: resulting-properties={base-type=uint8, sw-calibration-access=READ-WRITE, data-constr=uint8_DataConstr}
            sysmem1_sec: resulting-properties={base-type=uint8, sw-calibration-access=READ-WRITE, data-constr=uint8_DataConstr}
            not_recorded: resulting-properties={base-type=uint8, sw-calibration-access=READ-WRITE, data-constr=uint8_DataConstr}
        SWC_PLT_Appl_NvMHandler_NvMBringUp_DefaultValue: flat-map-entry=SWC_PLT_Appl_NvMHandler_NvMBringUp_DefaultValue, symbol=Rte_SWC_PLT_Appl_NvMHandler_NvMBringUp_DefaultValue, variation-point=post-build-variant-condition{matching-criterion=RDR_POS, value=7}
          19 x mc data instance, all with category=VALUE:
            AACurrentAzimuth: resulting-properties={base-type=float32, sw-calibration-access=READ-WRITE, data-constr=float32_DataConstr}
            AACurrentElevation: resulting-properties={base-type=float32, sw-calibration-access=READ-WRITE, data-constr=float32_DataConstr}
            AACurrentRoll: resulting-properties={base-type=float32, sw-calibration-access=READ-WRITE, data-constr=float32_DataConstr}
            InitialAlignmentResultAzimuth: resulting-properties={base-type=float32, sw-calibration-access=READ-WRITE, data-constr=float32_DataConstr}
            InitialAlignmentResultElevation: resulting-properties={base-type=float32, sw-calibration-access=READ-WRITE, data-constr=float32_DataConstr}
            InitialAlignmentResultRoll: resulting-properties={base-type=float32, sw-calibration-access=READ-WRITE, data-constr=float32_DataConstr}
            InitialLastSuccessfulAlignmentMode: resulting-properties={base-type=float32, sw-calibration-access=READ-WRITE, data-constr=float32_DataConstr}
            ElevationUpdates: resulting-properties={base-type=float32, sw-calibration-access=READ-WRITE, data-constr=float32_DataConstr}
            AzimuthUpdates: resulting-properties={base-type=float32, sw-calibration-access=READ-WRITE, data-constr=float32_DataConstr}
            RollUpdates: resulting-properties={base-type=float32, sw-calibration-access=READ-WRITE, data-constr=float32_DataConstr}
            InitialAlignmentResultElevationUpdates: resulting-properties={base-type=float32, sw-calibration-access=READ-WRITE, data-constr=float32_DataConstr}
            InitialAlignmentResultHostSpeedCompensationFactor: resulting-properties={base-type=float32, sw-calibration-access=READ-WRITE, data-constr=float32_DataConstr}
            HostSpeedCompensationFactor: resulting-properties={base-type=float32, sw-calibration-access=READ-WRITE, data-constr=float32_DataConstr}
            InitialAlignmentResultAzimuthUpdates: resulting-properties={base-type=float32, sw-calibration-access=READ-WRITE, data-constr=float32_DataConstr}
            InitialAlignmentResultRollUpdates: resulting-properties={base-type=float32, sw-calibration-access=READ-WRITE, data-constr=float32_DataConstr}
            AlignmentModeOut: resulting-properties={base-type=uint8, sw-calibration-access=READ-WRITE, data-constr=uint8_DataConstr}
            azimuth_estimation_qf: resulting-properties={base-type=uint8, sw-calibration-access=READ-WRITE, data-constr=uint8_DataConstr}
            elevation_estimation_qf: resulting-properties={base-type=uint8, sw-calibration-access=READ-WRITE, data-constr=uint8_DataConstr}
            scf_estimation_qf: resulting-properties={base-type=uint8, sw-calibration-access=READ-WRITE, data-constr=uint8_DataConstr}
        SWC_PLT_Appl_NvMHandler_RFE_R1R2_Fault_NvM_DefaultValue: flat-map-entry=SWC_PLT_Appl_NvMHandler_RFE_R1R2_Fault_NvM_DefaultValue, symbol=Rte_SWC_PLT_Appl_NvMHandler_RFE_R1R2_Fault_NvM_DefaultValue, variation-point=post-build-variant-condition{matching-criterion=RDR_POS, value=7}
          18 x mc data instance, all with category=VALUE:
            CORE_BANK_SFT_ERR_MON: resulting-properties={base-type=uint32, sw-calibration-access=READ-WRITE, data-constr=uint32_DataConstr}
            CORE_BANK_SFT_ERR_STATUS: resulting-properties={base-type=uint32, sw-calibration-access=READ-WRITE, data-constr=uint32_DataConstr}
            CORE_BANK_MCU_STS_MCU_MSSG: resulting-properties={base-type=uint32, sw-calibration-access=READ-WRITE, data-constr=uint32_DataConstr}
            FUSA_IRQ{0..2}_FLAG_R: resulting-properties={base-type=uint32, sw-calibration-access=READ-WRITE, data-constr=uint32_DataConstr}
            Api_ret_val: resulting-properties={base-type=uint32, sw-calibration-access=READ-WRITE, data-constr=uint32_DataConstr}
            LOGEN_BANK_CHRP_GEN_ERROR: resulting-properties={base-type=uint32, sw-calibration-access=READ-WRITE, data-constr=uint32_DataConstr}
            LOGEN_BANK_LOGEN_ERROR: resulting-properties={base-type=uint32, sw-calibration-access=READ-WRITE, data-constr=uint32_DataConstr}
            CPU_SYS_MCU_ERR_{0..3}: resulting-properties={base-type=uint32, sw-calibration-access=READ-WRITE, data-constr=uint32_DataConstr}
            ASYNC_BANK_ASYNC_ERR1: resulting-properties={base-type=uint32, sw-calibration-access=READ-WRITE, data-constr=uint32_DataConstr}
            PROF_BANK_PRF_ERR1: resulting-properties={base-type=uint32, sw-calibration-access=READ-WRITE, data-constr=uint32_DataConstr}
            PROF_BANK_PRF_ERR2: resulting-properties={base-type=uint32, sw-calibration-access=READ-WRITE, data-constr=uint32_DataConstr}
            RXADC_FUSAMON: resulting-properties={base-type=uint32, sw-calibration-access=READ-WRITE, data-constr=uint32_DataConstr}
            maf_status: resulting-properties={base-type=uint8, sw-calibration-access=READ-WRITE, data-constr=uint8_DataConstr}
        SWC_PLT_Appl_NvMHandler_SWC_PLT_CDD_FailSafe_DefaultValue: flat-map-entry=SWC_PLT_Appl_NvMHandler_SWC_PLT_CDD_FailSafe_DefaultValue, symbol=Rte_SWC_PLT_Appl_NvMHandler_SWC_PLT_CDD_FailSafe_DefaultValue, variation-point=post-build-variant-condition{matching-criterion=RDR_POS, value=7}
          11 x mc data instance:
            reset_reason: category=ARRAY, array-size=5, resulting-properties={base-type=uint8, sw-calibration-access=READ-WRITE, range raw 0..255}
            reset_counter: category=VALUE, resulting-properties={base-type=uint8, sw-calibration-access=READ-WRITE, data-constr=uint8_DataConstr}
            last_cycle_reset: category=VALUE, resulting-properties={base-type=uint8, sw-calibration-access=READ-WRITE, data-constr=uint8_DataConstr}
            reset_reason_crnt_indx: category=VALUE, resulting-properties={base-type=uint8, sw-calibration-access=READ-WRITE, data-constr=uint8_DataConstr}
            repetitive_reset_counter: category=VALUE, resulting-properties={base-type=uint8, sw-calibration-access=READ-WRITE, data-constr=uint8_DataConstr}
            RFE_Repetitive_Reset_Counter: category=VALUE, resulting-properties={base-type=uint8, sw-calibration-access=READ-WRITE, data-constr=uint8_DataConstr}
            mem_exception_reason: category=STRUCTURE
              6 x mc data instance, all with category=VALUE:
                ExceptionType: resulting-properties={base-type=uint32, sw-calibration-access=READ-WRITE, range raw 0..4294967295}
                ExceptionCausingAddress: resulting-properties={base-type=uint32, sw-calibration-access=READ-WRITE, range raw 0..4294967295}
                ExceptionStatusRegister: resulting-properties={base-type=uint32, sw-calibration-access=READ-WRITE, range raw 0..4294967295}
                IsMemException_Occured: resulting-properties={base-type=boolean, sw-calibration-access=READ-WRITE, compu {1=TRUE, 0=FALSE}, range raw 0..1}
                MemoryExceptionAddress: resulting-properties={base-type=uint32, sw-calibration-access=READ-WRITE, range raw 0..4294967295}
                StackPointer: resulting-properties={base-type=uint32, sw-calibration-access=READ-WRITE, range raw 0..4294967295}
            wdg_failed_SE_info: category=ARRAY, array-size=5, resulting-properties={base-type=uint16, sw-calibration-access=READ-WRITE, data-constr=uint16_DataConstr}
            FCCU_Faults: category=ARRAY, array-size=10, resulting-properties={base-type=uint16, sw-calibration-access=READ-WRITE, data-constr=uint16_DataConstr}
            StaticRegCheckFailureInfo: category=ARRAY, array-size=35, resulting-properties={base-type=uint8, sw-calibration-access=READ-WRITE, range raw 0..255}
            NOC_LatentIntFault_Info: category=STRUCTURE
              5 x mc data instance, all with category=VALUE:
                LatentFault{0..3}: resulting-properties={base-type=uint32, sw-calibration-access=READ-WRITE, data-constr=uint32_DataConstr}
                Resnum: resulting-properties={base-type=uint16, sw-calibration-access=READ-WRITE, data-constr=uint16_DataConstr}
        SWC_PLT_CDD_FailSafe_ExceptionReason_DefaultValue: flat-map-entry=SWC_PLT_CDD_FailSafe_ExceptionReason_DefaultValue, symbol=Rte_SWC_PLT_CDD_FailSafe_ExceptionReason_DefaultValue, variation-point=post-build-variant-condition{matching-criterion=RDR_POS, value=7}
          mc data instance exception_reason_info: category=ARRAY, array-size=3
            mc data instance Element_0: category=STRUCTURE, symbol=[0]
              4 x mc data instance:
                exception_type: category=VALUE, resulting-properties={base-type=uint8, sw-calibration-access=READ-WRITE, range raw 0..255}
                coreid: category=VALUE, resulting-properties={base-type=uint8, sw-calibration-access=READ-WRITE, range raw 0..255}
                reserved: category=VALUE, resulting-properties={base-type=uint16, sw-calibration-access=READ-WRITE, range raw 0..65535}
                spf_regs: category=ARRAY, array-size=5, resulting-properties={base-type=uint32, sw-calibration-access=READ-WRITE, range raw 0..4294967295}
            mc data instance Element_1: category=STRUCTURE, symbol=[1]
              4 x mc data instance:
                exception_type: category=VALUE, resulting-properties={base-type=uint8, sw-calibration-access=READ-WRITE, range raw 0..255}
                coreid: category=VALUE, resulting-properties={base-type=uint8, sw-calibration-access=READ-WRITE, range raw 0..255}
                reserved: category=VALUE, resulting-properties={base-type=uint16, sw-calibration-access=READ-WRITE, range raw 0..65535}
                spf_regs: category=ARRAY, array-size=5, resulting-properties={base-type=uint32, sw-calibration-access=READ-WRITE, range raw 0..4294967295}
            mc data instance Element_2: category=STRUCTURE, symbol=[2]
              4 x mc data instance:
                exception_type: category=VALUE, resulting-properties={base-type=uint8, sw-calibration-access=READ-WRITE, range raw 0..255}
                coreid: category=VALUE, resulting-properties={base-type=uint8, sw-calibration-access=READ-WRITE, range raw 0..255}
                reserved: category=VALUE, resulting-properties={base-type=uint16, sw-calibration-access=READ-WRITE, range raw 0..65535}
                spf_regs: category=ARRAY, array-size=5, resulting-properties={base-type=uint32, sw-calibration-access=READ-WRITE, range raw 0..4294967295}
          mc data instance exception_reason_crnt_indx: category=VALUE, resulting-properties={base-type=uint8, sw-calibration-access=READ-WRITE, data-constr=uint8_DataConstr}
        SWC_PLT_CDD_FailSafe_ResetReason_DefaultValue: flat-map-entry=SWC_PLT_CDD_FailSafe_ResetReason_DefaultValue, symbol=Rte_SWC_PLT_CDD_FailSafe_ResetReason_DefaultValue, variation-point=post-build-variant-condition{matching-criterion=RDR_POS, value=7}
          11 x mc data instance:
            reset_reason: category=ARRAY, array-size=5, resulting-properties={base-type=uint8, sw-calibration-access=READ-WRITE, range raw 0..255}
            reset_counter: category=VALUE, resulting-properties={base-type=uint8, sw-calibration-access=READ-WRITE, data-constr=uint8_DataConstr}
            last_cycle_reset: category=VALUE, resulting-properties={base-type=uint8, sw-calibration-access=READ-WRITE, data-constr=uint8_DataConstr}
            reset_reason_crnt_indx: category=VALUE, resulting-properties={base-type=uint8, sw-calibration-access=READ-WRITE, data-constr=uint8_DataConstr}
            repetitive_reset_counter: category=VALUE, resulting-properties={base-type=uint8, sw-calibration-access=READ-WRITE, data-constr=uint8_DataConstr}
            RFE_Repetitive_Reset_Counter: category=VALUE, resulting-properties={base-type=uint8, sw-calibration-access=READ-WRITE, data-constr=uint8_DataConstr}
            mem_exception_reason: category=STRUCTURE
              6 x mc data instance, all with category=VALUE:
                ExceptionType: resulting-properties={base-type=uint32, sw-calibration-access=READ-WRITE, range raw 0..4294967295}
                ExceptionCausingAddress: resulting-properties={base-type=uint32, sw-calibration-access=READ-WRITE, range raw 0..4294967295}
                ExceptionStatusRegister: resulting-properties={base-type=uint32, sw-calibration-access=READ-WRITE, range raw 0..4294967295}
                IsMemException_Occured: resulting-properties={base-type=boolean, sw-calibration-access=READ-WRITE, compu {1=TRUE, 0=FALSE}, range raw 0..1}
                MemoryExceptionAddress: resulting-properties={base-type=uint32, sw-calibration-access=READ-WRITE, range raw 0..4294967295}
                StackPointer: resulting-properties={base-type=uint32, sw-calibration-access=READ-WRITE, range raw 0..4294967295}
            wdg_failed_SE_info: category=ARRAY, array-size=5, resulting-properties={base-type=uint16, sw-calibration-access=READ-WRITE, data-constr=uint16_DataConstr}
            FCCU_Faults: category=ARRAY, array-size=10, resulting-properties={base-type=uint16, sw-calibration-access=READ-WRITE, data-constr=uint16_DataConstr}
            StaticRegCheckFailureInfo: category=ARRAY, array-size=35, resulting-properties={base-type=uint8, sw-calibration-access=READ-WRITE, range raw 0..255}
            NOC_LatentIntFault_Info: category=STRUCTURE
              5 x mc data instance, all with category=VALUE:
                LatentFault{0..3}: resulting-properties={base-type=uint32, sw-calibration-access=READ-WRITE, data-constr=uint32_DataConstr}
                Resnum: resulting-properties={base-type=uint16, sw-calibration-access=READ-WRITE, data-constr=uint16_DataConstr}
        SWC_PLT_Radar_Alignment_Handler_Appl_AutoAlignment_DefaultValue: flat-map-entry=SWC_PLT_Radar_Alignment_Handler_Appl_AutoAlignment_DefaultValue, symbol=Rte_SWC_PLT_Radar_Alignment_Handler_Appl_AutoAlignment_DefaultValue, variation-point=post-build-variant-condition{matching-criterion=RDR_POS, value=7}
          5 x mc data instance:
            Alignment_Initial_NVM_Data: category=STRUCTURE
              mc data instance InitialAlignmentResultAzimuth: category=VALUE, resulting-properties={base-type=float32, sw-calibration-access=READ-WRITE, data-constr=float32_DataConstr}
              mc data instance InitialAlignmentResultElevation: category=VALUE, resulting-properties={base-type=float32, sw-calibration-access=READ-WRITE, data-constr=float32_DataConstr}
              mc data instance InitialLastSuccessfulAlignmentMode: category=VALUE, resulting-properties={base-type=uint8, sw-calibration-access=READ-WRITE, compu-method=CM_AlignMode, range raw 0..255}
            AlignmentDyn_Initial_NVM_Data: category=STRUCTURE
              mc data instance InitialAlignmentResultAzimuthUpdates: category=VALUE, resulting-properties={base-type=uint32, sw-calibration-access=READ-WRITE, data-constr=uint32_DataConstr}
              mc data instance InitialAlignmentResultElevationUpdates: category=VALUE, resulting-properties={base-type=uint32, sw-calibration-access=READ-WRITE, data-constr=uint32_DataConstr}
              mc data instance InitialAlignmentResultHostSCF: category=VALUE, resulting-properties={base-type=float32, sw-calibration-access=READ-WRITE, data-constr=float32_DataConstr}
            Alignment_AutoCyclic_NVM_Data: category=STRUCTURE
              mc data instance AACurrentAzimuth: category=VALUE, resulting-properties={base-type=float32, sw-calibration-access=READ-WRITE, data-constr=float32_DataConstr}
              mc data instance AACurrentElevation: category=VALUE, resulting-properties={base-type=float32, sw-calibration-access=READ-WRITE, data-constr=float32_DataConstr}
            Alignment_Auto_NVM_data: category=STRUCTURE
              mc data instance AzimuthUpdates: category=VALUE, resulting-properties={base-type=uint32, sw-calibration-access=READ-WRITE, data-constr=uint32_DataConstr}
              mc data instance ElevationUpdates: category=VALUE, resulting-properties={base-type=uint32, sw-calibration-access=READ-WRITE, data-constr=uint32_DataConstr}
              mc data instance HostScf: category=VALUE, resulting-properties={base-type=float32, sw-calibration-access=READ-WRITE, data-constr=float32_DataConstr}
            AlignmentModeOut: category=VALUE, resulting-properties={base-type=uint8, sw-calibration-access=READ-WRITE, compu-method=CM_AlignMode, range raw 0..255}
    resource consumption ResourceConsumption
      40 x memory section:
        RTE_CODE_ASIL_B: prefix=RTE, sw-addrmethod=CODE_ASIL_B, symbol=CODE_ASIL_B
        RTE_CONST_ASIL_B_UNSPECIFIED: prefix=RTE, sw-addrmethod=CONST_ASIL_B, symbol=CONST_ASIL_B_UNSPECIFIED
        RTE_Lib_CODE_ASIL_B: prefix=RTE_Lib, sw-addrmethod=CODE_ASIL_B, symbol=CODE_ASIL_B
        RTE_Lifecycle_CODE_ASIL_B: prefix=RTE_Lifecycle, sw-addrmethod=CODE_ASIL_B, symbol=CODE_ASIL_B
        RTE_Trace_CODE_APPL_ASIL_B: prefix=RTE_Trace, sw-addrmethod=CODE_ASIL_B, symbol=CODE_APPL_ASIL_B
        RTE_VAR_CLEARED_LOCAL_UNSPECIFIED: prefix=RTE, sw-addrmethod=OsCore0_ASIL_VAR_CLEARED, symbol=VAR_CLEARED_LOCAL_UNSPECIFIED
        RTE_VAR_CLEARED_LOCAL_8: prefix=RTE, sw-addrmethod=OsCore0_ASIL_VAR_CLEARED, symbol=VAR_CLEARED_LOCAL_8
        RTE_VAR_INIT_LOCAL_UNSPECIFIED: prefix=RTE, sw-addrmethod=OsCore0_ASIL_VAR_INIT, symbol=VAR_INIT_LOCAL_UNSPECIFIED
        RTE_EcucPartition_Core0_ASIL_CODE_Appl_Init_ASIL_B: prefix=RTE_EcucPartition_Core0_ASIL, sw-addrmethod=CODE_ASIL_B, symbol=CODE_Appl_Init_ASIL_B
        RTE_EcucPartition_Core0_ASIL_CODE_Appl_Task_ASIL_B: prefix=RTE_EcucPartition_Core0_ASIL, sw-addrmethod=CODE_ASIL_B, symbol=CODE_Appl_Task_ASIL_B
        RTE_EcucPartition_Core0_ASIL_CODE_Appl_Task_Communication_ASIL_B: prefix=RTE_EcucPartition_Core0_ASIL, sw-addrmethod=CODE_ASIL_B, symbol=CODE_Appl_Task_Communication_ASIL_B
        RTE_EcucPartition_Core0_ASIL_CODE_Appl_Task_High_Prio_ASIL_B: prefix=RTE_EcucPartition_Core0_ASIL, sw-addrmethod=CODE_ASIL_B, symbol=CODE_Appl_Task_High_Prio_ASIL_B
        RTE_EcucPartition_OsCore0_QM_CODE_Appl_Task_Logging_QM: prefix=RTE_EcucPartition_OsCore0_QM, sw-addrmethod=CODE_QM, symbol=CODE_Appl_Task_Logging_QM
        RTE_EcucPartition_Core0_ASIL_CODE_BSW_Task_ASIL_B: prefix=RTE_EcucPartition_Core0_ASIL, sw-addrmethod=CODE_ASIL_B, symbol=CODE_BSW_Task_ASIL_B
        RTE_EcucPartition_SystemApplication_OsCore0_CODE_IdleTask_OsCore0_QM: prefix=RTE_EcucPartition_SystemApplication_OsCore0, sw-addrmethod=CODE_QM, symbol=CODE_IdleTask_OsCore0_QM
        RTE_EcucPartition_Core0_ASIL_CODE_Init_Task_ASIL_B: prefix=RTE_EcucPartition_Core0_ASIL, sw-addrmethod=CODE_ASIL_B, symbol=CODE_Init_Task_ASIL_B
        RTE_EcucPartition_OsCore0_QM_CODE_Init_Task_Qm_QM: prefix=RTE_EcucPartition_OsCore0_QM, sw-addrmethod=CODE_QM, symbol=CODE_Init_Task_Qm_QM
        RTE_EcucPartition_Core0_ASIL_CODE_Radar_Ctrl_Task_ASIL_B: prefix=RTE_EcucPartition_Core0_ASIL, sw-addrmethod=CODE_ASIL_B, symbol=CODE_Radar_Ctrl_Task_ASIL_B
        RTE_EcucPartition_Core0_ASIL_CODE_ASIL_B: prefix=RTE_EcucPartition_Core0_ASIL, sw-addrmethod=CODE_ASIL_B, symbol=CODE_ASIL_B
        RTE_EcucPartition_Core0_ASIL_CONST_ASIL_B_UNSPECIFIED: prefix=RTE_EcucPartition_Core0_ASIL, sw-addrmethod=CONST_ASIL_B, symbol=CONST_ASIL_B_UNSPECIFIED
        RTE_EcucPartition_Core0_ASIL_VAR_INIT_ASIL_B_LOCAL_UNSPECIFIED: prefix=RTE_EcucPartition_Core0_ASIL, sw-addrmethod=OsCore0_ASIL_VAR_INIT, symbol=VAR_INIT_ASIL_B_LOCAL_UNSPECIFIED
        RTE_EcucPartition_Core0_ASIL_VAR_CLEARED_ASIL_B_LOCAL_UNSPECIFIED: prefix=RTE_EcucPartition_Core0_ASIL, sw-addrmethod=OsCore0_ASIL_VAR_CLEARED, symbol=VAR_CLEARED_ASIL_B_LOCAL_UNSPECIFIED
        RTE_EcucPartition_Core0_ASIL_VAR_CLEARED_ASIL_B_LOCAL_8: prefix=RTE_EcucPartition_Core0_ASIL, sw-addrmethod=OsCore0_ASIL_VAR_CLEARED, symbol=VAR_CLEARED_ASIL_B_LOCAL_8
        RTE_EcucPartition_OsCore0_QM_CODE_QM: prefix=RTE_EcucPartition_OsCore0_QM, sw-addrmethod=CODE_QM, symbol=CODE_QM
        RTE_EcucPartition_OsCore0_QM_CONST_QM_UNSPECIFIED: prefix=RTE_EcucPartition_OsCore0_QM, sw-addrmethod=CONST_QM, symbol=CONST_QM_UNSPECIFIED
        RTE_EcucPartition_OsCore0_QM_VAR_INIT_QM_LOCAL_UNSPECIFIED: prefix=RTE_EcucPartition_OsCore0_QM, sw-addrmethod=OsCore_Qm_VAR_INIT, symbol=VAR_INIT_QM_LOCAL_UNSPECIFIED
        RTE_EcucPartition_OsCore0_QM_VAR_CLEARED_QM_LOCAL_UNSPECIFIED: prefix=RTE_EcucPartition_OsCore0_QM, sw-addrmethod=OsCore_Qm_VAR_CLEARED, symbol=VAR_CLEARED_QM_LOCAL_UNSPECIFIED
        RTE_EcucPartition_OsCore0_QM_VAR_CLEARED_QM_LOCAL_8: prefix=RTE_EcucPartition_OsCore0_QM, sw-addrmethod=OsCore_Qm_VAR_CLEARED, symbol=VAR_CLEARED_QM_LOCAL_8
        RTE_EcucPartition_SystemApplication_OsCore0_CODE_QM: prefix=RTE_EcucPartition_SystemApplication_OsCore0, sw-addrmethod=CODE_QM, symbol=CODE_QM
        RTE_EcucPartition_SystemApplication_OsCore0_CONST_QM_UNSPECIFIED: prefix=RTE_EcucPartition_SystemApplication_OsCore0, sw-addrmethod=CONST_QM, symbol=CONST_QM_UNSPECIFIED
        RTE_EcucPartition_SystemApplication_OsCore0_VAR_INIT_QM_LOCAL_UNSPECIFIED: prefix=RTE_EcucPartition_SystemApplication_OsCore0, sw-addrmethod=SystemApplication_OsCore0_VAR_INIT, symbol=VAR_INIT_QM_LOCAL_UNSPECIFIED
        RTE_EcucPartition_SystemApplication_OsCore0_VAR_CLEARED_QM_LOCAL_UNSPECIFIED: prefix=RTE_EcucPartition_SystemApplication_OsCore0, sw-addrmethod=SystemApplication_OsCore0_VAR_CLEARED, symbol=VAR_CLEARED_QM_LOCAL_UNSPECIFIED
        RTE_EcucPartition_SystemApplication_OsCore0_VAR_CLEARED_QM_LOCAL_8: prefix=RTE_EcucPartition_SystemApplication_OsCore0, sw-addrmethod=SystemApplication_OsCore0_VAR_CLEARED, symbol=VAR_CLEARED_QM_LOCAL_8
        RTE_CONST_DEFAULT_RTE_CDATA_GROUP_UNSPECIFIED: prefix=RTE, sw-addrmethod=CONST, symbol=CONST_DEFAULT_RTE_CDATA_GROUP_UNSPECIFIED
        RTE_EcucPartition_Core0_ASIL_VAR_INIT_DEFAULT_RTE_PIM_GROUP_INIT_ASIL_B_LOCAL_UNSPECIFIED: prefix=RTE_EcucPartition_Core0_ASIL, sw-addrmethod=OsCore0_ASIL_VAR_INIT, symbol=VAR_INIT_DEFAULT_RTE_PIM_GROUP_INIT_ASIL_B_LOCAL_UNSPECIFIED
        RTE_EcucPartition_Core0_ASIL_VAR_CLEARED_DEFAULT_RTE_PIM_GROUP_ASIL_B_LOCAL_UNSPECIFIED: prefix=RTE_EcucPartition_Core0_ASIL, sw-addrmethod=OsCore0_ASIL_VAR_CLEARED, symbol=VAR_CLEARED_DEFAULT_RTE_PIM_GROUP_ASIL_B_LOCAL_UNSPECIFIED
        RTE_EcucPartition_Core0_ASIL_CODE_Appl_IPC_Task_ASIL_B: prefix=RTE_EcucPartition_Core0_ASIL, sw-addrmethod=CODE_ASIL_B, symbol=CODE_Appl_IPC_Task_ASIL_B
        RTE_EcucPartition_OsCore0_QM_CODE_Appl_Task_Fast_QM: prefix=RTE_EcucPartition_OsCore0_QM, sw-addrmethod=CODE_QM, symbol=CODE_Appl_Task_Fast_QM
        RTE_EcucPartition_OsCore0_QM_VAR_INIT_DEFAULT_RTE_PIM_GROUP_INIT_QM_LOCAL_UNSPECIFIED: prefix=RTE_EcucPartition_OsCore0_QM, sw-addrmethod=OsCore_Qm_VAR_INIT, symbol=VAR_INIT_DEFAULT_RTE_PIM_GROUP_INIT_QM_LOCAL_UNSPECIFIED
        RTE_EcucPartition_Core0_ASIL_CODE_Appl_BackgroundTask_ASIL_B: prefix=RTE_EcucPartition_Core0_ASIL, sw-addrmethod=CODE_ASIL_B, symbol=CODE_Appl_BackgroundTask_ASIL_B
      7 x section name prefix:
        RTE
        RTE_Lib
        RTE_Lifecycle
        RTE_Trace
        RTE_EcucPartition_Core0_ASIL
        RTE_EcucPartition_OsCore0_QM
        RTE_EcucPartition_SystemApplication_OsCore0
package /MICROSAR/Rte_ib_bswmd/BswModuleDescriptions
  bsw module description Rte
    provided-entrys:
      Rte_ComMainFunctionTxProxyPeriodic_ComMainFunctionTx_Event_
      Rte_ComMainFunctionTxProxyPeriodic_ComMainFunctionTx_Event_001_
      Rte_ComMainFunctionTxProxyPeriodic_ComMainFunctionTx_Periodic_
      Rte_ComMainFunctionTxProxyPeriodic_ComMainFunctionTx_Event_SystemApplication_OsCore0
      Rte_ComMainFunctionTxProxyPeriodic_ComMainFunctionTx_Periodic_SystemApplication_OsCore0
      Rte_ComMainFunctionTxProxyPeriodic_ComMainFunctionTx_Event_OsCore0_ASIL
      Rte_ComMainFunctionTxProxyPeriodic_ComMainFunctionTx_Periodic_OsCore0_ASIL
    bsw internal behavior RteBehavior
      bsw schedulable entity Rte_ComMainFunctionTxProxyPeriodic_ComMainFunctionTx_Event_OsCore0_ASIL: implemented-entry=Rte_ComMainFunctionTxProxyPeriodic_ComMainFunctionTx_Event_OsCore0_ASIL
      bsw schedulable entity Rte_ComMainFunctionTxProxyPeriodic_ComMainFunctionTx_Periodic_OsCore0_ASIL: implemented-entry=Rte_ComMainFunctionTxProxyPeriodic_ComMainFunctionTx_Periodic_OsCore0_ASIL
      bsw timing event Rte_ComMainFunctionTxProxyPeriodic_ComMainFunctionTx_Event_OsCore0_ASILTimingEvent0: starts-on-event=Rte_ComMainFunctionTxProxyPeriodic_ComMainFunctionTx_Event_OsCore0_ASIL, period=0.01
      bsw timing event Rte_ComMainFunctionTxProxyPeriodic_ComMainFunctionTx_Periodic_OsCore0_ASILTimingEvent0: starts-on-event=Rte_ComMainFunctionTxProxyPeriodic_ComMainFunctionTx_Periodic_OsCore0_ASIL, period=0.025
  7 x bsw module entry, all with call-type=SCHEDULED, execution-context=TASK:
    Rte_ComMainFunctionTxProxyPeriodic_ComMainFunctionTx_Event_
    Rte_ComMainFunctionTxProxyPeriodic_ComMainFunctionTx_Event_001_
    Rte_ComMainFunctionTxProxyPeriodic_ComMainFunctionTx_Periodic_
    Rte_ComMainFunctionTxProxyPeriodic_ComMainFunctionTx_Event_SystemApplication_OsCore0
    Rte_ComMainFunctionTxProxyPeriodic_ComMainFunctionTx_Periodic_SystemApplication_OsCore0
    Rte_ComMainFunctionTxProxyPeriodic_ComMainFunctionTx_Event_OsCore0_ASIL
    Rte_ComMainFunctionTxProxyPeriodic_ComMainFunctionTx_Periodic_OsCore0_ASIL
