AUTOSAR XML (schema 00049)
package /MICROSAR
  bsw implementation SomeIpXf_Impl: programming-language=C, sw-version=4.40.00, used-code-generator=DaVinci Configurator, vendor-id=30, ar-release-version=4.03.01
    resource consumption ResourceConsumption
      5 x memory section, all with prefix=SOMEIPXF:
        SOMEIPXF_CODE_ASIL_B: sw-addrmethod=CODE_ASIL_B, symbol=CODE_ASIL_B
        SOMEIPXF_VAR_INIT_LOCAL_UNSPECIFIED: sw-addrmethod=OsCore0_ASIL_VAR_INIT, symbol=VAR_INIT_LOCAL_UNSPECIFIED
        SOMEIPXF_VAR_INIT_OsCore0_ASIL_ASIL_B_LOCAL_UNSPECIFIED: sw-addrmethod=OsCore0_ASIL_VAR_INIT, symbol=VAR_INIT_OsCore0_ASIL_ASIL_B_LOCAL_UNSPECIFIED
        SOMEIPXF_VAR_INIT_OsCore_Qm_QM_LOCAL_UNSPECIFIED: sw-addrmethod=OsCore_Qm_VAR_INIT, symbol=VAR_INIT_OsCore_Qm_QM_LOCAL_UNSPECIFIED
        SOMEIPXF_VAR_INIT_SystemApplication_OsCore0_QM_LOCAL_UNSPECIFIED: sw-addrmethod=SystemApplication_OsCore0_VAR_INIT, symbol=VAR_INIT_SystemApplication_OsCore0_QM_LOCAL_UNSPECIFIED
      section name prefix SOMEIPXF
package /MICROSAR/SomeIpXf_ib_bswmd/BswModuleDescriptions
  bsw module description SomeIpXf
    bsw internal behavior SomeIpXfBehavior
