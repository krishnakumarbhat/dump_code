AUTOSAR XML (schema 00049)
package /MICROSAR/Eth_30_Wrapper_ib_bswmd/BswModuleDescriptions
  bsw module description Eth: provided-entrys=Eth_30_Wrapper_Virtual
    bsw internal behavior Eth_30_WrapperBehavior
      exclusive area ETH_30_WRAPPER_EXCLUSIVE_AREA_MUTEX_ACCESS
      bsw called entity Eth_30_Wrapper_Virtual: can-enter-exclusive-area=ETH_30_WRAPPER_EXCLUSIVE_AREA_MUTEX_ACCESS, implemented-entry=Eth_30_Wrapper_Virtual
  bsw module entry Eth_30_Wrapper_Virtual: call-type=REGULAR, execution-context=TASK
