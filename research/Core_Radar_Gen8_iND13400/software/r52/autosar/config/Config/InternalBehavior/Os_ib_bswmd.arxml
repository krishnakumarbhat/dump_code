AUTOSAR XML (schema 00053)
package /MICROSAR
  bsw implementation Os_Impl: programming-language=C, sw-version=4.08.00, used-code-generator=DaVinci Configurator Classic, vendor-id=30, ar-release-version=4.02.01
    resource consumption ResourceConsumption
      489 x memory section:
        OS_SEC_CODE_ASIL_D: prefix=OSOsMemMap_OsCode, sw-addrmethod=OS_CODE, symbol=CODE_ASIL_D
        OS_SEC_CODE_EXCVEC_ASIL_D: prefix=OSOsMemMap_OsCode, sw-addrmethod=OS_CODE, symbol=CODE_EXCVEC_ASIL_D
        OS_SEC_CODE_INTVEC_ASIL_D: prefix=OSOsMemMap_OsCode, sw-addrmethod=INTVEC_CODE, symbol=CODE_INTVEC_ASIL_D
        OS_SEC_CODE_ERRORHOOK_ASIL_D: prefix=OSOsMemMap, sw-addrmethod=CALLOUT_CODE, symbol=CODE_ERRORHOOK_ASIL_D
        OS_SEC_CODE_STARTUPHOOK_ASIL_D: prefix=OSOsMemMap, sw-addrmethod=CALLOUT_CODE, symbol=CODE_STARTUPHOOK_ASIL_D
        OS_SEC_CODE_SHUTDOWNHOOK_ASIL_D: prefix=OSOsMemMap, sw-addrmethod=CALLOUT_CODE, symbol=CODE_SHUTDOWNHOOK_ASIL_D
        OS_SEC_CODE_PRETASKHOOK_ASIL_D: prefix=OSOsMemMap, sw-addrmethod=CALLOUT_CODE, symbol=CODE_PRETASKHOOK_ASIL_D
        OS_SEC_CODE_POSTTASKHOOK_ASIL_D: prefix=OSOsMemMap, sw-addrmethod=CALLOUT_CODE, symbol=CODE_POSTTASKHOOK_ASIL_D
        OS_SEC_CODE_PROTECTIONHOOK_ASIL_D: prefix=OSOsMemMap, sw-addrmethod=CALLOUT_CODE, symbol=CODE_PROTECTIONHOOK_ASIL_D
        OS_SEC_CODE_PANICHOOK_ASIL_D: prefix=OSOsMemMap, sw-addrmethod=CALLOUT_CODE, symbol=CODE_PANICHOOK_ASIL_D
        OS_SEC_CODE_Appl_Init_ASIL_B: prefix=OSOsMemMap, sw-addrmethod=CALLOUT_CODE, symbol=CODE_Appl_Init_ASIL_B
        OS_SEC_CODE_Appl_Task_ASIL_B: prefix=OSOsMemMap, sw-addrmethod=CALLOUT_CODE, symbol=CODE_Appl_Task_ASIL_B
        OS_SEC_CODE_Appl_Task_Communication_ASIL_B: prefix=OSOsMemMap, sw-addrmethod=CALLOUT_CODE, symbol=CODE_Appl_Task_Communication_ASIL_B
        OS_SEC_CODE_BSW_Task_ASIL_B: prefix=OSOsMemMap, sw-addrmethod=CALLOUT_CODE, symbol=CODE_BSW_Task_ASIL_B
        OS_SEC_CODE_Init_Task_ASIL_B: prefix=OSOsMemMap, sw-addrmethod=CALLOUT_CODE, symbol=CODE_Init_Task_ASIL_B
        OS_SEC_CODE_Radar_Ctrl_Task_ASIL_B: prefix=OSOsMemMap, sw-addrmethod=CALLOUT_CODE, symbol=CODE_Radar_Ctrl_Task_ASIL_B
        OS_SEC_CODE_Appl_Task_High_Prio_ASIL_B: prefix=OSOsMemMap, sw-addrmethod=CALLOUT_CODE, symbol=CODE_Appl_Task_High_Prio_ASIL_B
        OS_SEC_CODE_Appl_Task_Logging_QM: prefix=OSOsMemMap, sw-addrmethod=CALLOUT_CODE, symbol=CODE_Appl_Task_Logging_QM
        OS_SEC_CODE_Init_Task_Qm_QM: prefix=OSOsMemMap, sw-addrmethod=CALLOUT_CODE, symbol=CODE_Init_Task_Qm_QM
        OS_SEC_CODE_ETHERNET1_Handler_ASIL_B: prefix=OSOsMemMap, sw-addrmethod=CODE_ISR, symbol=CODE_ETHERNET1_Handler_ASIL_B
        OS_SEC_CODE_BBE_SP_FUSA_IRQ_Handler_ASIL_B: prefix=OSOsMemMap, sw-addrmethod=CODE_ISR, symbol=CODE_BBE_SP_FUSA_IRQ_Handler_ASIL_B
        OS_SEC_CODE_dsp_ctrl_err_fusa_irq_handler_ASIL_B: prefix=OSOsMemMap, sw-addrmethod=CODE_ISR, symbol=CODE_dsp_ctrl_err_fusa_irq_handler_ASIL_B
        OS_SEC_CODE_ETHERNET0_Handler_ASIL_B: prefix=OSOsMemMap, sw-addrmethod=CODE_ISR, symbol=CODE_ETHERNET0_Handler_ASIL_B
        OS_SEC_CODE_CANFD1_Handler_ASIL_B: prefix=OSOsMemMap, sw-addrmethod=CODE_ISR, symbol=CODE_CANFD1_Handler_ASIL_B
        OS_SEC_CODE_GPADC_Handler_ASIL_B: prefix=OSOsMemMap, sw-addrmethod=CODE_ISR, symbol=CODE_GPADC_Handler_ASIL_B
        OS_SEC_CODE_mipi_err_fusa_handler_ASIL_B: prefix=OSOsMemMap, sw-addrmethod=CODE_ISR, symbol=CODE_mipi_err_fusa_handler_ASIL_B
        OS_SEC_CODE_CANFD0_Handler_ASIL_B: prefix=OSOsMemMap, sw-addrmethod=CODE_ISR, symbol=CODE_CANFD0_Handler_ASIL_B
        OS_SEC_CODE_ETHERNET3_Handler_ASIL_B: prefix=OSOsMemMap, sw-addrmethod=CODE_ISR, symbol=CODE_ETHERNET3_Handler_ASIL_B
        OS_SEC_CODE_BBE_SP_GPIO0_Handler_ASIL_B: prefix=OSOsMemMap, sw-addrmethod=CODE_ISR, symbol=CODE_BBE_SP_GPIO0_Handler_ASIL_B
        OS_SEC_CODE_ETHERNET2_Handler_ASIL_B: prefix=OSOsMemMap, sw-addrmethod=CODE_ISR, symbol=CODE_ETHERNET2_Handler_ASIL_B
        OS_SEC_CODE_RA_Clock_Monitor_Handler_ASIL_B: prefix=OSOsMemMap, sw-addrmethod=CODE_ISR, symbol=CODE_RA_Clock_Monitor_Handler_ASIL_B
        OS_SEC_CODE_ETHERNET6_Handler_ASIL_B: prefix=OSOsMemMap, sw-addrmethod=CODE_ISR, symbol=CODE_ETHERNET6_Handler_ASIL_B
        OS_SEC_CODE_MIPI_Clock_Monitor_Handler_ASIL_B: prefix=OSOsMemMap, sw-addrmethod=CODE_ISR, symbol=CODE_MIPI_Clock_Monitor_Handler_ASIL_B
        OS_SEC_CODE_mipi_frm_start_handler_ASIL_B: prefix=OSOsMemMap, sw-addrmethod=CODE_ISR, symbol=CODE_mipi_frm_start_handler_ASIL_B
        OS_SEC_CODE_RA_FUSA_IRQ_Handler_ASIL_B: prefix=OSOsMemMap, sw-addrmethod=CODE_ISR, symbol=CODE_RA_FUSA_IRQ_Handler_ASIL_B
        OS_SEC_CODE_mipi_chp_end_handler_ASIL_B: prefix=OSOsMemMap, sw-addrmethod=CODE_ISR, symbol=CODE_mipi_chp_end_handler_ASIL_B
        OS_SEC_CODE_mipi_chp_fusa_handler_ASIL_B: prefix=OSOsMemMap, sw-addrmethod=CODE_ISR, symbol=CODE_mipi_chp_fusa_handler_ASIL_B
        OS_SEC_CODE_mm_intf0_handler_ASIL_B: prefix=OSOsMemMap, sw-addrmethod=CODE_ISR, symbol=CODE_mm_intf0_handler_ASIL_B
        OS_SEC_CODE_ETHERNET4_Handler_ASIL_B: prefix=OSOsMemMap, sw-addrmethod=CODE_ISR, symbol=CODE_ETHERNET4_Handler_ASIL_B
        OS_SEC_CODE_ETHERNET5_Handler_ASIL_B: prefix=OSOsMemMap, sw-addrmethod=CODE_ISR, symbol=CODE_ETHERNET5_Handler_ASIL_B
        OS_SEC_CODE_RA_ERROR_IRQ_Handler_ASIL_B: prefix=OSOsMemMap, sw-addrmethod=CODE_ISR, symbol=CODE_RA_ERROR_IRQ_Handler_ASIL_B
        OS_SEC_CODE_HSM0_Handler_ASIL_B: prefix=OSOsMemMap, sw-addrmethod=CODE_ISR, symbol=CODE_HSM0_Handler_ASIL_B
        OS_SEC_CODE_Artie_Mem_Fusa_Handler_ASIL_B: prefix=OSOsMemMap, sw-addrmethod=CODE_ISR, symbol=CODE_Artie_Mem_Fusa_Handler_ASIL_B
        OS_SEC_CODE_Serial_Clock_Monitor_Handler_ASIL_B: prefix=OSOsMemMap, sw-addrmethod=CODE_ISR, symbol=CODE_Serial_Clock_Monitor_Handler_ASIL_B
        OS_SEC_CODE_TIMER3_Handler_ASIL_B: prefix=OSOsMemMap, sw-addrmethod=CODE_ISR, symbol=CODE_TIMER3_Handler_ASIL_B
        OS_SEC_CODE_ETHERNET7_Handler_ASIL_B: prefix=OSOsMemMap, sw-addrmethod=CODE_ISR, symbol=CODE_ETHERNET7_Handler_ASIL_B
        OS_SEC_CODE_TIMER4_Handler_ASIL_B: prefix=OSOsMemMap, sw-addrmethod=CODE_ISR, symbol=CODE_TIMER4_Handler_ASIL_B
        OS_SEC_CODE_mipi_frm_end_handler_ASIL_B: prefix=OSOsMemMap, sw-addrmethod=CODE_ISR, symbol=CODE_mipi_frm_end_handler_ASIL_B
        OS_SEC_CODE_TIMER2_Handler_ASIL_B: prefix=OSOsMemMap, sw-addrmethod=CODE_ISR, symbol=CODE_TIMER2_Handler_ASIL_B
        OS_SEC_CODE_mipi_chp_start_handler_ASIL_B: prefix=OSOsMemMap, sw-addrmethod=CODE_ISR, symbol=CODE_mipi_chp_start_handler_ASIL_B
        OS_SEC_CODE_Sysmem0_Fusa_Handler_ASIL_B: prefix=OSOsMemMap, sw-addrmethod=CODE_ISR, symbol=CODE_Sysmem0_Fusa_Handler_ASIL_B
        OS_SEC_CODE_Sysmem1_Fusa_Handler_ASIL_B: prefix=OSOsMemMap, sw-addrmethod=CODE_ISR, symbol=CODE_Sysmem1_Fusa_Handler_ASIL_B
        OS_SEC_CODE_DSP_Clock_Monitor_Handler_ASIL_B: prefix=OSOsMemMap, sw-addrmethod=CODE_ISR, symbol=CODE_DSP_Clock_Monitor_Handler_ASIL_B
        OS_SEC_CODE_TIMER1_Handler_ASIL_B: prefix=OSOsMemMap, sw-addrmethod=CODE_ISR, symbol=CODE_TIMER1_Handler_ASIL_B
        OS_SEC_CONST_ASIL_D_32: alignment=32, prefix=OSOsMemMap_OsConst, sw-addrmethod=CONST, symbol=CONST_ASIL_D_32
        OS_SEC_CONST_INTVEC_ASIL_D_UNSPECIFIED: alignment=UNSPECIFIED, prefix=OSOsMemMap_OsConst, sw-addrmethod=INTVEC_CONST, symbol=CONST_INTVEC_ASIL_D_UNSPECIFIED
        OS_SEC_CONST_EXCVEC_ASIL_D_UNSPECIFIED: alignment=UNSPECIFIED, prefix=OSOsMemMap_OsConst, sw-addrmethod=CONST, symbol=CONST_EXCVEC_ASIL_D_UNSPECIFIED
        OS_SEC_VAR_CLEARED_NOCACHE_ASIL_D_32: alignment=32, prefix=OSOsMemMap_OsVar, sw-addrmethod=VAR_NOCACHE_CLEARED, symbol=VAR_CLEARED_NOCACHE_ASIL_D_32
        OS_CORE0_SEC_CODE_INTVEC_ASIL_D_LOCAL: prefix=OS_CORE0OsMemMap_OsCode, sw-addrmethod=INTVEC_OsCore0_CODE, symbol=CODE_INTVEC_ASIL_D_LOCAL
        OS_CORE0_SEC_CODE_EXCVEC_ASIL_D_LOCAL: options=vectorAlign32, prefix=OS_CORE0OsMemMap_OsCode, sw-addrmethod=EXCVEC_OsCore0_CODE, symbol=CODE_EXCVEC_ASIL_D_LOCAL
        OS_CORE0_SEC_CONST_ASIL_D_LOCAL_32: alignment=32, prefix=OS_CORE0OsMemMap_OsConst, sw-addrmethod=CONST, symbol=CONST_ASIL_D_LOCAL_32
        OS_CORE0_SEC_CONST_INTVEC_ASIL_D_LOCAL_UNSPECIFIED: alignment=UNSPECIFIED, prefix=OS_CORE0OsMemMap_OsConst, sw-addrmethod=INTVEC_OsCore0_CONST, symbol=CONST_INTVEC_ASIL_D_LOCAL_UNSPECIFIED
        OS_CORE0_SEC_CONST_EXCVEC_ASIL_D_LOCAL_UNSPECIFIED: alignment=UNSPECIFIED, options=vectorAlign32, prefix=OS_CORE0OsMemMap_OsConst, sw-addrmethod=EXCVEC_OsCore0_CONST, symbol=CONST_EXCVEC_ASIL_D_LOCAL_UNSPECIFIED
        OS_CORE0_SEC_VAR_CLEARED_ASIL_D_LOCAL_32: alignment=32, prefix=OS_CORE0OsMemMap_OsVar, sw-addrmethod=VAR_CLEARED, symbol=VAR_CLEARED_ASIL_D_LOCAL_32
        OS_CORE0_SEC_VAR_CLEARED_PUBLIC_ASIL_D_LOCAL_UNSPECIFIED: alignment=UNSPECIFIED, prefix=OS_CORE0OsMemMap_OsVar, sw-addrmethod=VAR_CLEARED, symbol=VAR_CLEARED_PUBLIC_ASIL_D_LOCAL_UNSPECIFIED
        OS_CORE0_SEC_VAR_CLEARED_STACK_OsCore0_Kernel_ASIL_D_LOCAL_UNSPECIFIED: alignment=UNSPECIFIED, options=vectorAlign64, prefix=OS_CORE0OsMemMap_OsStacks, sw-addrmethod=STACK_OsCore0_Kernel_VAR_CLEARED, symbol=VAR_CLEARED_STACK_OsCore0_Kernel_ASIL_D_LOCAL_UNSPECIFIED
        OS_CORE0_SEC_VAR_CLEARED_STACK_OsCore0_Init_ASIL_D_LOCAL_UNSPECIFIED: alignment=UNSPECIFIED, options=vectorAlign64, prefix=OS_CORE0OsMemMap_OsStacks, sw-addrmethod=STACK_OsCore0_Init_VAR_CLEARED, symbol=VAR_CLEARED_STACK_OsCore0_Init_ASIL_D_LOCAL_UNSPECIFIED
        OS_CORE0_SEC_VAR_CLEARED_STACK_OsCore0_Error_ASIL_D_LOCAL_UNSPECIFIED: alignment=UNSPECIFIED, options=vectorAlign64, prefix=OS_CORE0OsMemMap_OsStacks, sw-addrmethod=STACK_OsCore0_Error_VAR_CLEARED, symbol=VAR_CLEARED_STACK_OsCore0_Error_ASIL_D_LOCAL_UNSPECIFIED
        OS_CORE0_SEC_VAR_CLEARED_STACK_OsCore0_Task_Prio4294967295_ASIL_D_LOCAL_UNSPECIFIED: alignment=UNSPECIFIED, options=vectorAlign64, prefix=OS_CORE0OsMemMap_OsStacks, sw-addrmethod=STACK_OsCore0_Task_Prio4294967295_VAR_CLEARED, symbol=VAR_CLEARED_STACK_OsCore0_Task_Prio4294967295_ASIL_D_LOCAL_UNSPECIFIED
        OS_CORE0_SEC_VAR_CLEARED_STACK_OsCore0_Isr_Core_ASIL_D_LOCAL_UNSPECIFIED: alignment=UNSPECIFIED, options=vectorAlign64, prefix=OS_CORE0OsMemMap_OsStacks, sw-addrmethod=STACK_OsCore0_Isr_Core_VAR_CLEARED, symbol=VAR_CLEARED_STACK_OsCore0_Isr_Core_ASIL_D_LOCAL_UNSPECIFIED
        OS_CORE0_SEC_VAR_CLEARED_STACK_OsCore0_Startup_ASIL_D_LOCAL_UNSPECIFIED: alignment=UNSPECIFIED, options=vectorAlign64, prefix=OS_CORE0OsMemMap_OsStacks, sw-addrmethod=STACK_OsCore0_Startup_VAR_CLEARED, symbol=VAR_CLEARED_STACK_OsCore0_Startup_ASIL_D_LOCAL_UNSPECIFIED
        OS_CORE0_SEC_VAR_CLEARED_STACK_OsCore0_Shutdown_ASIL_D_LOCAL_UNSPECIFIED: alignment=UNSPECIFIED, options=vectorAlign64, prefix=OS_CORE0OsMemMap_OsStacks, sw-addrmethod=STACK_OsCore0_Shutdown_VAR_CLEARED, symbol=VAR_CLEARED_STACK_OsCore0_Shutdown_ASIL_D_LOCAL_UNSPECIFIED
        OS_CORE0_SEC_VAR_CLEARED_STACK_BSW_Task_ASIL_D_LOCAL_UNSPECIFIED: alignment=UNSPECIFIED, options=vectorAlign64, prefix=OS_CORE0OsMemMap_OsStacks, sw-addrmethod=STACK_BSW_Task_VAR_CLEARED, symbol=VAR_CLEARED_STACK_BSW_Task_ASIL_D_LOCAL_UNSPECIFIED
        OS_CORE0_SEC_VAR_CLEARED_STACK_OsCore0_Task_Prio200_ASIL_D_LOCAL_UNSPECIFIED: alignment=UNSPECIFIED, options=vectorAlign64, prefix=OS_CORE0OsMemMap_OsStacks, sw-addrmethod=STACK_OsCore0_Task_Prio200_VAR_CLEARED, symbol=VAR_CLEARED_STACK_OsCore0_Task_Prio200_ASIL_D_LOCAL_UNSPECIFIED
        OS_CORE0_SEC_VAR_CLEARED_STACK_OsCore0_Task_Prio190_ASIL_D_LOCAL_UNSPECIFIED: alignment=UNSPECIFIED, options=vectorAlign64, prefix=OS_CORE0OsMemMap_OsStacks, sw-addrmethod=STACK_OsCore0_Task_Prio190_VAR_CLEARED, symbol=VAR_CLEARED_STACK_OsCore0_Task_Prio190_ASIL_D_LOCAL_UNSPECIFIED
        OS_CORE0_SEC_VAR_CLEARED_STACK_Appl_Task_ASIL_D_LOCAL_UNSPECIFIED: alignment=UNSPECIFIED, options=vectorAlign64, prefix=OS_CORE0OsMemMap_OsStacks, sw-addrmethod=STACK_Appl_Task_VAR_CLEARED, symbol=VAR_CLEARED_STACK_Appl_Task_ASIL_D_LOCAL_UNSPECIFIED
        OS_CORE0_SEC_VAR_CLEARED_STACK_Radar_Ctrl_Task_ASIL_D_LOCAL_UNSPECIFIED: alignment=UNSPECIFIED, options=vectorAlign64, prefix=OS_CORE0OsMemMap_OsStacks, sw-addrmethod=STACK_Radar_Ctrl_Task_VAR_CLEARED, symbol=VAR_CLEARED_STACK_Radar_Ctrl_Task_ASIL_D_LOCAL_UNSPECIFIED
        OS_CORE0_SEC_VAR_CLEARED_STACK_Appl_Task_Logging_ASIL_D_LOCAL_UNSPECIFIED: alignment=UNSPECIFIED, options=vectorAlign64, prefix=OS_CORE0OsMemMap_OsStacks, sw-addrmethod=STACK_Appl_Task_Logging_VAR_CLEARED, symbol=VAR_CLEARED_STACK_Appl_Task_Logging_ASIL_D_LOCAL_UNSPECIFIED
        OS_CORE0_SEC_VAR_CLEARED_STACK_Appl_Task_Communication_ASIL_D_LOCAL_UNSPECIFIED: alignment=UNSPECIFIED, options=vectorAlign64, prefix=OS_CORE0OsMemMap_OsStacks, sw-addrmethod=STACK_Appl_Task_Communication_VAR_CLEARED, symbol=VAR_CLEARED_STACK_Appl_Task_Communication_ASIL_D_LOCAL_UNSPECIFIED
        OS_CORE0_SEC_VAR_CLEARED_STACK_Appl_Task_Fast_ASIL_D_LOCAL_UNSPECIFIED: alignment=UNSPECIFIED, options=vectorAlign64, prefix=OS_CORE0OsMemMap_OsStacks, sw-addrmethod=STACK_Appl_Task_Fast_VAR_CLEARED, symbol=VAR_CLEARED_STACK_Appl_Task_Fast_ASIL_D_LOCAL_UNSPECIFIED
        OS_CORE0_SEC_VAR_CLEARED_STACK_OsCore0_Task_Prio210_ASIL_D_LOCAL_UNSPECIFIED: alignment=UNSPECIFIED, options=vectorAlign64, prefix=OS_CORE0OsMemMap_OsStacks, sw-addrmethod=STACK_OsCore0_Task_Prio210_VAR_CLEARED, symbol=VAR_CLEARED_STACK_OsCore0_Task_Prio210_ASIL_D_LOCAL_UNSPECIFIED
        OS_CORE0_SEC_VAR_CLEARED_STACK_Appl_Task_High_Prio_ASIL_D_LOCAL_UNSPECIFIED: alignment=UNSPECIFIED, options=vectorAlign64, prefix=OS_CORE0OsMemMap_OsStacks, sw-addrmethod=STACK_Appl_Task_High_Prio_VAR_CLEARED, symbol=VAR_CLEARED_STACK_Appl_Task_High_Prio_ASIL_D_LOCAL_UNSPECIFIED
        OS_CORE0_SEC_VAR_FAST_CLEARED_ASIL_D_LOCAL_32: alignment=32, prefix=OS_CORE0OsMemMap_OsVar, sw-addrmethod=VAR_FAST_CLEARED, symbol=VAR_FAST_CLEARED_ASIL_D_LOCAL_32
        OS_CORE0_SEC_VAR_CLEARED_NOCACHE_ASIL_D_32: alignment=32, prefix=OS_CORE0OsMemMap_OsVar, sw-addrmethod=VAR_NOCACHE_CLEARED, symbol=VAR_CLEARED_NOCACHE_ASIL_D_32
        OS_CORE0_SEC_VAR_CLEARED_NOCACHE_CORESTATUS_ASIL_D_UNSPECIFIED: alignment=UNSPECIFIED, prefix=OS_CORE0OsMemMap_OsVar, sw-addrmethod=VAR_NOCACHE_CLEARED, symbol=VAR_CLEARED_NOCACHE_CORESTATUS_ASIL_D_UNSPECIFIED
        OS_CORE0_SEC_VAR_CLEARED_NOCACHE_BARRIER_ASIL_D_UNSPECIFIED: alignment=UNSPECIFIED, prefix=OS_CORE0OsMemMap_OsVar, sw-addrmethod=VAR_NOCACHE_CLEARED, symbol=VAR_CLEARED_NOCACHE_BARRIER_ASIL_D_UNSPECIFIED
        OS_CORE0_SEC_VAR_FAST_CLEARED_SUSPENDINTCOUNTERS_QM_LOCAL_16: alignment=16, prefix=OS_CORE0OsMemMap_OsVar, sw-addrmethod=GLOBALSHARED_VAR_FAST_CLEARED, symbol=VAR_FAST_CLEARED_SUSPENDINTCOUNTERS_QM_LOCAL_16
        OS_SystemApplication_OsCore0_SEC_CONST_QM_BOOLEAN: alignment=BOOLEAN, prefix=OS_SystemApplication_OsCore0OsMemMap, sw-addrmethod=SystemApplication_OsCore0_CONST, symbol=CONST_QM_BOOLEAN
        OS_SystemApplication_OsCore0_SEC_CONST_QM_8: alignment=8, prefix=OS_SystemApplication_OsCore0OsMemMap, sw-addrmethod=SystemApplication_OsCore0_CONST, symbol=CONST_QM_8
        OS_SystemApplication_OsCore0_SEC_CONST_QM_16: alignment=16, prefix=OS_SystemApplication_OsCore0OsMemMap, sw-addrmethod=SystemApplication_OsCore0_CONST, symbol=CONST_QM_16
        OS_SystemApplication_OsCore0_SEC_CONST_QM_32: alignment=32, prefix=OS_SystemApplication_OsCore0OsMemMap, sw-addrmethod=SystemApplication_OsCore0_CONST, symbol=CONST_QM_32
        OS_SystemApplication_OsCore0_SEC_CONST_QM_64: alignment=64, prefix=OS_SystemApplication_OsCore0OsMemMap, sw-addrmethod=SystemApplication_OsCore0_CONST, symbol=CONST_QM_64
        OS_SystemApplication_OsCore0_SEC_CONST_QM_UNSPECIFIED: alignment=UNSPECIFIED, prefix=OS_SystemApplication_OsCore0OsMemMap, sw-addrmethod=SystemApplication_OsCore0_CONST, symbol=CONST_QM_UNSPECIFIED
        OS_SystemApplication_OsCore0_SEC_VAR_INIT_QM_BOOLEAN: alignment=BOOLEAN, prefix=OS_SystemApplication_OsCore0OsMemMap, sw-addrmethod=SystemApplication_OsCore0_VAR_INIT, symbol=VAR_INIT_QM_BOOLEAN
        OS_SystemApplication_OsCore0_SEC_VAR_INIT_QM_8: alignment=8, prefix=OS_SystemApplication_OsCore0OsMemMap, sw-addrmethod=SystemApplication_OsCore0_VAR_INIT, symbol=VAR_INIT_QM_8
        OS_SystemApplication_OsCore0_SEC_VAR_INIT_QM_16: alignment=16, prefix=OS_SystemApplication_OsCore0OsMemMap, sw-addrmethod=SystemApplication_OsCore0_VAR_INIT, symbol=VAR_INIT_QM_16
        OS_SystemApplication_OsCore0_SEC_VAR_INIT_QM_32: alignment=32, prefix=OS_SystemApplication_OsCore0OsMemMap, sw-addrmethod=SystemApplication_OsCore0_VAR_INIT, symbol=VAR_INIT_QM_32
        OS_SystemApplication_OsCore0_SEC_VAR_INIT_QM_64: alignment=64, prefix=OS_SystemApplication_OsCore0OsMemMap, sw-addrmethod=SystemApplication_OsCore0_VAR_INIT, symbol=VAR_INIT_QM_64
        OS_SystemApplication_OsCore0_SEC_VAR_INIT_QM_UNSPECIFIED: alignment=UNSPECIFIED, prefix=OS_SystemApplication_OsCore0OsMemMap, sw-addrmethod=SystemApplication_OsCore0_VAR_INIT, symbol=VAR_INIT_QM_UNSPECIFIED
        OS_SystemApplication_OsCore0_SEC_VAR_FAST_INIT_QM_BOOLEAN: alignment=BOOLEAN, prefix=OS_SystemApplication_OsCore0OsMemMap, sw-addrmethod=SystemApplication_OsCore0_VAR_FAST_INIT, symbol=VAR_FAST_INIT_QM_BOOLEAN
        OS_SystemApplication_OsCore0_SEC_VAR_FAST_INIT_QM_8: alignment=8, prefix=OS_SystemApplication_OsCore0OsMemMap, sw-addrmethod=SystemApplication_OsCore0_VAR_FAST_INIT, symbol=VAR_FAST_INIT_QM_8
        OS_SystemApplication_OsCore0_SEC_VAR_FAST_INIT_QM_16: alignment=16, prefix=OS_SystemApplication_OsCore0OsMemMap, sw-addrmethod=SystemApplication_OsCore0_VAR_FAST_INIT, symbol=VAR_FAST_INIT_QM_16
        OS_SystemApplication_OsCore0_SEC_VAR_FAST_INIT_QM_32: alignment=32, prefix=OS_SystemApplication_OsCore0OsMemMap, sw-addrmethod=SystemApplication_OsCore0_VAR_FAST_INIT, symbol=VAR_FAST_INIT_QM_32
        OS_SystemApplication_OsCore0_SEC_VAR_FAST_INIT_QM_64: alignment=64, prefix=OS_SystemApplication_OsCore0OsMemMap, sw-addrmethod=SystemApplication_OsCore0_VAR_FAST_INIT, symbol=VAR_FAST_INIT_QM_64
        OS_SystemApplication_OsCore0_SEC_VAR_FAST_INIT_QM_UNSPECIFIED: alignment=UNSPECIFIED, prefix=OS_SystemApplication_OsCore0OsMemMap, sw-addrmethod=SystemApplication_OsCore0_VAR_FAST_INIT, symbol=VAR_FAST_INIT_QM_UNSPECIFIED
        OS_SystemApplication_OsCore0_SEC_VAR_INIT_NOCACHE_QM_BOOLEAN: alignment=BOOLEAN, prefix=OS_SystemApplication_OsCore0OsMemMap, sw-addrmethod=SystemApplication_OsCore0_VAR_NOCACHE_INIT, symbol=VAR_INIT_NOCACHE_QM_BOOLEAN
        OS_SystemApplication_OsCore0_SEC_VAR_INIT_NOCACHE_QM_8: alignment=8, prefix=OS_SystemApplication_OsCore0OsMemMap, sw-addrmethod=SystemApplication_OsCore0_VAR_NOCACHE_INIT, symbol=VAR_INIT_NOCACHE_QM_8
        OS_SystemApplication_OsCore0_SEC_VAR_INIT_NOCACHE_QM_16: alignment=16, prefix=OS_SystemApplication_OsCore0OsMemMap, sw-addrmethod=SystemApplication_OsCore0_VAR_NOCACHE_INIT, symbol=VAR_INIT_NOCACHE_QM_16
        OS_SystemApplication_OsCore0_SEC_VAR_INIT_NOCACHE_QM_32: alignment=32, prefix=OS_SystemApplication_OsCore0OsMemMap, sw-addrmethod=SystemApplication_OsCore0_VAR_NOCACHE_INIT, symbol=VAR_INIT_NOCACHE_QM_32
        OS_SystemApplication_OsCore0_SEC_VAR_INIT_NOCACHE_QM_64: alignment=64, prefix=OS_SystemApplication_OsCore0OsMemMap, sw-addrmethod=SystemApplication_OsCore0_VAR_NOCACHE_INIT, symbol=VAR_INIT_NOCACHE_QM_64
        OS_SystemApplication_OsCore0_SEC_VAR_INIT_NOCACHE_QM_UNSPECIFIED: alignment=UNSPECIFIED, prefix=OS_SystemApplication_OsCore0OsMemMap, sw-addrmethod=SystemApplication_OsCore0_VAR_NOCACHE_INIT, symbol=VAR_INIT_NOCACHE_QM_UNSPECIFIED
        OS_SystemApplication_OsCore0_SEC_VAR_CLEARED_QM_BOOLEAN: alignment=BOOLEAN, prefix=OS_SystemApplication_OsCore0OsMemMap, sw-addrmethod=SystemApplication_OsCore0_VAR_CLEARED, symbol=VAR_CLEARED_QM_BOOLEAN
        OS_SystemApplication_OsCore0_SEC_VAR_CLEARED_QM_8: alignment=8, prefix=OS_SystemApplication_OsCore0OsMemMap, sw-addrmethod=SystemApplication_OsCore0_VAR_CLEARED, symbol=VAR_CLEARED_QM_8
        OS_SystemApplication_OsCore0_SEC_VAR_CLEARED_QM_16: alignment=16, prefix=OS_SystemApplication_OsCore0OsMemMap, sw-addrmethod=SystemApplication_OsCore0_VAR_CLEARED, symbol=VAR_CLEARED_QM_16
        OS_SystemApplication_OsCore0_SEC_VAR_CLEARED_QM_32: alignment=32, prefix=OS_SystemApplication_OsCore0OsMemMap, sw-addrmethod=SystemApplication_OsCore0_VAR_CLEARED, symbol=VAR_CLEARED_QM_32
        OS_SystemApplication_OsCore0_SEC_VAR_CLEARED_QM_64: alignment=64, prefix=OS_SystemApplication_OsCore0OsMemMap, sw-addrmethod=SystemApplication_OsCore0_VAR_CLEARED, symbol=VAR_CLEARED_QM_64
        OS_SystemApplication_OsCore0_SEC_VAR_CLEARED_QM_UNSPECIFIED: alignment=UNSPECIFIED, prefix=OS_SystemApplication_OsCore0OsMemMap, sw-addrmethod=SystemApplication_OsCore0_VAR_CLEARED, symbol=VAR_CLEARED_QM_UNSPECIFIED
        OS_SystemApplication_OsCore0_SEC_VAR_FAST_CLEARED_QM_BOOLEAN: alignment=BOOLEAN, prefix=OS_SystemApplication_OsCore0OsMemMap, sw-addrmethod=SystemApplication_OsCore0_VAR_FAST_CLEARED, symbol=VAR_FAST_CLEARED_QM_BOOLEAN
        OS_SystemApplication_OsCore0_SEC_VAR_FAST_CLEARED_QM_8: alignment=8, prefix=OS_SystemApplication_OsCore0OsMemMap, sw-addrmethod=SystemApplication_OsCore0_VAR_FAST_CLEARED, symbol=VAR_FAST_CLEARED_QM_8
        OS_SystemApplication_OsCore0_SEC_VAR_FAST_CLEARED_QM_16: alignment=16, prefix=OS_SystemApplication_OsCore0OsMemMap, sw-addrmethod=SystemApplication_OsCore0_VAR_FAST_CLEARED, symbol=VAR_FAST_CLEARED_QM_16
        OS_SystemApplication_OsCore0_SEC_VAR_FAST_CLEARED_QM_32: alignment=32, prefix=OS_SystemApplication_OsCore0OsMemMap, sw-addrmethod=SystemApplication_OsCore0_VAR_FAST_CLEARED, symbol=VAR_FAST_CLEARED_QM_32
        OS_SystemApplication_OsCore0_SEC_VAR_FAST_CLEARED_QM_64: alignment=64, prefix=OS_SystemApplication_OsCore0OsMemMap, sw-addrmethod=SystemApplication_OsCore0_VAR_FAST_CLEARED, symbol=VAR_FAST_CLEARED_QM_64
        OS_SystemApplication_OsCore0_SEC_VAR_FAST_CLEARED_QM_UNSPECIFIED: alignment=UNSPECIFIED, prefix=OS_SystemApplication_OsCore0OsMemMap, sw-addrmethod=SystemApplication_OsCore0_VAR_FAST_CLEARED, symbol=VAR_FAST_CLEARED_QM_UNSPECIFIED
        OS_SystemApplication_OsCore0_SEC_VAR_CLEARED_NOCACHE_QM_BOOLEAN: alignment=BOOLEAN, prefix=OS_SystemApplication_OsCore0OsMemMap, sw-addrmethod=SystemApplication_OsCore0_VAR_NOCACHE_CLEARED, symbol=VAR_CLEARED_NOCACHE_QM_BOOLEAN
        OS_SystemApplication_OsCore0_SEC_VAR_CLEARED_NOCACHE_QM_8: alignment=8, prefix=OS_SystemApplication_OsCore0OsMemMap, sw-addrmethod=SystemApplication_OsCore0_VAR_NOCACHE_CLEARED, symbol=VAR_CLEARED_NOCACHE_QM_8
        OS_SystemApplication_OsCore0_SEC_VAR_CLEARED_NOCACHE_QM_16: alignment=16, prefix=OS_SystemApplication_OsCore0OsMemMap, sw-addrmethod=SystemApplication_OsCore0_VAR_NOCACHE_CLEARED, symbol=VAR_CLEARED_NOCACHE_QM_16
        OS_SystemApplication_OsCore0_SEC_VAR_CLEARED_NOCACHE_QM_32: alignment=32, prefix=OS_SystemApplication_OsCore0OsMemMap, sw-addrmethod=SystemApplication_OsCore0_VAR_NOCACHE_CLEARED, symbol=VAR_CLEARED_NOCACHE_QM_32
        OS_SystemApplication_OsCore0_SEC_VAR_CLEARED_NOCACHE_QM_64: alignment=64, prefix=OS_SystemApplication_OsCore0OsMemMap, sw-addrmethod=SystemApplication_OsCore0_VAR_NOCACHE_CLEARED, symbol=VAR_CLEARED_NOCACHE_QM_64
        OS_SystemApplication_OsCore0_SEC_VAR_CLEARED_NOCACHE_QM_UNSPECIFIED: alignment=UNSPECIFIED, prefix=OS_SystemApplication_OsCore0OsMemMap, sw-addrmethod=SystemApplication_OsCore0_VAR_NOCACHE_CLEARED, symbol=VAR_CLEARED_NOCACHE_QM_UNSPECIFIED
        OS_SystemApplication_OsCore0_SEC_VAR_NOINIT_QM_BOOLEAN: alignment=BOOLEAN, prefix=OS_SystemApplication_OsCore0OsMemMap, sw-addrmethod=SystemApplication_OsCore0_VAR_NOINIT, symbol=VAR_NOINIT_QM_BOOLEAN
        OS_SystemApplication_OsCore0_SEC_VAR_NOINIT_QM_8: alignment=8, prefix=OS_SystemApplication_OsCore0OsMemMap, sw-addrmethod=SystemApplication_OsCore0_VAR_NOINIT, symbol=VAR_NOINIT_QM_8
        OS_SystemApplication_OsCore0_SEC_VAR_NOINIT_QM_16: alignment=16, prefix=OS_SystemApplication_OsCore0OsMemMap, sw-addrmethod=SystemApplication_OsCore0_VAR_NOINIT, symbol=VAR_NOINIT_QM_16
        OS_SystemApplication_OsCore0_SEC_VAR_NOINIT_QM_32: alignment=32, prefix=OS_SystemApplication_OsCore0OsMemMap, sw-addrmethod=SystemApplication_OsCore0_VAR_NOINIT, symbol=VAR_NOINIT_QM_32
        OS_SystemApplication_OsCore0_SEC_VAR_NOINIT_QM_64: alignment=64, prefix=OS_SystemApplication_OsCore0OsMemMap, sw-addrmethod=SystemApplication_OsCore0_VAR_NOINIT, symbol=VAR_NOINIT_QM_64
        OS_SystemApplication_OsCore0_SEC_VAR_NOINIT_QM_UNSPECIFIED: alignment=UNSPECIFIED, prefix=OS_SystemApplication_OsCore0OsMemMap, sw-addrmethod=SystemApplication_OsCore0_VAR_NOINIT, symbol=VAR_NOINIT_QM_UNSPECIFIED
        OS_SystemApplication_OsCore0_SEC_VAR_FAST_NOINIT_QM_BOOLEAN: alignment=BOOLEAN, prefix=OS_SystemApplication_OsCore0OsMemMap, sw-addrmethod=SystemApplication_OsCore0_VAR_FAST_NOINIT, symbol=VAR_FAST_NOINIT_QM_BOOLEAN
        OS_SystemApplication_OsCore0_SEC_VAR_FAST_NOINIT_QM_8: alignment=8, prefix=OS_SystemApplication_OsCore0OsMemMap, sw-addrmethod=SystemApplication_OsCore0_VAR_FAST_NOINIT, symbol=VAR_FAST_NOINIT_QM_8
        OS_SystemApplication_OsCore0_SEC_VAR_FAST_NOINIT_QM_16: alignment=16, prefix=OS_SystemApplication_OsCore0OsMemMap, sw-addrmethod=SystemApplication_OsCore0_VAR_FAST_NOINIT, symbol=VAR_FAST_NOINIT_QM_16
        OS_SystemApplication_OsCore0_SEC_VAR_FAST_NOINIT_QM_32: alignment=32, prefix=OS_SystemApplication_OsCore0OsMemMap, sw-addrmethod=SystemApplication_OsCore0_VAR_FAST_NOINIT, symbol=VAR_FAST_NOINIT_QM_32
        OS_SystemApplication_OsCore0_SEC_VAR_FAST_NOINIT_QM_64: alignment=64, prefix=OS_SystemApplication_OsCore0OsMemMap, sw-addrmethod=SystemApplication_OsCore0_VAR_FAST_NOINIT, symbol=VAR_FAST_NOINIT_QM_64
        OS_SystemApplication_OsCore0_SEC_VAR_FAST_NOINIT_QM_UNSPECIFIED: alignment=UNSPECIFIED, prefix=OS_SystemApplication_OsCore0OsMemMap, sw-addrmethod=SystemApplication_OsCore0_VAR_FAST_NOINIT, symbol=VAR_FAST_NOINIT_QM_UNSPECIFIED
        OS_SystemApplication_OsCore0_SEC_VAR_NOINIT_NOCACHE_QM_BOOLEAN: alignment=BOOLEAN, prefix=OS_SystemApplication_OsCore0OsMemMap, sw-addrmethod=SystemApplication_OsCore0_VAR_NOCACHE_NOINIT, symbol=VAR_NOINIT_NOCACHE_QM_BOOLEAN
        OS_SystemApplication_OsCore0_SEC_VAR_NOINIT_NOCACHE_QM_8: alignment=8, prefix=OS_SystemApplication_OsCore0OsMemMap, sw-addrmethod=SystemApplication_OsCore0_VAR_NOCACHE_NOINIT, symbol=VAR_NOINIT_NOCACHE_QM_8
        OS_SystemApplication_OsCore0_SEC_VAR_NOINIT_NOCACHE_QM_16: alignment=16, prefix=OS_SystemApplication_OsCore0OsMemMap, sw-addrmethod=SystemApplication_OsCore0_VAR_NOCACHE_NOINIT, symbol=VAR_NOINIT_NOCACHE_QM_16
        OS_SystemApplication_OsCore0_SEC_VAR_NOINIT_NOCACHE_QM_32: alignment=32, prefix=OS_SystemApplication_OsCore0OsMemMap, sw-addrmethod=SystemApplication_OsCore0_VAR_NOCACHE_NOINIT, symbol=VAR_NOINIT_NOCACHE_QM_32
        OS_SystemApplication_OsCore0_SEC_VAR_NOINIT_NOCACHE_QM_64: alignment=64, prefix=OS_SystemApplication_OsCore0OsMemMap, sw-addrmethod=SystemApplication_OsCore0_VAR_NOCACHE_NOINIT, symbol=VAR_NOINIT_NOCACHE_QM_64
        OS_SystemApplication_OsCore0_SEC_VAR_NOINIT_NOCACHE_QM_UNSPECIFIED: alignment=UNSPECIFIED, prefix=OS_SystemApplication_OsCore0OsMemMap, sw-addrmethod=SystemApplication_OsCore0_VAR_NOCACHE_NOINIT, symbol=VAR_NOINIT_NOCACHE_QM_UNSPECIFIED
        OS_SystemApplication_OsCore0_SEC_VAR_POWER_ON_INIT_QM_BOOLEAN: alignment=BOOLEAN, prefix=OS_SystemApplication_OsCore0OsMemMap, sw-addrmethod=SystemApplication_OsCore0_VAR_POWER_ON_INIT, symbol=VAR_POWER_ON_INIT_QM_BOOLEAN
        OS_SystemApplication_OsCore0_SEC_VAR_POWER_ON_INIT_QM_8: alignment=8, prefix=OS_SystemApplication_OsCore0OsMemMap, sw-addrmethod=SystemApplication_OsCore0_VAR_POWER_ON_INIT, symbol=VAR_POWER_ON_INIT_QM_8
        OS_SystemApplication_OsCore0_SEC_VAR_POWER_ON_INIT_QM_16: alignment=16, prefix=OS_SystemApplication_OsCore0OsMemMap, sw-addrmethod=SystemApplication_OsCore0_VAR_POWER_ON_INIT, symbol=VAR_POWER_ON_INIT_QM_16
        OS_SystemApplication_OsCore0_SEC_VAR_POWER_ON_INIT_QM_32: alignment=32, prefix=OS_SystemApplication_OsCore0OsMemMap, sw-addrmethod=SystemApplication_OsCore0_VAR_POWER_ON_INIT, symbol=VAR_POWER_ON_INIT_QM_32
        OS_SystemApplication_OsCore0_SEC_VAR_POWER_ON_INIT_QM_64: alignment=64, prefix=OS_SystemApplication_OsCore0OsMemMap, sw-addrmethod=SystemApplication_OsCore0_VAR_POWER_ON_INIT, symbol=VAR_POWER_ON_INIT_QM_64
        OS_SystemApplication_OsCore0_SEC_VAR_POWER_ON_INIT_QM_UNSPECIFIED: alignment=UNSPECIFIED, prefix=OS_SystemApplication_OsCore0OsMemMap, sw-addrmethod=SystemApplication_OsCore0_VAR_POWER_ON_INIT, symbol=VAR_POWER_ON_INIT_QM_UNSPECIFIED
        OS_SystemApplication_OsCore0_SEC_VAR_FAST_POWER_ON_INIT_QM_BOOLEAN: alignment=BOOLEAN, prefix=OS_SystemApplication_OsCore0OsMemMap, sw-addrmethod=SystemApplication_OsCore0_VAR_FAST_POWER_ON_INIT, symbol=VAR_FAST_POWER_ON_INIT_QM_BOOLEAN
        OS_SystemApplication_OsCore0_SEC_VAR_FAST_POWER_ON_INIT_QM_8: alignment=8, prefix=OS_SystemApplication_OsCore0OsMemMap, sw-addrmethod=SystemApplication_OsCore0_VAR_FAST_POWER_ON_INIT, symbol=VAR_FAST_POWER_ON_INIT_QM_8
        OS_SystemApplication_OsCore0_SEC_VAR_FAST_POWER_ON_INIT_QM_16: alignment=16, prefix=OS_SystemApplication_OsCore0OsMemMap, sw-addrmethod=SystemApplication_OsCore0_VAR_FAST_POWER_ON_INIT, symbol=VAR_FAST_POWER_ON_INIT_QM_16
        OS_SystemApplication_OsCore0_SEC_VAR_FAST_POWER_ON_INIT_QM_32: alignment=32, prefix=OS_SystemApplication_OsCore0OsMemMap, sw-addrmethod=SystemApplication_OsCore0_VAR_FAST_POWER_ON_INIT, symbol=VAR_FAST_POWER_ON_INIT_QM_32
        OS_SystemApplication_OsCore0_SEC_VAR_FAST_POWER_ON_INIT_QM_64: alignment=64, prefix=OS_SystemApplication_OsCore0OsMemMap, sw-addrmethod=SystemApplication_OsCore0_VAR_FAST_POWER_ON_INIT, symbol=VAR_FAST_POWER_ON_INIT_QM_64
        OS_SystemApplication_OsCore0_SEC_VAR_FAST_POWER_ON_INIT_QM_UNSPECIFIED: alignment=UNSPECIFIED, prefix=OS_SystemApplication_OsCore0OsMemMap, sw-addrmethod=SystemApplication_OsCore0_VAR_FAST_POWER_ON_INIT, symbol=VAR_FAST_POWER_ON_INIT_QM_UNSPECIFIED
        OS_SystemApplication_OsCore0_SEC_VAR_POWER_ON_INIT_NOCACHE_QM_BOOLEAN: alignment=BOOLEAN, prefix=OS_SystemApplication_OsCore0OsMemMap, sw-addrmethod=SystemApplication_OsCore0_VAR_NOCACHE_POWER_ON_INIT, symbol=VAR_POWER_ON_INIT_NOCACHE_QM_BOOLEAN
        OS_SystemApplication_OsCore0_SEC_VAR_POWER_ON_INIT_NOCACHE_QM_8: alignment=8, prefix=OS_SystemApplication_OsCore0OsMemMap, sw-addrmethod=SystemApplication_OsCore0_VAR_NOCACHE_POWER_ON_INIT, symbol=VAR_POWER_ON_INIT_NOCACHE_QM_8
        OS_SystemApplication_OsCore0_SEC_VAR_POWER_ON_INIT_NOCACHE_QM_16: alignment=16, prefix=OS_SystemApplication_OsCore0OsMemMap, sw-addrmethod=SystemApplication_OsCore0_VAR_NOCACHE_POWER_ON_INIT, symbol=VAR_POWER_ON_INIT_NOCACHE_QM_16
        OS_SystemApplication_OsCore0_SEC_VAR_POWER_ON_INIT_NOCACHE_QM_32: alignment=32, prefix=OS_SystemApplication_OsCore0OsMemMap, sw-addrmethod=SystemApplication_OsCore0_VAR_NOCACHE_POWER_ON_INIT, symbol=VAR_POWER_ON_INIT_NOCACHE_QM_32
        OS_SystemApplication_OsCore0_SEC_VAR_POWER_ON_INIT_NOCACHE_QM_64: alignment=64, prefix=OS_SystemApplication_OsCore0OsMemMap, sw-addrmethod=SystemApplication_OsCore0_VAR_NOCACHE_POWER_ON_INIT, symbol=VAR_POWER_ON_INIT_NOCACHE_QM_64
        OS_SystemApplication_OsCore0_SEC_VAR_POWER_ON_INIT_NOCACHE_QM_UNSPECIFIED: alignment=UNSPECIFIED, prefix=OS_SystemApplication_OsCore0OsMemMap, sw-addrmethod=SystemApplication_OsCore0_VAR_NOCACHE_POWER_ON_INIT, symbol=VAR_POWER_ON_INIT_NOCACHE_QM_UNSPECIFIED
        OS_SystemApplication_OsCore0_SEC_VAR_POWER_ON_CLEARED_QM_BOOLEAN: alignment=BOOLEAN, prefix=OS_SystemApplication_OsCore0OsMemMap, sw-addrmethod=SystemApplication_OsCore0_VAR_POWER_ON_CLEARED, symbol=VAR_POWER_ON_CLEARED_QM_BOOLEAN
        OS_SystemApplication_OsCore0_SEC_VAR_POWER_ON_CLEARED_QM_8: alignment=8, prefix=OS_SystemApplication_OsCore0OsMemMap, sw-addrmethod=SystemApplication_OsCore0_VAR_POWER_ON_CLEARED, symbol=VAR_POWER_ON_CLEARED_QM_8
        OS_SystemApplication_OsCore0_SEC_VAR_POWER_ON_CLEARED_QM_16: alignment=16, prefix=OS_SystemApplication_OsCore0OsMemMap, sw-addrmethod=SystemApplication_OsCore0_VAR_POWER_ON_CLEARED, symbol=VAR_POWER_ON_CLEARED_QM_16
        OS_SystemApplication_OsCore0_SEC_VAR_POWER_ON_CLEARED_QM_32: alignment=32, prefix=OS_SystemApplication_OsCore0OsMemMap, sw-addrmethod=SystemApplication_OsCore0_VAR_POWER_ON_CLEARED, symbol=VAR_POWER_ON_CLEARED_QM_32
        OS_SystemApplication_OsCore0_SEC_VAR_POWER_ON_CLEARED_QM_64: alignment=64, prefix=OS_SystemApplication_OsCore0OsMemMap, sw-addrmethod=SystemApplication_OsCore0_VAR_POWER_ON_CLEARED, symbol=VAR_POWER_ON_CLEARED_QM_64
        OS_SystemApplication_OsCore0_SEC_VAR_POWER_ON_CLEARED_QM_UNSPECIFIED: alignment=UNSPECIFIED, prefix=OS_SystemApplication_OsCore0OsMemMap, sw-addrmethod=SystemApplication_OsCore0_VAR_POWER_ON_CLEARED, symbol=VAR_POWER_ON_CLEARED_QM_UNSPECIFIED
        OS_SystemApplication_OsCore0_SEC_VAR_FAST_POWER_ON_CLEARED_QM_BOOLEAN: alignment=BOOLEAN, prefix=OS_SystemApplication_OsCore0OsMemMap, sw-addrmethod=SystemApplication_OsCore0_VAR_FAST_POWER_ON_CLEARED, symbol=VAR_FAST_POWER_ON_CLEARED_QM_BOOLEAN
        OS_SystemApplication_OsCore0_SEC_VAR_FAST_POWER_ON_CLEARED_QM_8: alignment=8, prefix=OS_SystemApplication_OsCore0OsMemMap, sw-addrmethod=SystemApplication_OsCore0_VAR_FAST_POWER_ON_CLEARED, symbol=VAR_FAST_POWER_ON_CLEARED_QM_8
        OS_SystemApplication_OsCore0_SEC_VAR_FAST_POWER_ON_CLEARED_QM_16: alignment=16, prefix=OS_SystemApplication_OsCore0OsMemMap, sw-addrmethod=SystemApplication_OsCore0_VAR_FAST_POWER_ON_CLEARED, symbol=VAR_FAST_POWER_ON_CLEARED_QM_16
        OS_SystemApplication_OsCore0_SEC_VAR_FAST_POWER_ON_CLEARED_QM_32: alignment=32, prefix=OS_SystemApplication_OsCore0OsMemMap, sw-addrmethod=SystemApplication_OsCore0_VAR_FAST_POWER_ON_CLEARED, symbol=VAR_FAST_POWER_ON_CLEARED_QM_32
        OS_SystemApplication_OsCore0_SEC_VAR_FAST_POWER_ON_CLEARED_QM_64: alignment=64, prefix=OS_SystemApplication_OsCore0OsMemMap, sw-addrmethod=SystemApplication_OsCore0_VAR_FAST_POWER_ON_CLEARED, symbol=VAR_FAST_POWER_ON_CLEARED_QM_64
        OS_SystemApplication_OsCore0_SEC_VAR_FAST_POWER_ON_CLEARED_QM_UNSPECIFIED: alignment=UNSPECIFIED, prefix=OS_SystemApplication_OsCore0OsMemMap, sw-addrmethod=SystemApplication_OsCore0_VAR_FAST_POWER_ON_CLEARED, symbol=VAR_FAST_POWER_ON_CLEARED_QM_UNSPECIFIED
        OS_SystemApplication_OsCore0_SEC_VAR_POWER_ON_CLEARED_NOCACHE_QM_BOOLEAN: alignment=BOOLEAN, prefix=OS_SystemApplication_OsCore0OsMemMap, sw-addrmethod=SystemApplication_OsCore0_VAR_NOCACHE_POWER_ON_CLEARED, symbol=VAR_POWER_ON_CLEARED_NOCACHE_QM_BOOLEAN
        OS_SystemApplication_OsCore0_SEC_VAR_POWER_ON_CLEARED_NOCACHE_QM_8: alignment=8, prefix=OS_SystemApplication_OsCore0OsMemMap, sw-addrmethod=SystemApplication_OsCore0_VAR_NOCACHE_POWER_ON_CLEARED, symbol=VAR_POWER_ON_CLEARED_NOCACHE_QM_8
        OS_SystemApplication_OsCore0_SEC_VAR_POWER_ON_CLEARED_NOCACHE_QM_16: alignment=16, prefix=OS_SystemApplication_OsCore0OsMemMap, sw-addrmethod=SystemApplication_OsCore0_VAR_NOCACHE_POWER_ON_CLEARED, symbol=VAR_POWER_ON_CLEARED_NOCACHE_QM_16
        OS_SystemApplication_OsCore0_SEC_VAR_POWER_ON_CLEARED_NOCACHE_QM_32: alignment=32, prefix=OS_SystemApplication_OsCore0OsMemMap, sw-addrmethod=SystemApplication_OsCore0_VAR_NOCACHE_POWER_ON_CLEARED, symbol=VAR_POWER_ON_CLEARED_NOCACHE_QM_32
        OS_SystemApplication_OsCore0_SEC_VAR_POWER_ON_CLEARED_NOCACHE_QM_64: alignment=64, prefix=OS_SystemApplication_OsCore0OsMemMap, sw-addrmethod=SystemApplication_OsCore0_VAR_NOCACHE_POWER_ON_CLEARED, symbol=VAR_POWER_ON_CLEARED_NOCACHE_QM_64
        OS_SystemApplication_OsCore0_SEC_VAR_POWER_ON_CLEARED_NOCACHE_QM_UNSPECIFIED: alignment=UNSPECIFIED, prefix=OS_SystemApplication_OsCore0OsMemMap, sw-addrmethod=SystemApplication_OsCore0_VAR_NOCACHE_POWER_ON_CLEARED, symbol=VAR_POWER_ON_CLEARED_NOCACHE_QM_UNSPECIFIED
        OS_OsCore0_ASIL_SEC_CONST_ASIL_B_BOOLEAN: alignment=BOOLEAN, prefix=OS_OsCore0_ASILOsMemMap, sw-addrmethod=OsCore0_ASIL_CONST, symbol=CONST_ASIL_B_BOOLEAN
        OS_OsCore0_ASIL_SEC_CONST_ASIL_B_8: alignment=8, prefix=OS_OsCore0_ASILOsMemMap, sw-addrmethod=OsCore0_ASIL_CONST, symbol=CONST_ASIL_B_8
        OS_OsCore0_ASIL_SEC_CONST_ASIL_B_16: alignment=16, prefix=OS_OsCore0_ASILOsMemMap, sw-addrmethod=OsCore0_ASIL_CONST, symbol=CONST_ASIL_B_16
        OS_OsCore0_ASIL_SEC_CONST_ASIL_B_32: alignment=32, prefix=OS_OsCore0_ASILOsMemMap, sw-addrmethod=OsCore0_ASIL_CONST, symbol=CONST_ASIL_B_32
        OS_OsCore0_ASIL_SEC_CONST_ASIL_B_64: alignment=64, prefix=OS_OsCore0_ASILOsMemMap, sw-addrmethod=OsCore0_ASIL_CONST, symbol=CONST_ASIL_B_64
        OS_OsCore0_ASIL_SEC_CONST_ASIL_B_UNSPECIFIED: alignment=UNSPECIFIED, prefix=OS_OsCore0_ASILOsMemMap, sw-addrmethod=OsCore0_ASIL_CONST, symbol=CONST_ASIL_B_UNSPECIFIED
        OS_OsCore0_ASIL_SEC_VAR_INIT_ASIL_B_BOOLEAN: alignment=BOOLEAN, prefix=OS_OsCore0_ASILOsMemMap, sw-addrmethod=OsCore0_ASIL_VAR_INIT, symbol=VAR_INIT_ASIL_B_BOOLEAN
        OS_OsCore0_ASIL_SEC_VAR_INIT_ASIL_B_8: alignment=8, prefix=OS_OsCore0_ASILOsMemMap, sw-addrmethod=OsCore0_ASIL_VAR_INIT, symbol=VAR_INIT_ASIL_B_8
        OS_OsCore0_ASIL_SEC_VAR_INIT_ASIL_B_16: alignment=16, prefix=OS_OsCore0_ASILOsMemMap, sw-addrmethod=OsCore0_ASIL_VAR_INIT, symbol=VAR_INIT_ASIL_B_16
        OS_OsCore0_ASIL_SEC_VAR_INIT_ASIL_B_32: alignment=32, prefix=OS_OsCore0_ASILOsMemMap, sw-addrmethod=OsCore0_ASIL_VAR_INIT, symbol=VAR_INIT_ASIL_B_32
        OS_OsCore0_ASIL_SEC_VAR_INIT_ASIL_B_64: alignment=64, prefix=OS_OsCore0_ASILOsMemMap, sw-addrmethod=OsCore0_ASIL_VAR_INIT, symbol=VAR_INIT_ASIL_B_64
        OS_OsCore0_ASIL_SEC_VAR_INIT_ASIL_B_UNSPECIFIED: alignment=UNSPECIFIED, prefix=OS_OsCore0_ASILOsMemMap, sw-addrmethod=OsCore0_ASIL_VAR_INIT, symbol=VAR_INIT_ASIL_B_UNSPECIFIED
        OS_OsCore0_ASIL_SEC_VAR_FAST_INIT_ASIL_B_BOOLEAN: alignment=BOOLEAN, prefix=OS_OsCore0_ASILOsMemMap, sw-addrmethod=OsCore0_ASIL_VAR_FAST_INIT, symbol=VAR_FAST_INIT_ASIL_B_BOOLEAN
        OS_OsCore0_ASIL_SEC_VAR_FAST_INIT_ASIL_B_8: alignment=8, prefix=OS_OsCore0_ASILOsMemMap, sw-addrmethod=OsCore0_ASIL_VAR_FAST_INIT, symbol=VAR_FAST_INIT_ASIL_B_8
        OS_OsCore0_ASIL_SEC_VAR_FAST_INIT_ASIL_B_16: alignment=16, prefix=OS_OsCore0_ASILOsMemMap, sw-addrmethod=OsCore0_ASIL_VAR_FAST_INIT, symbol=VAR_FAST_INIT_ASIL_B_16
        OS_OsCore0_ASIL_SEC_VAR_FAST_INIT_ASIL_B_32: alignment=32, prefix=OS_OsCore0_ASILOsMemMap, sw-addrmethod=OsCore0_ASIL_VAR_FAST_INIT, symbol=VAR_FAST_INIT_ASIL_B_32
        OS_OsCore0_ASIL_SEC_VAR_FAST_INIT_ASIL_B_64: alignment=64, prefix=OS_OsCore0_ASILOsMemMap, sw-addrmethod=OsCore0_ASIL_VAR_FAST_INIT, symbol=VAR_FAST_INIT_ASIL_B_64
        OS_OsCore0_ASIL_SEC_VAR_FAST_INIT_ASIL_B_UNSPECIFIED: alignment=UNSPECIFIED, prefix=OS_OsCore0_ASILOsMemMap, sw-addrmethod=OsCore0_ASIL_VAR_FAST_INIT, symbol=VAR_FAST_INIT_ASIL_B_UNSPECIFIED
        OS_OsCore0_ASIL_SEC_VAR_INIT_NOCACHE_ASIL_B_BOOLEAN: alignment=BOOLEAN, prefix=OS_OsCore0_ASILOsMemMap, sw-addrmethod=OsCore0_ASIL_VAR_NOCACHE_INIT, symbol=VAR_INIT_NOCACHE_ASIL_B_BOOLEAN
        OS_OsCore0_ASIL_SEC_VAR_INIT_NOCACHE_ASIL_B_8: alignment=8, prefix=OS_OsCore0_ASILOsMemMap, sw-addrmethod=OsCore0_ASIL_VAR_NOCACHE_INIT, symbol=VAR_INIT_NOCACHE_ASIL_B_8
        OS_OsCore0_ASIL_SEC_VAR_INIT_NOCACHE_ASIL_B_16: alignment=16, prefix=OS_OsCore0_ASILOsMemMap, sw-addrmethod=OsCore0_ASIL_VAR_NOCACHE_INIT, symbol=VAR_INIT_NOCACHE_ASIL_B_16
        OS_OsCore0_ASIL_SEC_VAR_INIT_NOCACHE_ASIL_B_32: alignment=32, prefix=OS_OsCore0_ASILOsMemMap, sw-addrmethod=OsCore0_ASIL_VAR_NOCACHE_INIT, symbol=VAR_INIT_NOCACHE_ASIL_B_32
        OS_OsCore0_ASIL_SEC_VAR_INIT_NOCACHE_ASIL_B_64: alignment=64, prefix=OS_OsCore0_ASILOsMemMap, sw-addrmethod=OsCore0_ASIL_VAR_NOCACHE_INIT, symbol=VAR_INIT_NOCACHE_ASIL_B_64
        OS_OsCore0_ASIL_SEC_VAR_INIT_NOCACHE_ASIL_B_UNSPECIFIED: alignment=UNSPECIFIED, prefix=OS_OsCore0_ASILOsMemMap, sw-addrmethod=OsCore0_ASIL_VAR_NOCACHE_INIT, symbol=VAR_INIT_NOCACHE_ASIL_B_UNSPECIFIED
        OS_OsCore0_ASIL_SEC_VAR_CLEARED_ASIL_B_BOOLEAN: alignment=BOOLEAN, prefix=OS_OsCore0_ASILOsMemMap, sw-addrmethod=OsCore0_ASIL_VAR_CLEARED, symbol=VAR_CLEARED_ASIL_B_BOOLEAN
        OS_OsCore0_ASIL_SEC_VAR_CLEARED_ASIL_B_8: alignment=8, prefix=OS_OsCore0_ASILOsMemMap, sw-addrmethod=OsCore0_ASIL_VAR_CLEARED, symbol=VAR_CLEARED_ASIL_B_8
        OS_OsCore0_ASIL_SEC_VAR_CLEARED_ASIL_B_16: alignment=16, prefix=OS_OsCore0_ASILOsMemMap, sw-addrmethod=OsCore0_ASIL_VAR_CLEARED, symbol=VAR_CLEARED_ASIL_B_16
        OS_OsCore0_ASIL_SEC_VAR_CLEARED_ASIL_B_32: alignment=32, prefix=OS_OsCore0_ASILOsMemMap, sw-addrmethod=OsCore0_ASIL_VAR_CLEARED, symbol=VAR_CLEARED_ASIL_B_32
        OS_OsCore0_ASIL_SEC_VAR_CLEARED_ASIL_B_64: alignment=64, prefix=OS_OsCore0_ASILOsMemMap, sw-addrmethod=OsCore0_ASIL_VAR_CLEARED, symbol=VAR_CLEARED_ASIL_B_64
        OS_OsCore0_ASIL_SEC_VAR_CLEARED_ASIL_B_UNSPECIFIED: alignment=UNSPECIFIED, prefix=OS_OsCore0_ASILOsMemMap, sw-addrmethod=OsCore0_ASIL_VAR_CLEARED, symbol=VAR_CLEARED_ASIL_B_UNSPECIFIED
        OS_OsCore0_ASIL_SEC_VAR_FAST_CLEARED_ASIL_B_BOOLEAN: alignment=BOOLEAN, prefix=OS_OsCore0_ASILOsMemMap, sw-addrmethod=OsCore0_ASIL_VAR_FAST_CLEARED, symbol=VAR_FAST_CLEARED_ASIL_B_BOOLEAN
        OS_OsCore0_ASIL_SEC_VAR_FAST_CLEARED_ASIL_B_8: alignment=8, prefix=OS_OsCore0_ASILOsMemMap, sw-addrmethod=OsCore0_ASIL_VAR_FAST_CLEARED, symbol=VAR_FAST_CLEARED_ASIL_B_8
        OS_OsCore0_ASIL_SEC_VAR_FAST_CLEARED_ASIL_B_16: alignment=16, prefix=OS_OsCore0_ASILOsMemMap, sw-addrmethod=OsCore0_ASIL_VAR_FAST_CLEARED, symbol=VAR_FAST_CLEARED_ASIL_B_16
        OS_OsCore0_ASIL_SEC_VAR_FAST_CLEARED_ASIL_B_32: alignment=32, prefix=OS_OsCore0_ASILOsMemMap, sw-addrmethod=OsCore0_ASIL_VAR_FAST_CLEARED, symbol=VAR_FAST_CLEARED_ASIL_B_32
        OS_OsCore0_ASIL_SEC_VAR_FAST_CLEARED_ASIL_B_64: alignment=64, prefix=OS_OsCore0_ASILOsMemMap, sw-addrmethod=OsCore0_ASIL_VAR_FAST_CLEARED, symbol=VAR_FAST_CLEARED_ASIL_B_64
        OS_OsCore0_ASIL_SEC_VAR_FAST_CLEARED_ASIL_B_UNSPECIFIED: alignment=UNSPECIFIED, prefix=OS_OsCore0_ASILOsMemMap, sw-addrmethod=OsCore0_ASIL_VAR_FAST_CLEARED, symbol=VAR_FAST_CLEARED_ASIL_B_UNSPECIFIED
        OS_OsCore0_ASIL_SEC_VAR_CLEARED_NOCACHE_ASIL_B_BOOLEAN: alignment=BOOLEAN, prefix=OS_OsCore0_ASILOsMemMap, sw-addrmethod=OsCore0_ASIL_VAR_NOCACHE_CLEARED, symbol=VAR_CLEARED_NOCACHE_ASIL_B_BOOLEAN
        OS_OsCore0_ASIL_SEC_VAR_CLEARED_NOCACHE_ASIL_B_8: alignment=8, prefix=OS_OsCore0_ASILOsMemMap, sw-addrmethod=OsCore0_ASIL_VAR_NOCACHE_CLEARED, symbol=VAR_CLEARED_NOCACHE_ASIL_B_8
        OS_OsCore0_ASIL_SEC_VAR_CLEARED_NOCACHE_ASIL_B_16: alignment=16, prefix=OS_OsCore0_ASILOsMemMap, sw-addrmethod=OsCore0_ASIL_VAR_NOCACHE_CLEARED, symbol=VAR_CLEARED_NOCACHE_ASIL_B_16
        OS_OsCore0_ASIL_SEC_VAR_CLEARED_NOCACHE_ASIL_B_32: alignment=32, prefix=OS_OsCore0_ASILOsMemMap, sw-addrmethod=OsCore0_ASIL_VAR_NOCACHE_CLEARED, symbol=VAR_CLEARED_NOCACHE_ASIL_B_32
        OS_OsCore0_ASIL_SEC_VAR_CLEARED_NOCACHE_ASIL_B_64: alignment=64, prefix=OS_OsCore0_ASILOsMemMap, sw-addrmethod=OsCore0_ASIL_VAR_NOCACHE_CLEARED, symbol=VAR_CLEARED_NOCACHE_ASIL_B_64
        OS_OsCore0_ASIL_SEC_VAR_CLEARED_NOCACHE_ASIL_B_UNSPECIFIED: alignment=UNSPECIFIED, prefix=OS_OsCore0_ASILOsMemMap, sw-addrmethod=OsCore0_ASIL_VAR_NOCACHE_CLEARED, symbol=VAR_CLEARED_NOCACHE_ASIL_B_UNSPECIFIED
        OS_OsCore0_ASIL_SEC_VAR_NOINIT_ASIL_B_BOOLEAN: alignment=BOOLEAN, prefix=OS_OsCore0_ASILOsMemMap, sw-addrmethod=OsCore0_ASIL_VAR_NOINIT, symbol=VAR_NOINIT_ASIL_B_BOOLEAN
        OS_OsCore0_ASIL_SEC_VAR_NOINIT_ASIL_B_8: alignment=8, prefix=OS_OsCore0_ASILOsMemMap, sw-addrmethod=OsCore0_ASIL_VAR_NOINIT, symbol=VAR_NOINIT_ASIL_B_8
        OS_OsCore0_ASIL_SEC_VAR_NOINIT_ASIL_B_16: alignment=16, prefix=OS_OsCore0_ASILOsMemMap, sw-addrmethod=OsCore0_ASIL_VAR_NOINIT, symbol=VAR_NOINIT_ASIL_B_16
        OS_OsCore0_ASIL_SEC_VAR_NOINIT_ASIL_B_32: alignment=32, prefix=OS_OsCore0_ASILOsMemMap, sw-addrmethod=OsCore0_ASIL_VAR_NOINIT, symbol=VAR_NOINIT_ASIL_B_32
        OS_OsCore0_ASIL_SEC_VAR_NOINIT_ASIL_B_64: alignment=64, prefix=OS_OsCore0_ASILOsMemMap, sw-addrmethod=OsCore0_ASIL_VAR_NOINIT, symbol=VAR_NOINIT_ASIL_B_64
        OS_OsCore0_ASIL_SEC_VAR_NOINIT_ASIL_B_UNSPECIFIED: alignment=UNSPECIFIED, prefix=OS_OsCore0_ASILOsMemMap, sw-addrmethod=OsCore0_ASIL_VAR_NOINIT, symbol=VAR_NOINIT_ASIL_B_UNSPECIFIED
        OS_OsCore0_ASIL_SEC_VAR_FAST_NOINIT_ASIL_B_BOOLEAN: alignment=BOOLEAN, prefix=OS_OsCore0_ASILOsMemMap, sw-addrmethod=OsCore0_ASIL_VAR_FAST_NOINIT, symbol=VAR_FAST_NOINIT_ASIL_B_BOOLEAN
        OS_OsCore0_ASIL_SEC_VAR_FAST_NOINIT_ASIL_B_8: alignment=8, prefix=OS_OsCore0_ASILOsMemMap, sw-addrmethod=OsCore0_ASIL_VAR_FAST_NOINIT, symbol=VAR_FAST_NOINIT_ASIL_B_8
        OS_OsCore0_ASIL_SEC_VAR_FAST_NOINIT_ASIL_B_16: alignment=16, prefix=OS_OsCore0_ASILOsMemMap, sw-addrmethod=OsCore0_ASIL_VAR_FAST_NOINIT, symbol=VAR_FAST_NOINIT_ASIL_B_16
        OS_OsCore0_ASIL_SEC_VAR_FAST_NOINIT_ASIL_B_32: alignment=32, prefix=OS_OsCore0_ASILOsMemMap, sw-addrmethod=OsCore0_ASIL_VAR_FAST_NOINIT, symbol=VAR_FAST_NOINIT_ASIL_B_32
        OS_OsCore0_ASIL_SEC_VAR_FAST_NOINIT_ASIL_B_64: alignment=64, prefix=OS_OsCore0_ASILOsMemMap, sw-addrmethod=OsCore0_ASIL_VAR_FAST_NOINIT, symbol=VAR_FAST_NOINIT_ASIL_B_64
        OS_OsCore0_ASIL_SEC_VAR_FAST_NOINIT_ASIL_B_UNSPECIFIED: alignment=UNSPECIFIED, prefix=OS_OsCore0_ASILOsMemMap, sw-addrmethod=OsCore0_ASIL_VAR_FAST_NOINIT, symbol=VAR_FAST_NOINIT_ASIL_B_UNSPECIFIED
        OS_OsCore0_ASIL_SEC_VAR_NOINIT_NOCACHE_ASIL_B_BOOLEAN: alignment=BOOLEAN, prefix=OS_OsCore0_ASILOsMemMap, sw-addrmethod=OsCore0_ASIL_VAR_NOCACHE_NOINIT, symbol=VAR_NOINIT_NOCACHE_ASIL_B_BOOLEAN
        OS_OsCore0_ASIL_SEC_VAR_NOINIT_NOCACHE_ASIL_B_8: alignment=8, prefix=OS_OsCore0_ASILOsMemMap, sw-addrmethod=OsCore0_ASIL_VAR_NOCACHE_NOINIT, symbol=VAR_NOINIT_NOCACHE_ASIL_B_8
        OS_OsCore0_ASIL_SEC_VAR_NOINIT_NOCACHE_ASIL_B_16: alignment=16, prefix=OS_OsCore0_ASILOsMemMap, sw-addrmethod=OsCore0_ASIL_VAR_NOCACHE_NOINIT, symbol=VAR_NOINIT_NOCACHE_ASIL_B_16
        OS_OsCore0_ASIL_SEC_VAR_NOINIT_NOCACHE_ASIL_B_32: alignment=32, prefix=OS_OsCore0_ASILOsMemMap, sw-addrmethod=OsCore0_ASIL_VAR_NOCACHE_NOINIT, symbol=VAR_NOINIT_NOCACHE_ASIL_B_32
        OS_OsCore0_ASIL_SEC_VAR_NOINIT_NOCACHE_ASIL_B_64: alignment=64, prefix=OS_OsCore0_ASILOsMemMap, sw-addrmethod=OsCore0_ASIL_VAR_NOCACHE_NOINIT, symbol=VAR_NOINIT_NOCACHE_ASIL_B_64
        OS_OsCore0_ASIL_SEC_VAR_NOINIT_NOCACHE_ASIL_B_UNSPECIFIED: alignment=UNSPECIFIED, prefix=OS_OsCore0_ASILOsMemMap, sw-addrmethod=OsCore0_ASIL_VAR_NOCACHE_NOINIT, symbol=VAR_NOINIT_NOCACHE_ASIL_B_UNSPECIFIED
        OS_OsCore0_ASIL_SEC_VAR_POWER_ON_INIT_ASIL_B_BOOLEAN: alignment=BOOLEAN, prefix=OS_OsCore0_ASILOsMemMap, sw-addrmethod=OsCore0_ASIL_VAR_POWER_ON_INIT, symbol=VAR_POWER_ON_INIT_ASIL_B_BOOLEAN
        OS_OsCore0_ASIL_SEC_VAR_POWER_ON_INIT_ASIL_B_8: alignment=8, prefix=OS_OsCore0_ASILOsMemMap, sw-addrmethod=OsCore0_ASIL_VAR_POWER_ON_INIT, symbol=VAR_POWER_ON_INIT_ASIL_B_8
        OS_OsCore0_ASIL_SEC_VAR_POWER_ON_INIT_ASIL_B_16: alignment=16, prefix=OS_OsCore0_ASILOsMemMap, sw-addrmethod=OsCore0_ASIL_VAR_POWER_ON_INIT, symbol=VAR_POWER_ON_INIT_ASIL_B_16
        OS_OsCore0_ASIL_SEC_VAR_POWER_ON_INIT_ASIL_B_32: alignment=32, prefix=OS_OsCore0_ASILOsMemMap, sw-addrmethod=OsCore0_ASIL_VAR_POWER_ON_INIT, symbol=VAR_POWER_ON_INIT_ASIL_B_32
        OS_OsCore0_ASIL_SEC_VAR_POWER_ON_INIT_ASIL_B_64: alignment=64, prefix=OS_OsCore0_ASILOsMemMap, sw-addrmethod=OsCore0_ASIL_VAR_POWER_ON_INIT, symbol=VAR_POWER_ON_INIT_ASIL_B_64
        OS_OsCore0_ASIL_SEC_VAR_POWER_ON_INIT_ASIL_B_UNSPECIFIED: alignment=UNSPECIFIED, prefix=OS_OsCore0_ASILOsMemMap, sw-addrmethod=OsCore0_ASIL_VAR_POWER_ON_INIT, symbol=VAR_POWER_ON_INIT_ASIL_B_UNSPECIFIED
        OS_OsCore0_ASIL_SEC_VAR_FAST_POWER_ON_INIT_ASIL_B_BOOLEAN: alignment=BOOLEAN, prefix=OS_OsCore0_ASILOsMemMap, sw-addrmethod=OsCore0_ASIL_VAR_FAST_POWER_ON_INIT, symbol=VAR_FAST_POWER_ON_INIT_ASIL_B_BOOLEAN
        OS_OsCore0_ASIL_SEC_VAR_FAST_POWER_ON_INIT_ASIL_B_8: alignment=8, prefix=OS_OsCore0_ASILOsMemMap, sw-addrmethod=OsCore0_ASIL_VAR_FAST_POWER_ON_INIT, symbol=VAR_FAST_POWER_ON_INIT_ASIL_B_8
        OS_OsCore0_ASIL_SEC_VAR_FAST_POWER_ON_INIT_ASIL_B_16: alignment=16, prefix=OS_OsCore0_ASILOsMemMap, sw-addrmethod=OsCore0_ASIL_VAR_FAST_POWER_ON_INIT, symbol=VAR_FAST_POWER_ON_INIT_ASIL_B_16
        OS_OsCore0_ASIL_SEC_VAR_FAST_POWER_ON_INIT_ASIL_B_32: alignment=32, prefix=OS_OsCore0_ASILOsMemMap, sw-addrmethod=OsCore0_ASIL_VAR_FAST_POWER_ON_INIT, symbol=VAR_FAST_POWER_ON_INIT_ASIL_B_32
        OS_OsCore0_ASIL_SEC_VAR_FAST_POWER_ON_INIT_ASIL_B_64: alignment=64, prefix=OS_OsCore0_ASILOsMemMap, sw-addrmethod=OsCore0_ASIL_VAR_FAST_POWER_ON_INIT, symbol=VAR_FAST_POWER_ON_INIT_ASIL_B_64
        OS_OsCore0_ASIL_SEC_VAR_FAST_POWER_ON_INIT_ASIL_B_UNSPECIFIED: alignment=UNSPECIFIED, prefix=OS_OsCore0_ASILOsMemMap, sw-addrmethod=OsCore0_ASIL_VAR_FAST_POWER_ON_INIT, symbol=VAR_FAST_POWER_ON_INIT_ASIL_B_UNSPECIFIED
        OS_OsCore0_ASIL_SEC_VAR_POWER_ON_INIT_NOCACHE_ASIL_B_BOOLEAN: alignment=BOOLEAN, prefix=OS_OsCore0_ASILOsMemMap, sw-addrmethod=OsCore0_ASIL_VAR_NOCACHE_POWER_ON_INIT, symbol=VAR_POWER_ON_INIT_NOCACHE_ASIL_B_BOOLEAN
        OS_OsCore0_ASIL_SEC_VAR_POWER_ON_INIT_NOCACHE_ASIL_B_8: alignment=8, prefix=OS_OsCore0_ASILOsMemMap, sw-addrmethod=OsCore0_ASIL_VAR_NOCACHE_POWER_ON_INIT, symbol=VAR_POWER_ON_INIT_NOCACHE_ASIL_B_8
        OS_OsCore0_ASIL_SEC_VAR_POWER_ON_INIT_NOCACHE_ASIL_B_16: alignment=16, prefix=OS_OsCore0_ASILOsMemMap, sw-addrmethod=OsCore0_ASIL_VAR_NOCACHE_POWER_ON_INIT, symbol=VAR_POWER_ON_INIT_NOCACHE_ASIL_B_16
        OS_OsCore0_ASIL_SEC_VAR_POWER_ON_INIT_NOCACHE_ASIL_B_32: alignment=32, prefix=OS_OsCore0_ASILOsMemMap, sw-addrmethod=OsCore0_ASIL_VAR_NOCACHE_POWER_ON_INIT, symbol=VAR_POWER_ON_INIT_NOCACHE_ASIL_B_32
        OS_OsCore0_ASIL_SEC_VAR_POWER_ON_INIT_NOCACHE_ASIL_B_64: alignment=64, prefix=OS_OsCore0_ASILOsMemMap, sw-addrmethod=OsCore0_ASIL_VAR_NOCACHE_POWER_ON_INIT, symbol=VAR_POWER_ON_INIT_NOCACHE_ASIL_B_64
        OS_OsCore0_ASIL_SEC_VAR_POWER_ON_INIT_NOCACHE_ASIL_B_UNSPECIFIED: alignment=UNSPECIFIED, prefix=OS_OsCore0_ASILOsMemMap, sw-addrmethod=OsCore0_ASIL_VAR_NOCACHE_POWER_ON_INIT, symbol=VAR_POWER_ON_INIT_NOCACHE_ASIL_B_UNSPECIFIED
        OS_OsCore0_ASIL_SEC_VAR_POWER_ON_CLEARED_ASIL_B_BOOLEAN: alignment=BOOLEAN, prefix=OS_OsCore0_ASILOsMemMap, sw-addrmethod=OsCore0_ASIL_VAR_POWER_ON_CLEARED, symbol=VAR_POWER_ON_CLEARED_ASIL_B_BOOLEAN
        OS_OsCore0_ASIL_SEC_VAR_POWER_ON_CLEARED_ASIL_B_8: alignment=8, prefix=OS_OsCore0_ASILOsMemMap, sw-addrmethod=OsCore0_ASIL_VAR_POWER_ON_CLEARED, symbol=VAR_POWER_ON_CLEARED_ASIL_B_8
        OS_OsCore0_ASIL_SEC_VAR_POWER_ON_CLEARED_ASIL_B_16: alignment=16, prefix=OS_OsCore0_ASILOsMemMap, sw-addrmethod=OsCore0_ASIL_VAR_POWER_ON_CLEARED, symbol=VAR_POWER_ON_CLEARED_ASIL_B_16
        OS_OsCore0_ASIL_SEC_VAR_POWER_ON_CLEARED_ASIL_B_32: alignment=32, prefix=OS_OsCore0_ASILOsMemMap, sw-addrmethod=OsCore0_ASIL_VAR_POWER_ON_CLEARED, symbol=VAR_POWER_ON_CLEARED_ASIL_B_32
        OS_OsCore0_ASIL_SEC_VAR_POWER_ON_CLEARED_ASIL_B_64: alignment=64, prefix=OS_OsCore0_ASILOsMemMap, sw-addrmethod=OsCore0_ASIL_VAR_POWER_ON_CLEARED, symbol=VAR_POWER_ON_CLEARED_ASIL_B_64
        OS_OsCore0_ASIL_SEC_VAR_POWER_ON_CLEARED_ASIL_B_UNSPECIFIED: alignment=UNSPECIFIED, prefix=OS_OsCore0_ASILOsMemMap, sw-addrmethod=OsCore0_ASIL_VAR_POWER_ON_CLEARED, symbol=VAR_POWER_ON_CLEARED_ASIL_B_UNSPECIFIED
        OS_OsCore0_ASIL_SEC_VAR_FAST_POWER_ON_CLEARED_ASIL_B_BOOLEAN: alignment=BOOLEAN, prefix=OS_OsCore0_ASILOsMemMap, sw-addrmethod=OsCore0_ASIL_VAR_FAST_POWER_ON_CLEARED, symbol=VAR_FAST_POWER_ON_CLEARED_ASIL_B_BOOLEAN
        OS_OsCore0_ASIL_SEC_VAR_FAST_POWER_ON_CLEARED_ASIL_B_8: alignment=8, prefix=OS_OsCore0_ASILOsMemMap, sw-addrmethod=OsCore0_ASIL_VAR_FAST_POWER_ON_CLEARED, symbol=VAR_FAST_POWER_ON_CLEARED_ASIL_B_8
        OS_OsCore0_ASIL_SEC_VAR_FAST_POWER_ON_CLEARED_ASIL_B_16: alignment=16, prefix=OS_OsCore0_ASILOsMemMap, sw-addrmethod=OsCore0_ASIL_VAR_FAST_POWER_ON_CLEARED, symbol=VAR_FAST_POWER_ON_CLEARED_ASIL_B_16
        OS_OsCore0_ASIL_SEC_VAR_FAST_POWER_ON_CLEARED_ASIL_B_32: alignment=32, prefix=OS_OsCore0_ASILOsMemMap, sw-addrmethod=OsCore0_ASIL_VAR_FAST_POWER_ON_CLEARED, symbol=VAR_FAST_POWER_ON_CLEARED_ASIL_B_32
        OS_OsCore0_ASIL_SEC_VAR_FAST_POWER_ON_CLEARED_ASIL_B_64: alignment=64, prefix=OS_OsCore0_ASILOsMemMap, sw-addrmethod=OsCore0_ASIL_VAR_FAST_POWER_ON_CLEARED, symbol=VAR_FAST_POWER_ON_CLEARED_ASIL_B_64
        OS_OsCore0_ASIL_SEC_VAR_FAST_POWER_ON_CLEARED_ASIL_B_UNSPECIFIED: alignment=UNSPECIFIED, prefix=OS_OsCore0_ASILOsMemMap, sw-addrmethod=OsCore0_ASIL_VAR_FAST_POWER_ON_CLEARED, symbol=VAR_FAST_POWER_ON_CLEARED_ASIL_B_UNSPECIFIED
        OS_OsCore0_ASIL_SEC_VAR_POWER_ON_CLEARED_NOCACHE_ASIL_B_BOOLEAN: alignment=BOOLEAN, prefix=OS_OsCore0_ASILOsMemMap, sw-addrmethod=OsCore0_ASIL_VAR_NOCACHE_POWER_ON_CLEARED, symbol=VAR_POWER_ON_CLEARED_NOCACHE_ASIL_B_BOOLEAN
        OS_OsCore0_ASIL_SEC_VAR_POWER_ON_CLEARED_NOCACHE_ASIL_B_8: alignment=8, prefix=OS_OsCore0_ASILOsMemMap, sw-addrmethod=OsCore0_ASIL_VAR_NOCACHE_POWER_ON_CLEARED, symbol=VAR_POWER_ON_CLEARED_NOCACHE_ASIL_B_8
        OS_OsCore0_ASIL_SEC_VAR_POWER_ON_CLEARED_NOCACHE_ASIL_B_16: alignment=16, prefix=OS_OsCore0_ASILOsMemMap, sw-addrmethod=OsCore0_ASIL_VAR_NOCACHE_POWER_ON_CLEARED, symbol=VAR_POWER_ON_CLEARED_NOCACHE_ASIL_B_16
        OS_OsCore0_ASIL_SEC_VAR_POWER_ON_CLEARED_NOCACHE_ASIL_B_32: alignment=32, prefix=OS_OsCore0_ASILOsMemMap, sw-addrmethod=OsCore0_ASIL_VAR_NOCACHE_POWER_ON_CLEARED, symbol=VAR_POWER_ON_CLEARED_NOCACHE_ASIL_B_32
        OS_OsCore0_ASIL_SEC_VAR_POWER_ON_CLEARED_NOCACHE_ASIL_B_64: alignment=64, prefix=OS_OsCore0_ASILOsMemMap, sw-addrmethod=OsCore0_ASIL_VAR_NOCACHE_POWER_ON_CLEARED, symbol=VAR_POWER_ON_CLEARED_NOCACHE_ASIL_B_64
        OS_OsCore0_ASIL_SEC_VAR_POWER_ON_CLEARED_NOCACHE_ASIL_B_UNSPECIFIED: alignment=UNSPECIFIED, prefix=OS_OsCore0_ASILOsMemMap, sw-addrmethod=OsCore0_ASIL_VAR_NOCACHE_POWER_ON_CLEARED, symbol=VAR_POWER_ON_CLEARED_NOCACHE_ASIL_B_UNSPECIFIED
        OS_OsCore_Qm_SEC_CONST_QM_BOOLEAN: alignment=BOOLEAN, prefix=OS_OsCore_QmOsMemMap, sw-addrmethod=OsCore_Qm_CONST, symbol=CONST_QM_BOOLEAN
        OS_OsCore_Qm_SEC_CONST_QM_8: alignment=8, prefix=OS_OsCore_QmOsMemMap, sw-addrmethod=OsCore_Qm_CONST, symbol=CONST_QM_8
        OS_OsCore_Qm_SEC_CONST_QM_16: alignment=16, prefix=OS_OsCore_QmOsMemMap, sw-addrmethod=OsCore_Qm_CONST, symbol=CONST_QM_16
        OS_OsCore_Qm_SEC_CONST_QM_32: alignment=32, prefix=OS_OsCore_QmOsMemMap, sw-addrmethod=OsCore_Qm_CONST, symbol=CONST_QM_32
        OS_OsCore_Qm_SEC_CONST_QM_64: alignment=64, prefix=OS_OsCore_QmOsMemMap, sw-addrmethod=OsCore_Qm_CONST, symbol=CONST_QM_64
        OS_OsCore_Qm_SEC_CONST_QM_UNSPECIFIED: alignment=UNSPECIFIED, prefix=OS_OsCore_QmOsMemMap, sw-addrmethod=OsCore_Qm_CONST, symbol=CONST_QM_UNSPECIFIED
        OS_OsCore_Qm_SEC_VAR_INIT_QM_BOOLEAN: alignment=BOOLEAN, prefix=OS_OsCore_QmOsMemMap, sw-addrmethod=OsCore_Qm_VAR_INIT, symbol=VAR_INIT_QM_BOOLEAN
        OS_OsCore_Qm_SEC_VAR_INIT_QM_8: alignment=8, prefix=OS_OsCore_QmOsMemMap, sw-addrmethod=OsCore_Qm_VAR_INIT, symbol=VAR_INIT_QM_8
        OS_OsCore_Qm_SEC_VAR_INIT_QM_16: alignment=16, prefix=OS_OsCore_QmOsMemMap, sw-addrmethod=OsCore_Qm_VAR_INIT, symbol=VAR_INIT_QM_16
        OS_OsCore_Qm_SEC_VAR_INIT_QM_32: alignment=32, prefix=OS_OsCore_QmOsMemMap, sw-addrmethod=OsCore_Qm_VAR_INIT, symbol=VAR_INIT_QM_32
        OS_OsCore_Qm_SEC_VAR_INIT_QM_64: alignment=64, prefix=OS_OsCore_QmOsMemMap, sw-addrmethod=OsCore_Qm_VAR_INIT, symbol=VAR_INIT_QM_64
        OS_OsCore_Qm_SEC_VAR_INIT_QM_UNSPECIFIED: alignment=UNSPECIFIED, prefix=OS_OsCore_QmOsMemMap, sw-addrmethod=OsCore_Qm_VAR_INIT, symbol=VAR_INIT_QM_UNSPECIFIED
        OS_OsCore_Qm_SEC_VAR_FAST_INIT_QM_BOOLEAN: alignment=BOOLEAN, prefix=OS_OsCore_QmOsMemMap, sw-addrmethod=OsCore_Qm_VAR_FAST_INIT, symbol=VAR_FAST_INIT_QM_BOOLEAN
        OS_OsCore_Qm_SEC_VAR_FAST_INIT_QM_8: alignment=8, prefix=OS_OsCore_QmOsMemMap, sw-addrmethod=OsCore_Qm_VAR_FAST_INIT, symbol=VAR_FAST_INIT_QM_8
        OS_OsCore_Qm_SEC_VAR_FAST_INIT_QM_16: alignment=16, prefix=OS_OsCore_QmOsMemMap, sw-addrmethod=OsCore_Qm_VAR_FAST_INIT, symbol=VAR_FAST_INIT_QM_16
        OS_OsCore_Qm_SEC_VAR_FAST_INIT_QM_32: alignment=32, prefix=OS_OsCore_QmOsMemMap, sw-addrmethod=OsCore_Qm_VAR_FAST_INIT, symbol=VAR_FAST_INIT_QM_32
        OS_OsCore_Qm_SEC_VAR_FAST_INIT_QM_64: alignment=64, prefix=OS_OsCore_QmOsMemMap, sw-addrmethod=OsCore_Qm_VAR_FAST_INIT, symbol=VAR_FAST_INIT_QM_64
        OS_OsCore_Qm_SEC_VAR_FAST_INIT_QM_UNSPECIFIED: alignment=UNSPECIFIED, prefix=OS_OsCore_QmOsMemMap, sw-addrmethod=OsCore_Qm_VAR_FAST_INIT, symbol=VAR_FAST_INIT_QM_UNSPECIFIED
        OS_OsCore_Qm_SEC_VAR_INIT_NOCACHE_QM_BOOLEAN: alignment=BOOLEAN, prefix=OS_OsCore_QmOsMemMap, sw-addrmethod=OsCore_Qm_VAR_NOCACHE_INIT, symbol=VAR_INIT_NOCACHE_QM_BOOLEAN
        OS_OsCore_Qm_SEC_VAR_INIT_NOCACHE_QM_8: alignment=8, prefix=OS_OsCore_QmOsMemMap, sw-addrmethod=OsCore_Qm_VAR_NOCACHE_INIT, symbol=VAR_INIT_NOCACHE_QM_8
        OS_OsCore_Qm_SEC_VAR_INIT_NOCACHE_QM_16: alignment=16, prefix=OS_OsCore_QmOsMemMap, sw-addrmethod=OsCore_Qm_VAR_NOCACHE_INIT, symbol=VAR_INIT_NOCACHE_QM_16
        OS_OsCore_Qm_SEC_VAR_INIT_NOCACHE_QM_32: alignment=32, prefix=OS_OsCore_QmOsMemMap, sw-addrmethod=OsCore_Qm_VAR_NOCACHE_INIT, symbol=VAR_INIT_NOCACHE_QM_32
        OS_OsCore_Qm_SEC_VAR_INIT_NOCACHE_QM_64: alignment=64, prefix=OS_OsCore_QmOsMemMap, sw-addrmethod=OsCore_Qm_VAR_NOCACHE_INIT, symbol=VAR_INIT_NOCACHE_QM_64
        OS_OsCore_Qm_SEC_VAR_INIT_NOCACHE_QM_UNSPECIFIED: alignment=UNSPECIFIED, prefix=OS_OsCore_QmOsMemMap, sw-addrmethod=OsCore_Qm_VAR_NOCACHE_INIT, symbol=VAR_INIT_NOCACHE_QM_UNSPECIFIED
        OS_OsCore_Qm_SEC_VAR_CLEARED_QM_BOOLEAN: alignment=BOOLEAN, prefix=OS_OsCore_QmOsMemMap, sw-addrmethod=OsCore_Qm_VAR_CLEARED, symbol=VAR_CLEARED_QM_BOOLEAN
        OS_OsCore_Qm_SEC_VAR_CLEARED_QM_8: alignment=8, prefix=OS_OsCore_QmOsMemMap, sw-addrmethod=OsCore_Qm_VAR_CLEARED, symbol=VAR_CLEARED_QM_8
        OS_OsCore_Qm_SEC_VAR_CLEARED_QM_16: alignment=16, prefix=OS_OsCore_QmOsMemMap, sw-addrmethod=OsCore_Qm_VAR_CLEARED, symbol=VAR_CLEARED_QM_16
        OS_OsCore_Qm_SEC_VAR_CLEARED_QM_32: alignment=32, prefix=OS_OsCore_QmOsMemMap, sw-addrmethod=OsCore_Qm_VAR_CLEARED, symbol=VAR_CLEARED_QM_32
        OS_OsCore_Qm_SEC_VAR_CLEARED_QM_64: alignment=64, prefix=OS_OsCore_QmOsMemMap, sw-addrmethod=OsCore_Qm_VAR_CLEARED, symbol=VAR_CLEARED_QM_64
        OS_OsCore_Qm_SEC_VAR_CLEARED_QM_UNSPECIFIED: alignment=UNSPECIFIED, prefix=OS_OsCore_QmOsMemMap, sw-addrmethod=OsCore_Qm_VAR_CLEARED, symbol=VAR_CLEARED_QM_UNSPECIFIED
        OS_OsCore_Qm_SEC_VAR_FAST_CLEARED_QM_BOOLEAN: alignment=BOOLEAN, prefix=OS_OsCore_QmOsMemMap, sw-addrmethod=OsCore_Qm_VAR_FAST_CLEARED, symbol=VAR_FAST_CLEARED_QM_BOOLEAN
        OS_OsCore_Qm_SEC_VAR_FAST_CLEARED_QM_8: alignment=8, prefix=OS_OsCore_QmOsMemMap, sw-addrmethod=OsCore_Qm_VAR_FAST_CLEARED, symbol=VAR_FAST_CLEARED_QM_8
        OS_OsCore_Qm_SEC_VAR_FAST_CLEARED_QM_16: alignment=16, prefix=OS_OsCore_QmOsMemMap, sw-addrmethod=OsCore_Qm_VAR_FAST_CLEARED, symbol=VAR_FAST_CLEARED_QM_16
        OS_OsCore_Qm_SEC_VAR_FAST_CLEARED_QM_32: alignment=32, prefix=OS_OsCore_QmOsMemMap, sw-addrmethod=OsCore_Qm_VAR_FAST_CLEARED, symbol=VAR_FAST_CLEARED_QM_32
        OS_OsCore_Qm_SEC_VAR_FAST_CLEARED_QM_64: alignment=64, prefix=OS_OsCore_QmOsMemMap, sw-addrmethod=OsCore_Qm_VAR_FAST_CLEARED, symbol=VAR_FAST_CLEARED_QM_64
        OS_OsCore_Qm_SEC_VAR_FAST_CLEARED_QM_UNSPECIFIED: alignment=UNSPECIFIED, prefix=OS_OsCore_QmOsMemMap, sw-addrmethod=OsCore_Qm_VAR_FAST_CLEARED, symbol=VAR_FAST_CLEARED_QM_UNSPECIFIED
        OS_OsCore_Qm_SEC_VAR_CLEARED_NOCACHE_QM_BOOLEAN: alignment=BOOLEAN, prefix=OS_OsCore_QmOsMemMap, sw-addrmethod=OsCore_Qm_VAR_NOCACHE_CLEARED, symbol=VAR_CLEARED_NOCACHE_QM_BOOLEAN
        OS_OsCore_Qm_SEC_VAR_CLEARED_NOCACHE_QM_8: alignment=8, prefix=OS_OsCore_QmOsMemMap, sw-addrmethod=OsCore_Qm_VAR_NOCACHE_CLEARED, symbol=VAR_CLEARED_NOCACHE_QM_8
        OS_OsCore_Qm_SEC_VAR_CLEARED_NOCACHE_QM_16: alignment=16, prefix=OS_OsCore_QmOsMemMap, sw-addrmethod=OsCore_Qm_VAR_NOCACHE_CLEARED, symbol=VAR_CLEARED_NOCACHE_QM_16
        OS_OsCore_Qm_SEC_VAR_CLEARED_NOCACHE_QM_32: alignment=32, prefix=OS_OsCore_QmOsMemMap, sw-addrmethod=OsCore_Qm_VAR_NOCACHE_CLEARED, symbol=VAR_CLEARED_NOCACHE_QM_32
        OS_OsCore_Qm_SEC_VAR_CLEARED_NOCACHE_QM_64: alignment=64, prefix=OS_OsCore_QmOsMemMap, sw-addrmethod=OsCore_Qm_VAR_NOCACHE_CLEARED, symbol=VAR_CLEARED_NOCACHE_QM_64
        OS_OsCore_Qm_SEC_VAR_CLEARED_NOCACHE_QM_UNSPECIFIED: alignment=UNSPECIFIED, prefix=OS_OsCore_QmOsMemMap, sw-addrmethod=OsCore_Qm_VAR_NOCACHE_CLEARED, symbol=VAR_CLEARED_NOCACHE_QM_UNSPECIFIED
        OS_OsCore_Qm_SEC_VAR_NOINIT_QM_BOOLEAN: alignment=BOOLEAN, prefix=OS_OsCore_QmOsMemMap, sw-addrmethod=OsCore_Qm_VAR_NOINIT, symbol=VAR_NOINIT_QM_BOOLEAN
        OS_OsCore_Qm_SEC_VAR_NOINIT_QM_8: alignment=8, prefix=OS_OsCore_QmOsMemMap, sw-addrmethod=OsCore_Qm_VAR_NOINIT, symbol=VAR_NOINIT_QM_8
        OS_OsCore_Qm_SEC_VAR_NOINIT_QM_16: alignment=16, prefix=OS_OsCore_QmOsMemMap, sw-addrmethod=OsCore_Qm_VAR_NOINIT, symbol=VAR_NOINIT_QM_16
        OS_OsCore_Qm_SEC_VAR_NOINIT_QM_32: alignment=32, prefix=OS_OsCore_QmOsMemMap, sw-addrmethod=OsCore_Qm_VAR_NOINIT, symbol=VAR_NOINIT_QM_32
        OS_OsCore_Qm_SEC_VAR_NOINIT_QM_64: alignment=64, prefix=OS_OsCore_QmOsMemMap, sw-addrmethod=OsCore_Qm_VAR_NOINIT, symbol=VAR_NOINIT_QM_64
        OS_OsCore_Qm_SEC_VAR_NOINIT_QM_UNSPECIFIED: alignment=UNSPECIFIED, prefix=OS_OsCore_QmOsMemMap, sw-addrmethod=OsCore_Qm_VAR_NOINIT, symbol=VAR_NOINIT_QM_UNSPECIFIED
        OS_OsCore_Qm_SEC_VAR_FAST_NOINIT_QM_BOOLEAN: alignment=BOOLEAN, prefix=OS_OsCore_QmOsMemMap, sw-addrmethod=OsCore_Qm_VAR_FAST_NOINIT, symbol=VAR_FAST_NOINIT_QM_BOOLEAN
        OS_OsCore_Qm_SEC_VAR_FAST_NOINIT_QM_8: alignment=8, prefix=OS_OsCore_QmOsMemMap, sw-addrmethod=OsCore_Qm_VAR_FAST_NOINIT, symbol=VAR_FAST_NOINIT_QM_8
        OS_OsCore_Qm_SEC_VAR_FAST_NOINIT_QM_16: alignment=16, prefix=OS_OsCore_QmOsMemMap, sw-addrmethod=OsCore_Qm_VAR_FAST_NOINIT, symbol=VAR_FAST_NOINIT_QM_16
        OS_OsCore_Qm_SEC_VAR_FAST_NOINIT_QM_32: alignment=32, prefix=OS_OsCore_QmOsMemMap, sw-addrmethod=OsCore_Qm_VAR_FAST_NOINIT, symbol=VAR_FAST_NOINIT_QM_32
        OS_OsCore_Qm_SEC_VAR_FAST_NOINIT_QM_64: alignment=64, prefix=OS_OsCore_QmOsMemMap, sw-addrmethod=OsCore_Qm_VAR_FAST_NOINIT, symbol=VAR_FAST_NOINIT_QM_64
        OS_OsCore_Qm_SEC_VAR_FAST_NOINIT_QM_UNSPECIFIED: alignment=UNSPECIFIED, prefix=OS_OsCore_QmOsMemMap, sw-addrmethod=OsCore_Qm_VAR_FAST_NOINIT, symbol=VAR_FAST_NOINIT_QM_UNSPECIFIED
        OS_OsCore_Qm_SEC_VAR_NOINIT_NOCACHE_QM_BOOLEAN: alignment=BOOLEAN, prefix=OS_OsCore_QmOsMemMap, sw-addrmethod=OsCore_Qm_VAR_NOCACHE_NOINIT, symbol=VAR_NOINIT_NOCACHE_QM_BOOLEAN
        OS_OsCore_Qm_SEC_VAR_NOINIT_NOCACHE_QM_8: alignment=8, prefix=OS_OsCore_QmOsMemMap, sw-addrmethod=OsCore_Qm_VAR_NOCACHE_NOINIT, symbol=VAR_NOINIT_NOCACHE_QM_8
        OS_OsCore_Qm_SEC_VAR_NOINIT_NOCACHE_QM_16: alignment=16, prefix=OS_OsCore_QmOsMemMap, sw-addrmethod=OsCore_Qm_VAR_NOCACHE_NOINIT, symbol=VAR_NOINIT_NOCACHE_QM_16
        OS_OsCore_Qm_SEC_VAR_NOINIT_NOCACHE_QM_32: alignment=32, prefix=OS_OsCore_QmOsMemMap, sw-addrmethod=OsCore_Qm_VAR_NOCACHE_NOINIT, symbol=VAR_NOINIT_NOCACHE_QM_32
        OS_OsCore_Qm_SEC_VAR_NOINIT_NOCACHE_QM_64: alignment=64, prefix=OS_OsCore_QmOsMemMap, sw-addrmethod=OsCore_Qm_VAR_NOCACHE_NOINIT, symbol=VAR_NOINIT_NOCACHE_QM_64
        OS_OsCore_Qm_SEC_VAR_NOINIT_NOCACHE_QM_UNSPECIFIED: alignment=UNSPECIFIED, prefix=OS_OsCore_QmOsMemMap, sw-addrmethod=OsCore_Qm_VAR_NOCACHE_NOINIT, symbol=VAR_NOINIT_NOCACHE_QM_UNSPECIFIED
        OS_OsCore_Qm_SEC_VAR_POWER_ON_INIT_QM_BOOLEAN: alignment=BOOLEAN, prefix=OS_OsCore_QmOsMemMap, sw-addrmethod=OsCore_Qm_VAR_POWER_ON_INIT, symbol=VAR_POWER_ON_INIT_QM_BOOLEAN
        OS_OsCore_Qm_SEC_VAR_POWER_ON_INIT_QM_8: alignment=8, prefix=OS_OsCore_QmOsMemMap, sw-addrmethod=OsCore_Qm_VAR_POWER_ON_INIT, symbol=VAR_POWER_ON_INIT_QM_8
        OS_OsCore_Qm_SEC_VAR_POWER_ON_INIT_QM_16: alignment=16, prefix=OS_OsCore_QmOsMemMap, sw-addrmethod=OsCore_Qm_VAR_POWER_ON_INIT, symbol=VAR_POWER_ON_INIT_QM_16
        OS_OsCore_Qm_SEC_VAR_POWER_ON_INIT_QM_32: alignment=32, prefix=OS_OsCore_QmOsMemMap, sw-addrmethod=OsCore_Qm_VAR_POWER_ON_INIT, symbol=VAR_POWER_ON_INIT_QM_32
        OS_OsCore_Qm_SEC_VAR_POWER_ON_INIT_QM_64: alignment=64, prefix=OS_OsCore_QmOsMemMap, sw-addrmethod=OsCore_Qm_VAR_POWER_ON_INIT, symbol=VAR_POWER_ON_INIT_QM_64
        OS_OsCore_Qm_SEC_VAR_POWER_ON_INIT_QM_UNSPECIFIED: alignment=UNSPECIFIED, prefix=OS_OsCore_QmOsMemMap, sw-addrmethod=OsCore_Qm_VAR_POWER_ON_INIT, symbol=VAR_POWER_ON_INIT_QM_UNSPECIFIED
        OS_OsCore_Qm_SEC_VAR_FAST_POWER_ON_INIT_QM_BOOLEAN: alignment=BOOLEAN, prefix=OS_OsCore_QmOsMemMap, sw-addrmethod=OsCore_Qm_VAR_FAST_POWER_ON_INIT, symbol=VAR_FAST_POWER_ON_INIT_QM_BOOLEAN
        OS_OsCore_Qm_SEC_VAR_FAST_POWER_ON_INIT_QM_8: alignment=8, prefix=OS_OsCore_QmOsMemMap, sw-addrmethod=OsCore_Qm_VAR_FAST_POWER_ON_INIT, symbol=VAR_FAST_POWER_ON_INIT_QM_8
        OS_OsCore_Qm_SEC_VAR_FAST_POWER_ON_INIT_QM_16: alignment=16, prefix=OS_OsCore_QmOsMemMap, sw-addrmethod=OsCore_Qm_VAR_FAST_POWER_ON_INIT, symbol=VAR_FAST_POWER_ON_INIT_QM_16
        OS_OsCore_Qm_SEC_VAR_FAST_POWER_ON_INIT_QM_32: alignment=32, prefix=OS_OsCore_QmOsMemMap, sw-addrmethod=OsCore_Qm_VAR_FAST_POWER_ON_INIT, symbol=VAR_FAST_POWER_ON_INIT_QM_32
        OS_OsCore_Qm_SEC_VAR_FAST_POWER_ON_INIT_QM_64: alignment=64, prefix=OS_OsCore_QmOsMemMap, sw-addrmethod=OsCore_Qm_VAR_FAST_POWER_ON_INIT, symbol=VAR_FAST_POWER_ON_INIT_QM_64
        OS_OsCore_Qm_SEC_VAR_FAST_POWER_ON_INIT_QM_UNSPECIFIED: alignment=UNSPECIFIED, prefix=OS_OsCore_QmOsMemMap, sw-addrmethod=OsCore_Qm_VAR_FAST_POWER_ON_INIT, symbol=VAR_FAST_POWER_ON_INIT_QM_UNSPECIFIED
        OS_OsCore_Qm_SEC_VAR_POWER_ON_INIT_NOCACHE_QM_BOOLEAN: alignment=BOOLEAN, prefix=OS_OsCore_QmOsMemMap, sw-addrmethod=OsCore_Qm_VAR_NOCACHE_POWER_ON_INIT, symbol=VAR_POWER_ON_INIT_NOCACHE_QM_BOOLEAN
        OS_OsCore_Qm_SEC_VAR_POWER_ON_INIT_NOCACHE_QM_8: alignment=8, prefix=OS_OsCore_QmOsMemMap, sw-addrmethod=OsCore_Qm_VAR_NOCACHE_POWER_ON_INIT, symbol=VAR_POWER_ON_INIT_NOCACHE_QM_8
        OS_OsCore_Qm_SEC_VAR_POWER_ON_INIT_NOCACHE_QM_16: alignment=16, prefix=OS_OsCore_QmOsMemMap, sw-addrmethod=OsCore_Qm_VAR_NOCACHE_POWER_ON_INIT, symbol=VAR_POWER_ON_INIT_NOCACHE_QM_16
        OS_OsCore_Qm_SEC_VAR_POWER_ON_INIT_NOCACHE_QM_32: alignment=32, prefix=OS_OsCore_QmOsMemMap, sw-addrmethod=OsCore_Qm_VAR_NOCACHE_POWER_ON_INIT, symbol=VAR_POWER_ON_INIT_NOCACHE_QM_32
        OS_OsCore_Qm_SEC_VAR_POWER_ON_INIT_NOCACHE_QM_64: alignment=64, prefix=OS_OsCore_QmOsMemMap, sw-addrmethod=OsCore_Qm_VAR_NOCACHE_POWER_ON_INIT, symbol=VAR_POWER_ON_INIT_NOCACHE_QM_64
        OS_OsCore_Qm_SEC_VAR_POWER_ON_INIT_NOCACHE_QM_UNSPECIFIED: alignment=UNSPECIFIED, prefix=OS_OsCore_QmOsMemMap, sw-addrmethod=OsCore_Qm_VAR_NOCACHE_POWER_ON_INIT, symbol=VAR_POWER_ON_INIT_NOCACHE_QM_UNSPECIFIED
        OS_OsCore_Qm_SEC_VAR_POWER_ON_CLEARED_QM_BOOLEAN: alignment=BOOLEAN, prefix=OS_OsCore_QmOsMemMap, sw-addrmethod=OsCore_Qm_VAR_POWER_ON_CLEARED, symbol=VAR_POWER_ON_CLEARED_QM_BOOLEAN
        OS_OsCore_Qm_SEC_VAR_POWER_ON_CLEARED_QM_8: alignment=8, prefix=OS_OsCore_QmOsMemMap, sw-addrmethod=OsCore_Qm_VAR_POWER_ON_CLEARED, symbol=VAR_POWER_ON_CLEARED_QM_8
        OS_OsCore_Qm_SEC_VAR_POWER_ON_CLEARED_QM_16: alignment=16, prefix=OS_OsCore_QmOsMemMap, sw-addrmethod=OsCore_Qm_VAR_POWER_ON_CLEARED, symbol=VAR_POWER_ON_CLEARED_QM_16
        OS_OsCore_Qm_SEC_VAR_POWER_ON_CLEARED_QM_32: alignment=32, prefix=OS_OsCore_QmOsMemMap, sw-addrmethod=OsCore_Qm_VAR_POWER_ON_CLEARED, symbol=VAR_POWER_ON_CLEARED_QM_32
        OS_OsCore_Qm_SEC_VAR_POWER_ON_CLEARED_QM_64: alignment=64, prefix=OS_OsCore_QmOsMemMap, sw-addrmethod=OsCore_Qm_VAR_POWER_ON_CLEARED, symbol=VAR_POWER_ON_CLEARED_QM_64
        OS_OsCore_Qm_SEC_VAR_POWER_ON_CLEARED_QM_UNSPECIFIED: alignment=UNSPECIFIED, prefix=OS_OsCore_QmOsMemMap, sw-addrmethod=OsCore_Qm_VAR_POWER_ON_CLEARED, symbol=VAR_POWER_ON_CLEARED_QM_UNSPECIFIED
        OS_OsCore_Qm_SEC_VAR_FAST_POWER_ON_CLEARED_QM_BOOLEAN: alignment=BOOLEAN, prefix=OS_OsCore_QmOsMemMap, sw-addrmethod=OsCore_Qm_VAR_FAST_POWER_ON_CLEARED, symbol=VAR_FAST_POWER_ON_CLEARED_QM_BOOLEAN
        OS_OsCore_Qm_SEC_VAR_FAST_POWER_ON_CLEARED_QM_8: alignment=8, prefix=OS_OsCore_QmOsMemMap, sw-addrmethod=OsCore_Qm_VAR_FAST_POWER_ON_CLEARED, symbol=VAR_FAST_POWER_ON_CLEARED_QM_8
        OS_OsCore_Qm_SEC_VAR_FAST_POWER_ON_CLEARED_QM_16: alignment=16, prefix=OS_OsCore_QmOsMemMap, sw-addrmethod=OsCore_Qm_VAR_FAST_POWER_ON_CLEARED, symbol=VAR_FAST_POWER_ON_CLEARED_QM_16
        OS_OsCore_Qm_SEC_VAR_FAST_POWER_ON_CLEARED_QM_32: alignment=32, prefix=OS_OsCore_QmOsMemMap, sw-addrmethod=OsCore_Qm_VAR_FAST_POWER_ON_CLEARED, symbol=VAR_FAST_POWER_ON_CLEARED_QM_32
        OS_OsCore_Qm_SEC_VAR_FAST_POWER_ON_CLEARED_QM_64: alignment=64, prefix=OS_OsCore_QmOsMemMap, sw-addrmethod=OsCore_Qm_VAR_FAST_POWER_ON_CLEARED, symbol=VAR_FAST_POWER_ON_CLEARED_QM_64
        OS_OsCore_Qm_SEC_VAR_FAST_POWER_ON_CLEARED_QM_UNSPECIFIED: alignment=UNSPECIFIED, prefix=OS_OsCore_QmOsMemMap, sw-addrmethod=OsCore_Qm_VAR_FAST_POWER_ON_CLEARED, symbol=VAR_FAST_POWER_ON_CLEARED_QM_UNSPECIFIED
        OS_OsCore_Qm_SEC_VAR_POWER_ON_CLEARED_NOCACHE_QM_BOOLEAN: alignment=BOOLEAN, prefix=OS_OsCore_QmOsMemMap, sw-addrmethod=OsCore_Qm_VAR_NOCACHE_POWER_ON_CLEARED, symbol=VAR_POWER_ON_CLEARED_NOCACHE_QM_BOOLEAN
        OS_OsCore_Qm_SEC_VAR_POWER_ON_CLEARED_NOCACHE_QM_8: alignment=8, prefix=OS_OsCore_QmOsMemMap, sw-addrmethod=OsCore_Qm_VAR_NOCACHE_POWER_ON_CLEARED, symbol=VAR_POWER_ON_CLEARED_NOCACHE_QM_8
        OS_OsCore_Qm_SEC_VAR_POWER_ON_CLEARED_NOCACHE_QM_16: alignment=16, prefix=OS_OsCore_QmOsMemMap, sw-addrmethod=OsCore_Qm_VAR_NOCACHE_POWER_ON_CLEARED, symbol=VAR_POWER_ON_CLEARED_NOCACHE_QM_16
        OS_OsCore_Qm_SEC_VAR_POWER_ON_CLEARED_NOCACHE_QM_32: alignment=32, prefix=OS_OsCore_QmOsMemMap, sw-addrmethod=OsCore_Qm_VAR_NOCACHE_POWER_ON_CLEARED, symbol=VAR_POWER_ON_CLEARED_NOCACHE_QM_32
        OS_OsCore_Qm_SEC_VAR_POWER_ON_CLEARED_NOCACHE_QM_64: alignment=64, prefix=OS_OsCore_QmOsMemMap, sw-addrmethod=OsCore_Qm_VAR_NOCACHE_POWER_ON_CLEARED, symbol=VAR_POWER_ON_CLEARED_NOCACHE_QM_64
        OS_OsCore_Qm_SEC_VAR_POWER_ON_CLEARED_NOCACHE_QM_UNSPECIFIED: alignment=UNSPECIFIED, prefix=OS_OsCore_QmOsMemMap, sw-addrmethod=OsCore_Qm_VAR_NOCACHE_POWER_ON_CLEARED, symbol=VAR_POWER_ON_CLEARED_NOCACHE_QM_UNSPECIFIED
        OS_GLOBALSHARED_SEC_CONST_QM_BOOLEAN: alignment=BOOLEAN, prefix=OS_GLOBALSHAREDOsMemMap, sw-addrmethod=GLOBALSHARED_CONST, symbol=CONST_QM_BOOLEAN
        OS_GLOBALSHARED_SEC_CONST_QM_8: alignment=8, prefix=OS_GLOBALSHAREDOsMemMap, sw-addrmethod=GLOBALSHARED_CONST, symbol=CONST_QM_8
        OS_GLOBALSHARED_SEC_CONST_QM_16: alignment=16, prefix=OS_GLOBALSHAREDOsMemMap, sw-addrmethod=GLOBALSHARED_CONST, symbol=CONST_QM_16
        OS_GLOBALSHARED_SEC_CONST_QM_32: alignment=32, prefix=OS_GLOBALSHAREDOsMemMap, sw-addrmethod=GLOBALSHARED_CONST, symbol=CONST_QM_32
        OS_GLOBALSHARED_SEC_CONST_QM_64: alignment=64, prefix=OS_GLOBALSHAREDOsMemMap, sw-addrmethod=GLOBALSHARED_CONST, symbol=CONST_QM_64
        OS_GLOBALSHARED_SEC_CONST_QM_UNSPECIFIED: alignment=UNSPECIFIED, prefix=OS_GLOBALSHAREDOsMemMap, sw-addrmethod=GLOBALSHARED_CONST, symbol=CONST_QM_UNSPECIFIED
        OS_GLOBALSHARED_SEC_VAR_INIT_QM_BOOLEAN: alignment=BOOLEAN, prefix=OS_GLOBALSHAREDOsMemMap, sw-addrmethod=GLOBALSHARED_VAR_INIT, symbol=VAR_INIT_QM_BOOLEAN
        OS_GLOBALSHARED_SEC_VAR_INIT_QM_8: alignment=8, prefix=OS_GLOBALSHAREDOsMemMap, sw-addrmethod=GLOBALSHARED_VAR_INIT, symbol=VAR_INIT_QM_8
        OS_GLOBALSHARED_SEC_VAR_INIT_QM_16: alignment=16, prefix=OS_GLOBALSHAREDOsMemMap, sw-addrmethod=GLOBALSHARED_VAR_INIT, symbol=VAR_INIT_QM_16
        OS_GLOBALSHARED_SEC_VAR_INIT_QM_32: alignment=32, prefix=OS_GLOBALSHAREDOsMemMap, sw-addrmethod=GLOBALSHARED_VAR_INIT, symbol=VAR_INIT_QM_32
        OS_GLOBALSHARED_SEC_VAR_INIT_QM_64: alignment=64, prefix=OS_GLOBALSHAREDOsMemMap, sw-addrmethod=GLOBALSHARED_VAR_INIT, symbol=VAR_INIT_QM_64
        OS_GLOBALSHARED_SEC_VAR_INIT_QM_UNSPECIFIED: alignment=UNSPECIFIED, prefix=OS_GLOBALSHAREDOsMemMap, sw-addrmethod=GLOBALSHARED_VAR_INIT, symbol=VAR_INIT_QM_UNSPECIFIED
        OS_GLOBALSHARED_SEC_VAR_FAST_INIT_QM_BOOLEAN: alignment=BOOLEAN, prefix=OS_GLOBALSHAREDOsMemMap, sw-addrmethod=GLOBALSHARED_VAR_FAST_INIT, symbol=VAR_FAST_INIT_QM_BOOLEAN
        OS_GLOBALSHARED_SEC_VAR_FAST_INIT_QM_8: alignment=8, prefix=OS_GLOBALSHAREDOsMemMap, sw-addrmethod=GLOBALSHARED_VAR_FAST_INIT, symbol=VAR_FAST_INIT_QM_8
        OS_GLOBALSHARED_SEC_VAR_FAST_INIT_QM_16: alignment=16, prefix=OS_GLOBALSHAREDOsMemMap, sw-addrmethod=GLOBALSHARED_VAR_FAST_INIT, symbol=VAR_FAST_INIT_QM_16
        OS_GLOBALSHARED_SEC_VAR_FAST_INIT_QM_32: alignment=32, prefix=OS_GLOBALSHAREDOsMemMap, sw-addrmethod=GLOBALSHARED_VAR_FAST_INIT, symbol=VAR_FAST_INIT_QM_32
        OS_GLOBALSHARED_SEC_VAR_FAST_INIT_QM_64: alignment=64, prefix=OS_GLOBALSHAREDOsMemMap, sw-addrmethod=GLOBALSHARED_VAR_FAST_INIT, symbol=VAR_FAST_INIT_QM_64
        OS_GLOBALSHARED_SEC_VAR_FAST_INIT_QM_UNSPECIFIED: alignment=UNSPECIFIED, prefix=OS_GLOBALSHAREDOsMemMap, sw-addrmethod=GLOBALSHARED_VAR_FAST_INIT, symbol=VAR_FAST_INIT_QM_UNSPECIFIED
        OS_GLOBALSHARED_SEC_VAR_INIT_NOCACHE_QM_BOOLEAN: alignment=BOOLEAN, prefix=OS_GLOBALSHAREDOsMemMap, sw-addrmethod=GLOBALSHARED_VAR_NOCACHE_INIT, symbol=VAR_INIT_NOCACHE_QM_BOOLEAN
        OS_GLOBALSHARED_SEC_VAR_INIT_NOCACHE_QM_8: alignment=8, prefix=OS_GLOBALSHAREDOsMemMap, sw-addrmethod=GLOBALSHARED_VAR_NOCACHE_INIT, symbol=VAR_INIT_NOCACHE_QM_8
        OS_GLOBALSHARED_SEC_VAR_INIT_NOCACHE_QM_16: alignment=16, prefix=OS_GLOBALSHAREDOsMemMap, sw-addrmethod=GLOBALSHARED_VAR_NOCACHE_INIT, symbol=VAR_INIT_NOCACHE_QM_16
        OS_GLOBALSHARED_SEC_VAR_INIT_NOCACHE_QM_32: alignment=32, prefix=OS_GLOBALSHAREDOsMemMap, sw-addrmethod=GLOBALSHARED_VAR_NOCACHE_INIT, symbol=VAR_INIT_NOCACHE_QM_32
        OS_GLOBALSHARED_SEC_VAR_INIT_NOCACHE_QM_64: alignment=64, prefix=OS_GLOBALSHAREDOsMemMap, sw-addrmethod=GLOBALSHARED_VAR_NOCACHE_INIT, symbol=VAR_INIT_NOCACHE_QM_64
        OS_GLOBALSHARED_SEC_VAR_INIT_NOCACHE_QM_UNSPECIFIED: alignment=UNSPECIFIED, prefix=OS_GLOBALSHAREDOsMemMap, sw-addrmethod=GLOBALSHARED_VAR_NOCACHE_INIT, symbol=VAR_INIT_NOCACHE_QM_UNSPECIFIED
        OS_GLOBALSHARED_SEC_VAR_CLEARED_QM_BOOLEAN: alignment=BOOLEAN, prefix=OS_GLOBALSHAREDOsMemMap, sw-addrmethod=GLOBALSHARED_VAR_CLEARED, symbol=VAR_CLEARED_QM_BOOLEAN
        OS_GLOBALSHARED_SEC_VAR_CLEARED_QM_8: alignment=8, prefix=OS_GLOBALSHAREDOsMemMap, sw-addrmethod=GLOBALSHARED_VAR_CLEARED, symbol=VAR_CLEARED_QM_8
        OS_GLOBALSHARED_SEC_VAR_CLEARED_QM_16: alignment=16, prefix=OS_GLOBALSHAREDOsMemMap, sw-addrmethod=GLOBALSHARED_VAR_CLEARED, symbol=VAR_CLEARED_QM_16
        OS_GLOBALSHARED_SEC_VAR_CLEARED_QM_32: alignment=32, prefix=OS_GLOBALSHAREDOsMemMap, sw-addrmethod=GLOBALSHARED_VAR_CLEARED, symbol=VAR_CLEARED_QM_32
        OS_GLOBALSHARED_SEC_VAR_CLEARED_QM_64: alignment=64, prefix=OS_GLOBALSHAREDOsMemMap, sw-addrmethod=GLOBALSHARED_VAR_CLEARED, symbol=VAR_CLEARED_QM_64
        OS_GLOBALSHARED_SEC_VAR_CLEARED_QM_UNSPECIFIED: alignment=UNSPECIFIED, prefix=OS_GLOBALSHAREDOsMemMap, sw-addrmethod=GLOBALSHARED_VAR_CLEARED, symbol=VAR_CLEARED_QM_UNSPECIFIED
        OS_GLOBALSHARED_SEC_VAR_FAST_CLEARED_QM_BOOLEAN: alignment=BOOLEAN, prefix=OS_GLOBALSHAREDOsMemMap, sw-addrmethod=GLOBALSHARED_VAR_FAST_CLEARED, symbol=VAR_FAST_CLEARED_QM_BOOLEAN
        OS_GLOBALSHARED_SEC_VAR_FAST_CLEARED_QM_8: alignment=8, prefix=OS_GLOBALSHAREDOsMemMap, sw-addrmethod=GLOBALSHARED_VAR_FAST_CLEARED, symbol=VAR_FAST_CLEARED_QM_8
        OS_GLOBALSHARED_SEC_VAR_FAST_CLEARED_QM_16: alignment=16, prefix=OS_GLOBALSHAREDOsMemMap, sw-addrmethod=GLOBALSHARED_VAR_FAST_CLEARED, symbol=VAR_FAST_CLEARED_QM_16
        OS_GLOBALSHARED_SEC_VAR_FAST_CLEARED_QM_32: alignment=32, prefix=OS_GLOBALSHAREDOsMemMap, sw-addrmethod=GLOBALSHARED_VAR_FAST_CLEARED, symbol=VAR_FAST_CLEARED_QM_32
        OS_GLOBALSHARED_SEC_VAR_FAST_CLEARED_QM_64: alignment=64, prefix=OS_GLOBALSHAREDOsMemMap, sw-addrmethod=GLOBALSHARED_VAR_FAST_CLEARED, symbol=VAR_FAST_CLEARED_QM_64
        OS_GLOBALSHARED_SEC_VAR_FAST_CLEARED_QM_UNSPECIFIED: alignment=UNSPECIFIED, prefix=OS_GLOBALSHAREDOsMemMap, sw-addrmethod=GLOBALSHARED_VAR_FAST_CLEARED, symbol=VAR_FAST_CLEARED_QM_UNSPECIFIED
        OS_GLOBALSHARED_SEC_VAR_CLEARED_NOCACHE_QM_BOOLEAN: alignment=BOOLEAN, prefix=OS_GLOBALSHAREDOsMemMap, sw-addrmethod=GLOBALSHARED_VAR_NOCACHE_CLEARED, symbol=VAR_CLEARED_NOCACHE_QM_BOOLEAN
        OS_GLOBALSHARED_SEC_VAR_CLEARED_NOCACHE_QM_8: alignment=8, prefix=OS_GLOBALSHAREDOsMemMap, sw-addrmethod=GLOBALSHARED_VAR_NOCACHE_CLEARED, symbol=VAR_CLEARED_NOCACHE_QM_8
        OS_GLOBALSHARED_SEC_VAR_CLEARED_NOCACHE_QM_16: alignment=16, prefix=OS_GLOBALSHAREDOsMemMap, sw-addrmethod=GLOBALSHARED_VAR_NOCACHE_CLEARED, symbol=VAR_CLEARED_NOCACHE_QM_16
        OS_GLOBALSHARED_SEC_VAR_CLEARED_NOCACHE_QM_32: alignment=32, prefix=OS_GLOBALSHAREDOsMemMap, sw-addrmethod=GLOBALSHARED_VAR_NOCACHE_CLEARED, symbol=VAR_CLEARED_NOCACHE_QM_32
        OS_GLOBALSHARED_SEC_VAR_CLEARED_NOCACHE_QM_64: alignment=64, prefix=OS_GLOBALSHAREDOsMemMap, sw-addrmethod=GLOBALSHARED_VAR_NOCACHE_CLEARED, symbol=VAR_CLEARED_NOCACHE_QM_64
        OS_GLOBALSHARED_SEC_VAR_CLEARED_NOCACHE_QM_UNSPECIFIED: alignment=UNSPECIFIED, prefix=OS_GLOBALSHAREDOsMemMap, sw-addrmethod=GLOBALSHARED_VAR_NOCACHE_CLEARED, symbol=VAR_CLEARED_NOCACHE_QM_UNSPECIFIED
        OS_GLOBALSHARED_SEC_VAR_NOINIT_QM_BOOLEAN: alignment=BOOLEAN, prefix=OS_GLOBALSHAREDOsMemMap, sw-addrmethod=GLOBALSHARED_VAR_NOINIT, symbol=VAR_NOINIT_QM_BOOLEAN
        OS_GLOBALSHARED_SEC_VAR_NOINIT_QM_8: alignment=8, prefix=OS_GLOBALSHAREDOsMemMap, sw-addrmethod=GLOBALSHARED_VAR_NOINIT, symbol=VAR_NOINIT_QM_8
        OS_GLOBALSHARED_SEC_VAR_NOINIT_QM_16: alignment=16, prefix=OS_GLOBALSHAREDOsMemMap, sw-addrmethod=GLOBALSHARED_VAR_NOINIT, symbol=VAR_NOINIT_QM_16
        OS_GLOBALSHARED_SEC_VAR_NOINIT_QM_32: alignment=32, prefix=OS_GLOBALSHAREDOsMemMap, sw-addrmethod=GLOBALSHARED_VAR_NOINIT, symbol=VAR_NOINIT_QM_32
        OS_GLOBALSHARED_SEC_VAR_NOINIT_QM_64: alignment=64, prefix=OS_GLOBALSHAREDOsMemMap, sw-addrmethod=GLOBALSHARED_VAR_NOINIT, symbol=VAR_NOINIT_QM_64
        OS_GLOBALSHARED_SEC_VAR_NOINIT_QM_UNSPECIFIED: alignment=UNSPECIFIED, prefix=OS_GLOBALSHAREDOsMemMap, sw-addrmethod=GLOBALSHARED_VAR_NOINIT, symbol=VAR_NOINIT_QM_UNSPECIFIED
        OS_GLOBALSHARED_SEC_VAR_FAST_NOINIT_QM_BOOLEAN: alignment=BOOLEAN, prefix=OS_GLOBALSHAREDOsMemMap, sw-addrmethod=GLOBALSHARED_VAR_FAST_NOINIT, symbol=VAR_FAST_NOINIT_QM_BOOLEAN
        OS_GLOBALSHARED_SEC_VAR_FAST_NOINIT_QM_8: alignment=8, prefix=OS_GLOBALSHAREDOsMemMap, sw-addrmethod=GLOBALSHARED_VAR_FAST_NOINIT, symbol=VAR_FAST_NOINIT_QM_8
        OS_GLOBALSHARED_SEC_VAR_FAST_NOINIT_QM_16: alignment=16, prefix=OS_GLOBALSHAREDOsMemMap, sw-addrmethod=GLOBALSHARED_VAR_FAST_NOINIT, symbol=VAR_FAST_NOINIT_QM_16
        OS_GLOBALSHARED_SEC_VAR_FAST_NOINIT_QM_32: alignment=32, prefix=OS_GLOBALSHAREDOsMemMap, sw-addrmethod=GLOBALSHARED_VAR_FAST_NOINIT, symbol=VAR_FAST_NOINIT_QM_32
        OS_GLOBALSHARED_SEC_VAR_FAST_NOINIT_QM_64: alignment=64, prefix=OS_GLOBALSHAREDOsMemMap, sw-addrmethod=GLOBALSHARED_VAR_FAST_NOINIT, symbol=VAR_FAST_NOINIT_QM_64
        OS_GLOBALSHARED_SEC_VAR_FAST_NOINIT_QM_UNSPECIFIED: alignment=UNSPECIFIED, prefix=OS_GLOBALSHAREDOsMemMap, sw-addrmethod=GLOBALSHARED_VAR_FAST_NOINIT, symbol=VAR_FAST_NOINIT_QM_UNSPECIFIED
        OS_GLOBALSHARED_SEC_VAR_NOINIT_NOCACHE_QM_BOOLEAN: alignment=BOOLEAN, prefix=OS_GLOBALSHAREDOsMemMap, sw-addrmethod=GLOBALSHARED_VAR_NOCACHE_NOINIT, symbol=VAR_NOINIT_NOCACHE_QM_BOOLEAN
        OS_GLOBALSHARED_SEC_VAR_NOINIT_NOCACHE_QM_8: alignment=8, prefix=OS_GLOBALSHAREDOsMemMap, sw-addrmethod=GLOBALSHARED_VAR_NOCACHE_NOINIT, symbol=VAR_NOINIT_NOCACHE_QM_8
        OS_GLOBALSHARED_SEC_VAR_NOINIT_NOCACHE_QM_16: alignment=16, prefix=OS_GLOBALSHAREDOsMemMap, sw-addrmethod=GLOBALSHARED_VAR_NOCACHE_NOINIT, symbol=VAR_NOINIT_NOCACHE_QM_16
        OS_GLOBALSHARED_SEC_VAR_NOINIT_NOCACHE_QM_32: alignment=32, prefix=OS_GLOBALSHAREDOsMemMap, sw-addrmethod=GLOBALSHARED_VAR_NOCACHE_NOINIT, symbol=VAR_NOINIT_NOCACHE_QM_32
        OS_GLOBALSHARED_SEC_VAR_NOINIT_NOCACHE_QM_64: alignment=64, prefix=OS_GLOBALSHAREDOsMemMap, sw-addrmethod=GLOBALSHARED_VAR_NOCACHE_NOINIT, symbol=VAR_NOINIT_NOCACHE_QM_64
        OS_GLOBALSHARED_SEC_VAR_NOINIT_NOCACHE_QM_UNSPECIFIED: alignment=UNSPECIFIED, prefix=OS_GLOBALSHAREDOsMemMap, sw-addrmethod=GLOBALSHARED_VAR_NOCACHE_NOINIT, symbol=VAR_NOINIT_NOCACHE_QM_UNSPECIFIED
        OS_GLOBALSHARED_SEC_VAR_POWER_ON_INIT_QM_BOOLEAN: alignment=BOOLEAN, prefix=OS_GLOBALSHAREDOsMemMap, sw-addrmethod=GLOBALSHARED_VAR_POWER_ON_INIT, symbol=VAR_POWER_ON_INIT_QM_BOOLEAN
        OS_GLOBALSHARED_SEC_VAR_POWER_ON_INIT_QM_8: alignment=8, prefix=OS_GLOBALSHAREDOsMemMap, sw-addrmethod=GLOBALSHARED_VAR_POWER_ON_INIT, symbol=VAR_POWER_ON_INIT_QM_8
        OS_GLOBALSHARED_SEC_VAR_POWER_ON_INIT_QM_16: alignment=16, prefix=OS_GLOBALSHAREDOsMemMap, sw-addrmethod=GLOBALSHARED_VAR_POWER_ON_INIT, symbol=VAR_POWER_ON_INIT_QM_16
        OS_GLOBALSHARED_SEC_VAR_POWER_ON_INIT_QM_32: alignment=32, prefix=OS_GLOBALSHAREDOsMemMap, sw-addrmethod=GLOBALSHARED_VAR_POWER_ON_INIT, symbol=VAR_POWER_ON_INIT_QM_32
        OS_GLOBALSHARED_SEC_VAR_POWER_ON_INIT_QM_64: alignment=64, prefix=OS_GLOBALSHAREDOsMemMap, sw-addrmethod=GLOBALSHARED_VAR_POWER_ON_INIT, symbol=VAR_POWER_ON_INIT_QM_64
        OS_GLOBALSHARED_SEC_VAR_POWER_ON_INIT_QM_UNSPECIFIED: alignment=UNSPECIFIED, prefix=OS_GLOBALSHAREDOsMemMap, sw-addrmethod=GLOBALSHARED_VAR_POWER_ON_INIT, symbol=VAR_POWER_ON_INIT_QM_UNSPECIFIED
        OS_GLOBALSHARED_SEC_VAR_FAST_POWER_ON_INIT_QM_BOOLEAN: alignment=BOOLEAN, prefix=OS_GLOBALSHAREDOsMemMap, sw-addrmethod=GLOBALSHARED_VAR_FAST_POWER_ON_INIT, symbol=VAR_FAST_POWER_ON_INIT_QM_BOOLEAN
        OS_GLOBALSHARED_SEC_VAR_FAST_POWER_ON_INIT_QM_8: alignment=8, prefix=OS_GLOBALSHAREDOsMemMap, sw-addrmethod=GLOBALSHARED_VAR_FAST_POWER_ON_INIT, symbol=VAR_FAST_POWER_ON_INIT_QM_8
        OS_GLOBALSHARED_SEC_VAR_FAST_POWER_ON_INIT_QM_16: alignment=16, prefix=OS_GLOBALSHAREDOsMemMap, sw-addrmethod=GLOBALSHARED_VAR_FAST_POWER_ON_INIT, symbol=VAR_FAST_POWER_ON_INIT_QM_16
        OS_GLOBALSHARED_SEC_VAR_FAST_POWER_ON_INIT_QM_32: alignment=32, prefix=OS_GLOBALSHAREDOsMemMap, sw-addrmethod=GLOBALSHARED_VAR_FAST_POWER_ON_INIT, symbol=VAR_FAST_POWER_ON_INIT_QM_32
        OS_GLOBALSHARED_SEC_VAR_FAST_POWER_ON_INIT_QM_64: alignment=64, prefix=OS_GLOBALSHAREDOsMemMap, sw-addrmethod=GLOBALSHARED_VAR_FAST_POWER_ON_INIT, symbol=VAR_FAST_POWER_ON_INIT_QM_64
        OS_GLOBALSHARED_SEC_VAR_FAST_POWER_ON_INIT_QM_UNSPECIFIED: alignment=UNSPECIFIED, prefix=OS_GLOBALSHAREDOsMemMap, sw-addrmethod=GLOBALSHARED_VAR_FAST_POWER_ON_INIT, symbol=VAR_FAST_POWER_ON_INIT_QM_UNSPECIFIED
        OS_GLOBALSHARED_SEC_VAR_POWER_ON_INIT_NOCACHE_QM_BOOLEAN: alignment=BOOLEAN, prefix=OS_GLOBALSHAREDOsMemMap, sw-addrmethod=GLOBALSHARED_VAR_NOCACHE_POWER_ON_INIT, symbol=VAR_POWER_ON_INIT_NOCACHE_QM_BOOLEAN
        OS_GLOBALSHARED_SEC_VAR_POWER_ON_INIT_NOCACHE_QM_8: alignment=8, prefix=OS_GLOBALSHAREDOsMemMap, sw-addrmethod=GLOBALSHARED_VAR_NOCACHE_POWER_ON_INIT, symbol=VAR_POWER_ON_INIT_NOCACHE_QM_8
        OS_GLOBALSHARED_SEC_VAR_POWER_ON_INIT_NOCACHE_QM_16: alignment=16, prefix=OS_GLOBALSHAREDOsMemMap, sw-addrmethod=GLOBALSHARED_VAR_NOCACHE_POWER_ON_INIT, symbol=VAR_POWER_ON_INIT_NOCACHE_QM_16
        OS_GLOBALSHARED_SEC_VAR_POWER_ON_INIT_NOCACHE_QM_32: alignment=32, prefix=OS_GLOBALSHAREDOsMemMap, sw-addrmethod=GLOBALSHARED_VAR_NOCACHE_POWER_ON_INIT, symbol=VAR_POWER_ON_INIT_NOCACHE_QM_32
        OS_GLOBALSHARED_SEC_VAR_POWER_ON_INIT_NOCACHE_QM_64: alignment=64, prefix=OS_GLOBALSHAREDOsMemMap, sw-addrmethod=GLOBALSHARED_VAR_NOCACHE_POWER_ON_INIT, symbol=VAR_POWER_ON_INIT_NOCACHE_QM_64
        OS_GLOBALSHARED_SEC_VAR_POWER_ON_INIT_NOCACHE_QM_UNSPECIFIED: alignment=UNSPECIFIED, prefix=OS_GLOBALSHAREDOsMemMap, sw-addrmethod=GLOBALSHARED_VAR_NOCACHE_POWER_ON_INIT, symbol=VAR_POWER_ON_INIT_NOCACHE_QM_UNSPECIFIED
        OS_GLOBALSHARED_SEC_VAR_POWER_ON_CLEARED_QM_BOOLEAN: alignment=BOOLEAN, prefix=OS_GLOBALSHAREDOsMemMap, sw-addrmethod=GLOBALSHARED_VAR_POWER_ON_CLEARED, symbol=VAR_POWER_ON_CLEARED_QM_BOOLEAN
        OS_GLOBALSHARED_SEC_VAR_POWER_ON_CLEARED_QM_8: alignment=8, prefix=OS_GLOBALSHAREDOsMemMap, sw-addrmethod=GLOBALSHARED_VAR_POWER_ON_CLEARED, symbol=VAR_POWER_ON_CLEARED_QM_8
        OS_GLOBALSHARED_SEC_VAR_POWER_ON_CLEARED_QM_16: alignment=16, prefix=OS_GLOBALSHAREDOsMemMap, sw-addrmethod=GLOBALSHARED_VAR_POWER_ON_CLEARED, symbol=VAR_POWER_ON_CLEARED_QM_16
        OS_GLOBALSHARED_SEC_VAR_POWER_ON_CLEARED_QM_32: alignment=32, prefix=OS_GLOBALSHAREDOsMemMap, sw-addrmethod=GLOBALSHARED_VAR_POWER_ON_CLEARED, symbol=VAR_POWER_ON_CLEARED_QM_32
        OS_GLOBALSHARED_SEC_VAR_POWER_ON_CLEARED_QM_64: alignment=64, prefix=OS_GLOBALSHAREDOsMemMap, sw-addrmethod=GLOBALSHARED_VAR_POWER_ON_CLEARED, symbol=VAR_POWER_ON_CLEARED_QM_64
        OS_GLOBALSHARED_SEC_VAR_POWER_ON_CLEARED_QM_UNSPECIFIED: alignment=UNSPECIFIED, prefix=OS_GLOBALSHAREDOsMemMap, sw-addrmethod=GLOBALSHARED_VAR_POWER_ON_CLEARED, symbol=VAR_POWER_ON_CLEARED_QM_UNSPECIFIED
        OS_GLOBALSHARED_SEC_VAR_FAST_POWER_ON_CLEARED_QM_BOOLEAN: alignment=BOOLEAN, prefix=OS_GLOBALSHAREDOsMemMap, sw-addrmethod=GLOBALSHARED_VAR_FAST_POWER_ON_CLEARED, symbol=VAR_FAST_POWER_ON_CLEARED_QM_BOOLEAN
        OS_GLOBALSHARED_SEC_VAR_FAST_POWER_ON_CLEARED_QM_8: alignment=8, prefix=OS_GLOBALSHAREDOsMemMap, sw-addrmethod=GLOBALSHARED_VAR_FAST_POWER_ON_CLEARED, symbol=VAR_FAST_POWER_ON_CLEARED_QM_8
        OS_GLOBALSHARED_SEC_VAR_FAST_POWER_ON_CLEARED_QM_16: alignment=16, prefix=OS_GLOBALSHAREDOsMemMap, sw-addrmethod=GLOBALSHARED_VAR_FAST_POWER_ON_CLEARED, symbol=VAR_FAST_POWER_ON_CLEARED_QM_16
        OS_GLOBALSHARED_SEC_VAR_FAST_POWER_ON_CLEARED_QM_32: alignment=32, prefix=OS_GLOBALSHAREDOsMemMap, sw-addrmethod=GLOBALSHARED_VAR_FAST_POWER_ON_CLEARED, symbol=VAR_FAST_POWER_ON_CLEARED_QM_32
        OS_GLOBALSHARED_SEC_VAR_FAST_POWER_ON_CLEARED_QM_64: alignment=64, prefix=OS_GLOBALSHAREDOsMemMap, sw-addrmethod=GLOBALSHARED_VAR_FAST_POWER_ON_CLEARED, symbol=VAR_FAST_POWER_ON_CLEARED_QM_64
        OS_GLOBALSHARED_SEC_VAR_FAST_POWER_ON_CLEARED_QM_UNSPECIFIED: alignment=UNSPECIFIED, prefix=OS_GLOBALSHAREDOsMemMap, sw-addrmethod=GLOBALSHARED_VAR_FAST_POWER_ON_CLEARED, symbol=VAR_FAST_POWER_ON_CLEARED_QM_UNSPECIFIED
        OS_GLOBALSHARED_SEC_VAR_POWER_ON_CLEARED_NOCACHE_QM_BOOLEAN: alignment=BOOLEAN, prefix=OS_GLOBALSHAREDOsMemMap, sw-addrmethod=GLOBALSHARED_VAR_NOCACHE_POWER_ON_CLEARED, symbol=VAR_POWER_ON_CLEARED_NOCACHE_QM_BOOLEAN
        OS_GLOBALSHARED_SEC_VAR_POWER_ON_CLEARED_NOCACHE_QM_8: alignment=8, prefix=OS_GLOBALSHAREDOsMemMap, sw-addrmethod=GLOBALSHARED_VAR_NOCACHE_POWER_ON_CLEARED, symbol=VAR_POWER_ON_CLEARED_NOCACHE_QM_8
        OS_GLOBALSHARED_SEC_VAR_POWER_ON_CLEARED_NOCACHE_QM_16: alignment=16, prefix=OS_GLOBALSHAREDOsMemMap, sw-addrmethod=GLOBALSHARED_VAR_NOCACHE_POWER_ON_CLEARED, symbol=VAR_POWER_ON_CLEARED_NOCACHE_QM_16
        OS_GLOBALSHARED_SEC_VAR_POWER_ON_CLEARED_NOCACHE_QM_32: alignment=32, prefix=OS_GLOBALSHAREDOsMemMap, sw-addrmethod=GLOBALSHARED_VAR_NOCACHE_POWER_ON_CLEARED, symbol=VAR_POWER_ON_CLEARED_NOCACHE_QM_32
        OS_GLOBALSHARED_SEC_VAR_POWER_ON_CLEARED_NOCACHE_QM_64: alignment=64, prefix=OS_GLOBALSHAREDOsMemMap, sw-addrmethod=GLOBALSHARED_VAR_NOCACHE_POWER_ON_CLEARED, symbol=VAR_POWER_ON_CLEARED_NOCACHE_QM_64
        OS_GLOBALSHARED_SEC_VAR_POWER_ON_CLEARED_NOCACHE_QM_UNSPECIFIED: alignment=UNSPECIFIED, prefix=OS_GLOBALSHAREDOsMemMap, sw-addrmethod=GLOBALSHARED_VAR_NOCACHE_POWER_ON_CLEARED, symbol=VAR_POWER_ON_CLEARED_NOCACHE_QM_UNSPECIFIED
        OS_SEC_CODE_Appl_IPC_Task_ASIL_B: prefix=OSOsMemMap, sw-addrmethod=CALLOUT_CODE, symbol=CODE_Appl_IPC_Task_ASIL_B
        OS_SEC_CODE_ANOC_Latent_Fusa_Handler_ASIL_B: prefix=OSOsMemMap, sw-addrmethod=CODE_ISR, symbol=CODE_ANOC_Latent_Fusa_Handler_ASIL_B
        OS_SEC_CODE_SNOC_Latent_Fusa_Handler_ASIL_B: prefix=OSOsMemMap, sw-addrmethod=CODE_ISR, symbol=CODE_SNOC_Latent_Fusa_Handler_ASIL_B
        OS_SEC_CODE_AA0_Fusa_Handler_ASIL_B: prefix=OSOsMemMap, sw-addrmethod=CODE_ISR, symbol=CODE_AA0_Fusa_Handler_ASIL_B
        OS_SEC_CODE_CNOC_Latent_Fusa_Handler_ASIL_B: prefix=OSOsMemMap, sw-addrmethod=CODE_ISR, symbol=CODE_CNOC_Latent_Fusa_Handler_ASIL_B
        OS_SEC_CODE_AA1_Fusa_Handler_ASIL_B: prefix=OSOsMemMap, sw-addrmethod=CODE_ISR, symbol=CODE_AA1_Fusa_Handler_ASIL_B
        OS_CORE0_SEC_VAR_CLEARED_STACK_Appl_IPC_Task_ASIL_D_LOCAL_UNSPECIFIED: alignment=UNSPECIFIED, options=vectorAlign64, prefix=OS_CORE0OsMemMap_OsStacks, sw-addrmethod=STACK_Appl_IPC_Task_VAR_CLEARED, symbol=VAR_CLEARED_STACK_Appl_IPC_Task_ASIL_D_LOCAL_UNSPECIFIED
        OS_SEC_CODE_Appl_Task_Fast_QM: prefix=OSOsMemMap, sw-addrmethod=CALLOUT_CODE, symbol=CODE_Appl_Task_Fast_QM
        OS_SEC_CODE_Reset_Monitor_Handler_ASIL_B: prefix=OSOsMemMap, sw-addrmethod=CODE_ISR, symbol=CODE_Reset_Monitor_Handler_ASIL_B
        OS_SEC_CODE_I2CM_Handler_ASIL_B: prefix=OSOsMemMap, sw-addrmethod=CODE_ISR, symbol=CODE_I2CM_Handler_ASIL_B
        OS_CORE0_SEC_VAR_CLEARED_STACK_OsCore0_Protection_ASIL_D_LOCAL_UNSPECIFIED: alignment=UNSPECIFIED, options=vectorAlign64, prefix=OS_CORE0OsMemMap_OsStacks, sw-addrmethod=STACK_OsCore0_Protection_VAR_CLEARED, symbol=VAR_CLEARED_STACK_OsCore0_Protection_ASIL_D_LOCAL_UNSPECIFIED
        OS_SEC_CODE_DMB_Handler_ASIL_B: prefix=OSOsMemMap, sw-addrmethod=CODE_ISR, symbol=CODE_DMB_Handler_ASIL_B
        OS_SEC_CODE_HSM_ALARM_FUSA_Handler_ASIL_B: prefix=OSOsMemMap, sw-addrmethod=CODE_ISR, symbol=CODE_HSM_ALARM_FUSA_Handler_ASIL_B
        OS_SEC_CODE_Appl_BackgroundTask_ASIL_B: prefix=OSOsMemMap, sw-addrmethod=CALLOUT_CODE, symbol=CODE_Appl_BackgroundTask_ASIL_B
        OS_CORE0_SEC_VAR_CLEARED_STACK_Appl_BackgroundTask_ASIL_D_LOCAL_UNSPECIFIED: alignment=UNSPECIFIED, options=vectorAlign64, prefix=OS_CORE0OsMemMap_OsStacks, sw-addrmethod=STACK_Appl_BackgroundTask_VAR_CLEARED, symbol=VAR_CLEARED_STACK_Appl_BackgroundTask_ASIL_D_LOCAL_UNSPECIFIED
        OS_SEC_CODE_WATCHDOG_FUSA_Handler_ASIL_B: prefix=OSOsMemMap, sw-addrmethod=CODE_ISR, symbol=CODE_WATCHDOG_FUSA_Handler_ASIL_B
        OS_SEC_CODE_MCDMA_Handler_ASIL_B: prefix=OSOsMemMap, sw-addrmethod=CODE_ISR, symbol=CODE_MCDMA_Handler_ASIL_B
        OS_SEC_CODE_TIMER5_Handler_ASIL_B: prefix=OSOsMemMap, sw-addrmethod=CODE_ISR, symbol=CODE_TIMER5_Handler_ASIL_B
      12 x section name prefix:
        OSOsMemMap: implemented-in=OsMemMap
        OSOsMemMap_OsCode: implemented-in=OsMemMap_OsCode
        OSOsMemMap_OsConst: implemented-in=OsMemMap_OsConst
        OSOsMemMap_OsVar: implemented-in=OsMemMap_OsVar
        OS_CORE0OsMemMap_OsCode: symbol=OS_CORE0, implemented-in=OsMemMap_OsCode
        OS_CORE0OsMemMap_OsConst: symbol=OS_CORE0, implemented-in=OsMemMap_OsConst
        OS_CORE0OsMemMap_OsVar: symbol=OS_CORE0, implemented-in=OsMemMap_OsVar
        OS_CORE0OsMemMap_OsStacks: symbol=OS_CORE0, implemented-in=OsMemMap_OsStacks
        OS_SystemApplication_OsCore0OsMemMap: symbol=OS_SystemApplication_OsCore0, implemented-in=OsMemMap
        OS_OsCore0_ASILOsMemMap: symbol=OS_OsCore0_ASIL, implemented-in=OsMemMap
        OS_OsCore_QmOsMemMap: symbol=OS_OsCore_Qm, implemented-in=OsMemMap
        OS_GLOBALSHAREDOsMemMap: symbol=OS_GLOBALSHARED, implemented-in=OsMemMap
package /MICROSAR/Os_ib_bswmd/SwAddrMethods
  143 x sw addr method:
    GLOBALSHARED_CONST: options=safetyQM, section-type=CONST
    GLOBALSHARED_CONST_FAST: options=safetyQM, section-type=CONST
    GLOBALSHARED_VAR_SAVED_ZONE: options=safetyQM, section-initialization-policy=POWER-ON-CLEARED, section-type=VAR
    GLOBALSHARED_VAR_INIT: options=safetyQM, section-initialization-policy=INIT, section-type=VAR
    GLOBALSHARED_VAR_FAST_INIT: options=safetyQM, section-initialization-policy=INIT, section-type=VAR-FAST
    GLOBALSHARED_VAR_NOCACHE_INIT: options=safetyQM, section-initialization-policy=INIT, section-type=VAR
    GLOBALSHARED_VAR_NO_INIT: options=safetyQM, section-initialization-policy=NO-INIT, section-type=VAR
    GLOBALSHARED_VAR_FAST_NO_INIT: options=safetyQM, section-initialization-policy=NO-INIT, section-type=VAR-FAST
    GLOBALSHARED_VAR_NOCACHE_NO_INIT: options=safetyQM, section-initialization-policy=NO-INIT, section-type=VAR
    GLOBALSHARED_VAR_CLEARED: options=safetyQM, section-initialization-policy=CLEARED, section-type=VAR
    GLOBALSHARED_VAR_FAST_CLEARED: options=safetyQM, section-initialization-policy=CLEARED, section-type=VAR-FAST
    GLOBALSHARED_VAR_NOCACHE_CLEARED: options=safetyQM, section-initialization-policy=CLEARED, section-type=VAR
    SystemApplication_OsCore0_CONST: options=safetyQM, section-type=CONST
    SystemApplication_OsCore0_CONST_FAST: options=safetyQM, section-type=CONST
    SystemApplication_OsCore0_VAR_SAVED_ZONE: options=safetyQM, section-initialization-policy=POWER-ON-CLEARED, section-type=VAR
    SystemApplication_OsCore0_VAR_INIT: options=safetyQM, section-initialization-policy=INIT, section-type=VAR
    SystemApplication_OsCore0_VAR_FAST_INIT: options=safetyQM, section-initialization-policy=INIT, section-type=VAR-FAST
    SystemApplication_OsCore0_VAR_NOCACHE_INIT: options=safetyQM, section-initialization-policy=INIT, section-type=VAR
    SystemApplication_OsCore0_VAR_NO_INIT: options=safetyQM, section-initialization-policy=NO-INIT, section-type=VAR
    SystemApplication_OsCore0_VAR_FAST_NO_INIT: options=safetyQM, section-initialization-policy=NO-INIT, section-type=VAR-FAST
    SystemApplication_OsCore0_VAR_NOCACHE_NO_INIT: options=safetyQM, section-initialization-policy=NO-INIT, section-type=VAR
    SystemApplication_OsCore0_VAR_CLEARED: options=safetyQM, section-initialization-policy=CLEARED, section-type=VAR
    SystemApplication_OsCore0_VAR_FAST_CLEARED: options=safetyQM, section-initialization-policy=CLEARED, section-type=VAR-FAST
    SystemApplication_OsCore0_VAR_NOCACHE_CLEARED: options=safetyQM, section-initialization-policy=CLEARED, section-type=VAR
    OsCore0_ASIL_CONST: options=safetyAsilB, section-type=CONST
    OsCore0_ASIL_CONST_FAST: options=safetyAsilB, section-type=CONST
    OsCore0_ASIL_VAR_SAVED_ZONE: options=safetyAsilB, section-initialization-policy=POWER-ON-CLEARED, section-type=VAR
    OsCore0_ASIL_VAR_INIT: options=safetyAsilB, section-initialization-policy=INIT, section-type=VAR
    OsCore0_ASIL_VAR_FAST_INIT: options=safetyAsilB, section-initialization-policy=INIT, section-type=VAR-FAST
    OsCore0_ASIL_VAR_NOCACHE_INIT: options=safetyAsilB, section-initialization-policy=INIT, section-type=VAR
    OsCore0_ASIL_VAR_NO_INIT: options=safetyAsilB, section-initialization-policy=NO-INIT, section-type=VAR
    OsCore0_ASIL_VAR_FAST_NO_INIT: options=safetyAsilB, section-initialization-policy=NO-INIT, section-type=VAR-FAST
    OsCore0_ASIL_VAR_NOCACHE_NO_INIT: options=safetyAsilB, section-initialization-policy=NO-INIT, section-type=VAR
    OsCore0_ASIL_VAR_CLEARED: options=safetyAsilB, section-initialization-policy=CLEARED, section-type=VAR
    OsCore0_ASIL_VAR_FAST_CLEARED: options=safetyAsilB, section-initialization-policy=CLEARED, section-type=VAR-FAST
    OsCore0_ASIL_VAR_NOCACHE_CLEARED: options=safetyAsilB, section-initialization-policy=CLEARED, section-type=VAR
    OsCore_Qm_CONST: options=safetyQM, section-type=CONST
    OsCore_Qm_CONST_FAST: options=safetyQM, section-type=CONST
    OsCore_Qm_VAR_SAVED_ZONE: options=safetyQM, section-initialization-policy=POWER-ON-CLEARED, section-type=VAR
    OsCore_Qm_VAR_INIT: options=safetyQM, section-initialization-policy=INIT, section-type=VAR
    OsCore_Qm_VAR_FAST_INIT: options=safetyQM, section-initialization-policy=INIT, section-type=VAR-FAST
    OsCore_Qm_VAR_NOCACHE_INIT: options=safetyQM, section-initialization-policy=INIT, section-type=VAR
    OsCore_Qm_VAR_NO_INIT: options=safetyQM, section-initialization-policy=NO-INIT, section-type=VAR
    OsCore_Qm_VAR_FAST_NO_INIT: options=safetyQM, section-initialization-policy=NO-INIT, section-type=VAR-FAST
    OsCore_Qm_VAR_NOCACHE_NO_INIT: options=safetyQM, section-initialization-policy=NO-INIT, section-type=VAR
    OsCore_Qm_VAR_CLEARED: options=safetyQM, section-initialization-policy=CLEARED, section-type=VAR
    OsCore_Qm_VAR_FAST_CLEARED: options=safetyQM, section-initialization-policy=CLEARED, section-type=VAR-FAST
    OsCore_Qm_VAR_NOCACHE_CLEARED: options=safetyQM, section-initialization-policy=CLEARED, section-type=VAR
    OS_CODE: options=safetyAsilD, section-type=CODE
    INTVEC_CODE: options=safetyAsilD, section-type=CODE
    INTVEC_CONST: options=safetyAsilD, section-type=CONST
    INTVEC_OsCore0_CODE: options=[safetyAsilD, coreLocal], section-type=CODE
    EXCVEC_OsCore0_CODE: options=[safetyAsilD, coreLocal], section-type=CODE
    INTVEC_OsCore0_CONST: options=[safetyAsilD, coreLocal], section-type=CONST
    EXCVEC_OsCore0_CONST: options=[safetyAsilD, coreLocal], section-type=CONST
    STACK_OsCore0_Kernel_VAR_CLEARED: options=[safetyAsilD, coreLocal], section-initialization-policy=CLEARED, section-type=VAR
    STACK_OsCore0_Init_VAR_CLEARED: options=[safetyAsilD, coreLocal], section-initialization-policy=CLEARED, section-type=VAR
    STACK_OsCore0_Error_VAR_CLEARED: options=[safetyAsilD, coreLocal], section-initialization-policy=CLEARED, section-type=VAR
    STACK_OsCore0_Task_Prio4294967295_VAR_CLEARED: options=[safetyAsilD, coreLocal], section-initialization-policy=CLEARED, section-type=VAR
    STACK_OsCore0_Isr_Core_VAR_CLEARED: options=[safetyAsilD, coreLocal], section-initialization-policy=CLEARED, section-type=VAR
    STACK_OsCore0_Startup_VAR_CLEARED: options=[safetyAsilD, coreLocal], section-initialization-policy=CLEARED, section-type=VAR
    STACK_OsCore0_Shutdown_VAR_CLEARED: options=[safetyAsilD, coreLocal], section-initialization-policy=CLEARED, section-type=VAR
    STACK_BSW_Task_VAR_CLEARED: options=[safetyAsilD, coreLocal], section-initialization-policy=CLEARED, section-type=VAR
    STACK_OsCore0_Task_Prio200_VAR_CLEARED: options=[safetyAsilD, coreLocal], section-initialization-policy=CLEARED, section-type=VAR
    STACK_OsCore0_Task_Prio190_VAR_CLEARED: options=[safetyAsilD, coreLocal], section-initialization-policy=CLEARED, section-type=VAR
    STACK_Appl_Task_VAR_CLEARED: options=[safetyAsilD, coreLocal], section-initialization-policy=CLEARED, section-type=VAR
    STACK_Radar_Ctrl_Task_VAR_CLEARED: options=[safetyAsilD, coreLocal], section-initialization-policy=CLEARED, section-type=VAR
    STACK_Appl_Task_Logging_VAR_CLEARED: options=[safetyAsilD, coreLocal], section-initialization-policy=CLEARED, section-type=VAR
    STACK_Appl_Task_Communication_VAR_CLEARED: options=[safetyAsilD, coreLocal], section-initialization-policy=CLEARED, section-type=VAR
    STACK_Appl_Task_Fast_VAR_CLEARED: options=[safetyAsilD, coreLocal], section-initialization-policy=CLEARED, section-type=VAR
    STACK_OsCore0_Task_Prio210_VAR_CLEARED: options=[safetyAsilD, coreLocal], section-initialization-policy=CLEARED, section-type=VAR
    STACK_Appl_Task_High_Prio_VAR_CLEARED: options=[safetyAsilD, coreLocal], section-initialization-policy=CLEARED, section-type=VAR
    SystemApplication_OsCore0_CONFIG_DATA_PREBUILD: options=[safetyQM, configClassPreBuild], section-type=CONFIG-DATA
    SystemApplication_OsCore0_CONFIG_DATA_POSTBUILD: options=[safetyQM, configClassPostBuild], section-type=CONFIG-DATA
    SystemApplication_OsCore0_VAR_SLOW_INIT: options=safetyQM, section-initialization-policy=INIT, section-type=VAR
    SystemApplication_OsCore0_VAR_SLOW_CLEARED: options=safetyQM, section-initialization-policy=CLEARED, section-type=VAR
    SystemApplication_OsCore0_VAR_SLOW_NO_INIT: options=safetyQM, section-initialization-policy=NO-INIT, section-type=VAR
    SystemApplication_OsCore0_VAR_NOINIT: options=safetyQM, section-initialization-policy=NO-INIT, section-type=VAR
    SystemApplication_OsCore0_VAR_FAST_NOINIT: options=safetyQM, section-initialization-policy=NO-INIT, section-type=VAR-FAST
    SystemApplication_OsCore0_VAR_NOCACHE_NOINIT: options=safetyQM, section-initialization-policy=NO-INIT, section-type=VAR
    SystemApplication_OsCore0_VAR_SLOW_NOINIT: options=safetyQM, section-initialization-policy=NO-INIT, section-type=VAR
    SystemApplication_OsCore0_VAR_POWER_ON_INIT: options=safetyQM, section-initialization-policy=POWER-ON-INIT, section-type=VAR
    SystemApplication_OsCore0_VAR_FAST_POWER_ON_INIT: options=safetyQM, section-initialization-policy=POWER-ON-INIT, section-type=VAR-FAST
    SystemApplication_OsCore0_VAR_NOCACHE_POWER_ON_INIT: options=safetyQM, section-initialization-policy=POWER-ON-INIT, section-type=VAR
    SystemApplication_OsCore0_VAR_SLOW_POWER_ON_INIT: options=safetyQM, section-initialization-policy=POWER-ON-INIT, section-type=VAR
    SystemApplication_OsCore0_VAR_POWER_ON_CLEARED: options=safetyQM, section-initialization-policy=POWER-ON-CLEARED, section-type=VAR
    SystemApplication_OsCore0_VAR_FAST_POWER_ON_CLEARED: options=safetyQM, section-initialization-policy=POWER-ON-CLEARED, section-type=VAR-FAST
    SystemApplication_OsCore0_VAR_NOCACHE_POWER_ON_CLEARED: options=safetyQM, section-initialization-policy=POWER-ON-CLEARED, section-type=VAR
    SystemApplication_OsCore0_VAR_SLOW_POWER_ON_CLEARED: options=safetyQM, section-initialization-policy=POWER-ON-CLEARED, section-type=VAR
    OsCore0_ASIL_CONFIG_DATA_PREBUILD: options=[safetyAsilB, configClassPreBuild], section-type=CONFIG-DATA
    OsCore0_ASIL_CONFIG_DATA_POSTBUILD: options=[safetyAsilB, configClassPostBuild], section-type=CONFIG-DATA
    OsCore0_ASIL_VAR_SLOW_INIT: options=safetyAsilB, section-initialization-policy=INIT, section-type=VAR
    OsCore0_ASIL_VAR_SLOW_CLEARED: options=safetyAsilB, section-initialization-policy=CLEARED, section-type=VAR
    OsCore0_ASIL_VAR_SLOW_NO_INIT: options=safetyAsilB, section-initialization-policy=NO-INIT, section-type=VAR
    OsCore0_ASIL_VAR_NOINIT: options=safetyAsilB, section-initialization-policy=NO-INIT, section-type=VAR
    OsCore0_ASIL_VAR_FAST_NOINIT: options=safetyAsilB, section-initialization-policy=NO-INIT, section-type=VAR-FAST
    OsCore0_ASIL_VAR_NOCACHE_NOINIT: options=safetyAsilB, section-initialization-policy=NO-INIT, section-type=VAR
    OsCore0_ASIL_VAR_SLOW_NOINIT: options=safetyAsilB, section-initialization-policy=NO-INIT, section-type=VAR
    OsCore0_ASIL_VAR_POWER_ON_INIT: options=safetyAsilB, section-initialization-policy=POWER-ON-INIT, section-type=VAR
    OsCore0_ASIL_VAR_FAST_POWER_ON_INIT: options=safetyAsilB, section-initialization-policy=POWER-ON-INIT, section-type=VAR-FAST
    OsCore0_ASIL_VAR_NOCACHE_POWER_ON_INIT: options=safetyAsilB, section-initialization-policy=POWER-ON-INIT, section-type=VAR
    OsCore0_ASIL_VAR_SLOW_POWER_ON_INIT: options=safetyAsilB, section-initialization-policy=POWER-ON-INIT, section-type=VAR
    OsCore0_ASIL_VAR_POWER_ON_CLEARED: options=safetyAsilB, section-initialization-policy=POWER-ON-CLEARED, section-type=VAR
    OsCore0_ASIL_VAR_FAST_POWER_ON_CLEARED: options=safetyAsilB, section-initialization-policy=POWER-ON-CLEARED, section-type=VAR-FAST
    OsCore0_ASIL_VAR_NOCACHE_POWER_ON_CLEARED: options=safetyAsilB, section-initialization-policy=POWER-ON-CLEARED, section-type=VAR
    OsCore0_ASIL_VAR_SLOW_POWER_ON_CLEARED: options=safetyAsilB, section-initialization-policy=POWER-ON-CLEARED, section-type=VAR
    OsCore_Qm_CONFIG_DATA_PREBUILD: options=[safetyQM, configClassPreBuild], section-type=CONFIG-DATA
    OsCore_Qm_CONFIG_DATA_POSTBUILD: options=[safetyQM, configClassPostBuild], section-type=CONFIG-DATA
    OsCore_Qm_VAR_SLOW_INIT: options=safetyQM, section-initialization-policy=INIT, section-type=VAR
    OsCore_Qm_VAR_SLOW_CLEARED: options=safetyQM, section-initialization-policy=CLEARED, section-type=VAR
    OsCore_Qm_VAR_SLOW_NO_INIT: options=safetyQM, section-initialization-policy=NO-INIT, section-type=VAR
    OsCore_Qm_VAR_NOINIT: options=safetyQM, section-initialization-policy=NO-INIT, section-type=VAR
    OsCore_Qm_VAR_FAST_NOINIT: options=safetyQM, section-initialization-policy=NO-INIT, section-type=VAR-FAST
    OsCore_Qm_VAR_NOCACHE_NOINIT: options=safetyQM, section-initialization-policy=NO-INIT, section-type=VAR
    OsCore_Qm_VAR_SLOW_NOINIT: options=safetyQM, section-initialization-policy=NO-INIT, section-type=VAR
    OsCore_Qm_VAR_POWER_ON_INIT: options=safetyQM, section-initialization-policy=POWER-ON-INIT, section-type=VAR
    OsCore_Qm_VAR_FAST_POWER_ON_INIT: options=safetyQM, section-initialization-policy=POWER-ON-INIT, section-type=VAR-FAST
    OsCore_Qm_VAR_NOCACHE_POWER_ON_INIT: options=safetyQM, section-initialization-policy=POWER-ON-INIT, section-type=VAR
    OsCore_Qm_VAR_SLOW_POWER_ON_INIT: options=safetyQM, section-initialization-policy=POWER-ON-INIT, section-type=VAR
    OsCore_Qm_VAR_POWER_ON_CLEARED: options=safetyQM, section-initialization-policy=POWER-ON-CLEARED, section-type=VAR
    OsCore_Qm_VAR_FAST_POWER_ON_CLEARED: options=safetyQM, section-initialization-policy=POWER-ON-CLEARED, section-type=VAR-FAST
    OsCore_Qm_VAR_NOCACHE_POWER_ON_CLEARED: options=safetyQM, section-initialization-policy=POWER-ON-CLEARED, section-type=VAR
    OsCore_Qm_VAR_SLOW_POWER_ON_CLEARED: options=safetyQM, section-initialization-policy=POWER-ON-CLEARED, section-type=VAR
    GLOBALSHARED_CONFIG_DATA_PREBUILD: options=[safetyQM, configClassPreBuild], section-type=CONFIG-DATA
    GLOBALSHARED_CONFIG_DATA_POSTBUILD: options=[safetyQM, configClassPostBuild], section-type=CONFIG-DATA
    GLOBALSHARED_VAR_SLOW_INIT: options=safetyQM, section-initialization-policy=INIT, section-type=VAR
    GLOBALSHARED_VAR_SLOW_CLEARED: options=safetyQM, section-initialization-policy=CLEARED, section-type=VAR
    GLOBALSHARED_VAR_SLOW_NO_INIT: options=safetyQM, section-initialization-policy=NO-INIT, section-type=VAR
    GLOBALSHARED_VAR_NOINIT: options=safetyQM, section-initialization-policy=NO-INIT, section-type=VAR
    GLOBALSHARED_VAR_FAST_NOINIT: options=safetyQM, section-initialization-policy=NO-INIT, section-type=VAR-FAST
    GLOBALSHARED_VAR_NOCACHE_NOINIT: options=safetyQM, section-initialization-policy=NO-INIT, section-type=VAR
    GLOBALSHARED_VAR_SLOW_NOINIT: options=safetyQM, section-initialization-policy=NO-INIT, section-type=VAR
    GLOBALSHARED_VAR_POWER_ON_INIT: options=safetyQM, section-initialization-policy=POWER-ON-INIT, section-type=VAR
    GLOBALSHARED_VAR_FAST_POWER_ON_INIT: options=safetyQM, section-initialization-policy=POWER-ON-INIT, section-type=VAR-FAST
    GLOBALSHARED_VAR_NOCACHE_POWER_ON_INIT: options=safetyQM, section-initialization-policy=POWER-ON-INIT, section-type=VAR
    GLOBALSHARED_VAR_SLOW_POWER_ON_INIT: options=safetyQM, section-initialization-policy=POWER-ON-INIT, section-type=VAR
    GLOBALSHARED_VAR_POWER_ON_CLEARED: options=safetyQM, section-initialization-policy=POWER-ON-CLEARED, section-type=VAR
    GLOBALSHARED_VAR_FAST_POWER_ON_CLEARED: options=safetyQM, section-initialization-policy=POWER-ON-CLEARED, section-type=VAR-FAST
    GLOBALSHARED_VAR_NOCACHE_POWER_ON_CLEARED: options=safetyQM, section-initialization-policy=POWER-ON-CLEARED, section-type=VAR
    GLOBALSHARED_VAR_SLOW_POWER_ON_CLEARED: options=safetyQM, section-initialization-policy=POWER-ON-CLEARED, section-type=VAR
    STACK_Appl_IPC_Task_VAR_CLEARED: options=[safetyAsilD, coreLocal], section-initialization-policy=CLEARED, section-type=VAR
    STACK_OsCore0_Protection_VAR_CLEARED: options=[safetyAsilD, coreLocal], section-initialization-policy=CLEARED, section-type=VAR
    STACK_Appl_BackgroundTask_VAR_CLEARED: options=[safetyAsilD, coreLocal], section-initialization-policy=CLEARED, section-type=VAR
