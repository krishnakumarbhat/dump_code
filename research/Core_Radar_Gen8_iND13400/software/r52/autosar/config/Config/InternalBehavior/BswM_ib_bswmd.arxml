AUTOSAR XML (schema 00053)
package /MICROSAR
  bsw implementation BswM_Impl: programming-language=C, sw-version=20.02.01, used-code-generator=DaVinci Configurator, vendor-id=30, ar-release-version=4.00.03
    resource consumption ResourceConsumption
      52 x memory section:
        CODE: sw-addrmethod=CODE
        CALLOUT_CODE_ASIL_D: sw-addrmethod=CALLOUT_CODE_ASIL_D
        CODE_ASIL_D: sw-addrmethod=CODE_ASIL_D
        CONFIG_DATA_PREBUILD_ASIL_D_16: alignment=16, sw-addrmethod=CONFIG_DATA_PREBUILD_ASIL_D
        CONFIG_DATA_PREBUILD_ASIL_D_32: alignment=32, sw-addrmethod=CONFIG_DATA_PREBUILD_ASIL_D
        CONFIG_DATA_PREBUILD_ASIL_D_64: alignment=64, sw-addrmethod=CONFIG_DATA_PREBUILD_ASIL_D
        CONFIG_DATA_PREBUILD_ASIL_D_8: alignment=8, sw-addrmethod=CONFIG_DATA_PREBUILD_ASIL_D
        CONFIG_DATA_PREBUILD_ASIL_D_BOOLEAN: alignment=BOOLEAN, sw-addrmethod=CONFIG_DATA_PREBUILD_ASIL_D
        CONFIG_DATA_PREBUILD_ASIL_D_PTR: alignment=PTR, sw-addrmethod=CONFIG_DATA_PREBUILD_ASIL_D
        CONFIG_DATA_PREBUILD_ASIL_D_UNSPECIFIED: alignment=UNSPECIFIED, sw-addrmethod=CONFIG_DATA_PREBUILD_ASIL_D
        VAR_CLEARED_ASIL_D_GLOBAL_16: alignment=16, sw-addrmethod=VAR_CLEARED_ASIL_D
        VAR_CLEARED_ASIL_D_GLOBAL_32: alignment=32, sw-addrmethod=VAR_CLEARED_ASIL_D
        VAR_CLEARED_ASIL_D_GLOBAL_64: alignment=64, sw-addrmethod=VAR_CLEARED_ASIL_D
        VAR_CLEARED_ASIL_D_GLOBAL_8: alignment=8, sw-addrmethod=VAR_CLEARED_ASIL_D
        VAR_CLEARED_ASIL_D_GLOBAL_BOOLEAN: alignment=BOOLEAN, sw-addrmethod=VAR_CLEARED_ASIL_D
        VAR_CLEARED_ASIL_D_GLOBAL_PTR: alignment=PTR, sw-addrmethod=VAR_CLEARED_ASIL_D
        VAR_CLEARED_ASIL_D_GLOBAL_UNSPECIFIED: alignment=UNSPECIFIED, sw-addrmethod=VAR_CLEARED_ASIL_D
        VAR_FAST_CLEARED_ASIL_D_GLOBAL_16: alignment=16, sw-addrmethod=VAR_FAST_CLEARED_ASIL_D
        VAR_FAST_CLEARED_ASIL_D_GLOBAL_32: alignment=32, sw-addrmethod=VAR_FAST_CLEARED_ASIL_D
        VAR_FAST_CLEARED_ASIL_D_GLOBAL_64: alignment=64, sw-addrmethod=VAR_FAST_CLEARED_ASIL_D
        VAR_FAST_CLEARED_ASIL_D_GLOBAL_8: alignment=8, sw-addrmethod=VAR_FAST_CLEARED_ASIL_D
        VAR_FAST_CLEARED_ASIL_D_GLOBAL_BOOLEAN: alignment=BOOLEAN, sw-addrmethod=VAR_FAST_CLEARED_ASIL_D
        VAR_FAST_CLEARED_ASIL_D_GLOBAL_PTR: alignment=PTR, sw-addrmethod=VAR_FAST_CLEARED_ASIL_D
        VAR_FAST_CLEARED_ASIL_D_GLOBAL_UNSPECIFIED: alignment=UNSPECIFIED, sw-addrmethod=VAR_FAST_CLEARED_ASIL_D
        VAR_FAST_INIT_ASIL_D_GLOBAL_16: alignment=16, sw-addrmethod=VAR_FAST_INIT_ASIL_D
        VAR_FAST_INIT_ASIL_D_GLOBAL_32: alignment=32, sw-addrmethod=VAR_FAST_INIT_ASIL_D
        VAR_FAST_INIT_ASIL_D_GLOBAL_64: alignment=64, sw-addrmethod=VAR_FAST_INIT_ASIL_D
        VAR_FAST_INIT_ASIL_D_GLOBAL_8: alignment=8, sw-addrmethod=VAR_FAST_INIT_ASIL_D
        VAR_FAST_INIT_ASIL_D_GLOBAL_BOOLEAN: alignment=BOOLEAN, sw-addrmethod=VAR_FAST_INIT_ASIL_D
        VAR_FAST_INIT_ASIL_D_GLOBAL_PTR: alignment=PTR, sw-addrmethod=VAR_FAST_INIT_ASIL_D
        VAR_FAST_INIT_ASIL_D_GLOBAL_UNSPECIFIED: alignment=UNSPECIFIED, sw-addrmethod=VAR_FAST_INIT_ASIL_D
        VAR_INIT_ASIL_D_GLOBAL_16: alignment=16, sw-addrmethod=VAR_INIT_ASIL_D
        VAR_INIT_ASIL_D_GLOBAL_32: alignment=32, sw-addrmethod=VAR_INIT_ASIL_D
        VAR_INIT_ASIL_D_GLOBAL_64: alignment=64, sw-addrmethod=VAR_INIT_ASIL_D
        VAR_INIT_ASIL_D_GLOBAL_8: alignment=8, sw-addrmethod=VAR_INIT_ASIL_D
        VAR_INIT_ASIL_D_GLOBAL_BOOLEAN: alignment=BOOLEAN, sw-addrmethod=VAR_INIT_ASIL_D
        VAR_INIT_ASIL_D_GLOBAL_PTR: alignment=PTR, sw-addrmethod=VAR_INIT_ASIL_D
        VAR_INIT_ASIL_D_GLOBAL_UNSPECIFIED: alignment=UNSPECIFIED, sw-addrmethod=VAR_INIT_ASIL_D
        VAR_SLOW_CLEARED_ASIL_D_GLOBAL_16: alignment=16, sw-addrmethod=VAR_SLOW_CLEARED_ASIL_D
        VAR_SLOW_CLEARED_ASIL_D_GLOBAL_32: alignment=32, sw-addrmethod=VAR_SLOW_CLEARED_ASIL_D
        VAR_SLOW_CLEARED_ASIL_D_GLOBAL_64: alignment=64, sw-addrmethod=VAR_SLOW_CLEARED_ASIL_D
        VAR_SLOW_CLEARED_ASIL_D_GLOBAL_8: alignment=8, sw-addrmethod=VAR_SLOW_CLEARED_ASIL_D
        VAR_SLOW_CLEARED_ASIL_D_GLOBAL_BOOLEAN: alignment=BOOLEAN, sw-addrmethod=VAR_SLOW_CLEARED_ASIL_D
        VAR_SLOW_CLEARED_ASIL_D_GLOBAL_PTR: alignment=PTR, sw-addrmethod=VAR_SLOW_CLEARED_ASIL_D
        VAR_SLOW_CLEARED_ASIL_D_GLOBAL_UNSPECIFIED: alignment=UNSPECIFIED, sw-addrmethod=VAR_SLOW_CLEARED_ASIL_D
        VAR_SLOW_INIT_ASIL_D_GLOBAL_16: alignment=16, sw-addrmethod=VAR_SLOW_INIT_ASIL_D
        VAR_SLOW_INIT_ASIL_D_GLOBAL_32: alignment=32, sw-addrmethod=VAR_SLOW_INIT_ASIL_D
        VAR_SLOW_INIT_ASIL_D_GLOBAL_64: alignment=64, sw-addrmethod=VAR_SLOW_INIT_ASIL_D
        VAR_SLOW_INIT_ASIL_D_GLOBAL_8: alignment=8, sw-addrmethod=VAR_SLOW_INIT_ASIL_D
        VAR_SLOW_INIT_ASIL_D_GLOBAL_BOOLEAN: alignment=BOOLEAN, sw-addrmethod=VAR_SLOW_INIT_ASIL_D
        VAR_SLOW_INIT_ASIL_D_GLOBAL_PTR: alignment=PTR, sw-addrmethod=VAR_SLOW_INIT_ASIL_D
        VAR_SLOW_INIT_ASIL_D_GLOBAL_UNSPECIFIED: alignment=UNSPECIFIED, sw-addrmethod=VAR_SLOW_INIT_ASIL_D
package /MICROSAR/BswM_ib_bswmd/BswModuleDescriptions
  bsw module description BswM: provided-entrys=[BswM_Virtual, BswM_MainFunction]
    bsw internal behavior BswMBehavior
      exclusive area BSWM_EXCLUSIVE_AREA_0
      bsw schedulable entity BswM_MainFunction: can-enters=BSWM_EXCLUSIVE_AREA_0, can-enter-exclusive-area=BSWM_EXCLUSIVE_AREA_0, sw-addr-method=CODE_ASIL_D, implemented-entry=BswM_MainFunction
      bsw timing event BswM_MainFunctionTimingEvent0: starts-on-event=BswM_MainFunction, period=0.01
  bsw module entry BswM_Virtual: call-type=REGULAR, execution-context=TASK
  bsw module entry BswM_MainFunction: call-type=SCHEDULED, execution-context=TASK
