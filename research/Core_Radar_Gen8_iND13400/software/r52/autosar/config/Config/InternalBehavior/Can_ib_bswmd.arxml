AUTOSAR XML (schema 00051)
package /indieSemi/Can_ib_bswmd/BswModuleDescriptions
  bsw module description Can: provided-entrys=Can_MainFunction_Mode
    bsw internal behavior CanBehavior
      exclusive area CAN_EXCLUSIVE_AREA_0
      exclusive area CAN_EXCLUSIVE_AREA_1
      bsw schedulable entity Can_MainFunction_Mode: can-enters=[CAN_EXCLUSIVE_AREA_0, CAN_EXCLUSIVE_AREA_1], can-enter-exclusive-area=[CAN_EXCLUSIVE_AREA_0, CAN_EXCLUSIVE_AREA_1], implemented-entry=Can_MainFunction_Mode
      bsw timing event Can_MainFunction_ModeTimingEvent0: starts-on-event=Can_MainFunction_Mode, period=0.05
  bsw module entry Can_MainFunction_Mode: call-type=SCHEDULED, execution-context=TASK
