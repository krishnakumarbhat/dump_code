AUTOSAR XML (schema 00053)
package /MICROSAR/CanIf_ib_bswmd/BswModuleDescriptions
  bsw module description CanIf: provided-entrys=CanIf_Virtual
    bsw internal behavior CanIf_Behavior
      10 x exclusive area:
        CANIF_EXCLUSIVE_AREA_{0..9}
      bsw called entity CanIf_Virtual: can-enter-exclusive-area=[CANIF_EXCLUSIVE_AREA_0, CANIF_EXCLUSIVE_AREA_1, CANIF_EXCLUSIVE_AREA_2, CANIF_EXCLUSIVE_AREA_3, CANIF_EXCLUSIVE_AREA_4, CANIF_EXCLUSIVE_AREA_5, CANIF_EXCLUSIVE_AREA_6, CANIF_EXCLUSIVE_AREA_7, CANIF_EXCLUSIVE_AREA_8, CANIF_EXCLUSIVE_AREA_9], implemented-entry=CanIf_Virtual
        can-enters:
          CANIF_EXCLUSIVE_AREA_{0..9}
  bsw module entry CanIf_Virtual: call-type=REGULAR, execution-context=TASK
