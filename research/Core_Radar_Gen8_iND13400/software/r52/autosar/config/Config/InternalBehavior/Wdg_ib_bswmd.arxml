AUTOSAR XML (schema 00051)
package /indieSemi/Wdg_ib_bswmd/BswModuleDescriptions
  bsw module description Wdg: provided-entrys=Wdg_Virtual
    bsw internal behavior WdgBehavior
      exclusive area WDG_EXCLUSIVE_AREA_0
      bsw called entity Wdg_Virtual: can-enters=WDG_EXCLUSIVE_AREA_0, can-enter-exclusive-area=WDG_EXCLUSIVE_AREA_0, implemented-entry=Wdg_Virtual
  bsw module entry Wdg_Virtual: call-type=REGULAR, execution-context=TASK
