AUTOSAR XML (schema 00053)
package /MICROSAR
  bsw implementation EcuM_Impl: programming-language=C, sw-version=17.00.00, used-code-generator=DaVinci Configurator, vendor-id=30, ar-release-version=4.00.03
    resource consumption ResourceConsumption
      54 x memory section:
        CODE: sw-addrmethod=CODE
        CALLOUT_CODE_ASIL_D: sw-addrmethod=CALLOUT_CODE_ASIL_D
        CODE_ASIL_D: sw-addrmethod=CODE_ASIL_D
        CONFIG_DATA_POSTBUILD: sw-addrmethod=CONFIG_DATA_POSTBUILD
        CONFIG_DATA_PREBUILD_ASIL_D_16: alignment=16, sw-addrmethod=CONFIG_DATA_PREBUILD_ASIL_D
        CONFIG_DATA_PREBUILD_ASIL_D_32: alignment=32, sw-addrmethod=CONFIG_DATA_PREBUILD_ASIL_D
        CONFIG_DATA_PREBUILD_ASIL_D_64: alignment=64, sw-addrmethod=CONFIG_DATA_PREBUILD_ASIL_D
        CONFIG_DATA_PREBUILD_ASIL_D_8: alignment=8, sw-addrmethod=CONFIG_DATA_PREBUILD_ASIL_D
        CONFIG_DATA_PREBUILD_ASIL_D_BOOLEAN: alignment=BOOLEAN, sw-addrmethod=CONFIG_DATA_PREBUILD_ASIL_D
        CONFIG_DATA_PREBUILD_ASIL_D_PTR: alignment=PTR, sw-addrmethod=CONFIG_DATA_PREBUILD_ASIL_D
        CONFIG_DATA_PREBUILD_ASIL_D_UNSPECIFIED: alignment=UNSPECIFIED, sw-addrmethod=CONFIG_DATA_PREBUILD_ASIL_D
        CONST_ASIL_D: sw-addrmethod=CONST_ASIL_D
        VAR_CLEARED_ASIL_D_GLOBAL_16: alignment=16, sw-addrmethod=VAR_CLEARED_ASIL_D
        VAR_CLEARED_ASIL_D_GLOBAL_32: alignment=32, sw-addrmethod=VAR_CLEARED_ASIL_D
        VAR_CLEARED_ASIL_D_GLOBAL_64: alignment=64, sw-addrmethod=VAR_CLEARED_ASIL_D
        VAR_CLEARED_ASIL_D_GLOBAL_8: alignment=8, sw-addrmethod=VAR_CLEARED_ASIL_D
        VAR_CLEARED_ASIL_D_GLOBAL_BOOLEAN: alignment=BOOLEAN, sw-addrmethod=VAR_CLEARED_ASIL_D
        VAR_CLEARED_ASIL_D_GLOBAL_PTR: alignment=PTR, sw-addrmethod=VAR_CLEARED_ASIL_D
        VAR_CLEARED_ASIL_D_GLOBAL_UNSPECIFIED: alignment=UNSPECIFIED, sw-addrmethod=VAR_CLEARED_ASIL_D
        VAR_FAST_CLEARED_ASIL_D_GLOBAL_16: alignment=16, sw-addrmethod=VAR_FAST_CLEARED_ASIL_D
        VAR_FAST_CLEARED_ASIL_D_GLOBAL_32: alignment=32, sw-addrmethod=VAR_FAST_CLEARED_ASIL_D
        VAR_FAST_CLEARED_ASIL_D_GLOBAL_64: alignment=64, sw-addrmethod=VAR_FAST_CLEARED_ASIL_D
        VAR_FAST_CLEARED_ASIL_D_GLOBAL_8: alignment=8, sw-addrmethod=VAR_FAST_CLEARED_ASIL_D
        VAR_FAST_CLEARED_ASIL_D_GLOBAL_BOOLEAN: alignment=BOOLEAN, sw-addrmethod=VAR_FAST_CLEARED_ASIL_D
        VAR_FAST_CLEARED_ASIL_D_GLOBAL_PTR: alignment=PTR, sw-addrmethod=VAR_FAST_CLEARED_ASIL_D
        VAR_FAST_CLEARED_ASIL_D_GLOBAL_UNSPECIFIED: alignment=UNSPECIFIED, sw-addrmethod=VAR_FAST_CLEARED_ASIL_D
        VAR_FAST_INIT_ASIL_D_GLOBAL_16: alignment=16, sw-addrmethod=VAR_FAST_INIT_ASIL_D
        VAR_FAST_INIT_ASIL_D_GLOBAL_32: alignment=32, sw-addrmethod=VAR_FAST_INIT_ASIL_D
        VAR_FAST_INIT_ASIL_D_GLOBAL_64: alignment=64, sw-addrmethod=VAR_FAST_INIT_ASIL_D
        VAR_FAST_INIT_ASIL_D_GLOBAL_8: alignment=8, sw-addrmethod=VAR_FAST_INIT_ASIL_D
        VAR_FAST_INIT_ASIL_D_GLOBAL_BOOLEAN: alignment=BOOLEAN, sw-addrmethod=VAR_FAST_INIT_ASIL_D
        VAR_FAST_INIT_ASIL_D_GLOBAL_PTR: alignment=PTR, sw-addrmethod=VAR_FAST_INIT_ASIL_D
        VAR_FAST_INIT_ASIL_D_GLOBAL_UNSPECIFIED: alignment=UNSPECIFIED, sw-addrmethod=VAR_FAST_INIT_ASIL_D
        VAR_INIT_ASIL_D_GLOBAL_16: alignment=16, sw-addrmethod=VAR_INIT_ASIL_D
        VAR_INIT_ASIL_D_GLOBAL_32: alignment=32, sw-addrmethod=VAR_INIT_ASIL_D
        VAR_INIT_ASIL_D_GLOBAL_64: alignment=64, sw-addrmethod=VAR_INIT_ASIL_D
        VAR_INIT_ASIL_D_GLOBAL_8: alignment=8, sw-addrmethod=VAR_INIT_ASIL_D
        VAR_INIT_ASIL_D_GLOBAL_BOOLEAN: alignment=BOOLEAN, sw-addrmethod=VAR_INIT_ASIL_D
        VAR_INIT_ASIL_D_GLOBAL_PTR: alignment=PTR, sw-addrmethod=VAR_INIT_ASIL_D
        VAR_INIT_ASIL_D_GLOBAL_UNSPECIFIED: alignment=UNSPECIFIED, sw-addrmethod=VAR_INIT_ASIL_D
        VAR_SLOW_CLEARED_ASIL_D_GLOBAL_16: alignment=16, sw-addrmethod=VAR_SLOW_CLEARED_ASIL_D
        VAR_SLOW_CLEARED_ASIL_D_GLOBAL_32: alignment=32, sw-addrmethod=VAR_SLOW_CLEARED_ASIL_D
        VAR_SLOW_CLEARED_ASIL_D_GLOBAL_64: alignment=64, sw-addrmethod=VAR_SLOW_CLEARED_ASIL_D
        VAR_SLOW_CLEARED_ASIL_D_GLOBAL_8: alignment=8, sw-addrmethod=VAR_SLOW_CLEARED_ASIL_D
        VAR_SLOW_CLEARED_ASIL_D_GLOBAL_BOOLEAN: alignment=BOOLEAN, sw-addrmethod=VAR_SLOW_CLEARED_ASIL_D
        VAR_SLOW_CLEARED_ASIL_D_GLOBAL_PTR: alignment=PTR, sw-addrmethod=VAR_SLOW_CLEARED_ASIL_D
        VAR_SLOW_CLEARED_ASIL_D_GLOBAL_UNSPECIFIED: alignment=UNSPECIFIED, sw-addrmethod=VAR_SLOW_CLEARED_ASIL_D
        VAR_SLOW_INIT_ASIL_D_GLOBAL_16: alignment=16, sw-addrmethod=VAR_SLOW_INIT_ASIL_D
        VAR_SLOW_INIT_ASIL_D_GLOBAL_32: alignment=32, sw-addrmethod=VAR_SLOW_INIT_ASIL_D
        VAR_SLOW_INIT_ASIL_D_GLOBAL_64: alignment=64, sw-addrmethod=VAR_SLOW_INIT_ASIL_D
        VAR_SLOW_INIT_ASIL_D_GLOBAL_8: alignment=8, sw-addrmethod=VAR_SLOW_INIT_ASIL_D
        VAR_SLOW_INIT_ASIL_D_GLOBAL_BOOLEAN: alignment=BOOLEAN, sw-addrmethod=VAR_SLOW_INIT_ASIL_D
        VAR_SLOW_INIT_ASIL_D_GLOBAL_PTR: alignment=PTR, sw-addrmethod=VAR_SLOW_INIT_ASIL_D
        VAR_SLOW_INIT_ASIL_D_GLOBAL_UNSPECIFIED: alignment=UNSPECIFIED, sw-addrmethod=VAR_SLOW_INIT_ASIL_D
package /MICROSAR/EcuM_ib_bswmd/BswModuleDescriptions
  bsw module description EcuM: provided-entrys=EcuM_MainFunction
    bsw internal behavior EcuMBehavior
      5 x exclusive area:
        ECUM_EXCLUSIVE_AREA_0  # This exclusive area shall disable all wake up interrupts to prevent overwriting of some global variables.
        ECUM_EXCLUSIVE_AREA_1  # This exclusive area is only used in case of multi core and if the the EcuM is configured to handle also the slave cores. It must be configured as a spinlock to allow access to some variables simultaneously from multiple cores.
        ECUM_EXCLUSIVE_AREA_2  # This exclusive area is used for accessing the clock variable. It shall disable GPT interrupts and task changes. Only necessary if 32 Bit access is not atomic and Alarm Clock is present.
        ECUM_EXCLUSIVE_AREA_3  # This exclusive area is used in multi-core use cases to protect variables from concurrent access (configured as spinlock) and in single-core use cases to protect non-atomic access on the same variables (configured as interrupt blocking).
        ECUM_EXCLUSIVE_AREA_RUNREQUESTFLAGS  # This exclusive area protects the access to partition specific RunRequestFlags and PostRunRequestFlags if RUN or POSTRUN is requested or released by a user. It also ensures a consistent notification of RUN or POSTRUN request/release to BswM if ModeHandling feature is used. For more details see TechnicalReference.
      bsw schedulable entity EcuM_MainFunction: can-enter-exclusive-area=[ECUM_EXCLUSIVE_AREA_0, ECUM_EXCLUSIVE_AREA_1, ECUM_EXCLUSIVE_AREA_2, ECUM_EXCLUSIVE_AREA_3], sw-addr-method=CODE_ASIL_D, implemented-entry=EcuM_MainFunction
        can-enters:
          ECUM_EXCLUSIVE_AREA_{0..3}
          ECUM_EXCLUSIVE_AREA_RUNREQUESTFLAGS
      bsw timing event EcuM_MainFunctionTimingEvent0: starts-on-event=EcuM_MainFunction, period=0.01
  bsw module entry EcuM_MainFunction: call-type=SCHEDULED, execution-context=TASK
