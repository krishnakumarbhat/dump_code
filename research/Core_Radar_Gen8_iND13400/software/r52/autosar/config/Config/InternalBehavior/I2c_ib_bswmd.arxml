AUTOSAR XML (schema 00053)
package /indieSemi/I2c_ib_bswmd/BswModuleDescriptions
  bsw module description I2c: provided-entrys=I2c_Virtual
    bsw internal behavior I2cBehavior
      exclusive area I2C_EXCLUSIVE_AREA_0
      bsw called entity I2c_Virtual: can-enters=I2C_EXCLUSIVE_AREA_0, implemented-entry=I2c_Virtual
  bsw module entry I2c_Virtual: call-type=REGULAR, execution-context=TASK
