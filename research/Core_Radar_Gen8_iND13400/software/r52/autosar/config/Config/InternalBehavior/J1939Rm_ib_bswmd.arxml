AUTOSAR XML (schema 00049)
package /MICROSAR
  bsw implementation J1939Rm_Impl: programming-language=C, sw-version=10.03.01, used-code-generator=DaVinci Configurator, vendor-id=30, ar-release-version=4.05.00
