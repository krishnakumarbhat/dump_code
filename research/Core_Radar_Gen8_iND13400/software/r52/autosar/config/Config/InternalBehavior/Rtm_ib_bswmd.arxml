AUTOSAR XML (schema 00053)
standard types defined: sint32, uint32, uint8
package /MICROSAR
  bsw implementation Rtm_Impl: programming-language=C, sw-version=12.01.00, used-code-generator=DaVinci Configurator, vendor-id=30, ar-release-version=4.02.02
    mc-variable-instances:
      64 x mc data instance:
        Rtm_MeasTimeCorrection: category=VALUE, resulting-properties={base-type=sint32, sw-calibration-access=READ-ONLY, range raw -2147483648..2147483647}, variation-point=post-build-variant-condition{matching-criterion=RDR_POS, value=0}
        Rtm_Cmd: category=VALUE, resulting-properties={base-type=uint32, sw-calibration-access=READ-WRITE, range raw 0..4294967295}, variation-point=post-build-variant-condition{matching-criterion=RDR_POS, value=0}
        Rtm_Resp: category=VALUE, resulting-properties={base-type=uint32, sw-calibration-access=READ-WRITE, range raw 0..4294967295}, variation-point=post-build-variant-condition{matching-criterion=RDR_POS, value=0}
        Rtm_AverageMainFunctionCycleTime: category=VALUE, resulting-properties={base-type=uint32, sw-calibration-access=READ-ONLY, range raw 0..4294967295}, variation-point=post-build-variant-condition{matching-criterion=RDR_POS, value=0}
        Rtm_MainFunctionCounter: category=VALUE, resulting-properties={base-type=uint32, sw-calibration-access=READ-ONLY, range raw 0..4294967295}, variation-point=post-build-variant-condition{matching-criterion=RDR_POS, value=0}
        Rtm_CpuLoadTime: category=VALUE, resulting-properties={base-type=uint32, sw-calibration-access=READ-ONLY, range raw 0..4294967295}, variation-point=post-build-variant-condition{matching-criterion=RDR_POS, value=0}
        Rtm_MeasurementConfig: category=ARRAY, array-size=2, resulting-properties={base-type=uint8, sw-calibration-access=READ-WRITE, range raw 0..255}, variation-point=post-build-variant-condition{matching-criterion=RDR_POS, value=0}
        Rtm_Results: category=ARRAY, array-size=15, variation-point=post-build-variant-condition{matching-criterion=RDR_POS, value=0}
          15 x mc data instance, all with category=STRUCTURE:
            Element_0: symbol=[0]
              4 x mc data instance, all with category=VALUE, resulting-properties={base-type=uint32, sw-calibration-access=READ-ONLY, range raw 0..4294967295}:
                time
                count
                max
                min
            Element_1: symbol=[1]
              4 x mc data instance, all with category=VALUE, resulting-properties={base-type=uint32, sw-calibration-access=READ-ONLY, range raw 0..4294967295}:
                time
                count
                max
                min
            Element_2: symbol=[2]
              4 x mc data instance, all with category=VALUE, resulting-properties={base-type=uint32, sw-calibration-access=READ-ONLY, range raw 0..4294967295}:
                time
                count
                max
                min
            Element_3: symbol=[3]
              4 x mc data instance, all with category=VALUE, resulting-properties={base-type=uint32, sw-calibration-access=READ-ONLY, range raw 0..4294967295}:
                time
                count
                max
                min
            Element_4: symbol=[4]
              4 x mc data instance, all with category=VALUE, resulting-properties={base-type=uint32, sw-calibration-access=READ-ONLY, range raw 0..4294967295}:
                time
                count
                max
                min
            Element_5: symbol=[5]
              4 x mc data instance, all with category=VALUE, resulting-properties={base-type=uint32, sw-calibration-access=READ-ONLY, range raw 0..4294967295}:
                time
                count
                max
                min
            Element_6: symbol=[6]
              4 x mc data instance, all with category=VALUE, resulting-properties={base-type=uint32, sw-calibration-access=READ-ONLY, range raw 0..4294967295}:
                time
                count
                max
                min
            Element_7: symbol=[7]
              4 x mc data instance, all with category=VALUE, resulting-properties={base-type=uint32, sw-calibration-access=READ-ONLY, range raw 0..4294967295}:
                time
                count
                max
                min
            Element_8: symbol=[8]
              4 x mc data instance, all with category=VALUE, resulting-properties={base-type=uint32, sw-calibration-access=READ-ONLY, range raw 0..4294967295}:
                time
                count
                max
                min
            Element_9: symbol=[9]
              4 x mc data instance, all with category=VALUE, resulting-properties={base-type=uint32, sw-calibration-access=READ-ONLY, range raw 0..4294967295}:
                time
                count
                max
                min
            Element_10: symbol=[10]
              4 x mc data instance, all with category=VALUE, resulting-properties={base-type=uint32, sw-calibration-access=READ-ONLY, range raw 0..4294967295}:
                time
                count
                max
                min
            Element_11: symbol=[11]
              4 x mc data instance, all with category=VALUE, resulting-properties={base-type=uint32, sw-calibration-access=READ-ONLY, range raw 0..4294967295}:
                time
                count
                max
                min
            Element_12: symbol=[12]
              4 x mc data instance, all with category=VALUE, resulting-properties={base-type=uint32, sw-calibration-access=READ-ONLY, range raw 0..4294967295}:
                time
                count
                max
                min
            Element_13: symbol=[13]
              4 x mc data instance, all with category=VALUE, resulting-properties={base-type=uint32, sw-calibration-access=READ-ONLY, range raw 0..4294967295}:
                time
                count
                max
                min
            Element_14: symbol=[14]
              4 x mc data instance, all with category=VALUE, resulting-properties={base-type=uint32, sw-calibration-access=READ-ONLY, range raw 0..4294967295}:
                time
                count
                max
                min
        Rtm_MeasTimeCorrection: category=VALUE, resulting-properties={base-type=sint32, sw-calibration-access=READ-ONLY, range raw -2147483648..2147483647}, variation-point=post-build-variant-condition{matching-criterion=RDR_POS, value=1}
        Rtm_Cmd: category=VALUE, resulting-properties={base-type=uint32, sw-calibration-access=READ-WRITE, range raw 0..4294967295}, variation-point=post-build-variant-condition{matching-criterion=RDR_POS, value=1}
        Rtm_Resp: category=VALUE, resulting-properties={base-type=uint32, sw-calibration-access=READ-WRITE, range raw 0..4294967295}, variation-point=post-build-variant-condition{matching-criterion=RDR_POS, value=1}
        Rtm_AverageMainFunctionCycleTime: category=VALUE, resulting-properties={base-type=uint32, sw-calibration-access=READ-ONLY, range raw 0..4294967295}, variation-point=post-build-variant-condition{matching-criterion=RDR_POS, value=1}
        Rtm_MainFunctionCounter: category=VALUE, resulting-properties={base-type=uint32, sw-calibration-access=READ-ONLY, range raw 0..4294967295}, variation-point=post-build-variant-condition{matching-criterion=RDR_POS, value=1}
        Rtm_CpuLoadTime: category=VALUE, resulting-properties={base-type=uint32, sw-calibration-access=READ-ONLY, range raw 0..4294967295}, variation-point=post-build-variant-condition{matching-criterion=RDR_POS, value=1}
        Rtm_MeasurementConfig: category=ARRAY, array-size=2, resulting-properties={base-type=uint8, sw-calibration-access=READ-WRITE, range raw 0..255}, variation-point=post-build-variant-condition{matching-criterion=RDR_POS, value=1}
        Rtm_Results: category=ARRAY, array-size=15, variation-point=post-build-variant-condition{matching-criterion=RDR_POS, value=1}
          15 x mc data instance, all with category=STRUCTURE:
            Element_0: symbol=[0]
              4 x mc data instance, all with category=VALUE, resulting-properties={base-type=uint32, sw-calibration-access=READ-ONLY, range raw 0..4294967295}:
                time
                count
                max
                min
            Element_1: symbol=[1]
              4 x mc data instance, all with category=VALUE, resulting-properties={base-type=uint32, sw-calibration-access=READ-ONLY, range raw 0..4294967295}:
                time
                count
                max
                min
            Element_2: symbol=[2]
              4 x mc data instance, all with category=VALUE, resulting-properties={base-type=uint32, sw-calibration-access=READ-ONLY, range raw 0..4294967295}:
                time
                count
                max
                min
            Element_3: symbol=[3]
              4 x mc data instance, all with category=VALUE, resulting-properties={base-type=uint32, sw-calibration-access=READ-ONLY, range raw 0..4294967295}:
                time
                count
                max
                min
            Element_4: symbol=[4]
              4 x mc data instance, all with category=VALUE, resulting-properties={base-type=uint32, sw-calibration-access=READ-ONLY, range raw 0..4294967295}:
                time
                count
                max
                min
            Element_5: symbol=[5]
              4 x mc data instance, all with category=VALUE, resulting-properties={base-type=uint32, sw-calibration-access=READ-ONLY, range raw 0..4294967295}:
                time
                count
                max
                min
            Element_6: symbol=[6]
              4 x mc data instance, all with category=VALUE, resulting-properties={base-type=uint32, sw-calibration-access=READ-ONLY, range raw 0..4294967295}:
                time
                count
                max
                min
            Element_7: symbol=[7]
              4 x mc data instance, all with category=VALUE, resulting-properties={base-type=uint32, sw-calibration-access=READ-ONLY, range raw 0..4294967295}:
                time
                count
                max
                min
            Element_8: symbol=[8]
              4 x mc data instance, all with category=VALUE, resulting-properties={base-type=uint32, sw-calibration-access=READ-ONLY, range raw 0..4294967295}:
                time
                count
                max
                min
            Element_9: symbol=[9]
              4 x mc data instance, all with category=VALUE, resulting-properties={base-type=uint32, sw-calibration-access=READ-ONLY, range raw 0..4294967295}:
                time
                count
                max
                min
            Element_10: symbol=[10]
              4 x mc data instance, all with category=VALUE, resulting-properties={base-type=uint32, sw-calibration-access=READ-ONLY, range raw 0..4294967295}:
                time
                count
                max
                min
            Element_11: symbol=[11]
              4 x mc data instance, all with category=VALUE, resulting-properties={base-type=uint32, sw-calibration-access=READ-ONLY, range raw 0..4294967295}:
                time
                count
                max
                min
            Element_12: symbol=[12]
              4 x mc data instance, all with category=VALUE, resulting-properties={base-type=uint32, sw-calibration-access=READ-ONLY, range raw 0..4294967295}:
                time
                count
                max
                min
            Element_13: symbol=[13]
              4 x mc data instance, all with category=VALUE, resulting-properties={base-type=uint32, sw-calibration-access=READ-ONLY, range raw 0..4294967295}:
                time
                count
                max
                min
            Element_14: symbol=[14]
              4 x mc data instance, all with category=VALUE, resulting-properties={base-type=uint32, sw-calibration-access=READ-ONLY, range raw 0..4294967295}:
                time
                count
                max
                min
        Rtm_MeasTimeCorrection: category=VALUE, resulting-properties={base-type=sint32, sw-calibration-access=READ-ONLY, range raw -2147483648..2147483647}, variation-point=post-build-variant-condition{matching-criterion=RDR_POS, value=2}
        Rtm_Cmd: category=VALUE, resulting-properties={base-type=uint32, sw-calibration-access=READ-WRITE, range raw 0..4294967295}, variation-point=post-build-variant-condition{matching-criterion=RDR_POS, value=2}
        Rtm_Resp: category=VALUE, resulting-properties={base-type=uint32, sw-calibration-access=READ-WRITE, range raw 0..4294967295}, variation-point=post-build-variant-condition{matching-criterion=RDR_POS, value=2}
        Rtm_AverageMainFunctionCycleTime: category=VALUE, resulting-properties={base-type=uint32, sw-calibration-access=READ-ONLY, range raw 0..4294967295}, variation-point=post-build-variant-condition{matching-criterion=RDR_POS, value=2}
        Rtm_MainFunctionCounter: category=VALUE, resulting-properties={base-type=uint32, sw-calibration-access=READ-ONLY, range raw 0..4294967295}, variation-point=post-build-variant-condition{matching-criterion=RDR_POS, value=2}
        Rtm_CpuLoadTime: category=VALUE, resulting-properties={base-type=uint32, sw-calibration-access=READ-ONLY, range raw 0..4294967295}, variation-point=post-build-variant-condition{matching-criterion=RDR_POS, value=2}
        Rtm_MeasurementConfig: category=ARRAY, array-size=2, resulting-properties={base-type=uint8, sw-calibration-access=READ-WRITE, range raw 0..255}, variation-point=post-build-variant-condition{matching-criterion=RDR_POS, value=2}
        Rtm_Results: category=ARRAY, array-size=15, variation-point=post-build-variant-condition{matching-criterion=RDR_POS, value=2}
          15 x mc data instance, all with category=STRUCTURE:
            Element_0: symbol=[0]
              4 x mc data instance, all with category=VALUE, resulting-properties={base-type=uint32, sw-calibration-access=READ-ONLY, range raw 0..4294967295}:
                time
                count
                max
                min
            Element_1: symbol=[1]
              4 x mc data instance, all with category=VALUE, resulting-properties={base-type=uint32, sw-calibration-access=READ-ONLY, range raw 0..4294967295}:
                time
                count
                max
                min
            Element_2: symbol=[2]
              4 x mc data instance, all with category=VALUE, resulting-properties={base-type=uint32, sw-calibration-access=READ-ONLY, range raw 0..4294967295}:
                time
                count
                max
                min
            Element_3: symbol=[3]
              4 x mc data instance, all with category=VALUE, resulting-properties={base-type=uint32, sw-calibration-access=READ-ONLY, range raw 0..4294967295}:
                time
                count
                max
                min
            Element_4: symbol=[4]
              4 x mc data instance, all with category=VALUE, resulting-properties={base-type=uint32, sw-calibration-access=READ-ONLY, range raw 0..4294967295}:
                time
                count
                max
                min
            Element_5: symbol=[5]
              4 x mc data instance, all with category=VALUE, resulting-properties={base-type=uint32, sw-calibration-access=READ-ONLY, range raw 0..4294967295}:
                time
                count
                max
                min
            Element_6: symbol=[6]
              4 x mc data instance, all with category=VALUE, resulting-properties={base-type=uint32, sw-calibration-access=READ-ONLY, range raw 0..4294967295}:
                time
                count
                max
                min
            Element_7: symbol=[7]
              4 x mc data instance, all with category=VALUE, resulting-properties={base-type=uint32, sw-calibration-access=READ-ONLY, range raw 0..4294967295}:
                time
                count
                max
                min
            Element_8: symbol=[8]
              4 x mc data instance, all with category=VALUE, resulting-properties={base-type=uint32, sw-calibration-access=READ-ONLY, range raw 0..4294967295}:
                time
                count
                max
                min
            Element_9: symbol=[9]
              4 x mc data instance, all with category=VALUE, resulting-properties={base-type=uint32, sw-calibration-access=READ-ONLY, range raw 0..4294967295}:
                time
                count
                max
                min
            Element_10: symbol=[10]
              4 x mc data instance, all with category=VALUE, resulting-properties={base-type=uint32, sw-calibration-access=READ-ONLY, range raw 0..4294967295}:
                time
                count
                max
                min
            Element_11: symbol=[11]
              4 x mc data instance, all with category=VALUE, resulting-properties={base-type=uint32, sw-calibration-access=READ-ONLY, range raw 0..4294967295}:
                time
                count
                max
                min
            Element_12: symbol=[12]
              4 x mc data instance, all with category=VALUE, resulting-properties={base-type=uint32, sw-calibration-access=READ-ONLY, range raw 0..4294967295}:
                time
                count
                max
                min
            Element_13: symbol=[13]
              4 x mc data instance, all with category=VALUE, resulting-properties={base-type=uint32, sw-calibration-access=READ-ONLY, range raw 0..4294967295}:
                time
                count
                max
                min
            Element_14: symbol=[14]
              4 x mc data instance, all with category=VALUE, resulting-properties={base-type=uint32, sw-calibration-access=READ-ONLY, range raw 0..4294967295}:
                time
                count
                max
                min
        Rtm_MeasTimeCorrection: category=VALUE, resulting-properties={base-type=sint32, sw-calibration-access=READ-ONLY, range raw -2147483648..2147483647}, variation-point=post-build-variant-condition{matching-criterion=RDR_POS, value=3}
        Rtm_Cmd: category=VALUE, resulting-properties={base-type=uint32, sw-calibration-access=READ-WRITE, range raw 0..4294967295}, variation-point=post-build-variant-condition{matching-criterion=RDR_POS, value=3}
        Rtm_Resp: category=VALUE, resulting-properties={base-type=uint32, sw-calibration-access=READ-WRITE, range raw 0..4294967295}, variation-point=post-build-variant-condition{matching-criterion=RDR_POS, value=3}
        Rtm_AverageMainFunctionCycleTime: category=VALUE, resulting-properties={base-type=uint32, sw-calibration-access=READ-ONLY, range raw 0..4294967295}, variation-point=post-build-variant-condition{matching-criterion=RDR_POS, value=3}
        Rtm_MainFunctionCounter: category=VALUE, resulting-properties={base-type=uint32, sw-calibration-access=READ-ONLY, range raw 0..4294967295}, variation-point=post-build-variant-condition{matching-criterion=RDR_POS, value=3}
        Rtm_CpuLoadTime: category=VALUE, resulting-properties={base-type=uint32, sw-calibration-access=READ-ONLY, range raw 0..4294967295}, variation-point=post-build-variant-condition{matching-criterion=RDR_POS, value=3}
        Rtm_MeasurementConfig: category=ARRAY, array-size=2, resulting-properties={base-type=uint8, sw-calibration-access=READ-WRITE, range raw 0..255}, variation-point=post-build-variant-condition{matching-criterion=RDR_POS, value=3}
        Rtm_Results: category=ARRAY, array-size=15, variation-point=post-build-variant-condition{matching-criterion=RDR_POS, value=3}
          15 x mc data instance, all with category=STRUCTURE:
            Element_0: symbol=[0]
              4 x mc data instance, all with category=VALUE, resulting-properties={base-type=uint32, sw-calibration-access=READ-ONLY, range raw 0..4294967295}:
                time
                count
                max
                min
            Element_1: symbol=[1]
              4 x mc data instance, all with category=VALUE, resulting-properties={base-type=uint32, sw-calibration-access=READ-ONLY, range raw 0..4294967295}:
                time
                count
                max
                min
            Element_2: symbol=[2]
              4 x mc data instance, all with category=VALUE, resulting-properties={base-type=uint32, sw-calibration-access=READ-ONLY, range raw 0..4294967295}:
                time
                count
                max
                min
            Element_3: symbol=[3]
              4 x mc data instance, all with category=VALUE, resulting-properties={base-type=uint32, sw-calibration-access=READ-ONLY, range raw 0..4294967295}:
                time
                count
                max
                min
            Element_4: symbol=[4]
              4 x mc data instance, all with category=VALUE, resulting-properties={base-type=uint32, sw-calibration-access=READ-ONLY, range raw 0..4294967295}:
                time
                count
                max
                min
            Element_5: symbol=[5]
              4 x mc data instance, all with category=VALUE, resulting-properties={base-type=uint32, sw-calibration-access=READ-ONLY, range raw 0..4294967295}:
                time
                count
                max
                min
            Element_6: symbol=[6]
              4 x mc data instance, all with category=VALUE, resulting-properties={base-type=uint32, sw-calibration-access=READ-ONLY, range raw 0..4294967295}:
                time
                count
                max
                min
            Element_7: symbol=[7]
              4 x mc data instance, all with category=VALUE, resulting-properties={base-type=uint32, sw-calibration-access=READ-ONLY, range raw 0..4294967295}:
                time
                count
                max
                min
            Element_8: symbol=[8]
              4 x mc data instance, all with category=VALUE, resulting-properties={base-type=uint32, sw-calibration-access=READ-ONLY, range raw 0..4294967295}:
                time
                count
                max
                min
            Element_9: symbol=[9]
              4 x mc data instance, all with category=VALUE, resulting-properties={base-type=uint32, sw-calibration-access=READ-ONLY, range raw 0..4294967295}:
                time
                count
                max
                min
            Element_10: symbol=[10]
              4 x mc data instance, all with category=VALUE, resulting-properties={base-type=uint32, sw-calibration-access=READ-ONLY, range raw 0..4294967295}:
                time
                count
                max
                min
            Element_11: symbol=[11]
              4 x mc data instance, all with category=VALUE, resulting-properties={base-type=uint32, sw-calibration-access=READ-ONLY, range raw 0..4294967295}:
                time
                count
                max
                min
            Element_12: symbol=[12]
              4 x mc data instance, all with category=VALUE, resulting-properties={base-type=uint32, sw-calibration-access=READ-ONLY, range raw 0..4294967295}:
                time
                count
                max
                min
            Element_13: symbol=[13]
              4 x mc data instance, all with category=VALUE, resulting-properties={base-type=uint32, sw-calibration-access=READ-ONLY, range raw 0..4294967295}:
                time
                count
                max
                min
            Element_14: symbol=[14]
              4 x mc data instance, all with category=VALUE, resulting-properties={base-type=uint32, sw-calibration-access=READ-ONLY, range raw 0..4294967295}:
                time
                count
                max
                min
        Rtm_MeasTimeCorrection: category=VALUE, resulting-properties={base-type=sint32, sw-calibration-access=READ-ONLY, range raw -2147483648..2147483647}, variation-point=post-build-variant-condition{matching-criterion=RDR_POS, value=4}
        Rtm_Cmd: category=VALUE, resulting-properties={base-type=uint32, sw-calibration-access=READ-WRITE, range raw 0..4294967295}, variation-point=post-build-variant-condition{matching-criterion=RDR_POS, value=4}
        Rtm_Resp: category=VALUE, resulting-properties={base-type=uint32, sw-calibration-access=READ-WRITE, range raw 0..4294967295}, variation-point=post-build-variant-condition{matching-criterion=RDR_POS, value=4}
        Rtm_AverageMainFunctionCycleTime: category=VALUE, resulting-properties={base-type=uint32, sw-calibration-access=READ-ONLY, range raw 0..4294967295}, variation-point=post-build-variant-condition{matching-criterion=RDR_POS, value=4}
        Rtm_MainFunctionCounter: category=VALUE, resulting-properties={base-type=uint32, sw-calibration-access=READ-ONLY, range raw 0..4294967295}, variation-point=post-build-variant-condition{matching-criterion=RDR_POS, value=4}
        Rtm_CpuLoadTime: category=VALUE, resulting-properties={base-type=uint32, sw-calibration-access=READ-ONLY, range raw 0..4294967295}, variation-point=post-build-variant-condition{matching-criterion=RDR_POS, value=4}
        Rtm_MeasurementConfig: category=ARRAY, array-size=2, resulting-properties={base-type=uint8, sw-calibration-access=READ-WRITE, range raw 0..255}, variation-point=post-build-variant-condition{matching-criterion=RDR_POS, value=4}
        Rtm_Results: category=ARRAY, array-size=15, variation-point=post-build-variant-condition{matching-criterion=RDR_POS, value=4}
          15 x mc data instance, all with category=STRUCTURE:
            Element_0: symbol=[0]
              4 x mc data instance, all with category=VALUE, resulting-properties={base-type=uint32, sw-calibration-access=READ-ONLY, range raw 0..4294967295}:
                time
                count
                max
                min
            Element_1: symbol=[1]
              4 x mc data instance, all with category=VALUE, resulting-properties={base-type=uint32, sw-calibration-access=READ-ONLY, range raw 0..4294967295}:
                time
                count
                max
                min
            Element_2: symbol=[2]
              4 x mc data instance, all with category=VALUE, resulting-properties={base-type=uint32, sw-calibration-access=READ-ONLY, range raw 0..4294967295}:
                time
                count
                max
                min
            Element_3: symbol=[3]
              4 x mc data instance, all with category=VALUE, resulting-properties={base-type=uint32, sw-calibration-access=READ-ONLY, range raw 0..4294967295}:
                time
                count
                max
                min
            Element_4: symbol=[4]
              4 x mc data instance, all with category=VALUE, resulting-properties={base-type=uint32, sw-calibration-access=READ-ONLY, range raw 0..4294967295}:
                time
                count
                max
                min
            Element_5: symbol=[5]
              4 x mc data instance, all with category=VALUE, resulting-properties={base-type=uint32, sw-calibration-access=READ-ONLY, range raw 0..4294967295}:
                time
                count
                max
                min
            Element_6: symbol=[6]
              4 x mc data instance, all with category=VALUE, resulting-properties={base-type=uint32, sw-calibration-access=READ-ONLY, range raw 0..4294967295}:
                time
                count
                max
                min
            Element_7: symbol=[7]
              4 x mc data instance, all with category=VALUE, resulting-properties={base-type=uint32, sw-calibration-access=READ-ONLY, range raw 0..4294967295}:
                time
                count
                max
                min
            Element_8: symbol=[8]
              4 x mc data instance, all with category=VALUE, resulting-properties={base-type=uint32, sw-calibration-access=READ-ONLY, range raw 0..4294967295}:
                time
                count
                max
                min
            Element_9: symbol=[9]
              4 x mc data instance, all with category=VALUE, resulting-properties={base-type=uint32, sw-calibration-access=READ-ONLY, range raw 0..4294967295}:
                time
                count
                max
                min
            Element_10: symbol=[10]
              4 x mc data instance, all with category=VALUE, resulting-properties={base-type=uint32, sw-calibration-access=READ-ONLY, range raw 0..4294967295}:
                time
                count
                max
                min
            Element_11: symbol=[11]
              4 x mc data instance, all with category=VALUE, resulting-properties={base-type=uint32, sw-calibration-access=READ-ONLY, range raw 0..4294967295}:
                time
                count
                max
                min
            Element_12: symbol=[12]
              4 x mc data instance, all with category=VALUE, resulting-properties={base-type=uint32, sw-calibration-access=READ-ONLY, range raw 0..4294967295}:
                time
                count
                max
                min
            Element_13: symbol=[13]
              4 x mc data instance, all with category=VALUE, resulting-properties={base-type=uint32, sw-calibration-access=READ-ONLY, range raw 0..4294967295}:
                time
                count
                max
                min
            Element_14: symbol=[14]
              4 x mc data instance, all with category=VALUE, resulting-properties={base-type=uint32, sw-calibration-access=READ-ONLY, range raw 0..4294967295}:
                time
                count
                max
                min
        Rtm_MeasTimeCorrection: category=VALUE, resulting-properties={base-type=sint32, sw-calibration-access=READ-ONLY, range raw -2147483648..2147483647}, variation-point=post-build-variant-condition{matching-criterion=RDR_POS, value=5}
        Rtm_Cmd: category=VALUE, resulting-properties={base-type=uint32, sw-calibration-access=READ-WRITE, range raw 0..4294967295}, variation-point=post-build-variant-condition{matching-criterion=RDR_POS, value=5}
        Rtm_Resp: category=VALUE, resulting-properties={base-type=uint32, sw-calibration-access=READ-WRITE, range raw 0..4294967295}, variation-point=post-build-variant-condition{matching-criterion=RDR_POS, value=5}
        Rtm_AverageMainFunctionCycleTime: category=VALUE, resulting-properties={base-type=uint32, sw-calibration-access=READ-ONLY, range raw 0..4294967295}, variation-point=post-build-variant-condition{matching-criterion=RDR_POS, value=5}
        Rtm_MainFunctionCounter: category=VALUE, resulting-properties={base-type=uint32, sw-calibration-access=READ-ONLY, range raw 0..4294967295}, variation-point=post-build-variant-condition{matching-criterion=RDR_POS, value=5}
        Rtm_CpuLoadTime: category=VALUE, resulting-properties={base-type=uint32, sw-calibration-access=READ-ONLY, range raw 0..4294967295}, variation-point=post-build-variant-condition{matching-criterion=RDR_POS, value=5}
        Rtm_MeasurementConfig: category=ARRAY, array-size=2, resulting-properties={base-type=uint8, sw-calibration-access=READ-WRITE, range raw 0..255}, variation-point=post-build-variant-condition{matching-criterion=RDR_POS, value=5}
        Rtm_Results: category=ARRAY, array-size=15, variation-point=post-build-variant-condition{matching-criterion=RDR_POS, value=5}
          15 x mc data instance, all with category=STRUCTURE:
            Element_0: symbol=[0]
              4 x mc data instance, all with category=VALUE, resulting-properties={base-type=uint32, sw-calibration-access=READ-ONLY, range raw 0..4294967295}:
                time
                count
                max
                min
            Element_1: symbol=[1]
              4 x mc data instance, all with category=VALUE, resulting-properties={base-type=uint32, sw-calibration-access=READ-ONLY, range raw 0..4294967295}:
                time
                count
                max
                min
            Element_2: symbol=[2]
              4 x mc data instance, all with category=VALUE, resulting-properties={base-type=uint32, sw-calibration-access=READ-ONLY, range raw 0..4294967295}:
                time
                count
                max
                min
            Element_3: symbol=[3]
              4 x mc data instance, all with category=VALUE, resulting-properties={base-type=uint32, sw-calibration-access=READ-ONLY, range raw 0..4294967295}:
                time
                count
                max
                min
            Element_4: symbol=[4]
              4 x mc data instance, all with category=VALUE, resulting-properties={base-type=uint32, sw-calibration-access=READ-ONLY, range raw 0..4294967295}:
                time
                count
                max
                min
            Element_5: symbol=[5]
              4 x mc data instance, all with category=VALUE, resulting-properties={base-type=uint32, sw-calibration-access=READ-ONLY, range raw 0..4294967295}:
                time
                count
                max
                min
            Element_6: symbol=[6]
              4 x mc data instance, all with category=VALUE, resulting-properties={base-type=uint32, sw-calibration-access=READ-ONLY, range raw 0..4294967295}:
                time
                count
                max
                min
            Element_7: symbol=[7]
              4 x mc data instance, all with category=VALUE, resulting-properties={base-type=uint32, sw-calibration-access=READ-ONLY, range raw 0..4294967295}:
                time
                count
                max
                min
            Element_8: symbol=[8]
              4 x mc data instance, all with category=VALUE, resulting-properties={base-type=uint32, sw-calibration-access=READ-ONLY, range raw 0..4294967295}:
                time
                count
                max
                min
            Element_9: symbol=[9]
              4 x mc data instance, all with category=VALUE, resulting-properties={base-type=uint32, sw-calibration-access=READ-ONLY, range raw 0..4294967295}:
                time
                count
                max
                min
            Element_10: symbol=[10]
              4 x mc data instance, all with category=VALUE, resulting-properties={base-type=uint32, sw-calibration-access=READ-ONLY, range raw 0..4294967295}:
                time
                count
                max
                min
            Element_11: symbol=[11]
              4 x mc data instance, all with category=VALUE, resulting-properties={base-type=uint32, sw-calibration-access=READ-ONLY, range raw 0..4294967295}:
                time
                count
                max
                min
            Element_12: symbol=[12]
              4 x mc data instance, all with category=VALUE, resulting-properties={base-type=uint32, sw-calibration-access=READ-ONLY, range raw 0..4294967295}:
                time
                count
                max
                min
            Element_13: symbol=[13]
              4 x mc data instance, all with category=VALUE, resulting-properties={base-type=uint32, sw-calibration-access=READ-ONLY, range raw 0..4294967295}:
                time
                count
                max
                min
            Element_14: symbol=[14]
              4 x mc data instance, all with category=VALUE, resulting-properties={base-type=uint32, sw-calibration-access=READ-ONLY, range raw 0..4294967295}:
                time
                count
                max
                min
        Rtm_MeasTimeCorrection: category=VALUE, resulting-properties={base-type=sint32, sw-calibration-access=READ-ONLY, range raw -2147483648..2147483647}, variation-point=post-build-variant-condition{matching-criterion=RDR_POS, value=6}
        Rtm_Cmd: category=VALUE, resulting-properties={base-type=uint32, sw-calibration-access=READ-WRITE, range raw 0..4294967295}, variation-point=post-build-variant-condition{matching-criterion=RDR_POS, value=6}
        Rtm_Resp: category=VALUE, resulting-properties={base-type=uint32, sw-calibration-access=READ-WRITE, range raw 0..4294967295}, variation-point=post-build-variant-condition{matching-criterion=RDR_POS, value=6}
        Rtm_AverageMainFunctionCycleTime: category=VALUE, resulting-properties={base-type=uint32, sw-calibration-access=READ-ONLY, range raw 0..4294967295}, variation-point=post-build-variant-condition{matching-criterion=RDR_POS, value=6}
        Rtm_MainFunctionCounter: category=VALUE, resulting-properties={base-type=uint32, sw-calibration-access=READ-ONLY, range raw 0..4294967295}, variation-point=post-build-variant-condition{matching-criterion=RDR_POS, value=6}
        Rtm_CpuLoadTime: category=VALUE, resulting-properties={base-type=uint32, sw-calibration-access=READ-ONLY, range raw 0..4294967295}, variation-point=post-build-variant-condition{matching-criterion=RDR_POS, value=6}
        Rtm_MeasurementConfig: category=ARRAY, array-size=2, resulting-properties={base-type=uint8, sw-calibration-access=READ-WRITE, range raw 0..255}, variation-point=post-build-variant-condition{matching-criterion=RDR_POS, value=6}
        Rtm_Results: category=ARRAY, array-size=15, variation-point=post-build-variant-condition{matching-criterion=RDR_POS, value=6}
          15 x mc data instance, all with category=STRUCTURE:
            Element_0: symbol=[0]
              4 x mc data instance, all with category=VALUE, resulting-properties={base-type=uint32, sw-calibration-access=READ-ONLY, range raw 0..4294967295}:
                time
                count
                max
                min
            Element_1: symbol=[1]
              4 x mc data instance, all with category=VALUE, resulting-properties={base-type=uint32, sw-calibration-access=READ-ONLY, range raw 0..4294967295}:
                time
                count
                max
                min
            Element_2: symbol=[2]
              4 x mc data instance, all with category=VALUE, resulting-properties={base-type=uint32, sw-calibration-access=READ-ONLY, range raw 0..4294967295}:
                time
                count
                max
                min
            Element_3: symbol=[3]
              4 x mc data instance, all with category=VALUE, resulting-properties={base-type=uint32, sw-calibration-access=READ-ONLY, range raw 0..4294967295}:
                time
                count
                max
                min
            Element_4: symbol=[4]
              4 x mc data instance, all with category=VALUE, resulting-properties={base-type=uint32, sw-calibration-access=READ-ONLY, range raw 0..4294967295}:
                time
                count
                max
                min
            Element_5: symbol=[5]
              4 x mc data instance, all with category=VALUE, resulting-properties={base-type=uint32, sw-calibration-access=READ-ONLY, range raw 0..4294967295}:
                time
                count
                max
                min
            Element_6: symbol=[6]
              4 x mc data instance, all with category=VALUE, resulting-properties={base-type=uint32, sw-calibration-access=READ-ONLY, range raw 0..4294967295}:
                time
                count
                max
                min
            Element_7: symbol=[7]
              4 x mc data instance, all with category=VALUE, resulting-properties={base-type=uint32, sw-calibration-access=READ-ONLY, range raw 0..4294967295}:
                time
                count
                max
                min
            Element_8: symbol=[8]
              4 x mc data instance, all with category=VALUE, resulting-properties={base-type=uint32, sw-calibration-access=READ-ONLY, range raw 0..4294967295}:
                time
                count
                max
                min
            Element_9: symbol=[9]
              4 x mc data instance, all with category=VALUE, resulting-properties={base-type=uint32, sw-calibration-access=READ-ONLY, range raw 0..4294967295}:
                time
                count
                max
                min
            Element_10: symbol=[10]
              4 x mc data instance, all with category=VALUE, resulting-properties={base-type=uint32, sw-calibration-access=READ-ONLY, range raw 0..4294967295}:
                time
                count
                max
                min
            Element_11: symbol=[11]
              4 x mc data instance, all with category=VALUE, resulting-properties={base-type=uint32, sw-calibration-access=READ-ONLY, range raw 0..4294967295}:
                time
                count
                max
                min
            Element_12: symbol=[12]
              4 x mc data instance, all with category=VALUE, resulting-properties={base-type=uint32, sw-calibration-access=READ-ONLY, range raw 0..4294967295}:
                time
                count
                max
                min
            Element_13: symbol=[13]
              4 x mc data instance, all with category=VALUE, resulting-properties={base-type=uint32, sw-calibration-access=READ-ONLY, range raw 0..4294967295}:
                time
                count
                max
                min
            Element_14: symbol=[14]
              4 x mc data instance, all with category=VALUE, resulting-properties={base-type=uint32, sw-calibration-access=READ-ONLY, range raw 0..4294967295}:
                time
                count
                max
                min
        Rtm_MeasTimeCorrection: category=VALUE, resulting-properties={base-type=sint32, sw-calibration-access=READ-ONLY, range raw -2147483648..2147483647}, variation-point=post-build-variant-condition{matching-criterion=RDR_POS, value=7}
        Rtm_Cmd: category=VALUE, resulting-properties={base-type=uint32, sw-calibration-access=READ-WRITE, range raw 0..4294967295}, variation-point=post-build-variant-condition{matching-criterion=RDR_POS, value=7}
        Rtm_Resp: category=VALUE, resulting-properties={base-type=uint32, sw-calibration-access=READ-WRITE, range raw 0..4294967295}, variation-point=post-build-variant-condition{matching-criterion=RDR_POS, value=7}
        Rtm_AverageMainFunctionCycleTime: category=VALUE, resulting-properties={base-type=uint32, sw-calibration-access=READ-ONLY, range raw 0..4294967295}, variation-point=post-build-variant-condition{matching-criterion=RDR_POS, value=7}
        Rtm_MainFunctionCounter: category=VALUE, resulting-properties={base-type=uint32, sw-calibration-access=READ-ONLY, range raw 0..4294967295}, variation-point=post-build-variant-condition{matching-criterion=RDR_POS, value=7}
        Rtm_CpuLoadTime: category=VALUE, resulting-properties={base-type=uint32, sw-calibration-access=READ-ONLY, range raw 0..4294967295}, variation-point=post-build-variant-condition{matching-criterion=RDR_POS, value=7}
        Rtm_MeasurementConfig: category=ARRAY, array-size=2, resulting-properties={base-type=uint8, sw-calibration-access=READ-WRITE, range raw 0..255}, variation-point=post-build-variant-condition{matching-criterion=RDR_POS, value=7}
        Rtm_Results: category=ARRAY, array-size=15, variation-point=post-build-variant-condition{matching-criterion=RDR_POS, value=7}
          15 x mc data instance, all with category=STRUCTURE:
            Element_0: symbol=[0]
              4 x mc data instance, all with category=VALUE, resulting-properties={base-type=uint32, sw-calibration-access=READ-ONLY, range raw 0..4294967295}:
                time
                count
                max
                min
            Element_1: symbol=[1]
              4 x mc data instance, all with category=VALUE, resulting-properties={base-type=uint32, sw-calibration-access=READ-ONLY, range raw 0..4294967295}:
                time
                count
                max
                min
            Element_2: symbol=[2]
              4 x mc data instance, all with category=VALUE, resulting-properties={base-type=uint32, sw-calibration-access=READ-ONLY, range raw 0..4294967295}:
                time
                count
                max
                min
            Element_3: symbol=[3]
              4 x mc data instance, all with category=VALUE, resulting-properties={base-type=uint32, sw-calibration-access=READ-ONLY, range raw 0..4294967295}:
                time
                count
                max
                min
            Element_4: symbol=[4]
              4 x mc data instance, all with category=VALUE, resulting-properties={base-type=uint32, sw-calibration-access=READ-ONLY, range raw 0..4294967295}:
                time
                count
                max
                min
            Element_5: symbol=[5]
              4 x mc data instance, all with category=VALUE, resulting-properties={base-type=uint32, sw-calibration-access=READ-ONLY, range raw 0..4294967295}:
                time
                count
                max
                min
            Element_6: symbol=[6]
              4 x mc data instance, all with category=VALUE, resulting-properties={base-type=uint32, sw-calibration-access=READ-ONLY, range raw 0..4294967295}:
                time
                count
                max
                min
            Element_7: symbol=[7]
              4 x mc data instance, all with category=VALUE, resulting-properties={base-type=uint32, sw-calibration-access=READ-ONLY, range raw 0..4294967295}:
                time
                count
                max
                min
            Element_8: symbol=[8]
              4 x mc data instance, all with category=VALUE, resulting-properties={base-type=uint32, sw-calibration-access=READ-ONLY, range raw 0..4294967295}:
                time
                count
                max
                min
            Element_9: symbol=[9]
              4 x mc data instance, all with category=VALUE, resulting-properties={base-type=uint32, sw-calibration-access=READ-ONLY, range raw 0..4294967295}:
                time
                count
                max
                min
            Element_10: symbol=[10]
              4 x mc data instance, all with category=VALUE, resulting-properties={base-type=uint32, sw-calibration-access=READ-ONLY, range raw 0..4294967295}:
                time
                count
                max
                min
            Element_11: symbol=[11]
              4 x mc data instance, all with category=VALUE, resulting-properties={base-type=uint32, sw-calibration-access=READ-ONLY, range raw 0..4294967295}:
                time
                count
                max
                min
            Element_12: symbol=[12]
              4 x mc data instance, all with category=VALUE, resulting-properties={base-type=uint32, sw-calibration-access=READ-ONLY, range raw 0..4294967295}:
                time
                count
                max
                min
            Element_13: symbol=[13]
              4 x mc data instance, all with category=VALUE, resulting-properties={base-type=uint32, sw-calibration-access=READ-ONLY, range raw 0..4294967295}:
                time
                count
                max
                min
            Element_14: symbol=[14]
              4 x mc data instance, all with category=VALUE, resulting-properties={base-type=uint32, sw-calibration-access=READ-ONLY, range raw 0..4294967295}:
                time
                count
                max
                min
    resource consumption ResourceConsumption
      62 x memory section:
        CODE: sw-addrmethod=CODE
        CONST_16: alignment=16, sw-addrmethod=CONST
        CONST_32: alignment=32, sw-addrmethod=CONST
        CONST_64: alignment=64, sw-addrmethod=CONST
        CONST_8: alignment=8, sw-addrmethod=CONST
        CONST_BOOLEAN: alignment=BOOLEAN, sw-addrmethod=CONST
        CONST_UNSPECIFIED: alignment=UNSPECIFIED, sw-addrmethod=CONST
        RTM_VAR_INIT_UNSPECIFIED_SAFE: sw-addrmethod=VAR_INIT, symbol=VAR_INIT_UNSPECIFIED_SAFE
        VAR_CLEARED_16: alignment=16, sw-addrmethod=VAR_CLEARED
        VAR_CLEARED_32: alignment=32, sw-addrmethod=VAR_CLEARED
        VAR_CLEARED_64: alignment=64, sw-addrmethod=VAR_CLEARED
        VAR_CLEARED_8: alignment=8, sw-addrmethod=VAR_CLEARED
        VAR_CLEARED_BOOLEAN: alignment=BOOLEAN, sw-addrmethod=VAR_CLEARED
        VAR_CLEARED_UNSPECIFIED: alignment=UNSPECIFIED, sw-addrmethod=VAR_CLEARED
        VAR_FAST_CLEARED_16: alignment=16, sw-addrmethod=VAR_FAST_CLEARED
        VAR_FAST_CLEARED_32: alignment=32, sw-addrmethod=VAR_FAST_CLEARED
        VAR_FAST_CLEARED_64: alignment=64, sw-addrmethod=VAR_FAST_CLEARED
        VAR_FAST_CLEARED_8: alignment=8, sw-addrmethod=VAR_FAST_CLEARED
        VAR_FAST_CLEARED_BOOLEAN: alignment=BOOLEAN, sw-addrmethod=VAR_FAST_CLEARED
        VAR_FAST_CLEARED_UNSPECIFIED: alignment=UNSPECIFIED, sw-addrmethod=VAR_FAST_CLEARED
        VAR_FAST_INIT_16: alignment=16, sw-addrmethod=VAR_FAST_INIT
        VAR_FAST_INIT_32: alignment=32, sw-addrmethod=VAR_FAST_INIT
        VAR_FAST_INIT_64: alignment=64, sw-addrmethod=VAR_FAST_INIT
        VAR_FAST_INIT_8: alignment=8, sw-addrmethod=VAR_FAST_INIT
        VAR_FAST_INIT_BOOLEAN: alignment=BOOLEAN, sw-addrmethod=VAR_FAST_INIT
        VAR_FAST_INIT_UNSPECIFIED: alignment=UNSPECIFIED, sw-addrmethod=VAR_FAST_INIT
        VAR_FAST_NO_INIT_16: alignment=16, sw-addrmethod=VAR_FAST_NO_INIT
        VAR_FAST_NO_INIT_32: alignment=32, sw-addrmethod=VAR_FAST_NO_INIT
        VAR_FAST_NO_INIT_64: alignment=64, sw-addrmethod=VAR_FAST_NO_INIT
        VAR_FAST_NO_INIT_8: alignment=8, sw-addrmethod=VAR_FAST_NO_INIT
        VAR_FAST_NO_INIT_BOOLEAN: alignment=BOOLEAN, sw-addrmethod=VAR_FAST_NO_INIT
        VAR_FAST_NO_INIT_UNSPECIFIED: alignment=UNSPECIFIED, sw-addrmethod=VAR_FAST_NO_INIT
        VAR_INIT_16: alignment=16, sw-addrmethod=VAR_INIT
        VAR_INIT_32: alignment=32, sw-addrmethod=VAR_INIT
        VAR_INIT_64: alignment=64, sw-addrmethod=VAR_INIT
        VAR_INIT_8: alignment=8, sw-addrmethod=VAR_INIT
        VAR_INIT_BOOLEAN: alignment=BOOLEAN, sw-addrmethod=VAR_INIT
        VAR_INIT_UNSPECIFIED: alignment=UNSPECIFIED, sw-addrmethod=VAR_INIT
        VAR_NOCACHE_CLEARED_16: alignment=16, sw-addrmethod=VAR_NOCACHE_CLEARED
        VAR_NOCACHE_CLEARED_32: alignment=32, sw-addrmethod=VAR_NOCACHE_CLEARED
        VAR_NOCACHE_CLEARED_64: alignment=64, sw-addrmethod=VAR_NOCACHE_CLEARED
        VAR_NOCACHE_CLEARED_8: alignment=8, sw-addrmethod=VAR_NOCACHE_CLEARED
        VAR_NOCACHE_CLEARED_BOOLEAN: alignment=BOOLEAN, sw-addrmethod=VAR_NOCACHE_CLEARED
        VAR_NOCACHE_CLEARED_UNSPECIFIED: alignment=UNSPECIFIED, sw-addrmethod=VAR_NOCACHE_CLEARED
        VAR_NOCACHE_INIT_16: alignment=16, sw-addrmethod=VAR_NOCACHE_INIT
        VAR_NOCACHE_INIT_32: alignment=32, sw-addrmethod=VAR_NOCACHE_INIT
        VAR_NOCACHE_INIT_64: alignment=64, sw-addrmethod=VAR_NOCACHE_INIT
        VAR_NOCACHE_INIT_8: alignment=8, sw-addrmethod=VAR_NOCACHE_INIT
        VAR_NOCACHE_INIT_BOOLEAN: alignment=BOOLEAN, sw-addrmethod=VAR_NOCACHE_INIT
        VAR_NOCACHE_INIT_UNSPECIFIED: alignment=UNSPECIFIED, sw-addrmethod=VAR_NOCACHE_INIT
        VAR_NOCACHE_NO_INIT_16: alignment=16, sw-addrmethod=VAR_NOCACHE_NO_INIT
        VAR_NOCACHE_NO_INIT_32: alignment=32, sw-addrmethod=VAR_NOCACHE_NO_INIT
        VAR_NOCACHE_NO_INIT_64: alignment=64, sw-addrmethod=VAR_NOCACHE_NO_INIT
        VAR_NOCACHE_NO_INIT_8: alignment=8, sw-addrmethod=VAR_NOCACHE_NO_INIT
        VAR_NOCACHE_NO_INIT_BOOLEAN: alignment=BOOLEAN, sw-addrmethod=VAR_NOCACHE_NO_INIT
        VAR_NOCACHE_NO_INIT_UNSPECIFIED: alignment=UNSPECIFIED, sw-addrmethod=VAR_NOCACHE_NO_INIT
        VAR_NO_INIT_16: alignment=16, sw-addrmethod=VAR_NO_INIT
        VAR_NO_INIT_32: alignment=32, sw-addrmethod=VAR_NO_INIT
        VAR_NO_INIT_64: alignment=64, sw-addrmethod=VAR_NO_INIT
        VAR_NO_INIT_8: alignment=8, sw-addrmethod=VAR_NO_INIT
        VAR_NO_INIT_BOOLEAN: alignment=BOOLEAN, sw-addrmethod=VAR_NO_INIT
        VAR_NO_INIT_UNSPECIFIED: alignment=UNSPECIFIED, sw-addrmethod=VAR_NO_INIT
package /MICROSAR/Rtm_ib_bswmd/BswModuleDescriptions
  bsw module description Rtm: provided-entrys=Rtm_MainFunction
    bsw internal behavior RtmBehavior
      exclusive area RTM_EXCLUSIVE_AREA_{0..2}
      bsw schedulable entity Rtm_MainFunction: can-enters=[RTM_EXCLUSIVE_AREA_0, RTM_EXCLUSIVE_AREA_1, RTM_EXCLUSIVE_AREA_2], can-enter-exclusive-area=[RTM_EXCLUSIVE_AREA_0, RTM_EXCLUSIVE_AREA_1, RTM_EXCLUSIVE_AREA_2], implemented-entry=Rtm_MainFunction
      bsw timing event Rtm_MainFunctionTimingEvent0: starts-on-event=Rtm_MainFunction, period=0.05
  bsw module entry Rtm_MainFunction: call-type=SCHEDULED, execution-context=TASK
