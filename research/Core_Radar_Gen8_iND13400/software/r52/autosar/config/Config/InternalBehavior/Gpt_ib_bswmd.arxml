AUTOSAR XML (schema 00051)
package /indieSemi/Gpt_ib_bswmd/BswModuleDescriptions
  bsw module description Gpt: provided-entrys=Gpt_Virtual
    bsw internal behavior GptBehavior
      exclusive area GPT_EXCLUSIVE_AREA_0
      bsw called entity Gpt_Virtual: can-enters=GPT_EXCLUSIVE_AREA_0, can-enter-exclusive-area=GPT_EXCLUSIVE_AREA_0, implemented-entry=Gpt_Virtual
  bsw module entry Gpt_Virtual: call-type=REGULAR, execution-context=TASK
