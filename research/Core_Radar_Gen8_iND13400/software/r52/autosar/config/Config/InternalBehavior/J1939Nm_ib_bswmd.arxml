AUTOSAR XML (schema 00049)
package /MICROSAR
  bsw implementation J1939Nm_Impl: programming-language=C, sw-version=13.01.00, used-code-generator=DaVinci Configurator, vendor-id=30, ar-release-version=4.05.00
