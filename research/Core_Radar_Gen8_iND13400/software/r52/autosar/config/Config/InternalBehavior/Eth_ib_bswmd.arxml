AUTOSAR XML (schema 00051)
package /indieSemi/Eth_ib_bswmd/BswModuleDescriptions
  bsw module description Eth: provided-entrys=[Eth_Virtual, Eth_MainFunction]
    bsw internal behavior EthBehavior
      exclusive area ETH_EXCLUSIVE_AREA_0
      bsw schedulable entity Eth_MainFunction: can-enters=ETH_EXCLUSIVE_AREA_0, can-enter-exclusive-area=ETH_EXCLUSIVE_AREA_0, implemented-entry=Eth_MainFunction
      bsw timing event Eth_MainFunctionTimingEvent0: starts-on-event=Eth_MainFunction, period=0.01
  bsw module entry Eth_Virtual: call-type=REGULAR, execution-context=TASK
  bsw module entry Eth_MainFunction: call-type=SCHEDULED, execution-context=TASK
