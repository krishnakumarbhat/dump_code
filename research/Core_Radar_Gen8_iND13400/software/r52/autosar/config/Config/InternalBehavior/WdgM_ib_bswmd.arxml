AUTOSAR XML (schema 00049)
package /MICROSAR/WdgM_ib_bswmd/BswModuleDescriptions
  bsw module description WdgM: provided-entrys=WdgM_MainFunction
    bsw internal behavior WdgMBehavior
      exclusive area WDGM_EXCLUSIVE_AREA_0
      bsw schedulable entity WdgM_MainFunction: can-enter-exclusive-area=WDGM_EXCLUSIVE_AREA_0, sw-addr-method=CODE_ASIL_D, implemented-entry=WdgM_MainFunction
      bsw timing event WdgM_MainFunctionTimingEvent0: starts-on-event=WdgM_MainFunction, period=0.005
  bsw module entry WdgM_MainFunction: call-type=SCHEDULED, execution-context=TASK
package /MICROSAR/WdgM_ib_bswmd/SwAddrMethods
  sw addr method CODE_ASIL_D: options=safetyAsilD, section-type=CODE
