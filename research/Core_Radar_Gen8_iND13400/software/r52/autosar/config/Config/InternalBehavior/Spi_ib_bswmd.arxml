AUTOSAR XML (schema 00051)
package /indieSemi/Spi_ib_bswmd/BswModuleDescriptions
  bsw module description Spi: provided-entrys=Spi_MainFunction_Handling
    bsw internal behavior SpiBehavior
      exclusive area SPI_EXCLUSIVE_AREA_0
      bsw schedulable entity Spi_MainFunction_Handling: can-enters=SPI_EXCLUSIVE_AREA_0, can-enter-exclusive-area=SPI_EXCLUSIVE_AREA_0, implemented-entry=Spi_MainFunction_Handling
      bsw timing event Spi_MainFunction_HandlingTimingEvent0: starts-on-event=Spi_MainFunction_Handling, period=0.01
  bsw module entry Spi_MainFunction_Handling: call-type=SCHEDULED, execution-context=TASK
