AUTOSAR XML (schema 00053)
package /MICROSAR/EthTrcv_30_Rtl9010_ib_bswmd/BswModuleDescriptions
  bsw module description EthTrcv: provided-entrys=EthTrcv_30_Rtl9010_MainFunction
    bsw internal behavior EthTrcv_30_Rtl9010Behavior
      10 x exclusive area:
        ETHTRCV_30_RTL9010_EXCLUSIVE_AREA_CL45
        ETHTRCV_30_RTL9010_EXCLUSIVE_AREA_MACSEC
        ETHTRCV_30_RTL9010_EXCLUSIVE_AREA_MACSEC32
        ETHTRCV_30_RTL9010_EXCLUSIVE_AREA_MACSEC64
        ETHTRCV_30_RTL9010_EXCLUSIVE_AREA_DIAGNOSTICS
        ETHTRCV_30_RTL9010_EXCLUSIVE_AREA_MODE
        ETHTRCV_30_RTL9010_EXCLUSIVE_AREA_LINK
        ETHTRCV_30_RTL9010_EXCLUSIVE_AREA_HWINIT
        ETHTRCV_30_RTL9010_EXCLUSIVE_AREA_AUTONEG
        ETHTRCV_30_RTL9010_EXCLUSIVE_AREA_WAKEUP
      bsw schedulable entity EthTrcv_30_Rtl9010_MainFunction: implemented-entry=EthTrcv_30_Rtl9010_MainFunction
        can-enters:
          ETHTRCV_30_RTL9010_EXCLUSIVE_AREA_CL45
          ETHTRCV_30_RTL9010_EXCLUSIVE_AREA_MACSEC
          ETHTRCV_30_RTL9010_EXCLUSIVE_AREA_MACSEC32
          ETHTRCV_30_RTL9010_EXCLUSIVE_AREA_MACSEC64
          ETHTRCV_30_RTL9010_EXCLUSIVE_AREA_DIAGNOSTICS
          ETHTRCV_30_RTL9010_EXCLUSIVE_AREA_MODE
          ETHTRCV_30_RTL9010_EXCLUSIVE_AREA_LINK
          ETHTRCV_30_RTL9010_EXCLUSIVE_AREA_HWINIT
          ETHTRCV_30_RTL9010_EXCLUSIVE_AREA_AUTONEG
          ETHTRCV_30_RTL9010_EXCLUSIVE_AREA_WAKEUP
      bsw timing event EthTrcv_30_Rtl9010_MainFunctionTimingEvent0: starts-on-event=EthTrcv_30_Rtl9010_MainFunction, period=1
  bsw module entry EthTrcv_30_Rtl9010_MainFunction: call-type=SCHEDULED, execution-context=TASK
