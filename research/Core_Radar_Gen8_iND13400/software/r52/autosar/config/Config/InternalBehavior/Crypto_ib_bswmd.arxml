AUTOSAR XML (schema 00051)
package /indieSemi/Crypto_ib_bswmd/BswModuleDescriptions
  bsw module description Crypto: provided-entrys=[Crypto_Virtual, Crypto_182_iND13400_MainFunction]
    bsw internal behavior CryptoBehavior
      exclusive area CRYPTO_EXCLUSIVE_AREA_0
      exclusive area CRYPTO_EXCLUSIVE_AREA_1
      bsw schedulable entity Crypto_182_iND13400_MainFunction: can-enters=[CRYPTO_EXCLUSIVE_AREA_0, CRYPTO_EXCLUSIVE_AREA_1], implemented-entry=Crypto_182_iND13400_MainFunction
      bsw timing event Crypto_182_iND13400_MainFunctionTimingEvent0: starts-on-event=Crypto_182_iND13400_MainFunction, period=0.01
  bsw module entry Crypto_Virtual: call-type=REGULAR, execution-context=TASK
  bsw module entry Crypto_182_iND13400_MainFunction: call-type=SCHEDULED, execution-context=TASK
