AUTOSAR XML (schema 00049)
package /MICROSAR/EthTSyn_ib_bswmd/BswModuleDescriptions
  bsw module description EthTSyn: provided-entrys=EthTSyn_MainFunction
    bsw internal behavior EthTSynBehavior
      5 x exclusive area:
        ETHTSYN_EXCLUSIVE_AREA_RX  # Exclusive area to ensure consistency of global RAM variables by protection against Rx interrupts.
        ETHTSYN_EXCLUSIVE_AREA_TX  # Exclusive area to ensure consistency of global RAM variables by protection against Tx interrupts.
        ETHTSYN_EXCLUSIVE_AREA_LINK_STATE  # Exclusive area to ensure consistency of global RAM variables by protection against link state change interrupts.
        ETHTSYN_EXCLUSIVE_AREA_0  # Exclusive area to ensure consistency of global RAM variables by protection against Rx, Tx and link state change interrupts.
        ETHTSYN_EXCLUSIVE_AREA_GET_TS  # Exclusive area used to minimize delays when retrieving timestamps.
      bsw schedulable entity EthTSyn_MainFunction: can-enter-exclusive-area=[ETHTSYN_EXCLUSIVE_AREA_RX, ETHTSYN_EXCLUSIVE_AREA_TX, ETHTSYN_EXCLUSIVE_AREA_LINK_STATE, ETHTSYN_EXCLUSIVE_AREA_0, ETHTSYN_EXCLUSIVE_AREA_GET_TS], implemented-entry=EthTSyn_MainFunction
      bsw timing event EthTSyn_MainFunctionTimingEvent0: starts-on-event=EthTSyn_MainFunction, period=0.01
  bsw module entry EthTSyn_MainFunction: call-type=SCHEDULED, execution-context=TASK
