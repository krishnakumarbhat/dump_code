AUTOSAR XML (schema 00053)
package /indieSemi/Fls_ib_bswmd/BswModuleDescriptions
  bsw module description Fls: provided-entrys=Fls_MainFunction
    bsw internal behavior FlsBehavior
      bsw schedulable entity Fls_MainFunction: implemented-entry=Fls_MainFunction
      bsw timing event Fls_MainFunctionTimingEvent0: starts-on-event=Fls_MainFunction, period=0.005
  bsw module entry Fls_MainFunction: call-type=SCHEDULED, execution-context=TASK
