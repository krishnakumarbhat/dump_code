AUTOSAR XML (schema 00053)
package /MICROSAR
  bsw implementation ComM_Impl: programming-language=C, sw-version=18.02.01, used-code-generator=DaVinci Configurator, vendor-id=30, ar-release-version=4.00.03
    resource consumption ResourceConsumption
      73 x memory section:
        VAR_SAVED_ZONE0_8: alignment=8, sw-addrmethod=VAR_SAVED_ZONE
        VAR_NOCACHE_CLEARED_UNSPECIFIED: alignment=UNSPECIFIED, sw-addrmethod=VAR_NOCACHE_CLEARED
        VAR_FAST_INIT_64: alignment=64, sw-addrmethod=VAR_FAST_INIT
        VAR_FAST_CLEARED_UNSPECIFIED: alignment=UNSPECIFIED, sw-addrmethod=VAR_FAST_CLEARED
        VAR_NO_INIT_8: alignment=8, sw-addrmethod=VAR_NO_INIT
        VAR_NOCACHE_CLEARED_16: alignment=16, sw-addrmethod=VAR_NOCACHE_CLEARED
        VAR_NO_INIT_16: alignment=16, sw-addrmethod=VAR_NO_INIT
        VAR_SAVED_ZONE0_16: alignment=16, sw-addrmethod=VAR_SAVED_ZONE
        CONST_16: alignment=16, sw-addrmethod=CONST
        VAR_SAVED_ZONE0_BOOLEAN: alignment=BOOLEAN, sw-addrmethod=VAR_SAVED_ZONE
        VAR_FAST_CLEARED_8: alignment=8, sw-addrmethod=VAR_FAST_CLEARED
        CODE: sw-addrmethod=CODE
        VAR_NOCACHE_SAVED_ZONE0_8: alignment=8, sw-addrmethod=VAR_SAVED_ZONE
        CONST_64: alignment=64, sw-addrmethod=CONST
        VAR_NOCACHE_CLEARED_8: alignment=8, sw-addrmethod=VAR_NOCACHE_CLEARED
        VAR_CLEARED_16: alignment=16, sw-addrmethod=VAR_CLEARED
        VAR_NOCACHE_CLEARED_BOOLEAN: alignment=BOOLEAN, sw-addrmethod=VAR_NOCACHE_CLEARED
        VAR_FAST_NO_INIT_16: alignment=16, sw-addrmethod=VAR_FAST_NO_INIT
        VAR_NO_INIT_64: alignment=64, sw-addrmethod=VAR_NO_INIT
        VAR_NOCACHE_CLEARED_64: alignment=64, sw-addrmethod=VAR_NOCACHE_CLEARED
        VAR_NOCACHE_INIT_32: alignment=32, sw-addrmethod=VAR_NOCACHE_INIT
        VAR_FAST_INIT_32: alignment=32, sw-addrmethod=VAR_FAST_INIT
        VAR_NOCACHE_SAVED_ZONE0_16: alignment=16, sw-addrmethod=VAR_SAVED_ZONE
        VAR_NO_INIT_UNSPECIFIED: alignment=UNSPECIFIED, sw-addrmethod=VAR_NO_INIT
        VAR_CLEARED_8: alignment=8, sw-addrmethod=VAR_CLEARED
        VAR_FAST_CLEARED_16: alignment=16, sw-addrmethod=VAR_FAST_CLEARED
        VAR_NOCACHE_INIT_8: alignment=8, sw-addrmethod=VAR_NOCACHE_INIT
        CONST_UNSPECIFIED: alignment=UNSPECIFIED, sw-addrmethod=CONST
        VAR_NOCACHE_NO_INIT_32: alignment=32, sw-addrmethod=VAR_NOCACHE_NO_INIT
        CONST_32: alignment=32, sw-addrmethod=CONST
        VAR_FAST_CLEARED_64: alignment=64, sw-addrmethod=VAR_FAST_CLEARED
        VAR_INIT_32: alignment=32, sw-addrmethod=VAR_INIT
        VAR_FAST_NO_INIT_64: alignment=64, sw-addrmethod=VAR_FAST_NO_INIT
        VAR_INIT_8: alignment=8, sw-addrmethod=VAR_INIT
        VAR_CLEARED_64: alignment=64, sw-addrmethod=VAR_CLEARED
        VAR_NO_INIT_32: alignment=32, sw-addrmethod=VAR_NO_INIT
        VAR_NOCACHE_INIT_64: alignment=64, sw-addrmethod=VAR_NOCACHE_INIT
        VAR_NOCACHE_CLEARED_32: alignment=32, sw-addrmethod=VAR_NOCACHE_CLEARED
        VAR_NOCACHE_INIT_BOOLEAN: alignment=BOOLEAN, sw-addrmethod=VAR_NOCACHE_INIT
        VAR_FAST_NO_INIT_BOOLEAN: alignment=BOOLEAN, sw-addrmethod=VAR_FAST_NO_INIT
        VAR_SAVED_ZONE0_32: alignment=32, sw-addrmethod=VAR_SAVED_ZONE
        VAR_FAST_CLEARED_BOOLEAN: alignment=BOOLEAN, sw-addrmethod=VAR_FAST_CLEARED
        VAR_SAVED_ZONE0_UNSPECIFIED: alignment=UNSPECIFIED, sw-addrmethod=VAR_SAVED_ZONE
        VAR_CLEARED_BOOLEAN: alignment=BOOLEAN, sw-addrmethod=VAR_CLEARED
        VAR_NOCACHE_SAVED_ZONE0_64: alignment=64, sw-addrmethod=VAR_SAVED_ZONE
        VAR_NO_INIT_BOOLEAN: alignment=BOOLEAN, sw-addrmethod=VAR_NO_INIT
        VAR_NOCACHE_NO_INIT_64: alignment=64, sw-addrmethod=VAR_NOCACHE_NO_INIT
        VAR_FAST_CLEARED_32: alignment=32, sw-addrmethod=VAR_FAST_CLEARED
        VAR_NOCACHE_NO_INIT_UNSPECIFIED: alignment=UNSPECIFIED, sw-addrmethod=VAR_NOCACHE_NO_INIT
        VAR_INIT_64: alignment=64, sw-addrmethod=VAR_INIT
        VAR_NOCACHE_SAVED_ZONE0_BOOLEAN: alignment=BOOLEAN, sw-addrmethod=VAR_SAVED_ZONE
        VAR_CLEARED_UNSPECIFIED: alignment=UNSPECIFIED, sw-addrmethod=VAR_CLEARED
        VAR_INIT_UNSPECIFIED: alignment=UNSPECIFIED, sw-addrmethod=VAR_INIT
        CONST_8: alignment=8, sw-addrmethod=CONST
        VAR_NOCACHE_SAVED_ZONE0_UNSPECIFIED: alignment=UNSPECIFIED, sw-addrmethod=VAR_SAVED_ZONE
        VAR_FAST_NO_INIT_32: alignment=32, sw-addrmethod=VAR_FAST_NO_INIT
        VAR_CLEARED_32: alignment=32, sw-addrmethod=VAR_CLEARED
        VAR_NOCACHE_NO_INIT_BOOLEAN: alignment=BOOLEAN, sw-addrmethod=VAR_NOCACHE_NO_INIT
        VAR_INIT_BOOLEAN: alignment=BOOLEAN, sw-addrmethod=VAR_INIT
        VAR_NOCACHE_INIT_UNSPECIFIED: alignment=UNSPECIFIED, sw-addrmethod=VAR_NOCACHE_INIT
        VAR_FAST_INIT_UNSPECIFIED: alignment=UNSPECIFIED, sw-addrmethod=VAR_FAST_INIT
        VAR_FAST_NO_INIT_8: alignment=8, sw-addrmethod=VAR_FAST_NO_INIT
        VAR_FAST_INIT_8: alignment=8, sw-addrmethod=VAR_FAST_INIT
        VAR_NOCACHE_INIT_16: alignment=16, sw-addrmethod=VAR_NOCACHE_INIT
        VAR_FAST_NO_INIT_UNSPECIFIED: alignment=UNSPECIFIED, sw-addrmethod=VAR_FAST_NO_INIT
        VAR_SAVED_ZONE0_64: alignment=64, sw-addrmethod=VAR_SAVED_ZONE
        VAR_FAST_INIT_BOOLEAN: alignment=BOOLEAN, sw-addrmethod=VAR_FAST_INIT
        VAR_FAST_INIT_16: alignment=16, sw-addrmethod=VAR_FAST_INIT
        VAR_NOCACHE_NO_INIT_8: alignment=8, sw-addrmethod=VAR_NOCACHE_NO_INIT
        CONST_BOOLEAN: alignment=BOOLEAN, sw-addrmethod=CONST
        VAR_NOCACHE_SAVED_ZONE0_32: alignment=32, sw-addrmethod=VAR_SAVED_ZONE
        VAR_INIT_16: alignment=16, sw-addrmethod=VAR_INIT
        VAR_NOCACHE_NO_INIT_16: alignment=16, sw-addrmethod=VAR_NOCACHE_NO_INIT
package /MICROSAR/ComM_ib_bswmd/BswModuleDescriptions
  bsw module description ComM: provided-entrys=[ComM_MainFunction_0, ComM_MainFunction_1, ComM_MainFunction_2]
    bsw internal behavior ComMBehavior
      6 x exclusive area:
        COMM_EXCLUSIVE_AREA_0
        COMM_EXCLUSIVE_AREA_1
        COMM_EXCLUSIVE_AREA_{2..5}  # This exclusive area is only used in case of multi-partition. It must be configured as a spinlock to allow access to some variables simultaneously from multiple cores.
      bsw schedulable entity ComM_MainFunction_1: can-enter-exclusive-area=[COMM_EXCLUSIVE_AREA_0, COMM_EXCLUSIVE_AREA_1, COMM_EXCLUSIVE_AREA_2, COMM_EXCLUSIVE_AREA_3, COMM_EXCLUSIVE_AREA_4, COMM_EXCLUSIVE_AREA_5], implemented-entry=ComM_MainFunction_1
        can-enters:
          COMM_EXCLUSIVE_AREA_{0..5}
      bsw schedulable entity ComM_MainFunction_0: can-enter-exclusive-area=[COMM_EXCLUSIVE_AREA_0, COMM_EXCLUSIVE_AREA_1, COMM_EXCLUSIVE_AREA_2, COMM_EXCLUSIVE_AREA_3, COMM_EXCLUSIVE_AREA_4, COMM_EXCLUSIVE_AREA_5], implemented-entry=ComM_MainFunction_0
        can-enters:
          COMM_EXCLUSIVE_AREA_{0..5}
      bsw schedulable entity ComM_MainFunction_2: can-enter-exclusive-area=[COMM_EXCLUSIVE_AREA_0, COMM_EXCLUSIVE_AREA_1, COMM_EXCLUSIVE_AREA_2, COMM_EXCLUSIVE_AREA_3, COMM_EXCLUSIVE_AREA_4, COMM_EXCLUSIVE_AREA_5], implemented-entry=ComM_MainFunction_2
        can-enters:
          COMM_EXCLUSIVE_AREA_{0..5}
      bsw timing event ComM_MainFunction_1TimingEvent0: starts-on-event=ComM_MainFunction_1, period=0.02
      bsw timing event ComM_MainFunction_0TimingEvent0: starts-on-event=ComM_MainFunction_0, period=0.02
      bsw timing event ComM_MainFunction_2TimingEvent0: starts-on-event=ComM_MainFunction_2, period=0.02
  bsw module entry ComM_MainFunction_{0..2}: call-type=SCHEDULED, execution-context=TASK
