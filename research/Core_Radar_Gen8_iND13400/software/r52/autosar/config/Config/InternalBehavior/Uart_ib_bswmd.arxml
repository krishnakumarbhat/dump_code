AUTOSAR XML (schema 00049)
package /indieSemi/Uart_ib_bswmd/BswModuleDescriptions
  bsw module description Uart: provided-entrys=Uart_MainFunction
    bsw internal behavior UartBehavior
      bsw schedulable entity Uart_MainFunction: implemented-entry=Uart_MainFunction
      bsw timing event Uart_MainFunctionTimingEvent0: starts-on-event=Uart_MainFunction, period=0.05
  bsw module entry Uart_MainFunction: call-type=SCHEDULED, execution-context=TASK
