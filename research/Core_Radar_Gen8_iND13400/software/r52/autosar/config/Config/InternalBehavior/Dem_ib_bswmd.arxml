AUTOSAR XML (schema 00049)
package /MICROSAR
  bsw implementation Dem_Impl: programming-language=C, sw-version=29.03.00, used-code-generator=DaVinci Configurator Classic, vendor-id=30, ar-release-version=4.01.02
    resource consumption ResourceConsumption
      118 x memory section:
        CODE: sw-addrmethod=CODE
        CODE_ASIL_D: sw-addrmethod=CODE_ASIL_D
        CONFIG_DATA_PREBUILD_ASIL_D_16: alignment=16, sw-addrmethod=CONFIG_DATA_PREBUILD_ASIL_D
        CONFIG_DATA_PREBUILD_ASIL_D_32: alignment=32, sw-addrmethod=CONFIG_DATA_PREBUILD_ASIL_D
        CONFIG_DATA_PREBUILD_ASIL_D_64: alignment=64, sw-addrmethod=CONFIG_DATA_PREBUILD_ASIL_D
        CONFIG_DATA_PREBUILD_ASIL_D_8: alignment=8, sw-addrmethod=CONFIG_DATA_PREBUILD_ASIL_D
        CONFIG_DATA_PREBUILD_ASIL_D_BOOLEAN: alignment=BOOLEAN, sw-addrmethod=CONFIG_DATA_PREBUILD_ASIL_D
        CONFIG_DATA_PREBUILD_ASIL_D_PTR: alignment=PTR, sw-addrmethod=CONFIG_DATA_PREBUILD_ASIL_D
        CONFIG_DATA_PREBUILD_ASIL_D_UNSPECIFIED: alignment=UNSPECIFIED, sw-addrmethod=CONFIG_DATA_PREBUILD_ASIL_D
        CONFIG_DATA_PREBUILD_QM_16: alignment=16, sw-addrmethod=CONFIG_DATA_PREBUILD_QM
        CONFIG_DATA_PREBUILD_QM_32: alignment=32, sw-addrmethod=CONFIG_DATA_PREBUILD_QM
        CONFIG_DATA_PREBUILD_QM_64: alignment=64, sw-addrmethod=CONFIG_DATA_PREBUILD_QM
        CONFIG_DATA_PREBUILD_QM_8: alignment=8, sw-addrmethod=CONFIG_DATA_PREBUILD_QM
        CONFIG_DATA_PREBUILD_QM_BOOLEAN: alignment=BOOLEAN, sw-addrmethod=CONFIG_DATA_PREBUILD_QM
        CONFIG_DATA_PREBUILD_QM_PTR: alignment=PTR, sw-addrmethod=CONFIG_DATA_PREBUILD_QM
        CONFIG_DATA_PREBUILD_QM_UNSPECIFIED: alignment=UNSPECIFIED, sw-addrmethod=CONFIG_DATA_PREBUILD_QM
        CONST_ASIL_D_UNSPECIFIED: alignment=UNSPECIFIED, sw-addrmethod=CONST
        DEM_VAR_CLEARED_INVALID_OSAPPLICATION_ASIL_D_GLOBAL_UNSPECIFIED: alignment=UNSPECIFIED, sw-addrmethod=VAR_CLEARED, symbol=VAR_CLEARED_INVALID_OSAPPLICATION_ASIL_D_GLOBAL_UNSPECIFIED
        VAR_CLEARED_ASIL_D_GLOBAL_16: alignment=16, sw-addrmethod=VAR_CLEARED_ASIL_D
        VAR_CLEARED_ASIL_D_GLOBAL_32: alignment=32, sw-addrmethod=VAR_CLEARED_ASIL_D
        VAR_CLEARED_ASIL_D_GLOBAL_64: alignment=64, sw-addrmethod=VAR_CLEARED_ASIL_D
        VAR_CLEARED_ASIL_D_GLOBAL_8: alignment=8, sw-addrmethod=VAR_CLEARED_ASIL_D
        VAR_CLEARED_ASIL_D_GLOBAL_BOOLEAN: alignment=BOOLEAN, sw-addrmethod=VAR_CLEARED_ASIL_D
        VAR_CLEARED_ASIL_D_GLOBAL_PTR: alignment=PTR, sw-addrmethod=VAR_CLEARED_ASIL_D
        VAR_CLEARED_ASIL_D_GLOBAL_UNSPECIFIED: alignment=UNSPECIFIED, sw-addrmethod=VAR_CLEARED_ASIL_D
        VAR_CLEARED_QM_GLOBAL_16: alignment=16, sw-addrmethod=VAR_CLEARED_QM
        VAR_CLEARED_QM_GLOBAL_32: alignment=32, sw-addrmethod=VAR_CLEARED_QM
        VAR_CLEARED_QM_GLOBAL_64: alignment=64, sw-addrmethod=VAR_CLEARED_QM
        VAR_CLEARED_QM_GLOBAL_8: alignment=8, sw-addrmethod=VAR_CLEARED_QM
        VAR_CLEARED_QM_GLOBAL_BOOLEAN: alignment=BOOLEAN, sw-addrmethod=VAR_CLEARED_QM
        VAR_CLEARED_QM_GLOBAL_PTR: alignment=PTR, sw-addrmethod=VAR_CLEARED_QM
        VAR_CLEARED_QM_GLOBAL_UNSPECIFIED: alignment=UNSPECIFIED, sw-addrmethod=VAR_CLEARED_QM
        VAR_CLEARED_RESTRICTED_ASIL_D_PTR: alignment=PTR, sw-addrmethod=VAR_CLEARED
        VAR_FAST_CLEARED_ASIL_D_GLOBAL_16: alignment=16, sw-addrmethod=VAR_FAST_CLEARED_ASIL_D
        VAR_FAST_CLEARED_ASIL_D_GLOBAL_32: alignment=32, sw-addrmethod=VAR_FAST_CLEARED_ASIL_D
        VAR_FAST_CLEARED_ASIL_D_GLOBAL_64: alignment=64, sw-addrmethod=VAR_FAST_CLEARED_ASIL_D
        VAR_FAST_CLEARED_ASIL_D_GLOBAL_8: alignment=8, sw-addrmethod=VAR_FAST_CLEARED_ASIL_D
        VAR_FAST_CLEARED_ASIL_D_GLOBAL_BOOLEAN: alignment=BOOLEAN, sw-addrmethod=VAR_FAST_CLEARED_ASIL_D
        VAR_FAST_CLEARED_ASIL_D_GLOBAL_PTR: alignment=PTR, sw-addrmethod=VAR_FAST_CLEARED_ASIL_D
        VAR_FAST_CLEARED_ASIL_D_GLOBAL_UNSPECIFIED: alignment=UNSPECIFIED, sw-addrmethod=VAR_FAST_CLEARED_ASIL_D
        VAR_FAST_CLEARED_QM_GLOBAL_16: alignment=16, sw-addrmethod=VAR_FAST_CLEARED_QM
        VAR_FAST_CLEARED_QM_GLOBAL_32: alignment=32, sw-addrmethod=VAR_FAST_CLEARED_QM
        VAR_FAST_CLEARED_QM_GLOBAL_64: alignment=64, sw-addrmethod=VAR_FAST_CLEARED_QM
        VAR_FAST_CLEARED_QM_GLOBAL_8: alignment=8, sw-addrmethod=VAR_FAST_CLEARED_QM
        VAR_FAST_CLEARED_QM_GLOBAL_BOOLEAN: alignment=BOOLEAN, sw-addrmethod=VAR_FAST_CLEARED_QM
        VAR_FAST_CLEARED_QM_GLOBAL_PTR: alignment=PTR, sw-addrmethod=VAR_FAST_CLEARED_QM
        VAR_FAST_CLEARED_QM_GLOBAL_UNSPECIFIED: alignment=UNSPECIFIED, sw-addrmethod=VAR_FAST_CLEARED_QM
        VAR_FAST_INIT_ASIL_D_GLOBAL_16: alignment=16, sw-addrmethod=VAR_FAST_INIT_ASIL_D
        VAR_FAST_INIT_ASIL_D_GLOBAL_32: alignment=32, sw-addrmethod=VAR_FAST_INIT_ASIL_D
        VAR_FAST_INIT_ASIL_D_GLOBAL_64: alignment=64, sw-addrmethod=VAR_FAST_INIT_ASIL_D
        VAR_FAST_INIT_ASIL_D_GLOBAL_8: alignment=8, sw-addrmethod=VAR_FAST_INIT_ASIL_D
        VAR_FAST_INIT_ASIL_D_GLOBAL_BOOLEAN: alignment=BOOLEAN, sw-addrmethod=VAR_FAST_INIT_ASIL_D
        VAR_FAST_INIT_ASIL_D_GLOBAL_PTR: alignment=PTR, sw-addrmethod=VAR_FAST_INIT_ASIL_D
        VAR_FAST_INIT_ASIL_D_GLOBAL_UNSPECIFIED: alignment=UNSPECIFIED, sw-addrmethod=VAR_FAST_INIT_ASIL_D
        VAR_FAST_INIT_QM_GLOBAL_16: alignment=16, sw-addrmethod=VAR_FAST_INIT_QM
        VAR_FAST_INIT_QM_GLOBAL_32: alignment=32, sw-addrmethod=VAR_FAST_INIT_QM
        VAR_FAST_INIT_QM_GLOBAL_64: alignment=64, sw-addrmethod=VAR_FAST_INIT_QM
        VAR_FAST_INIT_QM_GLOBAL_8: alignment=8, sw-addrmethod=VAR_FAST_INIT_QM
        VAR_FAST_INIT_QM_GLOBAL_BOOLEAN: alignment=BOOLEAN, sw-addrmethod=VAR_FAST_INIT_QM
        VAR_FAST_INIT_QM_GLOBAL_PTR: alignment=PTR, sw-addrmethod=VAR_FAST_INIT_QM
        VAR_FAST_INIT_QM_GLOBAL_UNSPECIFIED: alignment=UNSPECIFIED, sw-addrmethod=VAR_FAST_INIT_QM
        VAR_INIT_ASIL_D_GLOBAL_16: alignment=16, sw-addrmethod=VAR_INIT_ASIL_D
        VAR_INIT_ASIL_D_GLOBAL_32: alignment=32, sw-addrmethod=VAR_INIT_ASIL_D
        VAR_INIT_ASIL_D_GLOBAL_64: alignment=64, sw-addrmethod=VAR_INIT_ASIL_D
        VAR_INIT_ASIL_D_GLOBAL_8: alignment=8, sw-addrmethod=VAR_INIT_ASIL_D
        VAR_INIT_ASIL_D_GLOBAL_BOOLEAN: alignment=BOOLEAN, sw-addrmethod=VAR_INIT_ASIL_D
        VAR_INIT_ASIL_D_GLOBAL_PTR: alignment=PTR, sw-addrmethod=VAR_INIT_ASIL_D
        VAR_INIT_ASIL_D_GLOBAL_UNSPECIFIED: alignment=UNSPECIFIED, sw-addrmethod=VAR_INIT_ASIL_D
        VAR_INIT_QM_GLOBAL_16: alignment=16, sw-addrmethod=VAR_INIT_QM
        VAR_INIT_QM_GLOBAL_32: alignment=32, sw-addrmethod=VAR_INIT_QM
        VAR_INIT_QM_GLOBAL_64: alignment=64, sw-addrmethod=VAR_INIT_QM
        VAR_INIT_QM_GLOBAL_8: alignment=8, sw-addrmethod=VAR_INIT_QM
        VAR_INIT_QM_GLOBAL_BOOLEAN: alignment=BOOLEAN, sw-addrmethod=VAR_INIT_QM
        VAR_INIT_QM_GLOBAL_PTR: alignment=PTR, sw-addrmethod=VAR_INIT_QM
        VAR_INIT_QM_GLOBAL_UNSPECIFIED: alignment=UNSPECIFIED, sw-addrmethod=VAR_INIT_QM
        VAR_INIT_RESTRICTED_ASIL_D_8: alignment=8, sw-addrmethod=VAR_INIT
        VAR_SAVED_ZONE_0_ASIL_D_16: alignment=16, sw-addrmethod=VAR_SAVED_ZONE_ASIL_D
        VAR_SAVED_ZONE_0_ASIL_D_32: alignment=32, sw-addrmethod=VAR_SAVED_ZONE_ASIL_D
        VAR_SAVED_ZONE_0_ASIL_D_64: alignment=64, sw-addrmethod=VAR_SAVED_ZONE_ASIL_D
        VAR_SAVED_ZONE_0_ASIL_D_8: alignment=8, sw-addrmethod=VAR_SAVED_ZONE_ASIL_D
        VAR_SAVED_ZONE_0_ASIL_D_BOOLEAN: alignment=BOOLEAN, sw-addrmethod=VAR_SAVED_ZONE_ASIL_D
        VAR_SAVED_ZONE_0_ASIL_D_PTR: alignment=PTR, sw-addrmethod=VAR_SAVED_ZONE_ASIL_D
        VAR_SAVED_ZONE_0_ASIL_D_UNSPECIFIED: alignment=UNSPECIFIED, sw-addrmethod=VAR_SAVED_ZONE_ASIL_D
        VAR_SAVED_ZONE_0_QM_16: alignment=16, sw-addrmethod=VAR_SAVED_ZONE_QM
        VAR_SAVED_ZONE_0_QM_32: alignment=32, sw-addrmethod=VAR_SAVED_ZONE_QM
        VAR_SAVED_ZONE_0_QM_64: alignment=64, sw-addrmethod=VAR_SAVED_ZONE_QM
        VAR_SAVED_ZONE_0_QM_8: alignment=8, sw-addrmethod=VAR_SAVED_ZONE_QM
        VAR_SAVED_ZONE_0_QM_BOOLEAN: alignment=BOOLEAN, sw-addrmethod=VAR_SAVED_ZONE_QM
        VAR_SAVED_ZONE_0_QM_PTR: alignment=PTR, sw-addrmethod=VAR_SAVED_ZONE_QM
        VAR_SAVED_ZONE_0_QM_UNSPECIFIED: alignment=UNSPECIFIED, sw-addrmethod=VAR_SAVED_ZONE_QM
        VAR_SLOW_CLEARED_ASIL_D_GLOBAL_16: alignment=16, sw-addrmethod=VAR_SLOW_CLEARED_ASIL_D
        VAR_SLOW_CLEARED_ASIL_D_GLOBAL_32: alignment=32, sw-addrmethod=VAR_SLOW_CLEARED_ASIL_D
        VAR_SLOW_CLEARED_ASIL_D_GLOBAL_64: alignment=64, sw-addrmethod=VAR_SLOW_CLEARED_ASIL_D
        VAR_SLOW_CLEARED_ASIL_D_GLOBAL_8: alignment=8, sw-addrmethod=VAR_SLOW_CLEARED_ASIL_D
        VAR_SLOW_CLEARED_ASIL_D_GLOBAL_BOOLEAN: alignment=BOOLEAN, sw-addrmethod=VAR_SLOW_CLEARED_ASIL_D
        VAR_SLOW_CLEARED_ASIL_D_GLOBAL_PTR: alignment=PTR, sw-addrmethod=VAR_SLOW_CLEARED_ASIL_D
        VAR_SLOW_CLEARED_ASIL_D_GLOBAL_UNSPECIFIED: alignment=UNSPECIFIED, sw-addrmethod=VAR_SLOW_CLEARED_ASIL_D
        VAR_SLOW_CLEARED_QM_GLOBAL_16: alignment=16, sw-addrmethod=VAR_SLOW_CLEARED_QM
        VAR_SLOW_CLEARED_QM_GLOBAL_32: alignment=32, sw-addrmethod=VAR_SLOW_CLEARED_QM
        VAR_SLOW_CLEARED_QM_GLOBAL_64: alignment=64, sw-addrmethod=VAR_SLOW_CLEARED_QM
        VAR_SLOW_CLEARED_QM_GLOBAL_8: alignment=8, sw-addrmethod=VAR_SLOW_CLEARED_QM
        VAR_SLOW_CLEARED_QM_GLOBAL_BOOLEAN: alignment=BOOLEAN, sw-addrmethod=VAR_SLOW_CLEARED_QM
        VAR_SLOW_CLEARED_QM_GLOBAL_PTR: alignment=PTR, sw-addrmethod=VAR_SLOW_CLEARED_QM
        VAR_SLOW_CLEARED_QM_GLOBAL_UNSPECIFIED: alignment=UNSPECIFIED, sw-addrmethod=VAR_SLOW_CLEARED_QM
        VAR_SLOW_INIT_ASIL_D_GLOBAL_16: alignment=16, sw-addrmethod=VAR_SLOW_INIT_ASIL_D
        VAR_SLOW_INIT_ASIL_D_GLOBAL_32: alignment=32, sw-addrmethod=VAR_SLOW_INIT_ASIL_D
        VAR_SLOW_INIT_ASIL_D_GLOBAL_64: alignment=64, sw-addrmethod=VAR_SLOW_INIT_ASIL_D
        VAR_SLOW_INIT_ASIL_D_GLOBAL_8: alignment=8, sw-addrmethod=VAR_SLOW_INIT_ASIL_D
        VAR_SLOW_INIT_ASIL_D_GLOBAL_BOOLEAN: alignment=BOOLEAN, sw-addrmethod=VAR_SLOW_INIT_ASIL_D
        VAR_SLOW_INIT_ASIL_D_GLOBAL_PTR: alignment=PTR, sw-addrmethod=VAR_SLOW_INIT_ASIL_D
        VAR_SLOW_INIT_ASIL_D_GLOBAL_UNSPECIFIED: alignment=UNSPECIFIED, sw-addrmethod=VAR_SLOW_INIT_ASIL_D
        VAR_SLOW_INIT_QM_GLOBAL_16: alignment=16, sw-addrmethod=VAR_SLOW_INIT_QM
        VAR_SLOW_INIT_QM_GLOBAL_32: alignment=32, sw-addrmethod=VAR_SLOW_INIT_QM
        VAR_SLOW_INIT_QM_GLOBAL_64: alignment=64, sw-addrmethod=VAR_SLOW_INIT_QM
        VAR_SLOW_INIT_QM_GLOBAL_8: alignment=8, sw-addrmethod=VAR_SLOW_INIT_QM
        VAR_SLOW_INIT_QM_GLOBAL_BOOLEAN: alignment=BOOLEAN, sw-addrmethod=VAR_SLOW_INIT_QM
        VAR_SLOW_INIT_QM_GLOBAL_PTR: alignment=PTR, sw-addrmethod=VAR_SLOW_INIT_QM
        VAR_SLOW_INIT_QM_GLOBAL_UNSPECIFIED: alignment=UNSPECIFIED, sw-addrmethod=VAR_SLOW_INIT_QM
package /MICROSAR/Dem_ib_bswmd/BswModuleDescriptions
  bsw module description Dem: provided-entrys=[Dem_MasterMainFunction, Dem_SatelliteMainFunction]
    bsw internal behavior DemBehavior
      5 x exclusive area:
        DEM_EXCLUSIVE_AREA_0  # (DiagMonitor) Ensures consistency and atomicity of event reports
        DEM_EXCLUSIVE_AREA_1  # (StateManager) Ensures consistent status updates when receiving ECU states managed outside the Dem
        DEM_EXCLUSIVE_AREA_2  # (DcmAPI) Ensures consistent status updates when receiving ECU states managed outside the Dem
        DEM_EXCLUSIVE_AREA_3  # (CrossCoreComm) Ensures consistent prestorage when called from multiple clients. Ensures data consistency between satellites and master if the platform does not provide a specific compareAndSwap instruction
        DEM_EXCLUSIVE_AREA_4  # (NonAtomic32bit) Ensures consistency if the platform does not provide an atomic 32bit access
      bsw schedulable entity Dem_MasterMainFunction: can-enter-exclusive-area=[DEM_EXCLUSIVE_AREA_0, DEM_EXCLUSIVE_AREA_1, DEM_EXCLUSIVE_AREA_2, DEM_EXCLUSIVE_AREA_3, DEM_EXCLUSIVE_AREA_4], implemented-entry=Dem_MasterMainFunction
      bsw schedulable entity Dem_SatelliteMainFunction: can-enter-exclusive-area=[DEM_EXCLUSIVE_AREA_0, DEM_EXCLUSIVE_AREA_1, DEM_EXCLUSIVE_AREA_2, DEM_EXCLUSIVE_AREA_3, DEM_EXCLUSIVE_AREA_4], implemented-entry=Dem_SatelliteMainFunction
      bsw timing event Dem_MasterMainFunctionTimingEvent0: starts-on-event=Dem_MasterMainFunction, period=0.01
      bsw timing event Dem_SatelliteMainFunctionTimingEvent0: starts-on-event=Dem_SatelliteMainFunction, period=0.01
  bsw module entry Dem_MasterMainFunction: call-type=SCHEDULED, execution-context=TASK
  bsw module entry Dem_SatelliteMainFunction: call-type=SCHEDULED, execution-context=TASK
