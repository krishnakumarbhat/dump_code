AUTOSAR XML (schema 00053)
package /MICROSAR/NvM_ib_bswmd/BswModuleDescriptions
  bsw module description NvM: provided-entrys=NvM_MainFunction
    bsw internal behavior NvMBehavior
      exclusive area NVM_EXCLUSIVE_AREA_0
      bsw schedulable entity NvM_MainFunction: can-enters=NVM_EXCLUSIVE_AREA_0, can-enter-exclusive-area=NVM_EXCLUSIVE_AREA_0, implemented-entry=NvM_MainFunction
      bsw timing event NvM_MainFunctionTimingEvent0: starts-on-event=NvM_MainFunction, period=0.005
  bsw module entry NvM_MainFunction: call-type=SCHEDULED, execution-context=TASK
