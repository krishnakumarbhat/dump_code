AUTOSAR XML (schema 00049)
package /MICROSAR
  bsw implementation ComXf_Impl: programming-language=C, sw-version=4.40.00, used-code-generator=DaVinci Configurator, vendor-id=30, ar-release-version=4.03.01
    resource consumption ResourceConsumption
      memory section COMXF_CODE_ASIL_B: prefix=COMXF, sw-addrmethod=CODE_ASIL_B, symbol=CODE_ASIL_B
      section name prefix COMXF
package /MICROSAR/ComXf_ib_bswmd/BswModuleDescriptions
  bsw module description ComXf
    bsw internal behavior ComXfBehavior
