AUTOSAR XML (schema 00049)
package /MICROSAR/Fee_30_FlexNor_ib_bswmd/BswModuleDescriptions
  bsw module description Fee: provided-entrys=Fee_30_FlexNor_MainFunction
    bsw internal behavior Fee_30_FlexNorBehavior
      bsw schedulable entity Fee_30_FlexNor_MainFunction: implemented-entry=Fee_30_FlexNor_MainFunction
      bsw timing event Fee_30_FlexNor_MainFunctionTimingEvent0: starts-on-event=Fee_30_FlexNor_MainFunction, period=0.005
  bsw module entry Fee_30_FlexNor_MainFunction: call-type=SCHEDULED, execution-context=TASK
