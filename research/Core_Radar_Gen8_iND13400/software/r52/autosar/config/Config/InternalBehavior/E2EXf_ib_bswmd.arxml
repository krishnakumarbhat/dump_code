AUTOSAR XML (schema 00053)
package /MICROSAR
  bsw implementation E2EXf_Impl: programming-language=C, sw-version=4.40.00, used-code-generator=DaVinci Configurator, vendor-id=30, ar-release-version=4.03.01
    resource consumption ResourceConsumption
      18 x memory section, all with prefix=E2EXF:
        E2EXF_CODE_ASIL_D: sw-addrmethod=CODE_ASIL_D, symbol=CODE_ASIL_D
        E2EXF_CONST_ASIL_D_UNSPECIFIED: sw-addrmethod=CONST_ASIL_D, symbol=CONST_ASIL_D_UNSPECIFIED
        E2EXF_VAR_INIT_OsCore0_ASIL_ASIL_B_LOCAL_UNSPECIFIED: sw-addrmethod=OsCore0_ASIL_VAR_INIT, symbol=VAR_INIT_OsCore0_ASIL_ASIL_B_LOCAL_UNSPECIFIED
        E2EXF_VAR_CLEARED_OsCore0_ASIL_ASIL_B_LOCAL_UNSPECIFIED: sw-addrmethod=OsCore0_ASIL_VAR_CLEARED, symbol=VAR_CLEARED_OsCore0_ASIL_ASIL_B_LOCAL_UNSPECIFIED
        E2EXF_VAR_CLEARED_OsCore0_ASIL_ASIL_B_LOCAL_8: sw-addrmethod=OsCore0_ASIL_VAR_CLEARED, symbol=VAR_CLEARED_OsCore0_ASIL_ASIL_B_LOCAL_8
        E2EXF_VAR_CLEARED_OsCore0_ASIL_NOCACHE_ASIL_B_GLOBAL_8: sw-addrmethod=OsCore0_ASIL_VAR_NOCACHE_CLEARED, symbol=VAR_CLEARED_OsCore0_ASIL_NOCACHE_ASIL_B_GLOBAL_8
        E2EXF_VAR_INIT_OsCore_Qm_QM_LOCAL_UNSPECIFIED: sw-addrmethod=OsCore_Qm_VAR_INIT, symbol=VAR_INIT_OsCore_Qm_QM_LOCAL_UNSPECIFIED
        E2EXF_VAR_CLEARED_OsCore_Qm_QM_LOCAL_UNSPECIFIED: sw-addrmethod=OsCore_Qm_VAR_CLEARED, symbol=VAR_CLEARED_OsCore_Qm_QM_LOCAL_UNSPECIFIED
        E2EXF_VAR_CLEARED_OsCore_Qm_QM_LOCAL_8: sw-addrmethod=OsCore_Qm_VAR_CLEARED, symbol=VAR_CLEARED_OsCore_Qm_QM_LOCAL_8
        E2EXF_VAR_CLEARED_OsCore_Qm_NOCACHE_QM_GLOBAL_8: sw-addrmethod=OsCore_Qm_VAR_NOCACHE_CLEARED, symbol=VAR_CLEARED_OsCore_Qm_NOCACHE_QM_GLOBAL_8
        E2EXF_VAR_INIT_SystemApplication_OsCore0_QM_LOCAL_UNSPECIFIED: sw-addrmethod=SystemApplication_OsCore0_VAR_INIT, symbol=VAR_INIT_SystemApplication_OsCore0_QM_LOCAL_UNSPECIFIED
        E2EXF_VAR_CLEARED_SystemApplication_OsCore0_QM_LOCAL_UNSPECIFIED: sw-addrmethod=SystemApplication_OsCore0_VAR_CLEARED, symbol=VAR_CLEARED_SystemApplication_OsCore0_QM_LOCAL_UNSPECIFIED
        E2EXF_VAR_CLEARED_SystemApplication_OsCore0_QM_LOCAL_8: sw-addrmethod=SystemApplication_OsCore0_VAR_CLEARED, symbol=VAR_CLEARED_SystemApplication_OsCore0_QM_LOCAL_8
        E2EXF_VAR_CLEARED_SystemApplication_OsCore0_NOCACHE_QM_GLOBAL_8: sw-addrmethod=SystemApplication_OsCore0_VAR_NOCACHE_CLEARED, symbol=VAR_CLEARED_SystemApplication_OsCore0_NOCACHE_QM_GLOBAL_8
        E2EXF_VAR_INIT_LOCAL_UNSPECIFIED: sw-addrmethod=OsCore0_ASIL_VAR_INIT, symbol=VAR_INIT_LOCAL_UNSPECIFIED
        E2EXF_VAR_CLEARED_LOCAL_UNSPECIFIED: sw-addrmethod=OsCore0_ASIL_VAR_CLEARED, symbol=VAR_CLEARED_LOCAL_UNSPECIFIED
        E2EXF_VAR_CLEARED_LOCAL_8: sw-addrmethod=OsCore0_ASIL_VAR_CLEARED, symbol=VAR_CLEARED_LOCAL_8
        E2EXF_VAR_CLEARED_NOCACHE_GLOBAL_8: sw-addrmethod=OsCore0_ASIL_VAR_NOCACHE_CLEARED, symbol=VAR_CLEARED_NOCACHE_GLOBAL_8
      section name prefix E2EXF
package /MICROSAR/E2EXf_ib_bswmd/BswModuleDescriptions
  bsw module description E2EXf
    bsw internal behavior E2EXfBehavior
