AUTOSAR XML (schema 00053)
package /indieSemi/Dio_ib_bswmd/BswModuleDescriptions
  bsw module description Dio: provided-entrys=Dio_Virtual
    bsw internal behavior DioBehavior
      exclusive area DIO_EXCLUSIVE_AREA_0
      bsw called entity Dio_Virtual: can-enters=DIO_EXCLUSIVE_AREA_0, implemented-entry=Dio_Virtual
  bsw module entry Dio_Virtual: call-type=REGULAR, execution-context=TASK
