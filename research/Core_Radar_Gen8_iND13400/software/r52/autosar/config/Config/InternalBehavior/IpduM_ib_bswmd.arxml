AUTOSAR XML (schema 00049)
package /MICROSAR
  bsw implementation IpduM_Impl: programming-language=C, sw-version=13.02.01, used-code-generator=DaVinci Configurator, vendor-id=30, ar-release-version=4.03.01
