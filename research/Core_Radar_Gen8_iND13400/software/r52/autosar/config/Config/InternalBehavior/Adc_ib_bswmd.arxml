AUTOSAR XML (schema 00051)
package /indieSemi/Adc_ib_bswmd/BswModuleDescriptions
  bsw module description Adc: provided-entrys=Adc_Virtual
    bsw internal behavior AdcBehavior
      exclusive area ADC_EXCLUSIVE_AREA_0
      bsw called entity Adc_Virtual: can-enters=ADC_EXCLUSIVE_AREA_0, can-enter-exclusive-area=ADC_EXCLUSIVE_AREA_0, implemented-entry=Adc_Virtual
  bsw module entry Adc_Virtual: call-type=REGULAR, execution-context=TASK
