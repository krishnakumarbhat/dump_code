/*@!Encoding:65001*/
includes
{

}

variables
{
  const char FALSE=0;
  const char TRUE=1;
  byte i=0;

  Dword gSocket;
  word Port_Num_Source = 65000;
  word Port_Num_Destination = 5557;
  /*Minumum lenth of Ethernt frame is 60 bytes,
  Therefore XCP frame is of 18 bytes*/
  byte XCP_Req[12]; /*XCP Request Frame(Header + Payload) */
  byte XCP_Expected_Response[12];
  byte RxBuffer[1500];
  ethernetPacket pkt, pkt1;
  dword page;
  byte cal_key[8]={0,0,0,0,0,0,0,0};
  byte cal_seed[8];
  int64 xcp_seed = 0;
  int64 calc_key = 0;
  dword xcp_seed_msb,xcp_seed_lsb =0 ;
  qword value = 0x4e874e874e874e87ll;

  enum seed_key
  {
    UNLOCK_CAL  = 0x01,
    UNLOCK_DAQ  = 0x04,
    UNLOCK_STIM = 0x08,
    UNLOCK_PAGE = 0x10
  };
  byte status = UNLOCK_CAL;

  msTimer myTimer;
}

void ethernet_config()
{
  pkt.udp.init();
  pkt.source=ethGetMacAddressAsNumber("68:05:CA:AC:73:AA");               // Source MAC
    pkt.destination=ethGetMacAddressAsNumber("28:63:BD:23:BB:47");  // Destination MAC
    pkt.ipv4.source.ParseAddress("192.168.1.40");                // Source IP
    pkt.ipv4.destination.ParseAddress("192.168.1.71");           //Destination IP
    pkt.udp.source=65000;                                     //Source port
    pkt.udp.destination=5557;                        //destination port
}

void XCP_Connect()
{

  int i=0;
  int Index;
  long table=0;
  byte XCP_Request[14]={0x00,0x00,0x00,0x00,0xFF,0x00,0x00,0x00,0x00,0x00,0x00,0x00,0x00,0x00};
  pkt.udp.SetData( 0, XCP_Request, elcount(XCP_Request) );
  pkt.CompletePacket();
  output(pkt);
}

void XCP_Get_Seed(byte command)
{
  int i=0;
  int Index;
  long table=0;
  byte XCP_Request[14]={0x00,0x00,0x00,0x00,0xF8,0x00,0x01,0x00,0x00,0x00,0x00,0x00,0x00,0x00};
  XCP_Request[6] = command;
  pkt.udp.SetData( 0, XCP_Request, elcount(XCP_Request) );
  pkt.CompletePacket();
  output(pkt);
}

void calculate_key()
{
  xcp_seed_msb= (((dword)cal_seed[0]<<24) |((dword)cal_seed[1]<<16) | ((dword)cal_seed[2]<<8) | (cal_seed[3]));
	xcp_seed_lsb= (((dword)cal_seed[4]<<24) |((dword)cal_seed[5]<<16) | ((dword)cal_seed[6]<<8) | (cal_seed[7]));

	xcp_seed = (((int64)xcp_seed_msb<<32) |(xcp_seed_lsb));
	calc_key =  (int64)(xcp_seed + value);

  cal_key[7] = calc_key & 0xFF ;
  cal_key[6] = calc_key >> 8 & 0xFF;
  cal_key[5] = calc_key >> 16 & 0xFF;
  cal_key[4] = calc_key >> 24 & 0xFF;
  cal_key[3] = calc_key >> 32 & 0xFF;
  cal_key[2] = calc_key >> 40 & 0xFF;
  cal_key[1] = calc_key >> 48 & 0xFF;
  cal_key[0] = calc_key >> 56 & 0xFF ;

  XCP_Unlock();
}

void XCP_Unlock()
{
  byte XCP_Unlock_Request[14]={0x08,0x00,0x00,0x00,0xF7,0x08,0x00,0x00,0x00,0x00,0x00,0x00,0x00,0x00};
  XCP_Unlock_Request[6] = cal_key[7];
  XCP_Unlock_Request[7] = cal_key[6];
  XCP_Unlock_Request[8] = cal_key[5];
  XCP_Unlock_Request[9] = cal_key[4];
  XCP_Unlock_Request[10] = cal_key[3];
  XCP_Unlock_Request[11] = cal_key[2];
  XCP_Unlock_Request[12] = cal_key[1];
  XCP_Unlock_Request[13] = cal_key[0];
  pkt.udp.SetData( 0, XCP_Unlock_Request, elcount(XCP_Unlock_Request) );
  pkt.CompletePacket();
  output(pkt);
}


on start
{
  page =1;
  writeClear(page);
  writeTextColor(page,255,0,0);
  writeTextColor(page,1,1,1);
  writeLineEx(page,0,"=================================================");
  writeLineEx(page,0,"         Seed and Key Unlock Script              ");
  writeLineEx(page,0,"=================================================");
  writeLineEx(page,0,"               GEN8 Hardware                     ");
  writeLineEx(page,0,"=================================================");
  write("\n");
  ethernet_config();

  writeLineEx(page,0,"=================================================");
  writeLineEx(page,0,"    Press 'c' to send Connect command            ");
  writeLineEx(page,0,"=================================================");
  writeLineEx(page,0,"    Press 'u' to complete Seed and Key Unlock    ");
  writeLineEx(page,0,"=================================================");
}

on key 'c'
{
    XCP_Connect();
    writeLineEx(page,0,"    XCP Connect command executed    ");
}

void delay(byte sec)
{
  write(".");
  setTimer(myTimer,50*sec);
}

on key 'u'
{
    writeLineEx(page,0,"    Unlock Process started    ");
  status = UNLOCK_CAL;
    delay(1);

}

on sysvar_update XCP_On_Eth::Unlock_ECU
{
    if(@this == 1)
  {
    status = UNLOCK_CAL;
    writeLineEx(page,0,"    Unlock Process started    ");
    delay(1);
  }

}

on timer myTimer
{

  switch (status)
  {
    case UNLOCK_CAL:
    XCP_Get_Seed(UNLOCK_CAL);
    status = UNLOCK_DAQ;
    delay(1);
    break;
    case UNLOCK_DAQ:
    XCP_Get_Seed(UNLOCK_DAQ);
    status = UNLOCK_STIM;
    delay(1);
    break;
    case UNLOCK_STIM:
    XCP_Get_Seed(UNLOCK_STIM);
    status = UNLOCK_PAGE;
    delay(1);
    break;
    case UNLOCK_PAGE:
    XCP_Get_Seed(UNLOCK_PAGE);
    status = 0;
    writeLineEx(page,0,"    Unlocked all Resources!    ");
    break;
  }

}

on ethernetPacket*
{
  word i=0,j=0,k=0;
  byte Arra[1500];
  word Ethernet_Type_XCP = 0x0800;
  word XCP_Response_Received_Length = 0;
  byte positive = 0;
  dword delay = 2000000;


  if( this.type == Ethernet_Type_XCP && this.byte(20)== 0X15 && this.byte(21)== 0XB5 && this.byte(22)== 0XFD && this.byte(23)== 0XE8 && (this.dir == rx) && this.byte(32)== 0XFF && this.udp.byteLength ==14)
  {
    cal_seed[0] = this.byte(34);
    cal_seed[1] = this.byte(35);
    cal_seed[2] = this.byte(36);
    cal_seed[3] = this.byte(37);
    cal_seed[4] = this.byte(38);
    cal_seed[5] = this.byte(39);
    cal_seed[6] = this.byte(40);
    cal_seed[7] = this.byte(41);
    calculate_key();

  }
  else if(this.type == Ethernet_Type_XCP && this.byte(20)== 0X15 && this.byte(21)== 0XB5 && this.byte(22)== 0XFD && this.byte(23)== 0XE8 && (this.dir == rx) && this.byte(32)== 0XFE && this.udp.byteLength ==14)
  {
    writeLineEx(page,0,"    Got Negative Response!    ");
  }

}
