TRANSlation.RESet
TRANSlation.Create 0x00000000--0x0000FFFF APB:0x90000000
TRANSlation.Create 0x00010000--0x7FFDFFFF A:0x00100000
TRANSlation.Create 0x7FFE0000--0x7FFEFFFF APB:0x90100000
TRANSlation.Create 0x7FFF0000--0x7FFFFFFF APB:0x90200000
TRANSlation.Create 0x80000000--0xFFFFFFFF A:0x80000000
TRANSlation.ON

SYStem.MemAccess APB

MAP.BUS32 0x80000000--0x803fffff

SYStem.Option.TRST OFF
SYStem.Option.EnReset ON
SYStem.Option.DUALPORT ON

ENDDO
