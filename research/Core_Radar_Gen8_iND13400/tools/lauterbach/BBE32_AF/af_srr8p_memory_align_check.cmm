// Usage Notes:
// Check anglefinding memory variables to ensure they are aligned on 32-byte boundary
// Output is written to the B::AREA.View log

// switch to decimal to avoid confusion
RADIX.Decimal
LOCAL &failurecount &optionalcount &missingcount &missingoptcount

&failurecount=0
&optionalcount=0
&missingcount=0
&missingoptcount=0

// High Level Vars
GOSUB test_align_option "AF_Mem" "*AF_Mem_ptr"
GOSUB test_align_option "AF_Mem_Pool" "*AF_Mem_Pool_ptr"
GOSUB test_align_option "RDD_Det" "*RDD_Det_ptr"
GOSUB test_align_option "AF_Data" "*AF_Data_ptr"
GOSUB test_align_option "Angle_Data" "*Angle_Data_ptr"
GOSUB test_align_option "Angle_Data_S4" "*Angle_Data_S4_ptr"
GOSUB test_align_option "Angle_Data_S5" "*Angle_Data_S5_ptr"

// Local Stage Datastructures
GOSUB test_align_option "RDD_Angle_Data_S1" "*RDD_Angle_Data_S1_ptr"
GOSUB test_align_option "RDD_Angle_Data_S4" "*RDD_Angle_Data_S4_ptr"
GOSUB test_align_option "RDD_Angle_Data_S5" "*RDD_Angle_Data_S5_ptr"

// Cals
GOSUB test_align "AF_SSC" 1
GOSUB test_align "AF_USC"
GOSUB test_align "af_gainpatfine"
GOSUB test_align "af_thold_sensitivity"
GOSUB test_align "af_fft_w"
GOSUB test_align "af_fft_rev"
//GOSUB test_align "*af_tx_cal_matrix[0]"
//GOSUB test_align "*af_tx_cal_matrix[1]"
//GOSUB test_align "*af_rx_cal_matrix[0]"
//GOSUB test_align "*af_rx_cal_matrix[1]"
//GOSUB test_align "*af_cal_matrix[0]"
//GOSUB test_align "*af_cal_matrix[1]"
GOSUB test_align "af_ctx0"
GOSUB test_align "af_ctx1"
GOSUB test_align "af_crx0"
GOSUB test_align "af_crx1"
GOSUB test_align "af_cal0_c1"
GOSUB test_align "af_cal1_c1"

IF &failurecount>0
(
    PRINT %ERROR &failurecount " failures were detected (" &missingcount " missing)"
)
ELSE
(
    PRINT %COLOR.GREEN "No failures were detected"
)
IF &optionalcount>0
(
    PRINT %ERROR &optionalcount " warnings were detected (" &missingoptcount " missing)"
)
ELSE
(
    PRINT %COLOR.GREEN "No warnings were detected"
)
ENDDO

// Subroutine test_align
// inputs
//  1. string: variable name to test
//  2. int: severity for the test - 1 indicates the test is optional
// return value: none
test_align:
    ENTRY &varname &optional
    PRIVATE &checkaddr &failincr

    IF "&optional"==""
        &optional=0

    IF Var.EXIST(&varname)
    (
        &checkaddr=Var.ADDRESS(&varname)
        &checkaddr=ADDRESS.OFFSET(&checkaddr)
        IF (&checkaddr!=0)&&(&checkaddr&0x1F)==0
        (
            PRINT &varname " is aligned"
        )
        ELSE
        (
            IF &optional==0
            (
                PRINT %ERROR &varname " is unaligned: " &checkaddr
                &failurecount=&failurecount+1
            )
            ELSE
            (
                PRINT %WARNING &varname " is unaligned: " &checkaddr
                &optionalcount=&optionalcount+1
            )
        )
    )
    ELSE
    (
        IF &optional==0
        (
            PRINT %ERROR &varname " does not exist"
            &failurecount=&failurecount+1
            &missingcount=&missingcount+1
        )
        ELSE
        (
            PRINT &WARNING " does not exist"
            &optionalcount=&optionalcount+1
            &missingoptcount=&missingoptcount+1
        )
    )
RETURN

// Subroutine test_align_option
//  Check that at least 1 of the 2 parameters exists and any that do exist are aligned
// inputs
//  1. string: variable1 name to test
//  2. string: variable2 name to test
// return value: none
test_align_option:
    ENTRY &varname1 &varname2
    PRIVATE &checkaddr &failincr &atleastoneexists

    &atleastoneexists=0

    IF Var.EXIST(&varname1)
    (
        &atleastoneexists=1
        &checkaddr=Var.ADDRESS(&varname1)
        &checkaddr=ADDRESS.OFFSET(&checkaddr)
        IF (&checkaddr!=0)&&(&checkaddr&0x1F)==0
        (
            PRINT &varname1 " is aligned"
        )
        ELSE
        (
            PRINT %ERROR &varname1 " is unaligned: " &checkaddr
            &failurecount=&failurecount+1
        )
    )
    IF Var.EXIST(&varname2)
    (
        &atleastoneexists=1
        &checkaddr=Var.ADDRESS(&varname2)
        &checkaddr=ADDRESS.OFFSET(&checkaddr)
        IF (&checkaddr!=0)&&(&checkaddr&0x1F)==0
        (
            PRINT &varname2 " is aligned"
        )
        ELSE
        (
            PRINT %ERROR &varname2 " is unaligned: " &checkaddr
            &failurecount=&failurecount+1
        )
    )

    IF &atleastoneexists==0
    (
        PRINT %ERROR "Neither " &varname1 " or " &varname2 "exist"
        &failurecount=&failurecount+1
        &missingcount=&missingcount+1
    )
RETURN
