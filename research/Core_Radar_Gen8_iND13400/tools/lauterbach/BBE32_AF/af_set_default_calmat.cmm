// Usage Notes:
// Update the AF cal matrices to be default (flat) values.
// Newer USCs set these to .001 by default to enable vehicle team to quickly identify
// uncalibrated units. This script should restore flat values for bench testing.

// switch to decimal to avoid confusion
RADIX.Decimal

// set default values for the flat calibration response
LOCAL &eye_real &eye_imag
&eye_real=1.0
&eye_imag=0.1

// call the function for each calmat structure
GOSUB eye USC_Cal_Data.USC_AF_Cal.k_calmat1_ctx 4 &eye_real &eye_imag
GOSUB eye USC_Cal_Data.USC_AF_Cal.k_calmat1_crx 8 &eye_real &eye_imag
GOSUB eye USC_Cal_Data.USC_AF_Cal.k_calmat1_c1 32 &eye_real &eye_imag
GOSUB eye USC_Cal_Data.USC_AF_Cal.k_calmat2_ctx 4 &eye_real &eye_imag
GOSUB eye USC_Cal_Data.USC_AF_Cal.k_calmat2_crx 8 &eye_real &eye_imag
GOSUB eye USC_Cal_Data.USC_AF_Cal.k_calmat2_c1 32 &eye_real &eye_imag

ENDDO

// Subroutine eye
// Populate the memory with an identity matrix (assumes a square matrix taking complex values)
// input parameters
//  1. var: variable name to write to
//  2. int: array dimension
//  3. float: real part for the value on the diagonal
//  4. float: imaginary part for the value on the diagonal
// return value: none
eye:
    ENTRY &varname &count &realval &imagval
    PRIVATE &i &j

    &i=0
    WHILE &i<&count
    (
        &j=0
        WHILE &j<&count
        (
            IF &j==&i
            (
                Var.set &varname[&i][&j*2+0]=&realval
                Var.set &varname[&i][&j*2+1]=&imagval
            )
            ELSE
            (
                Var.set &varname[&i][&j*2+0]=0.0
                Var.set &varname[&i][&j*2+1]=0.0
            )
            &j=&j+1
        )
        &i=&i+1
    )

RETURN
