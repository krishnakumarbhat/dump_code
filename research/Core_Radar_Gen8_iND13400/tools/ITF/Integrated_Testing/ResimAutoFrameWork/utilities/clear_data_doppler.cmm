// Script is used to debug issues with writing to the output circular buffers for the RA outputs in doppler

Intercom BBE32 Var.AddWatch %OPEN.1 *dp_rdop_avg_nci_data
Intercom BBE32 Var.AddWatch %OPEN.1 *dp_rdop_avg_ci1_data
Intercom BBE32 Var.AddWatch %OPEN.1 *dp_rdop_avg_ci2_data
Intercom BBE32 Var.AddWatch %OPEN.2 *dp_dfft_bv_output_buffer

Var.set %e (*dp_rdop_avg_nci_data)[0][0..1023] = 0
Var.set %e (*dp_rdop_avg_nci_data)[1][0..1023] = 0
Var.set %e (*dp_rdop_avg_nci_data)[2][0..1023] = 0
Var.set %e (*dp_rdop_avg_nci_data)[3][0..1023] = 0

Var.set %e (*dp_rdop_avg_ci1_data)[0][0..1023] = 0
Var.set %e (*dp_rdop_avg_ci1_data)[1][0..1023] = 0
Var.set %e (*dp_rdop_avg_ci1_data)[2][0..1023] = 0
Var.set %e (*dp_rdop_avg_ci1_data)[3][0..1023] = 0

Var.set %e (*dp_rdop_avg_ci2_data)[0][0..1023] = 0
Var.set %e (*dp_rdop_avg_ci2_data)[1][0..1023] = 0
Var.set %e (*dp_rdop_avg_ci2_data)[2][0..1023] = 0
Var.set %e (*dp_rdop_avg_ci2_data)[3][0..1023] = 0

Var.set %e (*dp_dfft_bv_output_buffer)[0][0][0..1023] = 0
Var.set %e (*dp_dfft_bv_output_buffer)[0][1][0..1023] = 0
Var.set %e (*dp_dfft_bv_output_buffer)[0][2][0..1023] = 0
Var.set %e (*dp_dfft_bv_output_buffer)[0][3][0..1023] = 0

Var.set %e (*dp_dfft_bv_output_buffer)[1][0][0..1023] = 0
Var.set %e (*dp_dfft_bv_output_buffer)[1][1][0..1023] = 0
Var.set %e (*dp_dfft_bv_output_buffer)[1][2][0..1023] = 0
Var.set %e (*dp_dfft_bv_output_buffer)[1][3][0..1023] = 0

Var.set %e (*dp_dfft_bv_output_buffer)[2][0][0..1023] = 0
Var.set %e (*dp_dfft_bv_output_buffer)[2][1][0..1023] = 0
Var.set %e (*dp_dfft_bv_output_buffer)[2][2][0..1023] = 0
Var.set %e (*dp_dfft_bv_output_buffer)[2][3][0..1023] = 0
